[part 2 of 2: package /MICROSAR/Dem_swc/ComponentTypes]
AUTOSAR XML (schema 4-3-0)
package /MICROSAR/Dem_swc/ComponentTypes  (continued)
  service sw component type DemSatellite_0: category=SERVICE_COMPONENT  (continued)
    behavior DemSatellite_0InternalBehavior: handle-termination-and-restart=NO-SUPPORT, included-data-type-set=data-type=[Dem_EventIdType, Dem_RatioIdType, Dem_EventStatusType, Dem_UdsStatusByteType, Dem_DTCFormatType, Dem_InitMonitorReasonType, Dem_OperationCycleStateType, Dem_DTCStatusMaskType, Dem_IndicatorStatusType, Dem_MaxDataValueType, Dem_DTCKindType, Dem_DTCGroupType, Dem_IumprDenomCondIdType, Dem_IumprDenomCondStatusType, Dem_DebounceResetStatusType, Dem_DebouncingStateType, Dem_IumprReadinessGroupType, Dem_DTRControlType, Dem_DTCSeverityType, Dem_MonitorStatusType]  (continued)
      1419 x operation invoked event:  (continued)
        OpEventGetFaultDetectionCounter_GetFaultDetectionCounter_Event_CansmEBusBodyCanOff: start-on-event=DemSatellite_0InternalBehavior/GetFaultDetectionCounter, operation=Event_CansmEBusBodyCanOff.GetFaultDetectionCounter
        OpEventGetFaultDetectionCounter_GetFaultDetectionCounter_EvtInfo_CbsReplacementValue: start-on-event=DemSatellite_0InternalBehavior/GetFaultDetectionCounter, operation=EvtInfo_CbsReplacementValue.GetFaultDetectionCounter
        OpEventGetFaultDetectionCounter_GetFaultDetectionCounter_Event_CbsReplacementValue: start-on-event=DemSatellite_0InternalBehavior/GetFaultDetectionCounter, operation=Event_CbsReplacementValue.GetFaultDetectionCounter
        OpEventGetFaultDetectionCounter_GetFaultDetectionCounter_EvtInfo_CansmEBusLeCanOff: start-on-event=DemSatellite_0InternalBehavior/GetFaultDetectionCounter, operation=EvtInfo_CansmEBusLeCanOff.GetFaultDetectionCounter
        OpEventGetFaultDetectionCounter_GetFaultDetectionCounter_Event_CansmEBusLeCanOff: start-on-event=DemSatellite_0InternalBehavior/GetFaultDetectionCounter, operation=Event_CansmEBusLeCanOff.GetFaultDetectionCounter
        OpEventGetFaultDetectionCounter_GetFaultDetectionCounter_EvtInfo_CansmEBusZsgCanOff: start-on-event=DemSatellite_0InternalBehavior/GetFaultDetectionCounter, operation=EvtInfo_CansmEBusZsgCanOff.GetFaultDetectionCounter
        OpEventGetFaultDetectionCounter_GetFaultDetectionCounter_Event_CansmEBusZsgCanOff: start-on-event=DemSatellite_0InternalBehavior/GetFaultDetectionCounter, operation=Event_CansmEBusZsgCanOff.GetFaultDetectionCounter
        OpEventGetFaultDetectionCounter_GetFaultDetectionCounter_EvtInfo_CodingEventWrongVehicle: start-on-event=DemSatellite_0InternalBehavior/GetFaultDetectionCounter, operation=EvtInfo_CodingEventWrongVehicle.GetFaultDetectionCounter
        OpEventGetFaultDetectionCounter_GetFaultDetectionCounter_Event_CodingEventWrongVehicle: start-on-event=DemSatellite_0InternalBehavior/GetFaultDetectionCounter, operation=Event_CodingEventWrongVehicle.GetFaultDetectionCounter
        OpEventGetFaultDetectionCounter_GetFaultDetectionCounter_EvtInfo_FrsmEClusterStartup: start-on-event=DemSatellite_0InternalBehavior/GetFaultDetectionCounter, operation=EvtInfo_FrsmEClusterStartup.GetFaultDetectionCounter
        OpEventGetFaultDetectionCounter_GetFaultDetectionCounter_Event_FrsmEClusterStartup: start-on-event=DemSatellite_0InternalBehavior/GetFaultDetectionCounter, operation=Event_FrsmEClusterStartup.GetFaultDetectionCounter
        OpEventGetFaultDetectionCounter_GetFaultDetectionCounter_EvtInfo_CansmEBusACanOff: start-on-event=DemSatellite_0InternalBehavior/GetFaultDetectionCounter, operation=EvtInfo_CansmEBusACanOff.GetFaultDetectionCounter
        OpEventGetFaultDetectionCounter_GetFaultDetectionCounter_Event_CansmEBusACanOff: start-on-event=DemSatellite_0InternalBehavior/GetFaultDetectionCounter, operation=Event_CansmEBusACanOff.GetFaultDetectionCounter
        OpEventGetFaultDetectionCounter_GetFaultDetectionCounter_EvtInfo_CansmEBusKCanOff: start-on-event=DemSatellite_0InternalBehavior/GetFaultDetectionCounter, operation=EvtInfo_CansmEBusKCanOff.GetFaultDetectionCounter
        OpEventGetFaultDetectionCounter_GetFaultDetectionCounter_Event_CansmEBusKCanOff: start-on-event=DemSatellite_0InternalBehavior/GetFaultDetectionCounter, operation=Event_CansmEBusKCanOff.GetFaultDetectionCounter
        OpEventGetFaultDetectionCounter_GetFaultDetectionCounter_EvtInfo_CantrcvEBusKCanError: start-on-event=DemSatellite_0InternalBehavior/GetFaultDetectionCounter, operation=EvtInfo_CantrcvEBusKCanError.GetFaultDetectionCounter
        OpEventGetFaultDetectionCounter_GetFaultDetectionCounter_Event_CantrcvEBusKCanError: start-on-event=DemSatellite_0InternalBehavior/GetFaultDetectionCounter, operation=Event_CantrcvEBusKCanError.GetFaultDetectionCounter
        OpEventGetFaultDetectionCounter_GetFaultDetectionCounter_EvtInfo_FrtrcvEFrBuserrorTrcv0: start-on-event=DemSatellite_0InternalBehavior/GetFaultDetectionCounter, operation=EvtInfo_FrtrcvEFrBuserrorTrcv0.GetFaultDetectionCounter
        OpEventGetFaultDetectionCounter_GetFaultDetectionCounter_Event_FrtrcvEFrBuserrorTrcv0: start-on-event=DemSatellite_0InternalBehavior/GetFaultDetectionCounter, operation=Event_FrtrcvEFrBuserrorTrcv0.GetFaultDetectionCounter
        OpEventGetFaultDetectionCounter_GetFaultDetectionCounter_EvtInfo_FrtrcvEFrErrnTrcv7: start-on-event=DemSatellite_0InternalBehavior/GetFaultDetectionCounter, operation=EvtInfo_FrtrcvEFrErrnTrcv7.GetFaultDetectionCounter
        OpEventGetFaultDetectionCounter_GetFaultDetectionCounter_Event_FrtrcvEFrErrnTrcv7: start-on-event=DemSatellite_0InternalBehavior/GetFaultDetectionCounter, operation=Event_FrtrcvEFrErrnTrcv7.GetFaultDetectionCounter
        OpEventGetFaultDetectionCounter_GetFaultDetectionCounter_EvtInfo_CansmEBusFaCanOff: start-on-event=DemSatellite_0InternalBehavior/GetFaultDetectionCounter, operation=EvtInfo_CansmEBusFaCanOff.GetFaultDetectionCounter
        OpEventGetFaultDetectionCounter_GetFaultDetectionCounter_Event_CansmEBusFaCanOff: start-on-event=DemSatellite_0InternalBehavior/GetFaultDetectionCounter, operation=Event_CansmEBusFaCanOff.GetFaultDetectionCounter
        OpEventGetFaultDetectionCounter_GetFaultDetectionCounter_EvtInfo_CantrcvEBusB2CanError: start-on-event=DemSatellite_0InternalBehavior/GetFaultDetectionCounter, operation=EvtInfo_CantrcvEBusB2CanError.GetFaultDetectionCounter
        OpEventGetFaultDetectionCounter_GetFaultDetectionCounter_Event_CantrcvEBusB2CanError: start-on-event=DemSatellite_0InternalBehavior/GetFaultDetectionCounter, operation=Event_CantrcvEBusB2CanError.GetFaultDetectionCounter
        OpEventGetFaultDetectionCounter_GetFaultDetectionCounter_EvtInfo_DtcCd0605: start-on-event=DemSatellite_0InternalBehavior/GetFaultDetectionCounter, operation=EvtInfo_DtcCd0605.GetFaultDetectionCounter
        OpEventGetFaultDetectionCounter_GetFaultDetectionCounter_Event_DtcCd0605: start-on-event=DemSatellite_0InternalBehavior/GetFaultDetectionCounter, operation=Event_DtcCd0605.GetFaultDetectionCounter
        OpEventGetFaultDetectionCounter_GetFaultDetectionCounter_EvtInfo_DtcCd0606: start-on-event=DemSatellite_0InternalBehavior/GetFaultDetectionCounter, operation=EvtInfo_DtcCd0606.GetFaultDetectionCounter
        OpEventGetFaultDetectionCounter_GetFaultDetectionCounter_Event_DtcCd0606: start-on-event=DemSatellite_0InternalBehavior/GetFaultDetectionCounter, operation=Event_DtcCd0606.GetFaultDetectionCounter
        OpEventGetFaultDetectionCounter_GetFaultDetectionCounter_EvtInfo_DtcCd0607: start-on-event=DemSatellite_0InternalBehavior/GetFaultDetectionCounter, operation=EvtInfo_DtcCd0607.GetFaultDetectionCounter
        OpEventGetFaultDetectionCounter_GetFaultDetectionCounter_Event_DtcCd0607: start-on-event=DemSatellite_0InternalBehavior/GetFaultDetectionCounter, operation=Event_DtcCd0607.GetFaultDetectionCounter
        OpEventGetFaultDetectionCounter_GetFaultDetectionCounter_EvtInfo_PiaEIoError: start-on-event=DemSatellite_0InternalBehavior/GetFaultDetectionCounter, operation=EvtInfo_PiaEIoError.GetFaultDetectionCounter
        OpEventGetFaultDetectionCounter_GetFaultDetectionCounter_Event_PiaEIoError: start-on-event=DemSatellite_0InternalBehavior/GetFaultDetectionCounter, operation=Event_PiaEIoError.GetFaultDetectionCounter
        OpEventGetFaultDetectionCounter_GetFaultDetectionCounter_EvtInfo_DtcCd0601: start-on-event=DemSatellite_0InternalBehavior/GetFaultDetectionCounter, operation=EvtInfo_DtcCd0601.GetFaultDetectionCounter
        OpEventGetFaultDetectionCounter_GetFaultDetectionCounter_Event_DtcCd0601: start-on-event=DemSatellite_0InternalBehavior/GetFaultDetectionCounter, operation=Event_DtcCd0601.GetFaultDetectionCounter
        OpEventGetFaultDetectionCounter_GetFaultDetectionCounter_EvtInfo_SwtExternalCheckFailure: start-on-event=DemSatellite_0InternalBehavior/GetFaultDetectionCounter, operation=EvtInfo_SwtExternalCheckFailure.GetFaultDetectionCounter
        OpEventGetFaultDetectionCounter_GetFaultDetectionCounter_Event_SwtExternalCheckFailure: start-on-event=DemSatellite_0InternalBehavior/GetFaultDetectionCounter, operation=Event_SwtExternalCheckFailure.GetFaultDetectionCounter
        OpEventGetFaultDetectionCounter_GetFaultDetectionCounter_EvtInfo_CantrcvEBusBodyCanError: start-on-event=DemSatellite_0InternalBehavior/GetFaultDetectionCounter, operation=EvtInfo_CantrcvEBusBodyCanError.GetFaultDetectionCounter
        OpEventGetFaultDetectionCounter_GetFaultDetectionCounter_Event_CantrcvEBusBodyCanError: start-on-event=DemSatellite_0InternalBehavior/GetFaultDetectionCounter, operation=Event_CantrcvEBusBodyCanError.GetFaultDetectionCounter
        OpEventGetFaultDetectionCounter_GetFaultDetectionCounter_EvtInfo_CantrcvEBusIukError: start-on-event=DemSatellite_0InternalBehavior/GetFaultDetectionCounter, operation=EvtInfo_CantrcvEBusIukError.GetFaultDetectionCounter
        OpEventGetFaultDetectionCounter_GetFaultDetectionCounter_Event_CantrcvEBusIukError: start-on-event=DemSatellite_0InternalBehavior/GetFaultDetectionCounter, operation=Event_CantrcvEBusIukError.GetFaultDetectionCounter
        OpEventGetFaultDetectionCounter_GetFaultDetectionCounter_EvtInfo_SwtInternalCheckFailure: start-on-event=DemSatellite_0InternalBehavior/GetFaultDetectionCounter, operation=EvtInfo_SwtInternalCheckFailure.GetFaultDetectionCounter
        OpEventGetFaultDetectionCounter_GetFaultDetectionCounter_Event_SwtInternalCheckFailure: start-on-event=DemSatellite_0InternalBehavior/GetFaultDetectionCounter, operation=Event_SwtInternalCheckFailure.GetFaultDetectionCounter
        OpEventGetFaultDetectionCounter_GetFaultDetectionCounter_EvtInfo_DmTestAppl: start-on-event=DemSatellite_0InternalBehavior/GetFaultDetectionCounter, operation=EvtInfo_DmTestAppl.GetFaultDetectionCounter
        OpEventGetFaultDetectionCounter_GetFaultDetectionCounter_Event_DmTestAppl: start-on-event=DemSatellite_0InternalBehavior/GetFaultDetectionCounter, operation=Event_DmTestAppl.GetFaultDetectionCounter
        OpEventGetFaultDetectionCounter_GetFaultDetectionCounter_EvtInfo_Dtc000032: start-on-event=DemSatellite_0InternalBehavior/GetFaultDetectionCounter, operation=EvtInfo_Dtc000032.GetFaultDetectionCounter
        OpEventGetFaultDetectionCounter_GetFaultDetectionCounter_Event_Dtc000032: start-on-event=DemSatellite_0InternalBehavior/GetFaultDetectionCounter, operation=Event_Dtc000032.GetFaultDetectionCounter
        OpEventGetFaultDetectionCounter_GetFaultDetectionCounter_EvtInfo_Dtc000031: start-on-event=DemSatellite_0InternalBehavior/GetFaultDetectionCounter, operation=EvtInfo_Dtc000031.GetFaultDetectionCounter
        OpEventGetFaultDetectionCounter_GetFaultDetectionCounter_Event_Dtc000031: start-on-event=DemSatellite_0InternalBehavior/GetFaultDetectionCounter, operation=Event_Dtc000031.GetFaultDetectionCounter
        OpEventGetFaultDetectionCounter_GetFaultDetectionCounter_EvtInfo_FrsmEClusterSyncLoss: start-on-event=DemSatellite_0InternalBehavior/GetFaultDetectionCounter, operation=EvtInfo_FrsmEClusterSyncLoss.GetFaultDetectionCounter
        OpEventGetFaultDetectionCounter_GetFaultDetectionCounter_Event_FrsmEClusterSyncLoss: start-on-event=DemSatellite_0InternalBehavior/GetFaultDetectionCounter, operation=Event_FrsmEClusterSyncLoss.GetFaultDetectionCounter
        OpEventGetFaultDetectionCounter_GetFaultDetectionCounter_EvtInfo_Dtc000030: start-on-event=DemSatellite_0InternalBehavior/GetFaultDetectionCounter, operation=EvtInfo_Dtc000030.GetFaultDetectionCounter
        OpEventGetFaultDetectionCounter_GetFaultDetectionCounter_Event_Dtc000030: start-on-event=DemSatellite_0InternalBehavior/GetFaultDetectionCounter, operation=Event_Dtc000030.GetFaultDetectionCounter
        OpEventGetFaultDetectionCounter_GetFaultDetectionCounter_EvtInfo_Dtc000034: start-on-event=DemSatellite_0InternalBehavior/GetFaultDetectionCounter, operation=EvtInfo_Dtc000034.GetFaultDetectionCounter
        OpEventGetFaultDetectionCounter_GetFaultDetectionCounter_Event_Dtc000034: start-on-event=DemSatellite_0InternalBehavior/GetFaultDetectionCounter, operation=Event_Dtc000034.GetFaultDetectionCounter
        OpEventGetFaultDetectionCounter_GetFaultDetectionCounter_EvtInfo_Dtc000033: start-on-event=DemSatellite_0InternalBehavior/GetFaultDetectionCounter, operation=EvtInfo_Dtc000033.GetFaultDetectionCounter
        OpEventGetFaultDetectionCounter_GetFaultDetectionCounter_Event_Dtc000033: start-on-event=DemSatellite_0InternalBehavior/GetFaultDetectionCounter, operation=Event_Dtc000033.GetFaultDetectionCounter
        OpEventGetFaultDetectionCounter_GetFaultDetectionCounter_EvtInfo_Undervoltage: start-on-event=DemSatellite_0InternalBehavior/GetFaultDetectionCounter, operation=EvtInfo_Undervoltage.GetFaultDetectionCounter
        OpEventGetFaultDetectionCounter_GetFaultDetectionCounter_Event_Undervoltage: start-on-event=DemSatellite_0InternalBehavior/GetFaultDetectionCounter, operation=Event_Undervoltage.GetFaultDetectionCounter
        OpEventGetFaultDetectionCounter_GetFaultDetectionCounter_EvtInfo_CodingEventTransactionFailed: start-on-event=DemSatellite_0InternalBehavior/GetFaultDetectionCounter, operation=EvtInfo_CodingEventTransactionFailed.GetFaultDetectionCounter
        OpEventGetFaultDetectionCounter_GetFaultDetectionCounter_Event_CodingEventTransactionFailed: start-on-event=DemSatellite_0InternalBehavior/GetFaultDetectionCounter, operation=Event_CodingEventTransactionFailed.GetFaultDetectionCounter
        OpEventGetFaultDetectionCounter_GetFaultDetectionCounter_EvtInfo_FrifENitChA: start-on-event=DemSatellite_0InternalBehavior/GetFaultDetectionCounter, operation=EvtInfo_FrifENitChA.GetFaultDetectionCounter
        OpEventGetFaultDetectionCounter_GetFaultDetectionCounter_Event_FrifENitChA: start-on-event=DemSatellite_0InternalBehavior/GetFaultDetectionCounter, operation=Event_FrifENitChA.GetFaultDetectionCounter
        OpEventGetFaultDetectionCounter_GetFaultDetectionCounter_EvtInfo_CansmEBusLpCanOff: start-on-event=DemSatellite_0InternalBehavior/GetFaultDetectionCounter, operation=EvtInfo_CansmEBusLpCanOff.GetFaultDetectionCounter
        OpEventGetFaultDetectionCounter_GetFaultDetectionCounter_Event_CansmEBusLpCanOff: start-on-event=DemSatellite_0InternalBehavior/GetFaultDetectionCounter, operation=Event_CansmEBusLpCanOff.GetFaultDetectionCounter
        OpEventGetFaultDetectionCounter_GetFaultDetectionCounter_EvtInfo_NVM_E_HARDWARE: start-on-event=DemSatellite_0InternalBehavior/GetFaultDetectionCounter, operation=EvtInfo_NVM_E_HARDWARE.GetFaultDetectionCounter
        OpEventGetFaultDetectionCounter_GetFaultDetectionCounter_EvtInfo_VsmEventOpmode: start-on-event=DemSatellite_0InternalBehavior/GetFaultDetectionCounter, operation=EvtInfo_VsmEventOpmode.GetFaultDetectionCounter
        OpEventGetFaultDetectionCounter_GetFaultDetectionCounter_Event_VsmEventOpmode: start-on-event=DemSatellite_0InternalBehavior/GetFaultDetectionCounter, operation=Event_VsmEventOpmode.GetFaultDetectionCounter
        OpEventGetFaultDetectionCounter_GetFaultDetectionCounter_EvtInfo_LIN_E_TIMEOUT: start-on-event=DemSatellite_0InternalBehavior/GetFaultDetectionCounter, operation=EvtInfo_LIN_E_TIMEOUT.GetFaultDetectionCounter
        OpEventGetFaultDetectionCounter_GetFaultDetectionCounter_EvtInfo_CantrcvEBusACanError: start-on-event=DemSatellite_0InternalBehavior/GetFaultDetectionCounter, operation=EvtInfo_CantrcvEBusACanError.GetFaultDetectionCounter
        OpEventGetFaultDetectionCounter_GetFaultDetectionCounter_Event_CantrcvEBusACanError: start-on-event=DemSatellite_0InternalBehavior/GetFaultDetectionCounter, operation=Event_CantrcvEBusACanError.GetFaultDetectionCounter
        OpEventGetFaultDetectionCounter_GetFaultDetectionCounter_EvtInfo_UDPNM_E_TCPIP_TRANSMIT_ERROR: start-on-event=DemSatellite_0InternalBehavior/GetFaultDetectionCounter, operation=EvtInfo_UDPNM_E_TCPIP_TRANSMIT_ERROR.GetFaultDetectionCounter
        OpEventGetFaultDetectionCounter_GetFaultDetectionCounter_EvtInfo_DmTestCom: start-on-event=DemSatellite_0InternalBehavior/GetFaultDetectionCounter, operation=EvtInfo_DmTestCom.GetFaultDetectionCounter
        OpEventGetFaultDetectionCounter_GetFaultDetectionCounter_Event_DmTestCom: start-on-event=DemSatellite_0InternalBehavior/GetFaultDetectionCounter, operation=Event_DmTestCom.GetFaultDetectionCounter
        OpEventGetFaultDetectionCounter_GetFaultDetectionCounter_EvtInfo_CodingEventSignatureError: start-on-event=DemSatellite_0InternalBehavior/GetFaultDetectionCounter, operation=EvtInfo_CodingEventSignatureError.GetFaultDetectionCounter
        OpEventGetFaultDetectionCounter_GetFaultDetectionCounter_Event_CodingEventSignatureError: start-on-event=DemSatellite_0InternalBehavior/GetFaultDetectionCounter, operation=Event_CodingEventSignatureError.GetFaultDetectionCounter
        OpEventGetFaultDetectionCounter_GetFaultDetectionCounter_EvtInfo_CodingEventUnqualifiedData: start-on-event=DemSatellite_0InternalBehavior/GetFaultDetectionCounter, operation=EvtInfo_CodingEventUnqualifiedData.GetFaultDetectionCounter
        OpEventGetFaultDetectionCounter_GetFaultDetectionCounter_Event_CodingEventUnqualifiedData: start-on-event=DemSatellite_0InternalBehavior/GetFaultDetectionCounter, operation=Event_CodingEventUnqualifiedData.GetFaultDetectionCounter
        OpEventGetFaultDetectionCounter_GetFaultDetectionCounter_EvtInfo_CodingEventInvalidData: start-on-event=DemSatellite_0InternalBehavior/GetFaultDetectionCounter, operation=EvtInfo_CodingEventInvalidData.GetFaultDetectionCounter
        OpEventGetFaultDetectionCounter_GetFaultDetectionCounter_Event_CodingEventInvalidData: start-on-event=DemSatellite_0InternalBehavior/GetFaultDetectionCounter, operation=Event_CodingEventInvalidData.GetFaultDetectionCounter
        OpEventGetFaultDetectionCounter_GetFaultDetectionCounter_EvtInfo_CansmEBusB2CanOff: start-on-event=DemSatellite_0InternalBehavior/GetFaultDetectionCounter, operation=EvtInfo_CansmEBusB2CanOff.GetFaultDetectionCounter
        OpEventGetFaultDetectionCounter_GetFaultDetectionCounter_Event_CansmEBusB2CanOff: start-on-event=DemSatellite_0InternalBehavior/GetFaultDetectionCounter, operation=Event_CansmEBusB2CanOff.GetFaultDetectionCounter
        OpEventGetFaultDetectionCounter_GetFaultDetectionCounter_EvtInfo_Overvoltage: start-on-event=DemSatellite_0InternalBehavior/GetFaultDetectionCounter, operation=EvtInfo_Overvoltage.GetFaultDetectionCounter
        OpEventGetFaultDetectionCounter_GetFaultDetectionCounter_Event_Overvoltage: start-on-event=DemSatellite_0InternalBehavior/GetFaultDetectionCounter, operation=Event_Overvoltage.GetFaultDetectionCounter
        OpEventGetFaultDetectionCounter_GetFaultDetectionCounter_EvtInfo_CodingEventNotCoded: start-on-event=DemSatellite_0InternalBehavior/GetFaultDetectionCounter, operation=EvtInfo_CodingEventNotCoded.GetFaultDetectionCounter
        OpEventGetFaultDetectionCounter_GetFaultDetectionCounter_Event_CodingEventNotCoded: start-on-event=DemSatellite_0InternalBehavior/GetFaultDetectionCounter, operation=Event_CodingEventNotCoded.GetFaultDetectionCounter
        OpEventGetFaultDetectionCounter_GetFaultDetectionCounter_EvtInfo_FrifEAcsChA: start-on-event=DemSatellite_0InternalBehavior/GetFaultDetectionCounter, operation=EvtInfo_FrifEAcsChA.GetFaultDetectionCounter
        OpEventGetFaultDetectionCounter_GetFaultDetectionCounter_Event_FrifEAcsChA: start-on-event=DemSatellite_0InternalBehavior/GetFaultDetectionCounter, operation=Event_FrifEAcsChA.GetFaultDetectionCounter
        OpEventGetFaultDetectionCounter_GetFaultDetectionCounter_EvtInfo_CantrcvEBusFaCanError: start-on-event=DemSatellite_0InternalBehavior/GetFaultDetectionCounter, operation=EvtInfo_CantrcvEBusFaCanError.GetFaultDetectionCounter
        OpEventGetFaultDetectionCounter_GetFaultDetectionCounter_Event_CantrcvEBusFaCanError: start-on-event=DemSatellite_0InternalBehavior/GetFaultDetectionCounter, operation=Event_CantrcvEBusFaCanError.GetFaultDetectionCounter
        OpEventGetFaultDetectionCounter_GetFaultDetectionCounter_EvtInfo_CantrcvEBusLeCanError: start-on-event=DemSatellite_0InternalBehavior/GetFaultDetectionCounter, operation=EvtInfo_CantrcvEBusLeCanError.GetFaultDetectionCounter
        OpEventGetFaultDetectionCounter_GetFaultDetectionCounter_Event_CantrcvEBusLeCanError: start-on-event=DemSatellite_0InternalBehavior/GetFaultDetectionCounter, operation=Event_CantrcvEBusLeCanError.GetFaultDetectionCounter
        OpEventGetFaultDetectionCounter_GetFaultDetectionCounter_EvtInfo_CantrcvEBusLpCanError: start-on-event=DemSatellite_0InternalBehavior/GetFaultDetectionCounter, operation=EvtInfo_CantrcvEBusLpCanError.GetFaultDetectionCounter
        OpEventGetFaultDetectionCounter_GetFaultDetectionCounter_Event_CantrcvEBusLpCanError: start-on-event=DemSatellite_0InternalBehavior/GetFaultDetectionCounter, operation=Event_CantrcvEBusLpCanError.GetFaultDetectionCounter
        OpEventGetFaultDetectionCounter_GetFaultDetectionCounter_EvtInfo_CantrcvEBusZsgCanError: start-on-event=DemSatellite_0InternalBehavior/GetFaultDetectionCounter, operation=EvtInfo_CantrcvEBusZsgCanError.GetFaultDetectionCounter
        OpEventGetFaultDetectionCounter_GetFaultDetectionCounter_Event_CantrcvEBusZsgCanError: start-on-event=DemSatellite_0InternalBehavior/GetFaultDetectionCounter, operation=Event_CantrcvEBusZsgCanError.GetFaultDetectionCounter
        OpEventGetFaultDetectionCounter_GetFaultDetectionCounter_EvtInfo_EthSignalQualityLow: start-on-event=DemSatellite_0InternalBehavior/GetFaultDetectionCounter, operation=EvtInfo_EthSignalQualityLow.GetFaultDetectionCounter
        OpEventGetFaultDetectionCounter_GetFaultDetectionCounter_Event_EthSignalQualityLow: start-on-event=DemSatellite_0InternalBehavior/GetFaultDetectionCounter, operation=Event_EthSignalQualityLow.GetFaultDetectionCounter
        OpEventGetFaultDetectionCounter_GetFaultDetectionCounter_EvtInfo_DemEventParameter_FlsConfigSet_FLS_E_COMPARE_FAILED: start-on-event=DemSatellite_0InternalBehavior/GetFaultDetectionCounter, operation=EvtInfo_DemEventParameter_FlsConfigSet_FLS_E_COMPARE_FAILED.GetFaultDetectionCounter
        OpEventGetFaultDetectionCounter_GetFaultDetectionCounter_EvtInfo_DemEventParameter_FlsConfigSet_FLS_E_ERASE_FAILED: start-on-event=DemSatellite_0InternalBehavior/GetFaultDetectionCounter, operation=EvtInfo_DemEventParameter_FlsConfigSet_FLS_E_ERASE_FAILED.GetFaultDetectionCounter
        OpEventGetFaultDetectionCounter_GetFaultDetectionCounter_EvtInfo_DemEventParameter_FlsConfigSet_FLS_E_READ_FAILED: start-on-event=DemSatellite_0InternalBehavior/GetFaultDetectionCounter, operation=EvtInfo_DemEventParameter_FlsConfigSet_FLS_E_READ_FAILED.GetFaultDetectionCounter
        OpEventGetFaultDetectionCounter_GetFaultDetectionCounter_EvtInfo_DemEventParameter_FlsConfigSet_FLS_E_WRITE_FAILED: start-on-event=DemSatellite_0InternalBehavior/GetFaultDetectionCounter, operation=EvtInfo_DemEventParameter_FlsConfigSet_FLS_E_WRITE_FAILED.GetFaultDetectionCounter
        OpEventGetFaultDetectionCounter_GetFaultDetectionCounter_EvtInfo_DemEventParameter_FlsConfigSet_FLS_E_READ_DED_FAILED: start-on-event=DemSatellite_0InternalBehavior/GetFaultDetectionCounter, operation=EvtInfo_DemEventParameter_FlsConfigSet_FLS_E_READ_DED_FAILED.GetFaultDetectionCounter
        OpEventGetFaultDetectionCounter_GetFaultDetectionCounter_EvtInfo_DemEventParameter_FlsConfigSet_FLS_E_UNEXPECTED_FLASH_ID: start-on-event=DemSatellite_0InternalBehavior/GetFaultDetectionCounter, operation=EvtInfo_DemEventParameter_FlsConfigSet_FLS_E_UNEXPECTED_FLASH_ID.GetFaultDetectionCounter
        OpEventGetFaultDetectionCounter_GetFaultDetectionCounter_EvtInfo_DemEventParameter_FlsConfigSet_MCU_E_CLOCK_FAILED: start-on-event=DemSatellite_0InternalBehavior/GetFaultDetectionCounter, operation=EvtInfo_DemEventParameter_FlsConfigSet_MCU_E_CLOCK_FAILED.GetFaultDetectionCounter
        OpEventGetFaultDetectionCounter_GetFaultDetectionCounter_EvtInfo_DemEventParameter_FlsConfigSet_MCU_E_HW_FAILED: start-on-event=DemSatellite_0InternalBehavior/GetFaultDetectionCounter, operation=EvtInfo_DemEventParameter_FlsConfigSet_MCU_E_HW_FAILED.GetFaultDetectionCounter
        OpEventGetFaultDetectionCounter_GetFaultDetectionCounter_EvtInfo_DemEventParameter_FlsConfigSet_MCU_E_STARTUP_FAILED: start-on-event=DemSatellite_0InternalBehavior/GetFaultDetectionCounter, operation=EvtInfo_DemEventParameter_FlsConfigSet_MCU_E_STARTUP_FAILED.GetFaultDetectionCounter
        OpEventGetFaultDetectionCounter_GetFaultDetectionCounter_EvtInfo_DemEventParameter_FlsConfigSet_FLS_E_ECC_FAILED: start-on-event=DemSatellite_0InternalBehavior/GetFaultDetectionCounter, operation=EvtInfo_DemEventParameter_FlsConfigSet_FLS_E_ECC_FAILED.GetFaultDetectionCounter
        OpEventGetFaultDetectionCounter_GetFaultDetectionCounter_EvtInfo_DemEventParameter_FlsConfigSet_FLS_E_VRFY_FAILED: start-on-event=DemSatellite_0InternalBehavior/GetFaultDetectionCounter, operation=EvtInfo_DemEventParameter_FlsConfigSet_FLS_E_VRFY_FAILED.GetFaultDetectionCounter
        OpEventGetFaultDetectionCounter_GetFaultDetectionCounter_EvtInfo_DemEventParameter_FlsConfigSet_FLS_E_INT_FAILED: start-on-event=DemSatellite_0InternalBehavior/GetFaultDetectionCounter, operation=EvtInfo_DemEventParameter_FlsConfigSet_FLS_E_INT_FAILED.GetFaultDetectionCounter
        OpEventGetFaultDetectionCounter_GetFaultDetectionCounter_EvtInfo_DemEventParameter_FlsConfigSet_FLS_E_HW_FAILED: start-on-event=DemSatellite_0InternalBehavior/GetFaultDetectionCounter, operation=EvtInfo_DemEventParameter_FlsConfigSet_FLS_E_HW_FAILED.GetFaultDetectionCounter
        OpEventGetFaultDetectionCounter_GetFaultDetectionCounter_GeneralEventInfo: start-on-event=DemSatellite_0InternalBehavior/GetFaultDetectionCounter, operation=GeneralEventInfo.GetFaultDetectionCounter
        OpEventGetEventFreezeFrameDataEx_GetEventFreezeFrameDataEx_EvtInfo_FrtrcvEFrErrnTrcv0: start-on-event=DemSatellite_0InternalBehavior/GetEventFreezeFrameDataEx, operation=EvtInfo_FrtrcvEFrErrnTrcv0.GetEventFreezeFrameDataEx
        OpEventGetEventFreezeFrameDataEx_GetEventFreezeFrameDataEx_Event_FrtrcvEFrErrnTrcv0: start-on-event=DemSatellite_0InternalBehavior/GetEventFreezeFrameDataEx, operation=Event_FrtrcvEFrErrnTrcv0.GetEventFreezeFrameDataEx
        OpEventGetEventFreezeFrameDataEx_GetEventFreezeFrameDataEx_EvtInfo_CansmEBusIukCanOff: start-on-event=DemSatellite_0InternalBehavior/GetEventFreezeFrameDataEx, operation=EvtInfo_CansmEBusIukCanOff.GetEventFreezeFrameDataEx
        OpEventGetEventFreezeFrameDataEx_GetEventFreezeFrameDataEx_Event_CansmEBusIukCanOff: start-on-event=DemSatellite_0InternalBehavior/GetEventFreezeFrameDataEx, operation=Event_CansmEBusIukCanOff.GetEventFreezeFrameDataEx
        OpEventGetEventFreezeFrameDataEx_GetEventFreezeFrameDataEx_EvtInfo_FrtrcvEFrErrnTrcv2: start-on-event=DemSatellite_0InternalBehavior/GetEventFreezeFrameDataEx, operation=EvtInfo_FrtrcvEFrErrnTrcv2.GetEventFreezeFrameDataEx
        OpEventGetEventFreezeFrameDataEx_GetEventFreezeFrameDataEx_Event_FrtrcvEFrErrnTrcv2: start-on-event=DemSatellite_0InternalBehavior/GetEventFreezeFrameDataEx, operation=Event_FrtrcvEFrErrnTrcv2.GetEventFreezeFrameDataEx
        OpEventGetEventFreezeFrameDataEx_GetEventFreezeFrameDataEx_EvtInfo_FrtrcvEFrErrnTrcv1: start-on-event=DemSatellite_0InternalBehavior/GetEventFreezeFrameDataEx, operation=EvtInfo_FrtrcvEFrErrnTrcv1.GetEventFreezeFrameDataEx
        OpEventGetEventFreezeFrameDataEx_GetEventFreezeFrameDataEx_Event_FrtrcvEFrErrnTrcv1: start-on-event=DemSatellite_0InternalBehavior/GetEventFreezeFrameDataEx, operation=Event_FrtrcvEFrErrnTrcv1.GetEventFreezeFrameDataEx
        OpEventGetEventFreezeFrameDataEx_GetEventFreezeFrameDataEx_EvtInfo_FrtrcvEFrErrnTrcv4: start-on-event=DemSatellite_0InternalBehavior/GetEventFreezeFrameDataEx, operation=EvtInfo_FrtrcvEFrErrnTrcv4.GetEventFreezeFrameDataEx
        OpEventGetEventFreezeFrameDataEx_GetEventFreezeFrameDataEx_Event_FrtrcvEFrErrnTrcv4: start-on-event=DemSatellite_0InternalBehavior/GetEventFreezeFrameDataEx, operation=Event_FrtrcvEFrErrnTrcv4.GetEventFreezeFrameDataEx
        OpEventGetEventFreezeFrameDataEx_GetEventFreezeFrameDataEx_EvtInfo_FrtrcvEFrErrnTrcv3: start-on-event=DemSatellite_0InternalBehavior/GetEventFreezeFrameDataEx, operation=EvtInfo_FrtrcvEFrErrnTrcv3.GetEventFreezeFrameDataEx
        OpEventGetEventFreezeFrameDataEx_GetEventFreezeFrameDataEx_Event_FrtrcvEFrErrnTrcv3: start-on-event=DemSatellite_0InternalBehavior/GetEventFreezeFrameDataEx, operation=Event_FrtrcvEFrErrnTrcv3.GetEventFreezeFrameDataEx
        OpEventGetEventFreezeFrameDataEx_GetEventFreezeFrameDataEx_EvtInfo_FrtrcvEFrErrnTrcv6: start-on-event=DemSatellite_0InternalBehavior/GetEventFreezeFrameDataEx, operation=EvtInfo_FrtrcvEFrErrnTrcv6.GetEventFreezeFrameDataEx
        OpEventGetEventFreezeFrameDataEx_GetEventFreezeFrameDataEx_Event_FrtrcvEFrErrnTrcv6: start-on-event=DemSatellite_0InternalBehavior/GetEventFreezeFrameDataEx, operation=Event_FrtrcvEFrErrnTrcv6.GetEventFreezeFrameDataEx
        OpEventGetEventFreezeFrameDataEx_GetEventFreezeFrameDataEx_EvtInfo_FrtrcvEFrErrnTrcv5: start-on-event=DemSatellite_0InternalBehavior/GetEventFreezeFrameDataEx, operation=EvtInfo_FrtrcvEFrErrnTrcv5.GetEventFreezeFrameDataEx
        OpEventGetEventFreezeFrameDataEx_GetEventFreezeFrameDataEx_Event_FrtrcvEFrErrnTrcv5: start-on-event=DemSatellite_0InternalBehavior/GetEventFreezeFrameDataEx, operation=Event_FrtrcvEFrErrnTrcv5.GetEventFreezeFrameDataEx
        OpEventGetEventFreezeFrameDataEx_GetEventFreezeFrameDataEx_EvtInfo_CansmEBusBodyCanOff: start-on-event=DemSatellite_0InternalBehavior/GetEventFreezeFrameDataEx, operation=EvtInfo_CansmEBusBodyCanOff.GetEventFreezeFrameDataEx
        OpEventGetEventFreezeFrameDataEx_GetEventFreezeFrameDataEx_Event_CansmEBusBodyCanOff: start-on-event=DemSatellite_0InternalBehavior/GetEventFreezeFrameDataEx, operation=Event_CansmEBusBodyCanOff.GetEventFreezeFrameDataEx
        OpEventGetEventFreezeFrameDataEx_GetEventFreezeFrameDataEx_EvtInfo_CbsReplacementValue: start-on-event=DemSatellite_0InternalBehavior/GetEventFreezeFrameDataEx, operation=EvtInfo_CbsReplacementValue.GetEventFreezeFrameDataEx
        OpEventGetEventFreezeFrameDataEx_GetEventFreezeFrameDataEx_Event_CbsReplacementValue: start-on-event=DemSatellite_0InternalBehavior/GetEventFreezeFrameDataEx, operation=Event_CbsReplacementValue.GetEventFreezeFrameDataEx
        OpEventGetEventFreezeFrameDataEx_GetEventFreezeFrameDataEx_EvtInfo_CansmEBusLeCanOff: start-on-event=DemSatellite_0InternalBehavior/GetEventFreezeFrameDataEx, operation=EvtInfo_CansmEBusLeCanOff.GetEventFreezeFrameDataEx
        OpEventGetEventFreezeFrameDataEx_GetEventFreezeFrameDataEx_Event_CansmEBusLeCanOff: start-on-event=DemSatellite_0InternalBehavior/GetEventFreezeFrameDataEx, operation=Event_CansmEBusLeCanOff.GetEventFreezeFrameDataEx
        OpEventGetEventFreezeFrameDataEx_GetEventFreezeFrameDataEx_EvtInfo_CansmEBusZsgCanOff: start-on-event=DemSatellite_0InternalBehavior/GetEventFreezeFrameDataEx, operation=EvtInfo_CansmEBusZsgCanOff.GetEventFreezeFrameDataEx
        OpEventGetEventFreezeFrameDataEx_GetEventFreezeFrameDataEx_Event_CansmEBusZsgCanOff: start-on-event=DemSatellite_0InternalBehavior/GetEventFreezeFrameDataEx, operation=Event_CansmEBusZsgCanOff.GetEventFreezeFrameDataEx
        OpEventGetEventFreezeFrameDataEx_GetEventFreezeFrameDataEx_EvtInfo_CodingEventWrongVehicle: start-on-event=DemSatellite_0InternalBehavior/GetEventFreezeFrameDataEx, operation=EvtInfo_CodingEventWrongVehicle.GetEventFreezeFrameDataEx
        OpEventGetEventFreezeFrameDataEx_GetEventFreezeFrameDataEx_Event_CodingEventWrongVehicle: start-on-event=DemSatellite_0InternalBehavior/GetEventFreezeFrameDataEx, operation=Event_CodingEventWrongVehicle.GetEventFreezeFrameDataEx
        OpEventGetEventFreezeFrameDataEx_GetEventFreezeFrameDataEx_EvtInfo_FrsmEClusterStartup: start-on-event=DemSatellite_0InternalBehavior/GetEventFreezeFrameDataEx, operation=EvtInfo_FrsmEClusterStartup.GetEventFreezeFrameDataEx
        OpEventGetEventFreezeFrameDataEx_GetEventFreezeFrameDataEx_Event_FrsmEClusterStartup: start-on-event=DemSatellite_0InternalBehavior/GetEventFreezeFrameDataEx, operation=Event_FrsmEClusterStartup.GetEventFreezeFrameDataEx
        OpEventGetEventFreezeFrameDataEx_GetEventFreezeFrameDataEx_EvtInfo_CansmEBusACanOff: start-on-event=DemSatellite_0InternalBehavior/GetEventFreezeFrameDataEx, operation=EvtInfo_CansmEBusACanOff.GetEventFreezeFrameDataEx
        OpEventGetEventFreezeFrameDataEx_GetEventFreezeFrameDataEx_Event_CansmEBusACanOff: start-on-event=DemSatellite_0InternalBehavior/GetEventFreezeFrameDataEx, operation=Event_CansmEBusACanOff.GetEventFreezeFrameDataEx
        OpEventGetEventFreezeFrameDataEx_GetEventFreezeFrameDataEx_EvtInfo_CansmEBusKCanOff: start-on-event=DemSatellite_0InternalBehavior/GetEventFreezeFrameDataEx, operation=EvtInfo_CansmEBusKCanOff.GetEventFreezeFrameDataEx
        OpEventGetEventFreezeFrameDataEx_GetEventFreezeFrameDataEx_Event_CansmEBusKCanOff: start-on-event=DemSatellite_0InternalBehavior/GetEventFreezeFrameDataEx, operation=Event_CansmEBusKCanOff.GetEventFreezeFrameDataEx
        OpEventGetEventFreezeFrameDataEx_GetEventFreezeFrameDataEx_EvtInfo_CantrcvEBusKCanError: start-on-event=DemSatellite_0InternalBehavior/GetEventFreezeFrameDataEx, operation=EvtInfo_CantrcvEBusKCanError.GetEventFreezeFrameDataEx
        OpEventGetEventFreezeFrameDataEx_GetEventFreezeFrameDataEx_Event_CantrcvEBusKCanError: start-on-event=DemSatellite_0InternalBehavior/GetEventFreezeFrameDataEx, operation=Event_CantrcvEBusKCanError.GetEventFreezeFrameDataEx
        OpEventGetEventFreezeFrameDataEx_GetEventFreezeFrameDataEx_EvtInfo_FrtrcvEFrBuserrorTrcv0: start-on-event=DemSatellite_0InternalBehavior/GetEventFreezeFrameDataEx, operation=EvtInfo_FrtrcvEFrBuserrorTrcv0.GetEventFreezeFrameDataEx
        OpEventGetEventFreezeFrameDataEx_GetEventFreezeFrameDataEx_Event_FrtrcvEFrBuserrorTrcv0: start-on-event=DemSatellite_0InternalBehavior/GetEventFreezeFrameDataEx, operation=Event_FrtrcvEFrBuserrorTrcv0.GetEventFreezeFrameDataEx
        OpEventGetEventFreezeFrameDataEx_GetEventFreezeFrameDataEx_EvtInfo_FrtrcvEFrErrnTrcv7: start-on-event=DemSatellite_0InternalBehavior/GetEventFreezeFrameDataEx, operation=EvtInfo_FrtrcvEFrErrnTrcv7.GetEventFreezeFrameDataEx
        OpEventGetEventFreezeFrameDataEx_GetEventFreezeFrameDataEx_Event_FrtrcvEFrErrnTrcv7: start-on-event=DemSatellite_0InternalBehavior/GetEventFreezeFrameDataEx, operation=Event_FrtrcvEFrErrnTrcv7.GetEventFreezeFrameDataEx
        OpEventGetEventFreezeFrameDataEx_GetEventFreezeFrameDataEx_EvtInfo_CansmEBusFaCanOff: start-on-event=DemSatellite_0InternalBehavior/GetEventFreezeFrameDataEx, operation=EvtInfo_CansmEBusFaCanOff.GetEventFreezeFrameDataEx
        OpEventGetEventFreezeFrameDataEx_GetEventFreezeFrameDataEx_Event_CansmEBusFaCanOff: start-on-event=DemSatellite_0InternalBehavior/GetEventFreezeFrameDataEx, operation=Event_CansmEBusFaCanOff.GetEventFreezeFrameDataEx
        OpEventGetEventFreezeFrameDataEx_GetEventFreezeFrameDataEx_EvtInfo_CantrcvEBusB2CanError: start-on-event=DemSatellite_0InternalBehavior/GetEventFreezeFrameDataEx, operation=EvtInfo_CantrcvEBusB2CanError.GetEventFreezeFrameDataEx
        OpEventGetEventFreezeFrameDataEx_GetEventFreezeFrameDataEx_Event_CantrcvEBusB2CanError: start-on-event=DemSatellite_0InternalBehavior/GetEventFreezeFrameDataEx, operation=Event_CantrcvEBusB2CanError.GetEventFreezeFrameDataEx
        OpEventGetEventFreezeFrameDataEx_GetEventFreezeFrameDataEx_EvtInfo_DtcCd0605: start-on-event=DemSatellite_0InternalBehavior/GetEventFreezeFrameDataEx, operation=EvtInfo_DtcCd0605.GetEventFreezeFrameDataEx
        OpEventGetEventFreezeFrameDataEx_GetEventFreezeFrameDataEx_Event_DtcCd0605: start-on-event=DemSatellite_0InternalBehavior/GetEventFreezeFrameDataEx, operation=Event_DtcCd0605.GetEventFreezeFrameDataEx
        OpEventGetEventFreezeFrameDataEx_GetEventFreezeFrameDataEx_EvtInfo_DtcCd0606: start-on-event=DemSatellite_0InternalBehavior/GetEventFreezeFrameDataEx, operation=EvtInfo_DtcCd0606.GetEventFreezeFrameDataEx
        OpEventGetEventFreezeFrameDataEx_GetEventFreezeFrameDataEx_Event_DtcCd0606: start-on-event=DemSatellite_0InternalBehavior/GetEventFreezeFrameDataEx, operation=Event_DtcCd0606.GetEventFreezeFrameDataEx
        OpEventGetEventFreezeFrameDataEx_GetEventFreezeFrameDataEx_EvtInfo_DtcCd0607: start-on-event=DemSatellite_0InternalBehavior/GetEventFreezeFrameDataEx, operation=EvtInfo_DtcCd0607.GetEventFreezeFrameDataEx
        OpEventGetEventFreezeFrameDataEx_GetEventFreezeFrameDataEx_Event_DtcCd0607: start-on-event=DemSatellite_0InternalBehavior/GetEventFreezeFrameDataEx, operation=Event_DtcCd0607.GetEventFreezeFrameDataEx
        OpEventGetEventFreezeFrameDataEx_GetEventFreezeFrameDataEx_EvtInfo_PiaEIoError: start-on-event=DemSatellite_0InternalBehavior/GetEventFreezeFrameDataEx, operation=EvtInfo_PiaEIoError.GetEventFreezeFrameDataEx
        OpEventGetEventFreezeFrameDataEx_GetEventFreezeFrameDataEx_Event_PiaEIoError: start-on-event=DemSatellite_0InternalBehavior/GetEventFreezeFrameDataEx, operation=Event_PiaEIoError.GetEventFreezeFrameDataEx
        OpEventGetEventFreezeFrameDataEx_GetEventFreezeFrameDataEx_EvtInfo_DtcCd0601: start-on-event=DemSatellite_0InternalBehavior/GetEventFreezeFrameDataEx, operation=EvtInfo_DtcCd0601.GetEventFreezeFrameDataEx
        OpEventGetEventFreezeFrameDataEx_GetEventFreezeFrameDataEx_Event_DtcCd0601: start-on-event=DemSatellite_0InternalBehavior/GetEventFreezeFrameDataEx, operation=Event_DtcCd0601.GetEventFreezeFrameDataEx
        OpEventGetEventFreezeFrameDataEx_GetEventFreezeFrameDataEx_EvtInfo_SwtExternalCheckFailure: start-on-event=DemSatellite_0InternalBehavior/GetEventFreezeFrameDataEx, operation=EvtInfo_SwtExternalCheckFailure.GetEventFreezeFrameDataEx
        OpEventGetEventFreezeFrameDataEx_GetEventFreezeFrameDataEx_Event_SwtExternalCheckFailure: start-on-event=DemSatellite_0InternalBehavior/GetEventFreezeFrameDataEx, operation=Event_SwtExternalCheckFailure.GetEventFreezeFrameDataEx
        OpEventGetEventFreezeFrameDataEx_GetEventFreezeFrameDataEx_EvtInfo_CantrcvEBusBodyCanError: start-on-event=DemSatellite_0InternalBehavior/GetEventFreezeFrameDataEx, operation=EvtInfo_CantrcvEBusBodyCanError.GetEventFreezeFrameDataEx
        OpEventGetEventFreezeFrameDataEx_GetEventFreezeFrameDataEx_Event_CantrcvEBusBodyCanError: start-on-event=DemSatellite_0InternalBehavior/GetEventFreezeFrameDataEx, operation=Event_CantrcvEBusBodyCanError.GetEventFreezeFrameDataEx
        OpEventGetEventFreezeFrameDataEx_GetEventFreezeFrameDataEx_EvtInfo_CantrcvEBusIukError: start-on-event=DemSatellite_0InternalBehavior/GetEventFreezeFrameDataEx, operation=EvtInfo_CantrcvEBusIukError.GetEventFreezeFrameDataEx
        OpEventGetEventFreezeFrameDataEx_GetEventFreezeFrameDataEx_Event_CantrcvEBusIukError: start-on-event=DemSatellite_0InternalBehavior/GetEventFreezeFrameDataEx, operation=Event_CantrcvEBusIukError.GetEventFreezeFrameDataEx
        OpEventGetEventFreezeFrameDataEx_GetEventFreezeFrameDataEx_EvtInfo_SwtInternalCheckFailure: start-on-event=DemSatellite_0InternalBehavior/GetEventFreezeFrameDataEx, operation=EvtInfo_SwtInternalCheckFailure.GetEventFreezeFrameDataEx
        OpEventGetEventFreezeFrameDataEx_GetEventFreezeFrameDataEx_Event_SwtInternalCheckFailure: start-on-event=DemSatellite_0InternalBehavior/GetEventFreezeFrameDataEx, operation=Event_SwtInternalCheckFailure.GetEventFreezeFrameDataEx
        OpEventGetEventFreezeFrameDataEx_GetEventFreezeFrameDataEx_EvtInfo_DmTestAppl: start-on-event=DemSatellite_0InternalBehavior/GetEventFreezeFrameDataEx, operation=EvtInfo_DmTestAppl.GetEventFreezeFrameDataEx
        OpEventGetEventFreezeFrameDataEx_GetEventFreezeFrameDataEx_Event_DmTestAppl: start-on-event=DemSatellite_0InternalBehavior/GetEventFreezeFrameDataEx, operation=Event_DmTestAppl.GetEventFreezeFrameDataEx
        OpEventGetEventFreezeFrameDataEx_GetEventFreezeFrameDataEx_EvtInfo_Dtc000032: start-on-event=DemSatellite_0InternalBehavior/GetEventFreezeFrameDataEx, operation=EvtInfo_Dtc000032.GetEventFreezeFrameDataEx
        OpEventGetEventFreezeFrameDataEx_GetEventFreezeFrameDataEx_Event_Dtc000032: start-on-event=DemSatellite_0InternalBehavior/GetEventFreezeFrameDataEx, operation=Event_Dtc000032.GetEventFreezeFrameDataEx
        OpEventGetEventFreezeFrameDataEx_GetEventFreezeFrameDataEx_EvtInfo_Dtc000031: start-on-event=DemSatellite_0InternalBehavior/GetEventFreezeFrameDataEx, operation=EvtInfo_Dtc000031.GetEventFreezeFrameDataEx
        OpEventGetEventFreezeFrameDataEx_GetEventFreezeFrameDataEx_Event_Dtc000031: start-on-event=DemSatellite_0InternalBehavior/GetEventFreezeFrameDataEx, operation=Event_Dtc000031.GetEventFreezeFrameDataEx
        OpEventGetEventFreezeFrameDataEx_GetEventFreezeFrameDataEx_EvtInfo_FrsmEClusterSyncLoss: start-on-event=DemSatellite_0InternalBehavior/GetEventFreezeFrameDataEx, operation=EvtInfo_FrsmEClusterSyncLoss.GetEventFreezeFrameDataEx
        OpEventGetEventFreezeFrameDataEx_GetEventFreezeFrameDataEx_Event_FrsmEClusterSyncLoss: start-on-event=DemSatellite_0InternalBehavior/GetEventFreezeFrameDataEx, operation=Event_FrsmEClusterSyncLoss.GetEventFreezeFrameDataEx
        OpEventGetEventFreezeFrameDataEx_GetEventFreezeFrameDataEx_EvtInfo_Dtc000030: start-on-event=DemSatellite_0InternalBehavior/GetEventFreezeFrameDataEx, operation=EvtInfo_Dtc000030.GetEventFreezeFrameDataEx
        OpEventGetEventFreezeFrameDataEx_GetEventFreezeFrameDataEx_Event_Dtc000030: start-on-event=DemSatellite_0InternalBehavior/GetEventFreezeFrameDataEx, operation=Event_Dtc000030.GetEventFreezeFrameDataEx
        OpEventGetEventFreezeFrameDataEx_GetEventFreezeFrameDataEx_EvtInfo_Dtc000034: start-on-event=DemSatellite_0InternalBehavior/GetEventFreezeFrameDataEx, operation=EvtInfo_Dtc000034.GetEventFreezeFrameDataEx
        OpEventGetEventFreezeFrameDataEx_GetEventFreezeFrameDataEx_Event_Dtc000034: start-on-event=DemSatellite_0InternalBehavior/GetEventFreezeFrameDataEx, operation=Event_Dtc000034.GetEventFreezeFrameDataEx
        OpEventGetEventFreezeFrameDataEx_GetEventFreezeFrameDataEx_EvtInfo_Dtc000033: start-on-event=DemSatellite_0InternalBehavior/GetEventFreezeFrameDataEx, operation=EvtInfo_Dtc000033.GetEventFreezeFrameDataEx
        OpEventGetEventFreezeFrameDataEx_GetEventFreezeFrameDataEx_Event_Dtc000033: start-on-event=DemSatellite_0InternalBehavior/GetEventFreezeFrameDataEx, operation=Event_Dtc000033.GetEventFreezeFrameDataEx
        OpEventGetEventFreezeFrameDataEx_GetEventFreezeFrameDataEx_EvtInfo_Undervoltage: start-on-event=DemSatellite_0InternalBehavior/GetEventFreezeFrameDataEx, operation=EvtInfo_Undervoltage.GetEventFreezeFrameDataEx
        OpEventGetEventFreezeFrameDataEx_GetEventFreezeFrameDataEx_Event_Undervoltage: start-on-event=DemSatellite_0InternalBehavior/GetEventFreezeFrameDataEx, operation=Event_Undervoltage.GetEventFreezeFrameDataEx
        OpEventGetEventFreezeFrameDataEx_GetEventFreezeFrameDataEx_EvtInfo_CodingEventTransactionFailed: start-on-event=DemSatellite_0InternalBehavior/GetEventFreezeFrameDataEx, operation=EvtInfo_CodingEventTransactionFailed.GetEventFreezeFrameDataEx
        OpEventGetEventFreezeFrameDataEx_GetEventFreezeFrameDataEx_Event_CodingEventTransactionFailed: start-on-event=DemSatellite_0InternalBehavior/GetEventFreezeFrameDataEx, operation=Event_CodingEventTransactionFailed.GetEventFreezeFrameDataEx
        OpEventGetEventFreezeFrameDataEx_GetEventFreezeFrameDataEx_EvtInfo_FrifENitChA: start-on-event=DemSatellite_0InternalBehavior/GetEventFreezeFrameDataEx, operation=EvtInfo_FrifENitChA.GetEventFreezeFrameDataEx
        OpEventGetEventFreezeFrameDataEx_GetEventFreezeFrameDataEx_Event_FrifENitChA: start-on-event=DemSatellite_0InternalBehavior/GetEventFreezeFrameDataEx, operation=Event_FrifENitChA.GetEventFreezeFrameDataEx
        OpEventGetEventFreezeFrameDataEx_GetEventFreezeFrameDataEx_EvtInfo_CansmEBusLpCanOff: start-on-event=DemSatellite_0InternalBehavior/GetEventFreezeFrameDataEx, operation=EvtInfo_CansmEBusLpCanOff.GetEventFreezeFrameDataEx
        OpEventGetEventFreezeFrameDataEx_GetEventFreezeFrameDataEx_Event_CansmEBusLpCanOff: start-on-event=DemSatellite_0InternalBehavior/GetEventFreezeFrameDataEx, operation=Event_CansmEBusLpCanOff.GetEventFreezeFrameDataEx
        OpEventGetEventFreezeFrameDataEx_GetEventFreezeFrameDataEx_EvtInfo_NVM_E_HARDWARE: start-on-event=DemSatellite_0InternalBehavior/GetEventFreezeFrameDataEx, operation=EvtInfo_NVM_E_HARDWARE.GetEventFreezeFrameDataEx
        OpEventGetEventFreezeFrameDataEx_GetEventFreezeFrameDataEx_EvtInfo_VsmEventOpmode: start-on-event=DemSatellite_0InternalBehavior/GetEventFreezeFrameDataEx, operation=EvtInfo_VsmEventOpmode.GetEventFreezeFrameDataEx
        OpEventGetEventFreezeFrameDataEx_GetEventFreezeFrameDataEx_Event_VsmEventOpmode: start-on-event=DemSatellite_0InternalBehavior/GetEventFreezeFrameDataEx, operation=Event_VsmEventOpmode.GetEventFreezeFrameDataEx
        OpEventGetEventFreezeFrameDataEx_GetEventFreezeFrameDataEx_EvtInfo_LIN_E_TIMEOUT: start-on-event=DemSatellite_0InternalBehavior/GetEventFreezeFrameDataEx, operation=EvtInfo_LIN_E_TIMEOUT.GetEventFreezeFrameDataEx
        OpEventGetEventFreezeFrameDataEx_GetEventFreezeFrameDataEx_EvtInfo_CantrcvEBusACanError: start-on-event=DemSatellite_0InternalBehavior/GetEventFreezeFrameDataEx, operation=EvtInfo_CantrcvEBusACanError.GetEventFreezeFrameDataEx
        OpEventGetEventFreezeFrameDataEx_GetEventFreezeFrameDataEx_Event_CantrcvEBusACanError: start-on-event=DemSatellite_0InternalBehavior/GetEventFreezeFrameDataEx, operation=Event_CantrcvEBusACanError.GetEventFreezeFrameDataEx
        OpEventGetEventFreezeFrameDataEx_GetEventFreezeFrameDataEx_EvtInfo_UDPNM_E_TCPIP_TRANSMIT_ERROR: start-on-event=DemSatellite_0InternalBehavior/GetEventFreezeFrameDataEx, operation=EvtInfo_UDPNM_E_TCPIP_TRANSMIT_ERROR.GetEventFreezeFrameDataEx
        OpEventGetEventFreezeFrameDataEx_GetEventFreezeFrameDataEx_EvtInfo_DmTestCom: start-on-event=DemSatellite_0InternalBehavior/GetEventFreezeFrameDataEx, operation=EvtInfo_DmTestCom.GetEventFreezeFrameDataEx
        OpEventGetEventFreezeFrameDataEx_GetEventFreezeFrameDataEx_Event_DmTestCom: start-on-event=DemSatellite_0InternalBehavior/GetEventFreezeFrameDataEx, operation=Event_DmTestCom.GetEventFreezeFrameDataEx
        OpEventGetEventFreezeFrameDataEx_GetEventFreezeFrameDataEx_EvtInfo_CodingEventSignatureError: start-on-event=DemSatellite_0InternalBehavior/GetEventFreezeFrameDataEx, operation=EvtInfo_CodingEventSignatureError.GetEventFreezeFrameDataEx
        OpEventGetEventFreezeFrameDataEx_GetEventFreezeFrameDataEx_Event_CodingEventSignatureError: start-on-event=DemSatellite_0InternalBehavior/GetEventFreezeFrameDataEx, operation=Event_CodingEventSignatureError.GetEventFreezeFrameDataEx
        OpEventGetEventFreezeFrameDataEx_GetEventFreezeFrameDataEx_EvtInfo_CodingEventUnqualifiedData: start-on-event=DemSatellite_0InternalBehavior/GetEventFreezeFrameDataEx, operation=EvtInfo_CodingEventUnqualifiedData.GetEventFreezeFrameDataEx
        OpEventGetEventFreezeFrameDataEx_GetEventFreezeFrameDataEx_Event_CodingEventUnqualifiedData: start-on-event=DemSatellite_0InternalBehavior/GetEventFreezeFrameDataEx, operation=Event_CodingEventUnqualifiedData.GetEventFreezeFrameDataEx
        OpEventGetEventFreezeFrameDataEx_GetEventFreezeFrameDataEx_EvtInfo_CodingEventInvalidData: start-on-event=DemSatellite_0InternalBehavior/GetEventFreezeFrameDataEx, operation=EvtInfo_CodingEventInvalidData.GetEventFreezeFrameDataEx
        OpEventGetEventFreezeFrameDataEx_GetEventFreezeFrameDataEx_Event_CodingEventInvalidData: start-on-event=DemSatellite_0InternalBehavior/GetEventFreezeFrameDataEx, operation=Event_CodingEventInvalidData.GetEventFreezeFrameDataEx
        OpEventGetEventFreezeFrameDataEx_GetEventFreezeFrameDataEx_EvtInfo_CansmEBusB2CanOff: start-on-event=DemSatellite_0InternalBehavior/GetEventFreezeFrameDataEx, operation=EvtInfo_CansmEBusB2CanOff.GetEventFreezeFrameDataEx
        OpEventGetEventFreezeFrameDataEx_GetEventFreezeFrameDataEx_Event_CansmEBusB2CanOff: start-on-event=DemSatellite_0InternalBehavior/GetEventFreezeFrameDataEx, operation=Event_CansmEBusB2CanOff.GetEventFreezeFrameDataEx
        OpEventGetEventFreezeFrameDataEx_GetEventFreezeFrameDataEx_EvtInfo_Overvoltage: start-on-event=DemSatellite_0InternalBehavior/GetEventFreezeFrameDataEx, operation=EvtInfo_Overvoltage.GetEventFreezeFrameDataEx
        OpEventGetEventFreezeFrameDataEx_GetEventFreezeFrameDataEx_Event_Overvoltage: start-on-event=DemSatellite_0InternalBehavior/GetEventFreezeFrameDataEx, operation=Event_Overvoltage.GetEventFreezeFrameDataEx
        OpEventGetEventFreezeFrameDataEx_GetEventFreezeFrameDataEx_EvtInfo_CodingEventNotCoded: start-on-event=DemSatellite_0InternalBehavior/GetEventFreezeFrameDataEx, operation=EvtInfo_CodingEventNotCoded.GetEventFreezeFrameDataEx
        OpEventGetEventFreezeFrameDataEx_GetEventFreezeFrameDataEx_Event_CodingEventNotCoded: start-on-event=DemSatellite_0InternalBehavior/GetEventFreezeFrameDataEx, operation=Event_CodingEventNotCoded.GetEventFreezeFrameDataEx
        OpEventGetEventFreezeFrameDataEx_GetEventFreezeFrameDataEx_EvtInfo_FrifEAcsChA: start-on-event=DemSatellite_0InternalBehavior/GetEventFreezeFrameDataEx, operation=EvtInfo_FrifEAcsChA.GetEventFreezeFrameDataEx
        OpEventGetEventFreezeFrameDataEx_GetEventFreezeFrameDataEx_Event_FrifEAcsChA: start-on-event=DemSatellite_0InternalBehavior/GetEventFreezeFrameDataEx, operation=Event_FrifEAcsChA.GetEventFreezeFrameDataEx
        OpEventGetEventFreezeFrameDataEx_GetEventFreezeFrameDataEx_EvtInfo_CantrcvEBusFaCanError: start-on-event=DemSatellite_0InternalBehavior/GetEventFreezeFrameDataEx, operation=EvtInfo_CantrcvEBusFaCanError.GetEventFreezeFrameDataEx
        OpEventGetEventFreezeFrameDataEx_GetEventFreezeFrameDataEx_Event_CantrcvEBusFaCanError: start-on-event=DemSatellite_0InternalBehavior/GetEventFreezeFrameDataEx, operation=Event_CantrcvEBusFaCanError.GetEventFreezeFrameDataEx
        OpEventGetEventFreezeFrameDataEx_GetEventFreezeFrameDataEx_EvtInfo_CantrcvEBusLeCanError: start-on-event=DemSatellite_0InternalBehavior/GetEventFreezeFrameDataEx, operation=EvtInfo_CantrcvEBusLeCanError.GetEventFreezeFrameDataEx
        OpEventGetEventFreezeFrameDataEx_GetEventFreezeFrameDataEx_Event_CantrcvEBusLeCanError: start-on-event=DemSatellite_0InternalBehavior/GetEventFreezeFrameDataEx, operation=Event_CantrcvEBusLeCanError.GetEventFreezeFrameDataEx
        OpEventGetEventFreezeFrameDataEx_GetEventFreezeFrameDataEx_EvtInfo_CantrcvEBusLpCanError: start-on-event=DemSatellite_0InternalBehavior/GetEventFreezeFrameDataEx, operation=EvtInfo_CantrcvEBusLpCanError.GetEventFreezeFrameDataEx
        OpEventGetEventFreezeFrameDataEx_GetEventFreezeFrameDataEx_Event_CantrcvEBusLpCanError: start-on-event=DemSatellite_0InternalBehavior/GetEventFreezeFrameDataEx, operation=Event_CantrcvEBusLpCanError.GetEventFreezeFrameDataEx
        OpEventGetEventFreezeFrameDataEx_GetEventFreezeFrameDataEx_EvtInfo_CantrcvEBusZsgCanError: start-on-event=DemSatellite_0InternalBehavior/GetEventFreezeFrameDataEx, operation=EvtInfo_CantrcvEBusZsgCanError.GetEventFreezeFrameDataEx
        OpEventGetEventFreezeFrameDataEx_GetEventFreezeFrameDataEx_Event_CantrcvEBusZsgCanError: start-on-event=DemSatellite_0InternalBehavior/GetEventFreezeFrameDataEx, operation=Event_CantrcvEBusZsgCanError.GetEventFreezeFrameDataEx
        OpEventGetEventFreezeFrameDataEx_GetEventFreezeFrameDataEx_EvtInfo_EthSignalQualityLow: start-on-event=DemSatellite_0InternalBehavior/GetEventFreezeFrameDataEx, operation=EvtInfo_EthSignalQualityLow.GetEventFreezeFrameDataEx
        OpEventGetEventFreezeFrameDataEx_GetEventFreezeFrameDataEx_Event_EthSignalQualityLow: start-on-event=DemSatellite_0InternalBehavior/GetEventFreezeFrameDataEx, operation=Event_EthSignalQualityLow.GetEventFreezeFrameDataEx
        OpEventGetEventFreezeFrameDataEx_GetEventFreezeFrameDataEx_EvtInfo_DemEventParameter_FlsConfigSet_FLS_E_COMPARE_FAILED: start-on-event=DemSatellite_0InternalBehavior/GetEventFreezeFrameDataEx, operation=EvtInfo_DemEventParameter_FlsConfigSet_FLS_E_COMPARE_FAILED.GetEventFreezeFrameDataEx
        OpEventGetEventFreezeFrameDataEx_GetEventFreezeFrameDataEx_EvtInfo_DemEventParameter_FlsConfigSet_FLS_E_ERASE_FAILED: start-on-event=DemSatellite_0InternalBehavior/GetEventFreezeFrameDataEx, operation=EvtInfo_DemEventParameter_FlsConfigSet_FLS_E_ERASE_FAILED.GetEventFreezeFrameDataEx
        OpEventGetEventFreezeFrameDataEx_GetEventFreezeFrameDataEx_EvtInfo_DemEventParameter_FlsConfigSet_FLS_E_READ_FAILED: start-on-event=DemSatellite_0InternalBehavior/GetEventFreezeFrameDataEx, operation=EvtInfo_DemEventParameter_FlsConfigSet_FLS_E_READ_FAILED.GetEventFreezeFrameDataEx
        OpEventGetEventFreezeFrameDataEx_GetEventFreezeFrameDataEx_EvtInfo_DemEventParameter_FlsConfigSet_FLS_E_WRITE_FAILED: start-on-event=DemSatellite_0InternalBehavior/GetEventFreezeFrameDataEx, operation=EvtInfo_DemEventParameter_FlsConfigSet_FLS_E_WRITE_FAILED.GetEventFreezeFrameDataEx
        OpEventGetEventFreezeFrameDataEx_GetEventFreezeFrameDataEx_EvtInfo_DemEventParameter_FlsConfigSet_FLS_E_READ_DED_FAILED: start-on-event=DemSatellite_0InternalBehavior/GetEventFreezeFrameDataEx, operation=EvtInfo_DemEventParameter_FlsConfigSet_FLS_E_READ_DED_FAILED.GetEventFreezeFrameDataEx
        OpEventGetEventFreezeFrameDataEx_GetEventFreezeFrameDataEx_EvtInfo_DemEventParameter_FlsConfigSet_FLS_E_UNEXPECTED_FLASH_ID: start-on-event=DemSatellite_0InternalBehavior/GetEventFreezeFrameDataEx, operation=EvtInfo_DemEventParameter_FlsConfigSet_FLS_E_UNEXPECTED_FLASH_ID.GetEventFreezeFrameDataEx
        OpEventGetEventFreezeFrameDataEx_GetEventFreezeFrameDataEx_EvtInfo_DemEventParameter_FlsConfigSet_MCU_E_CLOCK_FAILED: start-on-event=DemSatellite_0InternalBehavior/GetEventFreezeFrameDataEx, operation=EvtInfo_DemEventParameter_FlsConfigSet_MCU_E_CLOCK_FAILED.GetEventFreezeFrameDataEx
        OpEventGetEventFreezeFrameDataEx_GetEventFreezeFrameDataEx_EvtInfo_DemEventParameter_FlsConfigSet_MCU_E_HW_FAILED: start-on-event=DemSatellite_0InternalBehavior/GetEventFreezeFrameDataEx, operation=EvtInfo_DemEventParameter_FlsConfigSet_MCU_E_HW_FAILED.GetEventFreezeFrameDataEx
        OpEventGetEventFreezeFrameDataEx_GetEventFreezeFrameDataEx_EvtInfo_DemEventParameter_FlsConfigSet_MCU_E_STARTUP_FAILED: start-on-event=DemSatellite_0InternalBehavior/GetEventFreezeFrameDataEx, operation=EvtInfo_DemEventParameter_FlsConfigSet_MCU_E_STARTUP_FAILED.GetEventFreezeFrameDataEx
        OpEventGetEventFreezeFrameDataEx_GetEventFreezeFrameDataEx_EvtInfo_DemEventParameter_FlsConfigSet_FLS_E_ECC_FAILED: start-on-event=DemSatellite_0InternalBehavior/GetEventFreezeFrameDataEx, operation=EvtInfo_DemEventParameter_FlsConfigSet_FLS_E_ECC_FAILED.GetEventFreezeFrameDataEx
        OpEventGetEventFreezeFrameDataEx_GetEventFreezeFrameDataEx_EvtInfo_DemEventParameter_FlsConfigSet_FLS_E_VRFY_FAILED: start-on-event=DemSatellite_0InternalBehavior/GetEventFreezeFrameDataEx, operation=EvtInfo_DemEventParameter_FlsConfigSet_FLS_E_VRFY_FAILED.GetEventFreezeFrameDataEx
        OpEventGetEventFreezeFrameDataEx_GetEventFreezeFrameDataEx_EvtInfo_DemEventParameter_FlsConfigSet_FLS_E_INT_FAILED: start-on-event=DemSatellite_0InternalBehavior/GetEventFreezeFrameDataEx, operation=EvtInfo_DemEventParameter_FlsConfigSet_FLS_E_INT_FAILED.GetEventFreezeFrameDataEx
        OpEventGetEventFreezeFrameDataEx_GetEventFreezeFrameDataEx_EvtInfo_DemEventParameter_FlsConfigSet_FLS_E_HW_FAILED: start-on-event=DemSatellite_0InternalBehavior/GetEventFreezeFrameDataEx, operation=EvtInfo_DemEventParameter_FlsConfigSet_FLS_E_HW_FAILED.GetEventFreezeFrameDataEx
        OpEventGetEventFreezeFrameDataEx_GetEventFreezeFrameDataEx_GeneralEventInfo: start-on-event=DemSatellite_0InternalBehavior/GetEventFreezeFrameDataEx, operation=GeneralEventInfo.GetEventFreezeFrameDataEx
        OpEventGetEventExtendedDataRecordEx_GetEventExtendedDataRecordEx_EvtInfo_FrtrcvEFrErrnTrcv0: start-on-event=DemSatellite_0InternalBehavior/GetEventExtendedDataRecordEx, operation=EvtInfo_FrtrcvEFrErrnTrcv0.GetEventExtendedDataRecordEx
        OpEventGetEventExtendedDataRecordEx_GetEventExtendedDataRecordEx_Event_FrtrcvEFrErrnTrcv0: start-on-event=DemSatellite_0InternalBehavior/GetEventExtendedDataRecordEx, operation=Event_FrtrcvEFrErrnTrcv0.GetEventExtendedDataRecordEx
        OpEventGetEventExtendedDataRecordEx_GetEventExtendedDataRecordEx_EvtInfo_CansmEBusIukCanOff: start-on-event=DemSatellite_0InternalBehavior/GetEventExtendedDataRecordEx, operation=EvtInfo_CansmEBusIukCanOff.GetEventExtendedDataRecordEx
        OpEventGetEventExtendedDataRecordEx_GetEventExtendedDataRecordEx_Event_CansmEBusIukCanOff: start-on-event=DemSatellite_0InternalBehavior/GetEventExtendedDataRecordEx, operation=Event_CansmEBusIukCanOff.GetEventExtendedDataRecordEx
        OpEventGetEventExtendedDataRecordEx_GetEventExtendedDataRecordEx_EvtInfo_FrtrcvEFrErrnTrcv2: start-on-event=DemSatellite_0InternalBehavior/GetEventExtendedDataRecordEx, operation=EvtInfo_FrtrcvEFrErrnTrcv2.GetEventExtendedDataRecordEx
        OpEventGetEventExtendedDataRecordEx_GetEventExtendedDataRecordEx_Event_FrtrcvEFrErrnTrcv2: start-on-event=DemSatellite_0InternalBehavior/GetEventExtendedDataRecordEx, operation=Event_FrtrcvEFrErrnTrcv2.GetEventExtendedDataRecordEx
        OpEventGetEventExtendedDataRecordEx_GetEventExtendedDataRecordEx_EvtInfo_FrtrcvEFrErrnTrcv1: start-on-event=DemSatellite_0InternalBehavior/GetEventExtendedDataRecordEx, operation=EvtInfo_FrtrcvEFrErrnTrcv1.GetEventExtendedDataRecordEx
        OpEventGetEventExtendedDataRecordEx_GetEventExtendedDataRecordEx_Event_FrtrcvEFrErrnTrcv1: start-on-event=DemSatellite_0InternalBehavior/GetEventExtendedDataRecordEx, operation=Event_FrtrcvEFrErrnTrcv1.GetEventExtendedDataRecordEx
        OpEventGetEventExtendedDataRecordEx_GetEventExtendedDataRecordEx_EvtInfo_FrtrcvEFrErrnTrcv4: start-on-event=DemSatellite_0InternalBehavior/GetEventExtendedDataRecordEx, operation=EvtInfo_FrtrcvEFrErrnTrcv4.GetEventExtendedDataRecordEx
        OpEventGetEventExtendedDataRecordEx_GetEventExtendedDataRecordEx_Event_FrtrcvEFrErrnTrcv4: start-on-event=DemSatellite_0InternalBehavior/GetEventExtendedDataRecordEx, operation=Event_FrtrcvEFrErrnTrcv4.GetEventExtendedDataRecordEx
        OpEventGetEventExtendedDataRecordEx_GetEventExtendedDataRecordEx_EvtInfo_FrtrcvEFrErrnTrcv3: start-on-event=DemSatellite_0InternalBehavior/GetEventExtendedDataRecordEx, operation=EvtInfo_FrtrcvEFrErrnTrcv3.GetEventExtendedDataRecordEx
        OpEventGetEventExtendedDataRecordEx_GetEventExtendedDataRecordEx_Event_FrtrcvEFrErrnTrcv3: start-on-event=DemSatellite_0InternalBehavior/GetEventExtendedDataRecordEx, operation=Event_FrtrcvEFrErrnTrcv3.GetEventExtendedDataRecordEx
        OpEventGetEventExtendedDataRecordEx_GetEventExtendedDataRecordEx_EvtInfo_FrtrcvEFrErrnTrcv6: start-on-event=DemSatellite_0InternalBehavior/GetEventExtendedDataRecordEx, operation=EvtInfo_FrtrcvEFrErrnTrcv6.GetEventExtendedDataRecordEx
        OpEventGetEventExtendedDataRecordEx_GetEventExtendedDataRecordEx_Event_FrtrcvEFrErrnTrcv6: start-on-event=DemSatellite_0InternalBehavior/GetEventExtendedDataRecordEx, operation=Event_FrtrcvEFrErrnTrcv6.GetEventExtendedDataRecordEx
        OpEventGetEventExtendedDataRecordEx_GetEventExtendedDataRecordEx_EvtInfo_FrtrcvEFrErrnTrcv5: start-on-event=DemSatellite_0InternalBehavior/GetEventExtendedDataRecordEx, operation=EvtInfo_FrtrcvEFrErrnTrcv5.GetEventExtendedDataRecordEx
        OpEventGetEventExtendedDataRecordEx_GetEventExtendedDataRecordEx_Event_FrtrcvEFrErrnTrcv5: start-on-event=DemSatellite_0InternalBehavior/GetEventExtendedDataRecordEx, operation=Event_FrtrcvEFrErrnTrcv5.GetEventExtendedDataRecordEx
        OpEventGetEventExtendedDataRecordEx_GetEventExtendedDataRecordEx_EvtInfo_CansmEBusBodyCanOff: start-on-event=DemSatellite_0InternalBehavior/GetEventExtendedDataRecordEx, operation=EvtInfo_CansmEBusBodyCanOff.GetEventExtendedDataRecordEx
        OpEventGetEventExtendedDataRecordEx_GetEventExtendedDataRecordEx_Event_CansmEBusBodyCanOff: start-on-event=DemSatellite_0InternalBehavior/GetEventExtendedDataRecordEx, operation=Event_CansmEBusBodyCanOff.GetEventExtendedDataRecordEx
        OpEventGetEventExtendedDataRecordEx_GetEventExtendedDataRecordEx_EvtInfo_CbsReplacementValue: start-on-event=DemSatellite_0InternalBehavior/GetEventExtendedDataRecordEx, operation=EvtInfo_CbsReplacementValue.GetEventExtendedDataRecordEx
        OpEventGetEventExtendedDataRecordEx_GetEventExtendedDataRecordEx_Event_CbsReplacementValue: start-on-event=DemSatellite_0InternalBehavior/GetEventExtendedDataRecordEx, operation=Event_CbsReplacementValue.GetEventExtendedDataRecordEx
        OpEventGetEventExtendedDataRecordEx_GetEventExtendedDataRecordEx_EvtInfo_CansmEBusLeCanOff: start-on-event=DemSatellite_0InternalBehavior/GetEventExtendedDataRecordEx, operation=EvtInfo_CansmEBusLeCanOff.GetEventExtendedDataRecordEx
        OpEventGetEventExtendedDataRecordEx_GetEventExtendedDataRecordEx_Event_CansmEBusLeCanOff: start-on-event=DemSatellite_0InternalBehavior/GetEventExtendedDataRecordEx, operation=Event_CansmEBusLeCanOff.GetEventExtendedDataRecordEx
        OpEventGetEventExtendedDataRecordEx_GetEventExtendedDataRecordEx_EvtInfo_CansmEBusZsgCanOff: start-on-event=DemSatellite_0InternalBehavior/GetEventExtendedDataRecordEx, operation=EvtInfo_CansmEBusZsgCanOff.GetEventExtendedDataRecordEx
        OpEventGetEventExtendedDataRecordEx_GetEventExtendedDataRecordEx_Event_CansmEBusZsgCanOff: start-on-event=DemSatellite_0InternalBehavior/GetEventExtendedDataRecordEx, operation=Event_CansmEBusZsgCanOff.GetEventExtendedDataRecordEx
        OpEventGetEventExtendedDataRecordEx_GetEventExtendedDataRecordEx_EvtInfo_CodingEventWrongVehicle: start-on-event=DemSatellite_0InternalBehavior/GetEventExtendedDataRecordEx, operation=EvtInfo_CodingEventWrongVehicle.GetEventExtendedDataRecordEx
        OpEventGetEventExtendedDataRecordEx_GetEventExtendedDataRecordEx_Event_CodingEventWrongVehicle: start-on-event=DemSatellite_0InternalBehavior/GetEventExtendedDataRecordEx, operation=Event_CodingEventWrongVehicle.GetEventExtendedDataRecordEx
        OpEventGetEventExtendedDataRecordEx_GetEventExtendedDataRecordEx_EvtInfo_FrsmEClusterStartup: start-on-event=DemSatellite_0InternalBehavior/GetEventExtendedDataRecordEx, operation=EvtInfo_FrsmEClusterStartup.GetEventExtendedDataRecordEx
        OpEventGetEventExtendedDataRecordEx_GetEventExtendedDataRecordEx_Event_FrsmEClusterStartup: start-on-event=DemSatellite_0InternalBehavior/GetEventExtendedDataRecordEx, operation=Event_FrsmEClusterStartup.GetEventExtendedDataRecordEx
        OpEventGetEventExtendedDataRecordEx_GetEventExtendedDataRecordEx_EvtInfo_CansmEBusACanOff: start-on-event=DemSatellite_0InternalBehavior/GetEventExtendedDataRecordEx, operation=EvtInfo_CansmEBusACanOff.GetEventExtendedDataRecordEx
        OpEventGetEventExtendedDataRecordEx_GetEventExtendedDataRecordEx_Event_CansmEBusACanOff: start-on-event=DemSatellite_0InternalBehavior/GetEventExtendedDataRecordEx, operation=Event_CansmEBusACanOff.GetEventExtendedDataRecordEx
        OpEventGetEventExtendedDataRecordEx_GetEventExtendedDataRecordEx_EvtInfo_CansmEBusKCanOff: start-on-event=DemSatellite_0InternalBehavior/GetEventExtendedDataRecordEx, operation=EvtInfo_CansmEBusKCanOff.GetEventExtendedDataRecordEx
        OpEventGetEventExtendedDataRecordEx_GetEventExtendedDataRecordEx_Event_CansmEBusKCanOff: start-on-event=DemSatellite_0InternalBehavior/GetEventExtendedDataRecordEx, operation=Event_CansmEBusKCanOff.GetEventExtendedDataRecordEx
        OpEventGetEventExtendedDataRecordEx_GetEventExtendedDataRecordEx_EvtInfo_CantrcvEBusKCanError: start-on-event=DemSatellite_0InternalBehavior/GetEventExtendedDataRecordEx, operation=EvtInfo_CantrcvEBusKCanError.GetEventExtendedDataRecordEx
        OpEventGetEventExtendedDataRecordEx_GetEventExtendedDataRecordEx_Event_CantrcvEBusKCanError: start-on-event=DemSatellite_0InternalBehavior/GetEventExtendedDataRecordEx, operation=Event_CantrcvEBusKCanError.GetEventExtendedDataRecordEx
        OpEventGetEventExtendedDataRecordEx_GetEventExtendedDataRecordEx_EvtInfo_FrtrcvEFrBuserrorTrcv0: start-on-event=DemSatellite_0InternalBehavior/GetEventExtendedDataRecordEx, operation=EvtInfo_FrtrcvEFrBuserrorTrcv0.GetEventExtendedDataRecordEx
        OpEventGetEventExtendedDataRecordEx_GetEventExtendedDataRecordEx_Event_FrtrcvEFrBuserrorTrcv0: start-on-event=DemSatellite_0InternalBehavior/GetEventExtendedDataRecordEx, operation=Event_FrtrcvEFrBuserrorTrcv0.GetEventExtendedDataRecordEx
        OpEventGetEventExtendedDataRecordEx_GetEventExtendedDataRecordEx_EvtInfo_FrtrcvEFrErrnTrcv7: start-on-event=DemSatellite_0InternalBehavior/GetEventExtendedDataRecordEx, operation=EvtInfo_FrtrcvEFrErrnTrcv7.GetEventExtendedDataRecordEx
        OpEventGetEventExtendedDataRecordEx_GetEventExtendedDataRecordEx_Event_FrtrcvEFrErrnTrcv7: start-on-event=DemSatellite_0InternalBehavior/GetEventExtendedDataRecordEx, operation=Event_FrtrcvEFrErrnTrcv7.GetEventExtendedDataRecordEx
        OpEventGetEventExtendedDataRecordEx_GetEventExtendedDataRecordEx_EvtInfo_CansmEBusFaCanOff: start-on-event=DemSatellite_0InternalBehavior/GetEventExtendedDataRecordEx, operation=EvtInfo_CansmEBusFaCanOff.GetEventExtendedDataRecordEx
        OpEventGetEventExtendedDataRecordEx_GetEventExtendedDataRecordEx_Event_CansmEBusFaCanOff: start-on-event=DemSatellite_0InternalBehavior/GetEventExtendedDataRecordEx, operation=Event_CansmEBusFaCanOff.GetEventExtendedDataRecordEx
        OpEventGetEventExtendedDataRecordEx_GetEventExtendedDataRecordEx_EvtInfo_CantrcvEBusB2CanError: start-on-event=DemSatellite_0InternalBehavior/GetEventExtendedDataRecordEx, operation=EvtInfo_CantrcvEBusB2CanError.GetEventExtendedDataRecordEx
        OpEventGetEventExtendedDataRecordEx_GetEventExtendedDataRecordEx_Event_CantrcvEBusB2CanError: start-on-event=DemSatellite_0InternalBehavior/GetEventExtendedDataRecordEx, operation=Event_CantrcvEBusB2CanError.GetEventExtendedDataRecordEx
        OpEventGetEventExtendedDataRecordEx_GetEventExtendedDataRecordEx_EvtInfo_DtcCd0605: start-on-event=DemSatellite_0InternalBehavior/GetEventExtendedDataRecordEx, operation=EvtInfo_DtcCd0605.GetEventExtendedDataRecordEx
        OpEventGetEventExtendedDataRecordEx_GetEventExtendedDataRecordEx_Event_DtcCd0605: start-on-event=DemSatellite_0InternalBehavior/GetEventExtendedDataRecordEx, operation=Event_DtcCd0605.GetEventExtendedDataRecordEx
        OpEventGetEventExtendedDataRecordEx_GetEventExtendedDataRecordEx_EvtInfo_DtcCd0606: start-on-event=DemSatellite_0InternalBehavior/GetEventExtendedDataRecordEx, operation=EvtInfo_DtcCd0606.GetEventExtendedDataRecordEx
        OpEventGetEventExtendedDataRecordEx_GetEventExtendedDataRecordEx_Event_DtcCd0606: start-on-event=DemSatellite_0InternalBehavior/GetEventExtendedDataRecordEx, operation=Event_DtcCd0606.GetEventExtendedDataRecordEx
        OpEventGetEventExtendedDataRecordEx_GetEventExtendedDataRecordEx_EvtInfo_DtcCd0607: start-on-event=DemSatellite_0InternalBehavior/GetEventExtendedDataRecordEx, operation=EvtInfo_DtcCd0607.GetEventExtendedDataRecordEx
        OpEventGetEventExtendedDataRecordEx_GetEventExtendedDataRecordEx_Event_DtcCd0607: start-on-event=DemSatellite_0InternalBehavior/GetEventExtendedDataRecordEx, operation=Event_DtcCd0607.GetEventExtendedDataRecordEx
        OpEventGetEventExtendedDataRecordEx_GetEventExtendedDataRecordEx_EvtInfo_PiaEIoError: start-on-event=DemSatellite_0InternalBehavior/GetEventExtendedDataRecordEx, operation=EvtInfo_PiaEIoError.GetEventExtendedDataRecordEx
        OpEventGetEventExtendedDataRecordEx_GetEventExtendedDataRecordEx_Event_PiaEIoError: start-on-event=DemSatellite_0InternalBehavior/GetEventExtendedDataRecordEx, operation=Event_PiaEIoError.GetEventExtendedDataRecordEx
        OpEventGetEventExtendedDataRecordEx_GetEventExtendedDataRecordEx_EvtInfo_DtcCd0601: start-on-event=DemSatellite_0InternalBehavior/GetEventExtendedDataRecordEx, operation=EvtInfo_DtcCd0601.GetEventExtendedDataRecordEx
        OpEventGetEventExtendedDataRecordEx_GetEventExtendedDataRecordEx_Event_DtcCd0601: start-on-event=DemSatellite_0InternalBehavior/GetEventExtendedDataRecordEx, operation=Event_DtcCd0601.GetEventExtendedDataRecordEx
        OpEventGetEventExtendedDataRecordEx_GetEventExtendedDataRecordEx_EvtInfo_SwtExternalCheckFailure: start-on-event=DemSatellite_0InternalBehavior/GetEventExtendedDataRecordEx, operation=EvtInfo_SwtExternalCheckFailure.GetEventExtendedDataRecordEx
        OpEventGetEventExtendedDataRecordEx_GetEventExtendedDataRecordEx_Event_SwtExternalCheckFailure: start-on-event=DemSatellite_0InternalBehavior/GetEventExtendedDataRecordEx, operation=Event_SwtExternalCheckFailure.GetEventExtendedDataRecordEx
        OpEventGetEventExtendedDataRecordEx_GetEventExtendedDataRecordEx_EvtInfo_CantrcvEBusBodyCanError: start-on-event=DemSatellite_0InternalBehavior/GetEventExtendedDataRecordEx, operation=EvtInfo_CantrcvEBusBodyCanError.GetEventExtendedDataRecordEx
        OpEventGetEventExtendedDataRecordEx_GetEventExtendedDataRecordEx_Event_CantrcvEBusBodyCanError: start-on-event=DemSatellite_0InternalBehavior/GetEventExtendedDataRecordEx, operation=Event_CantrcvEBusBodyCanError.GetEventExtendedDataRecordEx
        OpEventGetEventExtendedDataRecordEx_GetEventExtendedDataRecordEx_EvtInfo_CantrcvEBusIukError: start-on-event=DemSatellite_0InternalBehavior/GetEventExtendedDataRecordEx, operation=EvtInfo_CantrcvEBusIukError.GetEventExtendedDataRecordEx
        OpEventGetEventExtendedDataRecordEx_GetEventExtendedDataRecordEx_Event_CantrcvEBusIukError: start-on-event=DemSatellite_0InternalBehavior/GetEventExtendedDataRecordEx, operation=Event_CantrcvEBusIukError.GetEventExtendedDataRecordEx
        OpEventGetEventExtendedDataRecordEx_GetEventExtendedDataRecordEx_EvtInfo_SwtInternalCheckFailure: start-on-event=DemSatellite_0InternalBehavior/GetEventExtendedDataRecordEx, operation=EvtInfo_SwtInternalCheckFailure.GetEventExtendedDataRecordEx
        OpEventGetEventExtendedDataRecordEx_GetEventExtendedDataRecordEx_Event_SwtInternalCheckFailure: start-on-event=DemSatellite_0InternalBehavior/GetEventExtendedDataRecordEx, operation=Event_SwtInternalCheckFailure.GetEventExtendedDataRecordEx
        OpEventGetEventExtendedDataRecordEx_GetEventExtendedDataRecordEx_EvtInfo_DmTestAppl: start-on-event=DemSatellite_0InternalBehavior/GetEventExtendedDataRecordEx, operation=EvtInfo_DmTestAppl.GetEventExtendedDataRecordEx
        OpEventGetEventExtendedDataRecordEx_GetEventExtendedDataRecordEx_Event_DmTestAppl: start-on-event=DemSatellite_0InternalBehavior/GetEventExtendedDataRecordEx, operation=Event_DmTestAppl.GetEventExtendedDataRecordEx
        OpEventGetEventExtendedDataRecordEx_GetEventExtendedDataRecordEx_EvtInfo_Dtc000032: start-on-event=DemSatellite_0InternalBehavior/GetEventExtendedDataRecordEx, operation=EvtInfo_Dtc000032.GetEventExtendedDataRecordEx
        OpEventGetEventExtendedDataRecordEx_GetEventExtendedDataRecordEx_Event_Dtc000032: start-on-event=DemSatellite_0InternalBehavior/GetEventExtendedDataRecordEx, operation=Event_Dtc000032.GetEventExtendedDataRecordEx
        OpEventGetEventExtendedDataRecordEx_GetEventExtendedDataRecordEx_EvtInfo_Dtc000031: start-on-event=DemSatellite_0InternalBehavior/GetEventExtendedDataRecordEx, operation=EvtInfo_Dtc000031.GetEventExtendedDataRecordEx
        OpEventGetEventExtendedDataRecordEx_GetEventExtendedDataRecordEx_Event_Dtc000031: start-on-event=DemSatellite_0InternalBehavior/GetEventExtendedDataRecordEx, operation=Event_Dtc000031.GetEventExtendedDataRecordEx
        OpEventGetEventExtendedDataRecordEx_GetEventExtendedDataRecordEx_EvtInfo_FrsmEClusterSyncLoss: start-on-event=DemSatellite_0InternalBehavior/GetEventExtendedDataRecordEx, operation=EvtInfo_FrsmEClusterSyncLoss.GetEventExtendedDataRecordEx
        OpEventGetEventExtendedDataRecordEx_GetEventExtendedDataRecordEx_Event_FrsmEClusterSyncLoss: start-on-event=DemSatellite_0InternalBehavior/GetEventExtendedDataRecordEx, operation=Event_FrsmEClusterSyncLoss.GetEventExtendedDataRecordEx
        OpEventGetEventExtendedDataRecordEx_GetEventExtendedDataRecordEx_EvtInfo_Dtc000030: start-on-event=DemSatellite_0InternalBehavior/GetEventExtendedDataRecordEx, operation=EvtInfo_Dtc000030.GetEventExtendedDataRecordEx
        OpEventGetEventExtendedDataRecordEx_GetEventExtendedDataRecordEx_Event_Dtc000030: start-on-event=DemSatellite_0InternalBehavior/GetEventExtendedDataRecordEx, operation=Event_Dtc000030.GetEventExtendedDataRecordEx
        OpEventGetEventExtendedDataRecordEx_GetEventExtendedDataRecordEx_EvtInfo_Dtc000034: start-on-event=DemSatellite_0InternalBehavior/GetEventExtendedDataRecordEx, operation=EvtInfo_Dtc000034.GetEventExtendedDataRecordEx
        OpEventGetEventExtendedDataRecordEx_GetEventExtendedDataRecordEx_Event_Dtc000034: start-on-event=DemSatellite_0InternalBehavior/GetEventExtendedDataRecordEx, operation=Event_Dtc000034.GetEventExtendedDataRecordEx
        OpEventGetEventExtendedDataRecordEx_GetEventExtendedDataRecordEx_EvtInfo_Dtc000033: start-on-event=DemSatellite_0InternalBehavior/GetEventExtendedDataRecordEx, operation=EvtInfo_Dtc000033.GetEventExtendedDataRecordEx
        OpEventGetEventExtendedDataRecordEx_GetEventExtendedDataRecordEx_Event_Dtc000033: start-on-event=DemSatellite_0InternalBehavior/GetEventExtendedDataRecordEx, operation=Event_Dtc000033.GetEventExtendedDataRecordEx
        OpEventGetEventExtendedDataRecordEx_GetEventExtendedDataRecordEx_EvtInfo_Undervoltage: start-on-event=DemSatellite_0InternalBehavior/GetEventExtendedDataRecordEx, operation=EvtInfo_Undervoltage.GetEventExtendedDataRecordEx
        OpEventGetEventExtendedDataRecordEx_GetEventExtendedDataRecordEx_Event_Undervoltage: start-on-event=DemSatellite_0InternalBehavior/GetEventExtendedDataRecordEx, operation=Event_Undervoltage.GetEventExtendedDataRecordEx
        OpEventGetEventExtendedDataRecordEx_GetEventExtendedDataRecordEx_EvtInfo_CodingEventTransactionFailed: start-on-event=DemSatellite_0InternalBehavior/GetEventExtendedDataRecordEx, operation=EvtInfo_CodingEventTransactionFailed.GetEventExtendedDataRecordEx
        OpEventGetEventExtendedDataRecordEx_GetEventExtendedDataRecordEx_Event_CodingEventTransactionFailed: start-on-event=DemSatellite_0InternalBehavior/GetEventExtendedDataRecordEx, operation=Event_CodingEventTransactionFailed.GetEventExtendedDataRecordEx
        OpEventGetEventExtendedDataRecordEx_GetEventExtendedDataRecordEx_EvtInfo_FrifENitChA: start-on-event=DemSatellite_0InternalBehavior/GetEventExtendedDataRecordEx, operation=EvtInfo_FrifENitChA.GetEventExtendedDataRecordEx
        OpEventGetEventExtendedDataRecordEx_GetEventExtendedDataRecordEx_Event_FrifENitChA: start-on-event=DemSatellite_0InternalBehavior/GetEventExtendedDataRecordEx, operation=Event_FrifENitChA.GetEventExtendedDataRecordEx
        OpEventGetEventExtendedDataRecordEx_GetEventExtendedDataRecordEx_EvtInfo_CansmEBusLpCanOff: start-on-event=DemSatellite_0InternalBehavior/GetEventExtendedDataRecordEx, operation=EvtInfo_CansmEBusLpCanOff.GetEventExtendedDataRecordEx
        OpEventGetEventExtendedDataRecordEx_GetEventExtendedDataRecordEx_Event_CansmEBusLpCanOff: start-on-event=DemSatellite_0InternalBehavior/GetEventExtendedDataRecordEx, operation=Event_CansmEBusLpCanOff.GetEventExtendedDataRecordEx
        OpEventGetEventExtendedDataRecordEx_GetEventExtendedDataRecordEx_EvtInfo_NVM_E_HARDWARE: start-on-event=DemSatellite_0InternalBehavior/GetEventExtendedDataRecordEx, operation=EvtInfo_NVM_E_HARDWARE.GetEventExtendedDataRecordEx
        OpEventGetEventExtendedDataRecordEx_GetEventExtendedDataRecordEx_EvtInfo_VsmEventOpmode: start-on-event=DemSatellite_0InternalBehavior/GetEventExtendedDataRecordEx, operation=EvtInfo_VsmEventOpmode.GetEventExtendedDataRecordEx
        OpEventGetEventExtendedDataRecordEx_GetEventExtendedDataRecordEx_Event_VsmEventOpmode: start-on-event=DemSatellite_0InternalBehavior/GetEventExtendedDataRecordEx, operation=Event_VsmEventOpmode.GetEventExtendedDataRecordEx
        OpEventGetEventExtendedDataRecordEx_GetEventExtendedDataRecordEx_EvtInfo_LIN_E_TIMEOUT: start-on-event=DemSatellite_0InternalBehavior/GetEventExtendedDataRecordEx, operation=EvtInfo_LIN_E_TIMEOUT.GetEventExtendedDataRecordEx
        OpEventGetEventExtendedDataRecordEx_GetEventExtendedDataRecordEx_EvtInfo_CantrcvEBusACanError: start-on-event=DemSatellite_0InternalBehavior/GetEventExtendedDataRecordEx, operation=EvtInfo_CantrcvEBusACanError.GetEventExtendedDataRecordEx
        OpEventGetEventExtendedDataRecordEx_GetEventExtendedDataRecordEx_Event_CantrcvEBusACanError: start-on-event=DemSatellite_0InternalBehavior/GetEventExtendedDataRecordEx, operation=Event_CantrcvEBusACanError.GetEventExtendedDataRecordEx
        OpEventGetEventExtendedDataRecordEx_GetEventExtendedDataRecordEx_EvtInfo_UDPNM_E_TCPIP_TRANSMIT_ERROR: start-on-event=DemSatellite_0InternalBehavior/GetEventExtendedDataRecordEx, operation=EvtInfo_UDPNM_E_TCPIP_TRANSMIT_ERROR.GetEventExtendedDataRecordEx
        OpEventGetEventExtendedDataRecordEx_GetEventExtendedDataRecordEx_EvtInfo_DmTestCom: start-on-event=DemSatellite_0InternalBehavior/GetEventExtendedDataRecordEx, operation=EvtInfo_DmTestCom.GetEventExtendedDataRecordEx
        OpEventGetEventExtendedDataRecordEx_GetEventExtendedDataRecordEx_Event_DmTestCom: start-on-event=DemSatellite_0InternalBehavior/GetEventExtendedDataRecordEx, operation=Event_DmTestCom.GetEventExtendedDataRecordEx
        OpEventGetEventExtendedDataRecordEx_GetEventExtendedDataRecordEx_EvtInfo_CodingEventSignatureError: start-on-event=DemSatellite_0InternalBehavior/GetEventExtendedDataRecordEx, operation=EvtInfo_CodingEventSignatureError.GetEventExtendedDataRecordEx
        OpEventGetEventExtendedDataRecordEx_GetEventExtendedDataRecordEx_Event_CodingEventSignatureError: start-on-event=DemSatellite_0InternalBehavior/GetEventExtendedDataRecordEx, operation=Event_CodingEventSignatureError.GetEventExtendedDataRecordEx
        OpEventGetEventExtendedDataRecordEx_GetEventExtendedDataRecordEx_EvtInfo_CodingEventUnqualifiedData: start-on-event=DemSatellite_0InternalBehavior/GetEventExtendedDataRecordEx, operation=EvtInfo_CodingEventUnqualifiedData.GetEventExtendedDataRecordEx
        OpEventGetEventExtendedDataRecordEx_GetEventExtendedDataRecordEx_Event_CodingEventUnqualifiedData: start-on-event=DemSatellite_0InternalBehavior/GetEventExtendedDataRecordEx, operation=Event_CodingEventUnqualifiedData.GetEventExtendedDataRecordEx
        OpEventGetEventExtendedDataRecordEx_GetEventExtendedDataRecordEx_EvtInfo_CodingEventInvalidData: start-on-event=DemSatellite_0InternalBehavior/GetEventExtendedDataRecordEx, operation=EvtInfo_CodingEventInvalidData.GetEventExtendedDataRecordEx
        OpEventGetEventExtendedDataRecordEx_GetEventExtendedDataRecordEx_Event_CodingEventInvalidData: start-on-event=DemSatellite_0InternalBehavior/GetEventExtendedDataRecordEx, operation=Event_CodingEventInvalidData.GetEventExtendedDataRecordEx
        OpEventGetEventExtendedDataRecordEx_GetEventExtendedDataRecordEx_EvtInfo_CansmEBusB2CanOff: start-on-event=DemSatellite_0InternalBehavior/GetEventExtendedDataRecordEx, operation=EvtInfo_CansmEBusB2CanOff.GetEventExtendedDataRecordEx
        OpEventGetEventExtendedDataRecordEx_GetEventExtendedDataRecordEx_Event_CansmEBusB2CanOff: start-on-event=DemSatellite_0InternalBehavior/GetEventExtendedDataRecordEx, operation=Event_CansmEBusB2CanOff.GetEventExtendedDataRecordEx
        OpEventGetEventExtendedDataRecordEx_GetEventExtendedDataRecordEx_EvtInfo_Overvoltage: start-on-event=DemSatellite_0InternalBehavior/GetEventExtendedDataRecordEx, operation=EvtInfo_Overvoltage.GetEventExtendedDataRecordEx
        OpEventGetEventExtendedDataRecordEx_GetEventExtendedDataRecordEx_Event_Overvoltage: start-on-event=DemSatellite_0InternalBehavior/GetEventExtendedDataRecordEx, operation=Event_Overvoltage.GetEventExtendedDataRecordEx
        OpEventGetEventExtendedDataRecordEx_GetEventExtendedDataRecordEx_EvtInfo_CodingEventNotCoded: start-on-event=DemSatellite_0InternalBehavior/GetEventExtendedDataRecordEx, operation=EvtInfo_CodingEventNotCoded.GetEventExtendedDataRecordEx
        OpEventGetEventExtendedDataRecordEx_GetEventExtendedDataRecordEx_Event_CodingEventNotCoded: start-on-event=DemSatellite_0InternalBehavior/GetEventExtendedDataRecordEx, operation=Event_CodingEventNotCoded.GetEventExtendedDataRecordEx
        OpEventGetEventExtendedDataRecordEx_GetEventExtendedDataRecordEx_EvtInfo_FrifEAcsChA: start-on-event=DemSatellite_0InternalBehavior/GetEventExtendedDataRecordEx, operation=EvtInfo_FrifEAcsChA.GetEventExtendedDataRecordEx
        OpEventGetEventExtendedDataRecordEx_GetEventExtendedDataRecordEx_Event_FrifEAcsChA: start-on-event=DemSatellite_0InternalBehavior/GetEventExtendedDataRecordEx, operation=Event_FrifEAcsChA.GetEventExtendedDataRecordEx
        OpEventGetEventExtendedDataRecordEx_GetEventExtendedDataRecordEx_EvtInfo_CantrcvEBusFaCanError: start-on-event=DemSatellite_0InternalBehavior/GetEventExtendedDataRecordEx, operation=EvtInfo_CantrcvEBusFaCanError.GetEventExtendedDataRecordEx
        OpEventGetEventExtendedDataRecordEx_GetEventExtendedDataRecordEx_Event_CantrcvEBusFaCanError: start-on-event=DemSatellite_0InternalBehavior/GetEventExtendedDataRecordEx, operation=Event_CantrcvEBusFaCanError.GetEventExtendedDataRecordEx
        OpEventGetEventExtendedDataRecordEx_GetEventExtendedDataRecordEx_EvtInfo_CantrcvEBusLeCanError: start-on-event=DemSatellite_0InternalBehavior/GetEventExtendedDataRecordEx, operation=EvtInfo_CantrcvEBusLeCanError.GetEventExtendedDataRecordEx
        OpEventGetEventExtendedDataRecordEx_GetEventExtendedDataRecordEx_Event_CantrcvEBusLeCanError: start-on-event=DemSatellite_0InternalBehavior/GetEventExtendedDataRecordEx, operation=Event_CantrcvEBusLeCanError.GetEventExtendedDataRecordEx
        OpEventGetEventExtendedDataRecordEx_GetEventExtendedDataRecordEx_EvtInfo_CantrcvEBusLpCanError: start-on-event=DemSatellite_0InternalBehavior/GetEventExtendedDataRecordEx, operation=EvtInfo_CantrcvEBusLpCanError.GetEventExtendedDataRecordEx
        OpEventGetEventExtendedDataRecordEx_GetEventExtendedDataRecordEx_Event_CantrcvEBusLpCanError: start-on-event=DemSatellite_0InternalBehavior/GetEventExtendedDataRecordEx, operation=Event_CantrcvEBusLpCanError.GetEventExtendedDataRecordEx
        OpEventGetEventExtendedDataRecordEx_GetEventExtendedDataRecordEx_EvtInfo_CantrcvEBusZsgCanError: start-on-event=DemSatellite_0InternalBehavior/GetEventExtendedDataRecordEx, operation=EvtInfo_CantrcvEBusZsgCanError.GetEventExtendedDataRecordEx
        OpEventGetEventExtendedDataRecordEx_GetEventExtendedDataRecordEx_Event_CantrcvEBusZsgCanError: start-on-event=DemSatellite_0InternalBehavior/GetEventExtendedDataRecordEx, operation=Event_CantrcvEBusZsgCanError.GetEventExtendedDataRecordEx
        OpEventGetEventExtendedDataRecordEx_GetEventExtendedDataRecordEx_EvtInfo_EthSignalQualityLow: start-on-event=DemSatellite_0InternalBehavior/GetEventExtendedDataRecordEx, operation=EvtInfo_EthSignalQualityLow.GetEventExtendedDataRecordEx
        OpEventGetEventExtendedDataRecordEx_GetEventExtendedDataRecordEx_Event_EthSignalQualityLow: start-on-event=DemSatellite_0InternalBehavior/GetEventExtendedDataRecordEx, operation=Event_EthSignalQualityLow.GetEventExtendedDataRecordEx
        OpEventGetEventExtendedDataRecordEx_GetEventExtendedDataRecordEx_EvtInfo_DemEventParameter_FlsConfigSet_FLS_E_COMPARE_FAILED: start-on-event=DemSatellite_0InternalBehavior/GetEventExtendedDataRecordEx, operation=EvtInfo_DemEventParameter_FlsConfigSet_FLS_E_COMPARE_FAILED.GetEventExtendedDataRecordEx
        OpEventGetEventExtendedDataRecordEx_GetEventExtendedDataRecordEx_EvtInfo_DemEventParameter_FlsConfigSet_FLS_E_ERASE_FAILED: start-on-event=DemSatellite_0InternalBehavior/GetEventExtendedDataRecordEx, operation=EvtInfo_DemEventParameter_FlsConfigSet_FLS_E_ERASE_FAILED.GetEventExtendedDataRecordEx
        OpEventGetEventExtendedDataRecordEx_GetEventExtendedDataRecordEx_EvtInfo_DemEventParameter_FlsConfigSet_FLS_E_READ_FAILED: start-on-event=DemSatellite_0InternalBehavior/GetEventExtendedDataRecordEx, operation=EvtInfo_DemEventParameter_FlsConfigSet_FLS_E_READ_FAILED.GetEventExtendedDataRecordEx
        OpEventGetEventExtendedDataRecordEx_GetEventExtendedDataRecordEx_EvtInfo_DemEventParameter_FlsConfigSet_FLS_E_WRITE_FAILED: start-on-event=DemSatellite_0InternalBehavior/GetEventExtendedDataRecordEx, operation=EvtInfo_DemEventParameter_FlsConfigSet_FLS_E_WRITE_FAILED.GetEventExtendedDataRecordEx
        OpEventGetEventExtendedDataRecordEx_GetEventExtendedDataRecordEx_EvtInfo_DemEventParameter_FlsConfigSet_FLS_E_READ_DED_FAILED: start-on-event=DemSatellite_0InternalBehavior/GetEventExtendedDataRecordEx, operation=EvtInfo_DemEventParameter_FlsConfigSet_FLS_E_READ_DED_FAILED.GetEventExtendedDataRecordEx
        OpEventGetEventExtendedDataRecordEx_GetEventExtendedDataRecordEx_EvtInfo_DemEventParameter_FlsConfigSet_FLS_E_UNEXPECTE_bccf2493: start-on-event=DemSatellite_0InternalBehavior/GetEventExtendedDataRecordEx, operation=EvtInfo_DemEventParameter_FlsConfigSet_FLS_E_UNEXPECTED_FLASH_ID.GetEventExtendedDataRecordEx
        OpEventGetEventExtendedDataRecordEx_GetEventExtendedDataRecordEx_EvtInfo_DemEventParameter_FlsConfigSet_MCU_E_CLOCK_FAILED: start-on-event=DemSatellite_0InternalBehavior/GetEventExtendedDataRecordEx, operation=EvtInfo_DemEventParameter_FlsConfigSet_MCU_E_CLOCK_FAILED.GetEventExtendedDataRecordEx
        OpEventGetEventExtendedDataRecordEx_GetEventExtendedDataRecordEx_EvtInfo_DemEventParameter_FlsConfigSet_MCU_E_HW_FAILED: start-on-event=DemSatellite_0InternalBehavior/GetEventExtendedDataRecordEx, operation=EvtInfo_DemEventParameter_FlsConfigSet_MCU_E_HW_FAILED.GetEventExtendedDataRecordEx
        OpEventGetEventExtendedDataRecordEx_GetEventExtendedDataRecordEx_EvtInfo_DemEventParameter_FlsConfigSet_MCU_E_STARTUP_FAILED: start-on-event=DemSatellite_0InternalBehavior/GetEventExtendedDataRecordEx, operation=EvtInfo_DemEventParameter_FlsConfigSet_MCU_E_STARTUP_FAILED.GetEventExtendedDataRecordEx
        OpEventGetEventExtendedDataRecordEx_GetEventExtendedDataRecordEx_EvtInfo_DemEventParameter_FlsConfigSet_FLS_E_ECC_FAILED: start-on-event=DemSatellite_0InternalBehavior/GetEventExtendedDataRecordEx, operation=EvtInfo_DemEventParameter_FlsConfigSet_FLS_E_ECC_FAILED.GetEventExtendedDataRecordEx
        OpEventGetEventExtendedDataRecordEx_GetEventExtendedDataRecordEx_EvtInfo_DemEventParameter_FlsConfigSet_FLS_E_VRFY_FAILED: start-on-event=DemSatellite_0InternalBehavior/GetEventExtendedDataRecordEx, operation=EvtInfo_DemEventParameter_FlsConfigSet_FLS_E_VRFY_FAILED.GetEventExtendedDataRecordEx
        OpEventGetEventExtendedDataRecordEx_GetEventExtendedDataRecordEx_EvtInfo_DemEventParameter_FlsConfigSet_FLS_E_INT_FAILED: start-on-event=DemSatellite_0InternalBehavior/GetEventExtendedDataRecordEx, operation=EvtInfo_DemEventParameter_FlsConfigSet_FLS_E_INT_FAILED.GetEventExtendedDataRecordEx
        OpEventGetEventExtendedDataRecordEx_GetEventExtendedDataRecordEx_EvtInfo_DemEventParameter_FlsConfigSet_FLS_E_HW_FAILED: start-on-event=DemSatellite_0InternalBehavior/GetEventExtendedDataRecordEx, operation=EvtInfo_DemEventParameter_FlsConfigSet_FLS_E_HW_FAILED.GetEventExtendedDataRecordEx
        OpEventGetEventExtendedDataRecordEx_GetEventExtendedDataRecordEx_GeneralEventInfo: start-on-event=DemSatellite_0InternalBehavior/GetEventExtendedDataRecordEx, operation=GeneralEventInfo.GetEventExtendedDataRecordEx
        OpEventGetEventEnableCondition_GetEventEnableCondition_EvtInfo_FrtrcvEFrErrnTrcv0: start-on-event=DemSatellite_0InternalBehavior/GetEventEnableCondition, operation=EvtInfo_FrtrcvEFrErrnTrcv0.GetEventEnableCondition
        OpEventGetEventEnableCondition_GetEventEnableCondition_EvtInfo_CansmEBusIukCanOff: start-on-event=DemSatellite_0InternalBehavior/GetEventEnableCondition, operation=EvtInfo_CansmEBusIukCanOff.GetEventEnableCondition
        OpEventGetEventEnableCondition_GetEventEnableCondition_EvtInfo_FrtrcvEFrErrnTrcv2: start-on-event=DemSatellite_0InternalBehavior/GetEventEnableCondition, operation=EvtInfo_FrtrcvEFrErrnTrcv2.GetEventEnableCondition
        OpEventGetEventEnableCondition_GetEventEnableCondition_EvtInfo_FrtrcvEFrErrnTrcv1: start-on-event=DemSatellite_0InternalBehavior/GetEventEnableCondition, operation=EvtInfo_FrtrcvEFrErrnTrcv1.GetEventEnableCondition
        OpEventGetEventEnableCondition_GetEventEnableCondition_EvtInfo_FrtrcvEFrErrnTrcv4: start-on-event=DemSatellite_0InternalBehavior/GetEventEnableCondition, operation=EvtInfo_FrtrcvEFrErrnTrcv4.GetEventEnableCondition
        OpEventGetEventEnableCondition_GetEventEnableCondition_EvtInfo_FrtrcvEFrErrnTrcv3: start-on-event=DemSatellite_0InternalBehavior/GetEventEnableCondition, operation=EvtInfo_FrtrcvEFrErrnTrcv3.GetEventEnableCondition
        OpEventGetEventEnableCondition_GetEventEnableCondition_EvtInfo_FrtrcvEFrErrnTrcv6: start-on-event=DemSatellite_0InternalBehavior/GetEventEnableCondition, operation=EvtInfo_FrtrcvEFrErrnTrcv6.GetEventEnableCondition
        OpEventGetEventEnableCondition_GetEventEnableCondition_EvtInfo_FrtrcvEFrErrnTrcv5: start-on-event=DemSatellite_0InternalBehavior/GetEventEnableCondition, operation=EvtInfo_FrtrcvEFrErrnTrcv5.GetEventEnableCondition
        OpEventGetEventEnableCondition_GetEventEnableCondition_EvtInfo_CansmEBusBodyCanOff: start-on-event=DemSatellite_0InternalBehavior/GetEventEnableCondition, operation=EvtInfo_CansmEBusBodyCanOff.GetEventEnableCondition
        OpEventGetEventEnableCondition_GetEventEnableCondition_EvtInfo_CbsReplacementValue: start-on-event=DemSatellite_0InternalBehavior/GetEventEnableCondition, operation=EvtInfo_CbsReplacementValue.GetEventEnableCondition
        OpEventGetEventEnableCondition_GetEventEnableCondition_EvtInfo_CansmEBusLeCanOff: start-on-event=DemSatellite_0InternalBehavior/GetEventEnableCondition, operation=EvtInfo_CansmEBusLeCanOff.GetEventEnableCondition
        OpEventGetEventEnableCondition_GetEventEnableCondition_EvtInfo_CansmEBusZsgCanOff: start-on-event=DemSatellite_0InternalBehavior/GetEventEnableCondition, operation=EvtInfo_CansmEBusZsgCanOff.GetEventEnableCondition
        OpEventGetEventEnableCondition_GetEventEnableCondition_EvtInfo_CodingEventWrongVehicle: start-on-event=DemSatellite_0InternalBehavior/GetEventEnableCondition, operation=EvtInfo_CodingEventWrongVehicle.GetEventEnableCondition
        OpEventGetEventEnableCondition_GetEventEnableCondition_EvtInfo_FrsmEClusterStartup: start-on-event=DemSatellite_0InternalBehavior/GetEventEnableCondition, operation=EvtInfo_FrsmEClusterStartup.GetEventEnableCondition
        OpEventGetEventEnableCondition_GetEventEnableCondition_EvtInfo_CansmEBusACanOff: start-on-event=DemSatellite_0InternalBehavior/GetEventEnableCondition, operation=EvtInfo_CansmEBusACanOff.GetEventEnableCondition
        OpEventGetEventEnableCondition_GetEventEnableCondition_EvtInfo_CansmEBusKCanOff: start-on-event=DemSatellite_0InternalBehavior/GetEventEnableCondition, operation=EvtInfo_CansmEBusKCanOff.GetEventEnableCondition
        OpEventGetEventEnableCondition_GetEventEnableCondition_EvtInfo_CantrcvEBusKCanError: start-on-event=DemSatellite_0InternalBehavior/GetEventEnableCondition, operation=EvtInfo_CantrcvEBusKCanError.GetEventEnableCondition
        OpEventGetEventEnableCondition_GetEventEnableCondition_EvtInfo_FrtrcvEFrBuserrorTrcv0: start-on-event=DemSatellite_0InternalBehavior/GetEventEnableCondition, operation=EvtInfo_FrtrcvEFrBuserrorTrcv0.GetEventEnableCondition
        OpEventGetEventEnableCondition_GetEventEnableCondition_EvtInfo_FrtrcvEFrErrnTrcv7: start-on-event=DemSatellite_0InternalBehavior/GetEventEnableCondition, operation=EvtInfo_FrtrcvEFrErrnTrcv7.GetEventEnableCondition
        OpEventGetEventEnableCondition_GetEventEnableCondition_EvtInfo_CansmEBusFaCanOff: start-on-event=DemSatellite_0InternalBehavior/GetEventEnableCondition, operation=EvtInfo_CansmEBusFaCanOff.GetEventEnableCondition
        OpEventGetEventEnableCondition_GetEventEnableCondition_EvtInfo_CantrcvEBusB2CanError: start-on-event=DemSatellite_0InternalBehavior/GetEventEnableCondition, operation=EvtInfo_CantrcvEBusB2CanError.GetEventEnableCondition
        OpEventGetEventEnableCondition_GetEventEnableCondition_EvtInfo_DtcCd{0605..0607}: start-on-event=DemSatellite_0InternalBehavior/GetEventEnableCondition, operation=EvtInfo_DtcCd{0605..0607}.GetEventEnableCondition
        OpEventGetEventEnableCondition_GetEventEnableCondition_EvtInfo_PiaEIoError: start-on-event=DemSatellite_0InternalBehavior/GetEventEnableCondition, operation=EvtInfo_PiaEIoError.GetEventEnableCondition
        OpEventGetEventEnableCondition_GetEventEnableCondition_EvtInfo_DtcCd0601: start-on-event=DemSatellite_0InternalBehavior/GetEventEnableCondition, operation=EvtInfo_DtcCd0601.GetEventEnableCondition
        OpEventGetEventEnableCondition_GetEventEnableCondition_EvtInfo_SwtExternalCheckFailure: start-on-event=DemSatellite_0InternalBehavior/GetEventEnableCondition, operation=EvtInfo_SwtExternalCheckFailure.GetEventEnableCondition
        OpEventGetEventEnableCondition_GetEventEnableCondition_EvtInfo_CantrcvEBusBodyCanError: start-on-event=DemSatellite_0InternalBehavior/GetEventEnableCondition, operation=EvtInfo_CantrcvEBusBodyCanError.GetEventEnableCondition
        OpEventGetEventEnableCondition_GetEventEnableCondition_EvtInfo_CantrcvEBusIukError: start-on-event=DemSatellite_0InternalBehavior/GetEventEnableCondition, operation=EvtInfo_CantrcvEBusIukError.GetEventEnableCondition
        OpEventGetEventEnableCondition_GetEventEnableCondition_EvtInfo_SwtInternalCheckFailure: start-on-event=DemSatellite_0InternalBehavior/GetEventEnableCondition, operation=EvtInfo_SwtInternalCheckFailure.GetEventEnableCondition
        OpEventGetEventEnableCondition_GetEventEnableCondition_EvtInfo_DmTestAppl: start-on-event=DemSatellite_0InternalBehavior/GetEventEnableCondition, operation=EvtInfo_DmTestAppl.GetEventEnableCondition
        OpEventGetEventEnableCondition_GetEventEnableCondition_EvtInfo_Dtc000032: start-on-event=DemSatellite_0InternalBehavior/GetEventEnableCondition, operation=EvtInfo_Dtc000032.GetEventEnableCondition
        OpEventGetEventEnableCondition_GetEventEnableCondition_EvtInfo_Dtc000031: start-on-event=DemSatellite_0InternalBehavior/GetEventEnableCondition, operation=EvtInfo_Dtc000031.GetEventEnableCondition
        OpEventGetEventEnableCondition_GetEventEnableCondition_EvtInfo_FrsmEClusterSyncLoss: start-on-event=DemSatellite_0InternalBehavior/GetEventEnableCondition, operation=EvtInfo_FrsmEClusterSyncLoss.GetEventEnableCondition
        OpEventGetEventEnableCondition_GetEventEnableCondition_EvtInfo_Dtc000030: start-on-event=DemSatellite_0InternalBehavior/GetEventEnableCondition, operation=EvtInfo_Dtc000030.GetEventEnableCondition
        OpEventGetEventEnableCondition_GetEventEnableCondition_EvtInfo_Dtc000034: start-on-event=DemSatellite_0InternalBehavior/GetEventEnableCondition, operation=EvtInfo_Dtc000034.GetEventEnableCondition
        OpEventGetEventEnableCondition_GetEventEnableCondition_EvtInfo_Dtc000033: start-on-event=DemSatellite_0InternalBehavior/GetEventEnableCondition, operation=EvtInfo_Dtc000033.GetEventEnableCondition
        OpEventGetEventEnableCondition_GetEventEnableCondition_EvtInfo_Undervoltage: start-on-event=DemSatellite_0InternalBehavior/GetEventEnableCondition, operation=EvtInfo_Undervoltage.GetEventEnableCondition
        OpEventGetEventEnableCondition_GetEventEnableCondition_EvtInfo_CodingEventTransactionFailed: start-on-event=DemSatellite_0InternalBehavior/GetEventEnableCondition, operation=EvtInfo_CodingEventTransactionFailed.GetEventEnableCondition
        OpEventGetEventEnableCondition_GetEventEnableCondition_EvtInfo_FrifENitChA: start-on-event=DemSatellite_0InternalBehavior/GetEventEnableCondition, operation=EvtInfo_FrifENitChA.GetEventEnableCondition
        OpEventGetEventEnableCondition_GetEventEnableCondition_EvtInfo_CansmEBusLpCanOff: start-on-event=DemSatellite_0InternalBehavior/GetEventEnableCondition, operation=EvtInfo_CansmEBusLpCanOff.GetEventEnableCondition
        OpEventGetEventEnableCondition_GetEventEnableCondition_EvtInfo_NVM_E_HARDWARE: start-on-event=DemSatellite_0InternalBehavior/GetEventEnableCondition, operation=EvtInfo_NVM_E_HARDWARE.GetEventEnableCondition
        OpEventGetEventEnableCondition_GetEventEnableCondition_EvtInfo_VsmEventOpmode: start-on-event=DemSatellite_0InternalBehavior/GetEventEnableCondition, operation=EvtInfo_VsmEventOpmode.GetEventEnableCondition
        OpEventGetEventEnableCondition_GetEventEnableCondition_EvtInfo_LIN_E_TIMEOUT: start-on-event=DemSatellite_0InternalBehavior/GetEventEnableCondition, operation=EvtInfo_LIN_E_TIMEOUT.GetEventEnableCondition
        OpEventGetEventEnableCondition_GetEventEnableCondition_EvtInfo_CantrcvEBusACanError: start-on-event=DemSatellite_0InternalBehavior/GetEventEnableCondition, operation=EvtInfo_CantrcvEBusACanError.GetEventEnableCondition
        OpEventGetEventEnableCondition_GetEventEnableCondition_EvtInfo_UDPNM_E_TCPIP_TRANSMIT_ERROR: start-on-event=DemSatellite_0InternalBehavior/GetEventEnableCondition, operation=EvtInfo_UDPNM_E_TCPIP_TRANSMIT_ERROR.GetEventEnableCondition
        OpEventGetEventEnableCondition_GetEventEnableCondition_EvtInfo_DmTestCom: start-on-event=DemSatellite_0InternalBehavior/GetEventEnableCondition, operation=EvtInfo_DmTestCom.GetEventEnableCondition
        OpEventGetEventEnableCondition_GetEventEnableCondition_EvtInfo_CodingEventSignatureError: start-on-event=DemSatellite_0InternalBehavior/GetEventEnableCondition, operation=EvtInfo_CodingEventSignatureError.GetEventEnableCondition
        OpEventGetEventEnableCondition_GetEventEnableCondition_EvtInfo_CodingEventUnqualifiedData: start-on-event=DemSatellite_0InternalBehavior/GetEventEnableCondition, operation=EvtInfo_CodingEventUnqualifiedData.GetEventEnableCondition
        OpEventGetEventEnableCondition_GetEventEnableCondition_EvtInfo_CodingEventInvalidData: start-on-event=DemSatellite_0InternalBehavior/GetEventEnableCondition, operation=EvtInfo_CodingEventInvalidData.GetEventEnableCondition
        OpEventGetEventEnableCondition_GetEventEnableCondition_EvtInfo_CansmEBusB2CanOff: start-on-event=DemSatellite_0InternalBehavior/GetEventEnableCondition, operation=EvtInfo_CansmEBusB2CanOff.GetEventEnableCondition
        OpEventGetEventEnableCondition_GetEventEnableCondition_EvtInfo_Overvoltage: start-on-event=DemSatellite_0InternalBehavior/GetEventEnableCondition, operation=EvtInfo_Overvoltage.GetEventEnableCondition
        OpEventGetEventEnableCondition_GetEventEnableCondition_EvtInfo_CodingEventNotCoded: start-on-event=DemSatellite_0InternalBehavior/GetEventEnableCondition, operation=EvtInfo_CodingEventNotCoded.GetEventEnableCondition
        OpEventGetEventEnableCondition_GetEventEnableCondition_EvtInfo_FrifEAcsChA: start-on-event=DemSatellite_0InternalBehavior/GetEventEnableCondition, operation=EvtInfo_FrifEAcsChA.GetEventEnableCondition
        OpEventGetEventEnableCondition_GetEventEnableCondition_EvtInfo_CantrcvEBusFaCanError: start-on-event=DemSatellite_0InternalBehavior/GetEventEnableCondition, operation=EvtInfo_CantrcvEBusFaCanError.GetEventEnableCondition
        OpEventGetEventEnableCondition_GetEventEnableCondition_EvtInfo_CantrcvEBusLeCanError: start-on-event=DemSatellite_0InternalBehavior/GetEventEnableCondition, operation=EvtInfo_CantrcvEBusLeCanError.GetEventEnableCondition
        OpEventGetEventEnableCondition_GetEventEnableCondition_EvtInfo_CantrcvEBusLpCanError: start-on-event=DemSatellite_0InternalBehavior/GetEventEnableCondition, operation=EvtInfo_CantrcvEBusLpCanError.GetEventEnableCondition
        OpEventGetEventEnableCondition_GetEventEnableCondition_EvtInfo_CantrcvEBusZsgCanError: start-on-event=DemSatellite_0InternalBehavior/GetEventEnableCondition, operation=EvtInfo_CantrcvEBusZsgCanError.GetEventEnableCondition
        OpEventGetEventEnableCondition_GetEventEnableCondition_EvtInfo_EthSignalQualityLow: start-on-event=DemSatellite_0InternalBehavior/GetEventEnableCondition, operation=EvtInfo_EthSignalQualityLow.GetEventEnableCondition
        OpEventGetEventEnableCondition_GetEventEnableCondition_EvtInfo_DemEventParameter_FlsConfigSet_FLS_E_COMPARE_FAILED: start-on-event=DemSatellite_0InternalBehavior/GetEventEnableCondition, operation=EvtInfo_DemEventParameter_FlsConfigSet_FLS_E_COMPARE_FAILED.GetEventEnableCondition
        OpEventGetEventEnableCondition_GetEventEnableCondition_EvtInfo_DemEventParameter_FlsConfigSet_FLS_E_ERASE_FAILED: start-on-event=DemSatellite_0InternalBehavior/GetEventEnableCondition, operation=EvtInfo_DemEventParameter_FlsConfigSet_FLS_E_ERASE_FAILED.GetEventEnableCondition
        OpEventGetEventEnableCondition_GetEventEnableCondition_EvtInfo_DemEventParameter_FlsConfigSet_FLS_E_READ_FAILED: start-on-event=DemSatellite_0InternalBehavior/GetEventEnableCondition, operation=EvtInfo_DemEventParameter_FlsConfigSet_FLS_E_READ_FAILED.GetEventEnableCondition
        OpEventGetEventEnableCondition_GetEventEnableCondition_EvtInfo_DemEventParameter_FlsConfigSet_FLS_E_WRITE_FAILED: start-on-event=DemSatellite_0InternalBehavior/GetEventEnableCondition, operation=EvtInfo_DemEventParameter_FlsConfigSet_FLS_E_WRITE_FAILED.GetEventEnableCondition
        OpEventGetEventEnableCondition_GetEventEnableCondition_EvtInfo_DemEventParameter_FlsConfigSet_FLS_E_READ_DED_FAILED: start-on-event=DemSatellite_0InternalBehavior/GetEventEnableCondition, operation=EvtInfo_DemEventParameter_FlsConfigSet_FLS_E_READ_DED_FAILED.GetEventEnableCondition
        OpEventGetEventEnableCondition_GetEventEnableCondition_EvtInfo_DemEventParameter_FlsConfigSet_FLS_E_UNEXPECTED_FLASH_ID: start-on-event=DemSatellite_0InternalBehavior/GetEventEnableCondition, operation=EvtInfo_DemEventParameter_FlsConfigSet_FLS_E_UNEXPECTED_FLASH_ID.GetEventEnableCondition
        OpEventGetEventEnableCondition_GetEventEnableCondition_EvtInfo_DemEventParameter_FlsConfigSet_MCU_E_CLOCK_FAILED: start-on-event=DemSatellite_0InternalBehavior/GetEventEnableCondition, operation=EvtInfo_DemEventParameter_FlsConfigSet_MCU_E_CLOCK_FAILED.GetEventEnableCondition
        OpEventGetEventEnableCondition_GetEventEnableCondition_EvtInfo_DemEventParameter_FlsConfigSet_MCU_E_HW_FAILED: start-on-event=DemSatellite_0InternalBehavior/GetEventEnableCondition, operation=EvtInfo_DemEventParameter_FlsConfigSet_MCU_E_HW_FAILED.GetEventEnableCondition
        OpEventGetEventEnableCondition_GetEventEnableCondition_EvtInfo_DemEventParameter_FlsConfigSet_MCU_E_STARTUP_FAILED: start-on-event=DemSatellite_0InternalBehavior/GetEventEnableCondition, operation=EvtInfo_DemEventParameter_FlsConfigSet_MCU_E_STARTUP_FAILED.GetEventEnableCondition
        OpEventGetEventEnableCondition_GetEventEnableCondition_EvtInfo_DemEventParameter_FlsConfigSet_FLS_E_ECC_FAILED: start-on-event=DemSatellite_0InternalBehavior/GetEventEnableCondition, operation=EvtInfo_DemEventParameter_FlsConfigSet_FLS_E_ECC_FAILED.GetEventEnableCondition
        OpEventGetEventEnableCondition_GetEventEnableCondition_EvtInfo_DemEventParameter_FlsConfigSet_FLS_E_VRFY_FAILED: start-on-event=DemSatellite_0InternalBehavior/GetEventEnableCondition, operation=EvtInfo_DemEventParameter_FlsConfigSet_FLS_E_VRFY_FAILED.GetEventEnableCondition
        OpEventGetEventEnableCondition_GetEventEnableCondition_EvtInfo_DemEventParameter_FlsConfigSet_FLS_E_INT_FAILED: start-on-event=DemSatellite_0InternalBehavior/GetEventEnableCondition, operation=EvtInfo_DemEventParameter_FlsConfigSet_FLS_E_INT_FAILED.GetEventEnableCondition
        OpEventGetEventEnableCondition_GetEventEnableCondition_EvtInfo_DemEventParameter_FlsConfigSet_FLS_E_HW_FAILED: start-on-event=DemSatellite_0InternalBehavior/GetEventEnableCondition, operation=EvtInfo_DemEventParameter_FlsConfigSet_FLS_E_HW_FAILED.GetEventEnableCondition
        OpEventGetEventEnableCondition_GetEventEnableCondition_GeneralEventInfo: start-on-event=DemSatellite_0InternalBehavior/GetEventEnableCondition, operation=GeneralEventInfo.GetEventEnableCondition
        OpEventGetDebouncingOfEvent_GetDebouncingOfEvent_EvtInfo_FrtrcvEFrErrnTrcv0: start-on-event=DemSatellite_0InternalBehavior/GetDebouncingOfEvent, operation=EvtInfo_FrtrcvEFrErrnTrcv0.GetDebouncingOfEvent
        OpEventGetDebouncingOfEvent_GetDebouncingOfEvent_EvtInfo_CansmEBusIukCanOff: start-on-event=DemSatellite_0InternalBehavior/GetDebouncingOfEvent, operation=EvtInfo_CansmEBusIukCanOff.GetDebouncingOfEvent
        OpEventGetDebouncingOfEvent_GetDebouncingOfEvent_EvtInfo_FrtrcvEFrErrnTrcv2: start-on-event=DemSatellite_0InternalBehavior/GetDebouncingOfEvent, operation=EvtInfo_FrtrcvEFrErrnTrcv2.GetDebouncingOfEvent
        OpEventGetDebouncingOfEvent_GetDebouncingOfEvent_EvtInfo_FrtrcvEFrErrnTrcv1: start-on-event=DemSatellite_0InternalBehavior/GetDebouncingOfEvent, operation=EvtInfo_FrtrcvEFrErrnTrcv1.GetDebouncingOfEvent
        OpEventGetDebouncingOfEvent_GetDebouncingOfEvent_EvtInfo_FrtrcvEFrErrnTrcv4: start-on-event=DemSatellite_0InternalBehavior/GetDebouncingOfEvent, operation=EvtInfo_FrtrcvEFrErrnTrcv4.GetDebouncingOfEvent
        OpEventGetDebouncingOfEvent_GetDebouncingOfEvent_EvtInfo_FrtrcvEFrErrnTrcv3: start-on-event=DemSatellite_0InternalBehavior/GetDebouncingOfEvent, operation=EvtInfo_FrtrcvEFrErrnTrcv3.GetDebouncingOfEvent
        OpEventGetDebouncingOfEvent_GetDebouncingOfEvent_EvtInfo_FrtrcvEFrErrnTrcv6: start-on-event=DemSatellite_0InternalBehavior/GetDebouncingOfEvent, operation=EvtInfo_FrtrcvEFrErrnTrcv6.GetDebouncingOfEvent
        OpEventGetDebouncingOfEvent_GetDebouncingOfEvent_EvtInfo_FrtrcvEFrErrnTrcv5: start-on-event=DemSatellite_0InternalBehavior/GetDebouncingOfEvent, operation=EvtInfo_FrtrcvEFrErrnTrcv5.GetDebouncingOfEvent
        OpEventGetDebouncingOfEvent_GetDebouncingOfEvent_EvtInfo_CansmEBusBodyCanOff: start-on-event=DemSatellite_0InternalBehavior/GetDebouncingOfEvent, operation=EvtInfo_CansmEBusBodyCanOff.GetDebouncingOfEvent
        OpEventGetDebouncingOfEvent_GetDebouncingOfEvent_EvtInfo_CbsReplacementValue: start-on-event=DemSatellite_0InternalBehavior/GetDebouncingOfEvent, operation=EvtInfo_CbsReplacementValue.GetDebouncingOfEvent
        OpEventGetDebouncingOfEvent_GetDebouncingOfEvent_EvtInfo_CansmEBusLeCanOff: start-on-event=DemSatellite_0InternalBehavior/GetDebouncingOfEvent, operation=EvtInfo_CansmEBusLeCanOff.GetDebouncingOfEvent
        OpEventGetDebouncingOfEvent_GetDebouncingOfEvent_EvtInfo_CansmEBusZsgCanOff: start-on-event=DemSatellite_0InternalBehavior/GetDebouncingOfEvent, operation=EvtInfo_CansmEBusZsgCanOff.GetDebouncingOfEvent
        OpEventGetDebouncingOfEvent_GetDebouncingOfEvent_EvtInfo_CodingEventWrongVehicle: start-on-event=DemSatellite_0InternalBehavior/GetDebouncingOfEvent, operation=EvtInfo_CodingEventWrongVehicle.GetDebouncingOfEvent
        OpEventGetDebouncingOfEvent_GetDebouncingOfEvent_EvtInfo_FrsmEClusterStartup: start-on-event=DemSatellite_0InternalBehavior/GetDebouncingOfEvent, operation=EvtInfo_FrsmEClusterStartup.GetDebouncingOfEvent
        OpEventGetDebouncingOfEvent_GetDebouncingOfEvent_EvtInfo_CansmEBusACanOff: start-on-event=DemSatellite_0InternalBehavior/GetDebouncingOfEvent, operation=EvtInfo_CansmEBusACanOff.GetDebouncingOfEvent
        OpEventGetDebouncingOfEvent_GetDebouncingOfEvent_EvtInfo_CansmEBusKCanOff: start-on-event=DemSatellite_0InternalBehavior/GetDebouncingOfEvent, operation=EvtInfo_CansmEBusKCanOff.GetDebouncingOfEvent
        OpEventGetDebouncingOfEvent_GetDebouncingOfEvent_EvtInfo_CantrcvEBusKCanError: start-on-event=DemSatellite_0InternalBehavior/GetDebouncingOfEvent, operation=EvtInfo_CantrcvEBusKCanError.GetDebouncingOfEvent
        OpEventGetDebouncingOfEvent_GetDebouncingOfEvent_EvtInfo_FrtrcvEFrBuserrorTrcv0: start-on-event=DemSatellite_0InternalBehavior/GetDebouncingOfEvent, operation=EvtInfo_FrtrcvEFrBuserrorTrcv0.GetDebouncingOfEvent
        OpEventGetDebouncingOfEvent_GetDebouncingOfEvent_EvtInfo_FrtrcvEFrErrnTrcv7: start-on-event=DemSatellite_0InternalBehavior/GetDebouncingOfEvent, operation=EvtInfo_FrtrcvEFrErrnTrcv7.GetDebouncingOfEvent
        OpEventGetDebouncingOfEvent_GetDebouncingOfEvent_EvtInfo_CansmEBusFaCanOff: start-on-event=DemSatellite_0InternalBehavior/GetDebouncingOfEvent, operation=EvtInfo_CansmEBusFaCanOff.GetDebouncingOfEvent
        OpEventGetDebouncingOfEvent_GetDebouncingOfEvent_EvtInfo_CantrcvEBusB2CanError: start-on-event=DemSatellite_0InternalBehavior/GetDebouncingOfEvent, operation=EvtInfo_CantrcvEBusB2CanError.GetDebouncingOfEvent
        OpEventGetDebouncingOfEvent_GetDebouncingOfEvent_EvtInfo_DtcCd{0605..0607}: start-on-event=DemSatellite_0InternalBehavior/GetDebouncingOfEvent, operation=EvtInfo_DtcCd{0605..0607}.GetDebouncingOfEvent
        OpEventGetDebouncingOfEvent_GetDebouncingOfEvent_EvtInfo_PiaEIoError: start-on-event=DemSatellite_0InternalBehavior/GetDebouncingOfEvent, operation=EvtInfo_PiaEIoError.GetDebouncingOfEvent
        OpEventGetDebouncingOfEvent_GetDebouncingOfEvent_EvtInfo_DtcCd0601: start-on-event=DemSatellite_0InternalBehavior/GetDebouncingOfEvent, operation=EvtInfo_DtcCd0601.GetDebouncingOfEvent
        OpEventGetDebouncingOfEvent_GetDebouncingOfEvent_EvtInfo_SwtExternalCheckFailure: start-on-event=DemSatellite_0InternalBehavior/GetDebouncingOfEvent, operation=EvtInfo_SwtExternalCheckFailure.GetDebouncingOfEvent
        OpEventGetDebouncingOfEvent_GetDebouncingOfEvent_EvtInfo_CantrcvEBusBodyCanError: start-on-event=DemSatellite_0InternalBehavior/GetDebouncingOfEvent, operation=EvtInfo_CantrcvEBusBodyCanError.GetDebouncingOfEvent
        OpEventGetDebouncingOfEvent_GetDebouncingOfEvent_EvtInfo_CantrcvEBusIukError: start-on-event=DemSatellite_0InternalBehavior/GetDebouncingOfEvent, operation=EvtInfo_CantrcvEBusIukError.GetDebouncingOfEvent
        OpEventGetDebouncingOfEvent_GetDebouncingOfEvent_EvtInfo_SwtInternalCheckFailure: start-on-event=DemSatellite_0InternalBehavior/GetDebouncingOfEvent, operation=EvtInfo_SwtInternalCheckFailure.GetDebouncingOfEvent
        OpEventGetDebouncingOfEvent_GetDebouncingOfEvent_EvtInfo_DmTestAppl: start-on-event=DemSatellite_0InternalBehavior/GetDebouncingOfEvent, operation=EvtInfo_DmTestAppl.GetDebouncingOfEvent
        OpEventGetDebouncingOfEvent_GetDebouncingOfEvent_EvtInfo_Dtc000032: start-on-event=DemSatellite_0InternalBehavior/GetDebouncingOfEvent, operation=EvtInfo_Dtc000032.GetDebouncingOfEvent
        OpEventGetDebouncingOfEvent_GetDebouncingOfEvent_EvtInfo_Dtc000031: start-on-event=DemSatellite_0InternalBehavior/GetDebouncingOfEvent, operation=EvtInfo_Dtc000031.GetDebouncingOfEvent
        OpEventGetDebouncingOfEvent_GetDebouncingOfEvent_EvtInfo_FrsmEClusterSyncLoss: start-on-event=DemSatellite_0InternalBehavior/GetDebouncingOfEvent, operation=EvtInfo_FrsmEClusterSyncLoss.GetDebouncingOfEvent
        OpEventGetDebouncingOfEvent_GetDebouncingOfEvent_EvtInfo_Dtc000030: start-on-event=DemSatellite_0InternalBehavior/GetDebouncingOfEvent, operation=EvtInfo_Dtc000030.GetDebouncingOfEvent
        OpEventGetDebouncingOfEvent_GetDebouncingOfEvent_EvtInfo_Dtc000034: start-on-event=DemSatellite_0InternalBehavior/GetDebouncingOfEvent, operation=EvtInfo_Dtc000034.GetDebouncingOfEvent
        OpEventGetDebouncingOfEvent_GetDebouncingOfEvent_EvtInfo_Dtc000033: start-on-event=DemSatellite_0InternalBehavior/GetDebouncingOfEvent, operation=EvtInfo_Dtc000033.GetDebouncingOfEvent
        OpEventGetDebouncingOfEvent_GetDebouncingOfEvent_EvtInfo_Undervoltage: start-on-event=DemSatellite_0InternalBehavior/GetDebouncingOfEvent, operation=EvtInfo_Undervoltage.GetDebouncingOfEvent
        OpEventGetDebouncingOfEvent_GetDebouncingOfEvent_EvtInfo_CodingEventTransactionFailed: start-on-event=DemSatellite_0InternalBehavior/GetDebouncingOfEvent, operation=EvtInfo_CodingEventTransactionFailed.GetDebouncingOfEvent
        OpEventGetDebouncingOfEvent_GetDebouncingOfEvent_EvtInfo_FrifENitChA: start-on-event=DemSatellite_0InternalBehavior/GetDebouncingOfEvent, operation=EvtInfo_FrifENitChA.GetDebouncingOfEvent
        OpEventGetDebouncingOfEvent_GetDebouncingOfEvent_EvtInfo_CansmEBusLpCanOff: start-on-event=DemSatellite_0InternalBehavior/GetDebouncingOfEvent, operation=EvtInfo_CansmEBusLpCanOff.GetDebouncingOfEvent
        OpEventGetDebouncingOfEvent_GetDebouncingOfEvent_EvtInfo_NVM_E_HARDWARE: start-on-event=DemSatellite_0InternalBehavior/GetDebouncingOfEvent, operation=EvtInfo_NVM_E_HARDWARE.GetDebouncingOfEvent
        OpEventGetDebouncingOfEvent_GetDebouncingOfEvent_EvtInfo_VsmEventOpmode: start-on-event=DemSatellite_0InternalBehavior/GetDebouncingOfEvent, operation=EvtInfo_VsmEventOpmode.GetDebouncingOfEvent
        OpEventGetDebouncingOfEvent_GetDebouncingOfEvent_EvtInfo_LIN_E_TIMEOUT: start-on-event=DemSatellite_0InternalBehavior/GetDebouncingOfEvent, operation=EvtInfo_LIN_E_TIMEOUT.GetDebouncingOfEvent
        OpEventGetDebouncingOfEvent_GetDebouncingOfEvent_EvtInfo_CantrcvEBusACanError: start-on-event=DemSatellite_0InternalBehavior/GetDebouncingOfEvent, operation=EvtInfo_CantrcvEBusACanError.GetDebouncingOfEvent
        OpEventGetDebouncingOfEvent_GetDebouncingOfEvent_EvtInfo_UDPNM_E_TCPIP_TRANSMIT_ERROR: start-on-event=DemSatellite_0InternalBehavior/GetDebouncingOfEvent, operation=EvtInfo_UDPNM_E_TCPIP_TRANSMIT_ERROR.GetDebouncingOfEvent
        OpEventGetDebouncingOfEvent_GetDebouncingOfEvent_EvtInfo_DmTestCom: start-on-event=DemSatellite_0InternalBehavior/GetDebouncingOfEvent, operation=EvtInfo_DmTestCom.GetDebouncingOfEvent
        OpEventGetDebouncingOfEvent_GetDebouncingOfEvent_EvtInfo_CodingEventSignatureError: start-on-event=DemSatellite_0InternalBehavior/GetDebouncingOfEvent, operation=EvtInfo_CodingEventSignatureError.GetDebouncingOfEvent
        OpEventGetDebouncingOfEvent_GetDebouncingOfEvent_EvtInfo_CodingEventUnqualifiedData: start-on-event=DemSatellite_0InternalBehavior/GetDebouncingOfEvent, operation=EvtInfo_CodingEventUnqualifiedData.GetDebouncingOfEvent
        OpEventGetDebouncingOfEvent_GetDebouncingOfEvent_EvtInfo_CodingEventInvalidData: start-on-event=DemSatellite_0InternalBehavior/GetDebouncingOfEvent, operation=EvtInfo_CodingEventInvalidData.GetDebouncingOfEvent
        OpEventGetDebouncingOfEvent_GetDebouncingOfEvent_EvtInfo_CansmEBusB2CanOff: start-on-event=DemSatellite_0InternalBehavior/GetDebouncingOfEvent, operation=EvtInfo_CansmEBusB2CanOff.GetDebouncingOfEvent
        OpEventGetDebouncingOfEvent_GetDebouncingOfEvent_EvtInfo_Overvoltage: start-on-event=DemSatellite_0InternalBehavior/GetDebouncingOfEvent, operation=EvtInfo_Overvoltage.GetDebouncingOfEvent
        OpEventGetDebouncingOfEvent_GetDebouncingOfEvent_EvtInfo_CodingEventNotCoded: start-on-event=DemSatellite_0InternalBehavior/GetDebouncingOfEvent, operation=EvtInfo_CodingEventNotCoded.GetDebouncingOfEvent
        OpEventGetDebouncingOfEvent_GetDebouncingOfEvent_EvtInfo_FrifEAcsChA: start-on-event=DemSatellite_0InternalBehavior/GetDebouncingOfEvent, operation=EvtInfo_FrifEAcsChA.GetDebouncingOfEvent
        OpEventGetDebouncingOfEvent_GetDebouncingOfEvent_EvtInfo_CantrcvEBusFaCanError: start-on-event=DemSatellite_0InternalBehavior/GetDebouncingOfEvent, operation=EvtInfo_CantrcvEBusFaCanError.GetDebouncingOfEvent
        OpEventGetDebouncingOfEvent_GetDebouncingOfEvent_EvtInfo_CantrcvEBusLeCanError: start-on-event=DemSatellite_0InternalBehavior/GetDebouncingOfEvent, operation=EvtInfo_CantrcvEBusLeCanError.GetDebouncingOfEvent
        OpEventGetDebouncingOfEvent_GetDebouncingOfEvent_EvtInfo_CantrcvEBusLpCanError: start-on-event=DemSatellite_0InternalBehavior/GetDebouncingOfEvent, operation=EvtInfo_CantrcvEBusLpCanError.GetDebouncingOfEvent
        OpEventGetDebouncingOfEvent_GetDebouncingOfEvent_EvtInfo_CantrcvEBusZsgCanError: start-on-event=DemSatellite_0InternalBehavior/GetDebouncingOfEvent, operation=EvtInfo_CantrcvEBusZsgCanError.GetDebouncingOfEvent
        OpEventGetDebouncingOfEvent_GetDebouncingOfEvent_EvtInfo_EthSignalQualityLow: start-on-event=DemSatellite_0InternalBehavior/GetDebouncingOfEvent, operation=EvtInfo_EthSignalQualityLow.GetDebouncingOfEvent
        OpEventGetDebouncingOfEvent_GetDebouncingOfEvent_EvtInfo_DemEventParameter_FlsConfigSet_FLS_E_COMPARE_FAILED: start-on-event=DemSatellite_0InternalBehavior/GetDebouncingOfEvent, operation=EvtInfo_DemEventParameter_FlsConfigSet_FLS_E_COMPARE_FAILED.GetDebouncingOfEvent
        OpEventGetDebouncingOfEvent_GetDebouncingOfEvent_EvtInfo_DemEventParameter_FlsConfigSet_FLS_E_ERASE_FAILED: start-on-event=DemSatellite_0InternalBehavior/GetDebouncingOfEvent, operation=EvtInfo_DemEventParameter_FlsConfigSet_FLS_E_ERASE_FAILED.GetDebouncingOfEvent
        OpEventGetDebouncingOfEvent_GetDebouncingOfEvent_EvtInfo_DemEventParameter_FlsConfigSet_FLS_E_READ_FAILED: start-on-event=DemSatellite_0InternalBehavior/GetDebouncingOfEvent, operation=EvtInfo_DemEventParameter_FlsConfigSet_FLS_E_READ_FAILED.GetDebouncingOfEvent
        OpEventGetDebouncingOfEvent_GetDebouncingOfEvent_EvtInfo_DemEventParameter_FlsConfigSet_FLS_E_WRITE_FAILED: start-on-event=DemSatellite_0InternalBehavior/GetDebouncingOfEvent, operation=EvtInfo_DemEventParameter_FlsConfigSet_FLS_E_WRITE_FAILED.GetDebouncingOfEvent
        OpEventGetDebouncingOfEvent_GetDebouncingOfEvent_EvtInfo_DemEventParameter_FlsConfigSet_FLS_E_READ_DED_FAILED: start-on-event=DemSatellite_0InternalBehavior/GetDebouncingOfEvent, operation=EvtInfo_DemEventParameter_FlsConfigSet_FLS_E_READ_DED_FAILED.GetDebouncingOfEvent
        OpEventGetDebouncingOfEvent_GetDebouncingOfEvent_EvtInfo_DemEventParameter_FlsConfigSet_FLS_E_UNEXPECTED_FLASH_ID: start-on-event=DemSatellite_0InternalBehavior/GetDebouncingOfEvent, operation=EvtInfo_DemEventParameter_FlsConfigSet_FLS_E_UNEXPECTED_FLASH_ID.GetDebouncingOfEvent
        OpEventGetDebouncingOfEvent_GetDebouncingOfEvent_EvtInfo_DemEventParameter_FlsConfigSet_MCU_E_CLOCK_FAILED: start-on-event=DemSatellite_0InternalBehavior/GetDebouncingOfEvent, operation=EvtInfo_DemEventParameter_FlsConfigSet_MCU_E_CLOCK_FAILED.GetDebouncingOfEvent
        OpEventGetDebouncingOfEvent_GetDebouncingOfEvent_EvtInfo_DemEventParameter_FlsConfigSet_MCU_E_HW_FAILED: start-on-event=DemSatellite_0InternalBehavior/GetDebouncingOfEvent, operation=EvtInfo_DemEventParameter_FlsConfigSet_MCU_E_HW_FAILED.GetDebouncingOfEvent
        OpEventGetDebouncingOfEvent_GetDebouncingOfEvent_EvtInfo_DemEventParameter_FlsConfigSet_MCU_E_STARTUP_FAILED: start-on-event=DemSatellite_0InternalBehavior/GetDebouncingOfEvent, operation=EvtInfo_DemEventParameter_FlsConfigSet_MCU_E_STARTUP_FAILED.GetDebouncingOfEvent
        OpEventGetDebouncingOfEvent_GetDebouncingOfEvent_EvtInfo_DemEventParameter_FlsConfigSet_FLS_E_ECC_FAILED: start-on-event=DemSatellite_0InternalBehavior/GetDebouncingOfEvent, operation=EvtInfo_DemEventParameter_FlsConfigSet_FLS_E_ECC_FAILED.GetDebouncingOfEvent
        OpEventGetDebouncingOfEvent_GetDebouncingOfEvent_EvtInfo_DemEventParameter_FlsConfigSet_FLS_E_VRFY_FAILED: start-on-event=DemSatellite_0InternalBehavior/GetDebouncingOfEvent, operation=EvtInfo_DemEventParameter_FlsConfigSet_FLS_E_VRFY_FAILED.GetDebouncingOfEvent
        OpEventGetDebouncingOfEvent_GetDebouncingOfEvent_EvtInfo_DemEventParameter_FlsConfigSet_FLS_E_INT_FAILED: start-on-event=DemSatellite_0InternalBehavior/GetDebouncingOfEvent, operation=EvtInfo_DemEventParameter_FlsConfigSet_FLS_E_INT_FAILED.GetDebouncingOfEvent
        OpEventGetDebouncingOfEvent_GetDebouncingOfEvent_EvtInfo_DemEventParameter_FlsConfigSet_FLS_E_HW_FAILED: start-on-event=DemSatellite_0InternalBehavior/GetDebouncingOfEvent, operation=EvtInfo_DemEventParameter_FlsConfigSet_FLS_E_HW_FAILED.GetDebouncingOfEvent
        OpEventGetDebouncingOfEvent_GetDebouncingOfEvent_GeneralEventInfo: start-on-event=DemSatellite_0InternalBehavior/GetDebouncingOfEvent, operation=GeneralEventInfo.GetDebouncingOfEvent
        OpEventGetMonitorStatus_GetMonitorStatus_EvtInfo_FrtrcvEFrErrnTrcv0: start-on-event=DemSatellite_0InternalBehavior/GetMonitorStatus, operation=EvtInfo_FrtrcvEFrErrnTrcv0.GetMonitorStatus
        OpEventGetMonitorStatus_GetMonitorStatus_EvtInfo_CansmEBusIukCanOff: start-on-event=DemSatellite_0InternalBehavior/GetMonitorStatus, operation=EvtInfo_CansmEBusIukCanOff.GetMonitorStatus
        OpEventGetMonitorStatus_GetMonitorStatus_EvtInfo_FrtrcvEFrErrnTrcv2: start-on-event=DemSatellite_0InternalBehavior/GetMonitorStatus, operation=EvtInfo_FrtrcvEFrErrnTrcv2.GetMonitorStatus
        OpEventGetMonitorStatus_GetMonitorStatus_EvtInfo_FrtrcvEFrErrnTrcv1: start-on-event=DemSatellite_0InternalBehavior/GetMonitorStatus, operation=EvtInfo_FrtrcvEFrErrnTrcv1.GetMonitorStatus
        OpEventGetMonitorStatus_GetMonitorStatus_EvtInfo_FrtrcvEFrErrnTrcv4: start-on-event=DemSatellite_0InternalBehavior/GetMonitorStatus, operation=EvtInfo_FrtrcvEFrErrnTrcv4.GetMonitorStatus
        OpEventGetMonitorStatus_GetMonitorStatus_EvtInfo_FrtrcvEFrErrnTrcv3: start-on-event=DemSatellite_0InternalBehavior/GetMonitorStatus, operation=EvtInfo_FrtrcvEFrErrnTrcv3.GetMonitorStatus
        OpEventGetMonitorStatus_GetMonitorStatus_EvtInfo_FrtrcvEFrErrnTrcv6: start-on-event=DemSatellite_0InternalBehavior/GetMonitorStatus, operation=EvtInfo_FrtrcvEFrErrnTrcv6.GetMonitorStatus
        OpEventGetMonitorStatus_GetMonitorStatus_EvtInfo_FrtrcvEFrErrnTrcv5: start-on-event=DemSatellite_0InternalBehavior/GetMonitorStatus, operation=EvtInfo_FrtrcvEFrErrnTrcv5.GetMonitorStatus
        OpEventGetMonitorStatus_GetMonitorStatus_EvtInfo_CansmEBusBodyCanOff: start-on-event=DemSatellite_0InternalBehavior/GetMonitorStatus, operation=EvtInfo_CansmEBusBodyCanOff.GetMonitorStatus
        OpEventGetMonitorStatus_GetMonitorStatus_EvtInfo_CbsReplacementValue: start-on-event=DemSatellite_0InternalBehavior/GetMonitorStatus, operation=EvtInfo_CbsReplacementValue.GetMonitorStatus
        OpEventGetMonitorStatus_GetMonitorStatus_EvtInfo_CansmEBusLeCanOff: start-on-event=DemSatellite_0InternalBehavior/GetMonitorStatus, operation=EvtInfo_CansmEBusLeCanOff.GetMonitorStatus
        OpEventGetMonitorStatus_GetMonitorStatus_EvtInfo_CansmEBusZsgCanOff: start-on-event=DemSatellite_0InternalBehavior/GetMonitorStatus, operation=EvtInfo_CansmEBusZsgCanOff.GetMonitorStatus
        OpEventGetMonitorStatus_GetMonitorStatus_EvtInfo_CodingEventWrongVehicle: start-on-event=DemSatellite_0InternalBehavior/GetMonitorStatus, operation=EvtInfo_CodingEventWrongVehicle.GetMonitorStatus
        OpEventGetMonitorStatus_GetMonitorStatus_EvtInfo_FrsmEClusterStartup: start-on-event=DemSatellite_0InternalBehavior/GetMonitorStatus, operation=EvtInfo_FrsmEClusterStartup.GetMonitorStatus
        OpEventGetMonitorStatus_GetMonitorStatus_EvtInfo_CansmEBusACanOff: start-on-event=DemSatellite_0InternalBehavior/GetMonitorStatus, operation=EvtInfo_CansmEBusACanOff.GetMonitorStatus
        OpEventGetMonitorStatus_GetMonitorStatus_EvtInfo_CansmEBusKCanOff: start-on-event=DemSatellite_0InternalBehavior/GetMonitorStatus, operation=EvtInfo_CansmEBusKCanOff.GetMonitorStatus
        OpEventGetMonitorStatus_GetMonitorStatus_EvtInfo_CantrcvEBusKCanError: start-on-event=DemSatellite_0InternalBehavior/GetMonitorStatus, operation=EvtInfo_CantrcvEBusKCanError.GetMonitorStatus
        OpEventGetMonitorStatus_GetMonitorStatus_EvtInfo_FrtrcvEFrBuserrorTrcv0: start-on-event=DemSatellite_0InternalBehavior/GetMonitorStatus, operation=EvtInfo_FrtrcvEFrBuserrorTrcv0.GetMonitorStatus
        OpEventGetMonitorStatus_GetMonitorStatus_EvtInfo_FrtrcvEFrErrnTrcv7: start-on-event=DemSatellite_0InternalBehavior/GetMonitorStatus, operation=EvtInfo_FrtrcvEFrErrnTrcv7.GetMonitorStatus
        OpEventGetMonitorStatus_GetMonitorStatus_EvtInfo_CansmEBusFaCanOff: start-on-event=DemSatellite_0InternalBehavior/GetMonitorStatus, operation=EvtInfo_CansmEBusFaCanOff.GetMonitorStatus
        OpEventGetMonitorStatus_GetMonitorStatus_EvtInfo_CantrcvEBusB2CanError: start-on-event=DemSatellite_0InternalBehavior/GetMonitorStatus, operation=EvtInfo_CantrcvEBusB2CanError.GetMonitorStatus
        OpEventGetMonitorStatus_GetMonitorStatus_EvtInfo_DtcCd{0605..0607}: start-on-event=DemSatellite_0InternalBehavior/GetMonitorStatus, operation=EvtInfo_DtcCd{0605..0607}.GetMonitorStatus
        OpEventGetMonitorStatus_GetMonitorStatus_EvtInfo_PiaEIoError: start-on-event=DemSatellite_0InternalBehavior/GetMonitorStatus, operation=EvtInfo_PiaEIoError.GetMonitorStatus
        OpEventGetMonitorStatus_GetMonitorStatus_EvtInfo_DtcCd0601: start-on-event=DemSatellite_0InternalBehavior/GetMonitorStatus, operation=EvtInfo_DtcCd0601.GetMonitorStatus
        OpEventGetMonitorStatus_GetMonitorStatus_EvtInfo_SwtExternalCheckFailure: start-on-event=DemSatellite_0InternalBehavior/GetMonitorStatus, operation=EvtInfo_SwtExternalCheckFailure.GetMonitorStatus
        OpEventGetMonitorStatus_GetMonitorStatus_EvtInfo_CantrcvEBusBodyCanError: start-on-event=DemSatellite_0InternalBehavior/GetMonitorStatus, operation=EvtInfo_CantrcvEBusBodyCanError.GetMonitorStatus
        OpEventGetMonitorStatus_GetMonitorStatus_EvtInfo_CantrcvEBusIukError: start-on-event=DemSatellite_0InternalBehavior/GetMonitorStatus, operation=EvtInfo_CantrcvEBusIukError.GetMonitorStatus
        OpEventGetMonitorStatus_GetMonitorStatus_EvtInfo_SwtInternalCheckFailure: start-on-event=DemSatellite_0InternalBehavior/GetMonitorStatus, operation=EvtInfo_SwtInternalCheckFailure.GetMonitorStatus
        OpEventGetMonitorStatus_GetMonitorStatus_EvtInfo_DmTestAppl: start-on-event=DemSatellite_0InternalBehavior/GetMonitorStatus, operation=EvtInfo_DmTestAppl.GetMonitorStatus
        OpEventGetMonitorStatus_GetMonitorStatus_EvtInfo_Dtc000032: start-on-event=DemSatellite_0InternalBehavior/GetMonitorStatus, operation=EvtInfo_Dtc000032.GetMonitorStatus
        OpEventGetMonitorStatus_GetMonitorStatus_EvtInfo_Dtc000031: start-on-event=DemSatellite_0InternalBehavior/GetMonitorStatus, operation=EvtInfo_Dtc000031.GetMonitorStatus
        OpEventGetMonitorStatus_GetMonitorStatus_EvtInfo_FrsmEClusterSyncLoss: start-on-event=DemSatellite_0InternalBehavior/GetMonitorStatus, operation=EvtInfo_FrsmEClusterSyncLoss.GetMonitorStatus
        OpEventGetMonitorStatus_GetMonitorStatus_EvtInfo_Dtc000030: start-on-event=DemSatellite_0InternalBehavior/GetMonitorStatus, operation=EvtInfo_Dtc000030.GetMonitorStatus
        OpEventGetMonitorStatus_GetMonitorStatus_EvtInfo_Dtc000034: start-on-event=DemSatellite_0InternalBehavior/GetMonitorStatus, operation=EvtInfo_Dtc000034.GetMonitorStatus
        OpEventGetMonitorStatus_GetMonitorStatus_EvtInfo_Dtc000033: start-on-event=DemSatellite_0InternalBehavior/GetMonitorStatus, operation=EvtInfo_Dtc000033.GetMonitorStatus
        OpEventGetMonitorStatus_GetMonitorStatus_EvtInfo_Undervoltage: start-on-event=DemSatellite_0InternalBehavior/GetMonitorStatus, operation=EvtInfo_Undervoltage.GetMonitorStatus
        OpEventGetMonitorStatus_GetMonitorStatus_EvtInfo_CodingEventTransactionFailed: start-on-event=DemSatellite_0InternalBehavior/GetMonitorStatus, operation=EvtInfo_CodingEventTransactionFailed.GetMonitorStatus
        OpEventGetMonitorStatus_GetMonitorStatus_EvtInfo_FrifENitChA: start-on-event=DemSatellite_0InternalBehavior/GetMonitorStatus, operation=EvtInfo_FrifENitChA.GetMonitorStatus
        OpEventGetMonitorStatus_GetMonitorStatus_EvtInfo_CansmEBusLpCanOff: start-on-event=DemSatellite_0InternalBehavior/GetMonitorStatus, operation=EvtInfo_CansmEBusLpCanOff.GetMonitorStatus
        OpEventGetMonitorStatus_GetMonitorStatus_EvtInfo_NVM_E_HARDWARE: start-on-event=DemSatellite_0InternalBehavior/GetMonitorStatus, operation=EvtInfo_NVM_E_HARDWARE.GetMonitorStatus
        OpEventGetMonitorStatus_GetMonitorStatus_EvtInfo_VsmEventOpmode: start-on-event=DemSatellite_0InternalBehavior/GetMonitorStatus, operation=EvtInfo_VsmEventOpmode.GetMonitorStatus
        OpEventGetMonitorStatus_GetMonitorStatus_EvtInfo_LIN_E_TIMEOUT: start-on-event=DemSatellite_0InternalBehavior/GetMonitorStatus, operation=EvtInfo_LIN_E_TIMEOUT.GetMonitorStatus
        OpEventGetMonitorStatus_GetMonitorStatus_EvtInfo_CantrcvEBusACanError: start-on-event=DemSatellite_0InternalBehavior/GetMonitorStatus, operation=EvtInfo_CantrcvEBusACanError.GetMonitorStatus
        OpEventGetMonitorStatus_GetMonitorStatus_EvtInfo_UDPNM_E_TCPIP_TRANSMIT_ERROR: start-on-event=DemSatellite_0InternalBehavior/GetMonitorStatus, operation=EvtInfo_UDPNM_E_TCPIP_TRANSMIT_ERROR.GetMonitorStatus
        OpEventGetMonitorStatus_GetMonitorStatus_EvtInfo_DmTestCom: start-on-event=DemSatellite_0InternalBehavior/GetMonitorStatus, operation=EvtInfo_DmTestCom.GetMonitorStatus
        OpEventGetMonitorStatus_GetMonitorStatus_EvtInfo_CodingEventSignatureError: start-on-event=DemSatellite_0InternalBehavior/GetMonitorStatus, operation=EvtInfo_CodingEventSignatureError.GetMonitorStatus
        OpEventGetMonitorStatus_GetMonitorStatus_EvtInfo_CodingEventUnqualifiedData: start-on-event=DemSatellite_0InternalBehavior/GetMonitorStatus, operation=EvtInfo_CodingEventUnqualifiedData.GetMonitorStatus
        OpEventGetMonitorStatus_GetMonitorStatus_EvtInfo_CodingEventInvalidData: start-on-event=DemSatellite_0InternalBehavior/GetMonitorStatus, operation=EvtInfo_CodingEventInvalidData.GetMonitorStatus
        OpEventGetMonitorStatus_GetMonitorStatus_EvtInfo_CansmEBusB2CanOff: start-on-event=DemSatellite_0InternalBehavior/GetMonitorStatus, operation=EvtInfo_CansmEBusB2CanOff.GetMonitorStatus
        OpEventGetMonitorStatus_GetMonitorStatus_EvtInfo_Overvoltage: start-on-event=DemSatellite_0InternalBehavior/GetMonitorStatus, operation=EvtInfo_Overvoltage.GetMonitorStatus
        OpEventGetMonitorStatus_GetMonitorStatus_EvtInfo_CodingEventNotCoded: start-on-event=DemSatellite_0InternalBehavior/GetMonitorStatus, operation=EvtInfo_CodingEventNotCoded.GetMonitorStatus
        OpEventGetMonitorStatus_GetMonitorStatus_EvtInfo_FrifEAcsChA: start-on-event=DemSatellite_0InternalBehavior/GetMonitorStatus, operation=EvtInfo_FrifEAcsChA.GetMonitorStatus
        OpEventGetMonitorStatus_GetMonitorStatus_EvtInfo_CantrcvEBusFaCanError: start-on-event=DemSatellite_0InternalBehavior/GetMonitorStatus, operation=EvtInfo_CantrcvEBusFaCanError.GetMonitorStatus
        OpEventGetMonitorStatus_GetMonitorStatus_EvtInfo_CantrcvEBusLeCanError: start-on-event=DemSatellite_0InternalBehavior/GetMonitorStatus, operation=EvtInfo_CantrcvEBusLeCanError.GetMonitorStatus
        OpEventGetMonitorStatus_GetMonitorStatus_EvtInfo_CantrcvEBusLpCanError: start-on-event=DemSatellite_0InternalBehavior/GetMonitorStatus, operation=EvtInfo_CantrcvEBusLpCanError.GetMonitorStatus
        OpEventGetMonitorStatus_GetMonitorStatus_EvtInfo_CantrcvEBusZsgCanError: start-on-event=DemSatellite_0InternalBehavior/GetMonitorStatus, operation=EvtInfo_CantrcvEBusZsgCanError.GetMonitorStatus
        OpEventGetMonitorStatus_GetMonitorStatus_EvtInfo_EthSignalQualityLow: start-on-event=DemSatellite_0InternalBehavior/GetMonitorStatus, operation=EvtInfo_EthSignalQualityLow.GetMonitorStatus
        OpEventGetMonitorStatus_GetMonitorStatus_EvtInfo_DemEventParameter_FlsConfigSet_FLS_E_COMPARE_FAILED: start-on-event=DemSatellite_0InternalBehavior/GetMonitorStatus, operation=EvtInfo_DemEventParameter_FlsConfigSet_FLS_E_COMPARE_FAILED.GetMonitorStatus
        OpEventGetMonitorStatus_GetMonitorStatus_EvtInfo_DemEventParameter_FlsConfigSet_FLS_E_ERASE_FAILED: start-on-event=DemSatellite_0InternalBehavior/GetMonitorStatus, operation=EvtInfo_DemEventParameter_FlsConfigSet_FLS_E_ERASE_FAILED.GetMonitorStatus
        OpEventGetMonitorStatus_GetMonitorStatus_EvtInfo_DemEventParameter_FlsConfigSet_FLS_E_READ_FAILED: start-on-event=DemSatellite_0InternalBehavior/GetMonitorStatus, operation=EvtInfo_DemEventParameter_FlsConfigSet_FLS_E_READ_FAILED.GetMonitorStatus
        OpEventGetMonitorStatus_GetMonitorStatus_EvtInfo_DemEventParameter_FlsConfigSet_FLS_E_WRITE_FAILED: start-on-event=DemSatellite_0InternalBehavior/GetMonitorStatus, operation=EvtInfo_DemEventParameter_FlsConfigSet_FLS_E_WRITE_FAILED.GetMonitorStatus
        OpEventGetMonitorStatus_GetMonitorStatus_EvtInfo_DemEventParameter_FlsConfigSet_FLS_E_READ_DED_FAILED: start-on-event=DemSatellite_0InternalBehavior/GetMonitorStatus, operation=EvtInfo_DemEventParameter_FlsConfigSet_FLS_E_READ_DED_FAILED.GetMonitorStatus
        OpEventGetMonitorStatus_GetMonitorStatus_EvtInfo_DemEventParameter_FlsConfigSet_FLS_E_UNEXPECTED_FLASH_ID: start-on-event=DemSatellite_0InternalBehavior/GetMonitorStatus, operation=EvtInfo_DemEventParameter_FlsConfigSet_FLS_E_UNEXPECTED_FLASH_ID.GetMonitorStatus
        OpEventGetMonitorStatus_GetMonitorStatus_EvtInfo_DemEventParameter_FlsConfigSet_MCU_E_CLOCK_FAILED: start-on-event=DemSatellite_0InternalBehavior/GetMonitorStatus, operation=EvtInfo_DemEventParameter_FlsConfigSet_MCU_E_CLOCK_FAILED.GetMonitorStatus
        OpEventGetMonitorStatus_GetMonitorStatus_EvtInfo_DemEventParameter_FlsConfigSet_MCU_E_HW_FAILED: start-on-event=DemSatellite_0InternalBehavior/GetMonitorStatus, operation=EvtInfo_DemEventParameter_FlsConfigSet_MCU_E_HW_FAILED.GetMonitorStatus
        OpEventGetMonitorStatus_GetMonitorStatus_EvtInfo_DemEventParameter_FlsConfigSet_MCU_E_STARTUP_FAILED: start-on-event=DemSatellite_0InternalBehavior/GetMonitorStatus, operation=EvtInfo_DemEventParameter_FlsConfigSet_MCU_E_STARTUP_FAILED.GetMonitorStatus
        OpEventGetMonitorStatus_GetMonitorStatus_EvtInfo_DemEventParameter_FlsConfigSet_FLS_E_ECC_FAILED: start-on-event=DemSatellite_0InternalBehavior/GetMonitorStatus, operation=EvtInfo_DemEventParameter_FlsConfigSet_FLS_E_ECC_FAILED.GetMonitorStatus
        OpEventGetMonitorStatus_GetMonitorStatus_EvtInfo_DemEventParameter_FlsConfigSet_FLS_E_VRFY_FAILED: start-on-event=DemSatellite_0InternalBehavior/GetMonitorStatus, operation=EvtInfo_DemEventParameter_FlsConfigSet_FLS_E_VRFY_FAILED.GetMonitorStatus
        OpEventGetMonitorStatus_GetMonitorStatus_EvtInfo_DemEventParameter_FlsConfigSet_FLS_E_INT_FAILED: start-on-event=DemSatellite_0InternalBehavior/GetMonitorStatus, operation=EvtInfo_DemEventParameter_FlsConfigSet_FLS_E_INT_FAILED.GetMonitorStatus
        OpEventGetMonitorStatus_GetMonitorStatus_EvtInfo_DemEventParameter_FlsConfigSet_FLS_E_HW_FAILED: start-on-event=DemSatellite_0InternalBehavior/GetMonitorStatus, operation=EvtInfo_DemEventParameter_FlsConfigSet_FLS_E_HW_FAILED.GetMonitorStatus
        OpEventGetMonitorStatus_GetMonitorStatus_GeneralEventInfo: start-on-event=DemSatellite_0InternalBehavior/GetMonitorStatus, operation=GeneralEventInfo.GetMonitorStatus
        OpEventSetEventStatus_SetEventStatus_Event_FrtrcvEFrErrnTrcv0: start-on-event=SetEventStatus, operation=Event_FrtrcvEFrErrnTrcv0.SetEventStatus
        OpEventSetEventStatus_SetEventStatus_Event_CansmEBusIukCanOff: start-on-event=SetEventStatus, operation=Event_CansmEBusIukCanOff.SetEventStatus
        OpEventSetEventStatus_SetEventStatus_Event_FrtrcvEFrErrnTrcv2: start-on-event=SetEventStatus, operation=Event_FrtrcvEFrErrnTrcv2.SetEventStatus
        OpEventSetEventStatus_SetEventStatus_Event_FrtrcvEFrErrnTrcv1: start-on-event=SetEventStatus, operation=Event_FrtrcvEFrErrnTrcv1.SetEventStatus
        OpEventSetEventStatus_SetEventStatus_Event_FrtrcvEFrErrnTrcv4: start-on-event=SetEventStatus, operation=Event_FrtrcvEFrErrnTrcv4.SetEventStatus
        OpEventSetEventStatus_SetEventStatus_Event_FrtrcvEFrErrnTrcv3: start-on-event=SetEventStatus, operation=Event_FrtrcvEFrErrnTrcv3.SetEventStatus
        OpEventSetEventStatus_SetEventStatus_Event_FrtrcvEFrErrnTrcv6: start-on-event=SetEventStatus, operation=Event_FrtrcvEFrErrnTrcv6.SetEventStatus
        OpEventSetEventStatus_SetEventStatus_Event_FrtrcvEFrErrnTrcv5: start-on-event=SetEventStatus, operation=Event_FrtrcvEFrErrnTrcv5.SetEventStatus
        OpEventSetEventStatus_SetEventStatus_Event_CansmEBusBodyCanOff: start-on-event=SetEventStatus, operation=Event_CansmEBusBodyCanOff.SetEventStatus
        OpEventSetEventStatus_SetEventStatus_Event_CbsReplacementValue: start-on-event=SetEventStatus, operation=Event_CbsReplacementValue.SetEventStatus
        OpEventSetEventStatus_SetEventStatus_Event_CansmEBusLeCanOff: start-on-event=SetEventStatus, operation=Event_CansmEBusLeCanOff.SetEventStatus
        OpEventSetEventStatus_SetEventStatus_Event_CansmEBusZsgCanOff: start-on-event=SetEventStatus, operation=Event_CansmEBusZsgCanOff.SetEventStatus
        OpEventSetEventStatus_SetEventStatus_Event_CodingEventWrongVehicle: start-on-event=SetEventStatus, operation=Event_CodingEventWrongVehicle.SetEventStatus
        OpEventSetEventStatus_SetEventStatus_Event_FrsmEClusterStartup: start-on-event=SetEventStatus, operation=Event_FrsmEClusterStartup.SetEventStatus
        OpEventSetEventStatus_SetEventStatus_Event_CansmEBusACanOff: start-on-event=SetEventStatus, operation=Event_CansmEBusACanOff.SetEventStatus
        OpEventSetEventStatus_SetEventStatus_Event_CansmEBusKCanOff: start-on-event=SetEventStatus, operation=Event_CansmEBusKCanOff.SetEventStatus
        OpEventSetEventStatus_SetEventStatus_Event_CantrcvEBusKCanError: start-on-event=SetEventStatus, operation=Event_CantrcvEBusKCanError.SetEventStatus
        OpEventSetEventStatus_SetEventStatus_Event_FrtrcvEFrBuserrorTrcv0: start-on-event=SetEventStatus, operation=Event_FrtrcvEFrBuserrorTrcv0.SetEventStatus
        OpEventSetEventStatus_SetEventStatus_Event_FrtrcvEFrErrnTrcv7: start-on-event=SetEventStatus, operation=Event_FrtrcvEFrErrnTrcv7.SetEventStatus
        OpEventSetEventStatus_SetEventStatus_Event_CansmEBusFaCanOff: start-on-event=SetEventStatus, operation=Event_CansmEBusFaCanOff.SetEventStatus
        OpEventSetEventStatus_SetEventStatus_Event_CantrcvEBusB2CanError: start-on-event=SetEventStatus, operation=Event_CantrcvEBusB2CanError.SetEventStatus
        OpEventSetEventStatus_SetEventStatus_Event_DtcCd{0605..0607}: start-on-event=SetEventStatus, operation=Event_DtcCd{0605..0607}.SetEventStatus
        OpEventSetEventStatus_SetEventStatus_Event_PiaEIoError: start-on-event=SetEventStatus, operation=Event_PiaEIoError.SetEventStatus
        OpEventSetEventStatus_SetEventStatus_Event_DtcCd0601: start-on-event=SetEventStatus, operation=Event_DtcCd0601.SetEventStatus
        OpEventSetEventStatus_SetEventStatus_Event_SwtExternalCheckFailure: start-on-event=SetEventStatus, operation=Event_SwtExternalCheckFailure.SetEventStatus
        OpEventSetEventStatus_SetEventStatus_Event_CantrcvEBusBodyCanError: start-on-event=SetEventStatus, operation=Event_CantrcvEBusBodyCanError.SetEventStatus
        OpEventSetEventStatus_SetEventStatus_Event_CantrcvEBusIukError: start-on-event=SetEventStatus, operation=Event_CantrcvEBusIukError.SetEventStatus
        OpEventSetEventStatus_SetEventStatus_Event_SwtInternalCheckFailure: start-on-event=SetEventStatus, operation=Event_SwtInternalCheckFailure.SetEventStatus
        OpEventSetEventStatus_SetEventStatus_Event_DmTestAppl: start-on-event=SetEventStatus, operation=Event_DmTestAppl.SetEventStatus
        OpEventSetEventStatus_SetEventStatus_Event_Dtc000032: start-on-event=SetEventStatus, operation=Event_Dtc000032.SetEventStatus
        OpEventSetEventStatus_SetEventStatus_Event_Dtc000031: start-on-event=SetEventStatus, operation=Event_Dtc000031.SetEventStatus
        OpEventSetEventStatus_SetEventStatus_Event_FrsmEClusterSyncLoss: start-on-event=SetEventStatus, operation=Event_FrsmEClusterSyncLoss.SetEventStatus
        OpEventSetEventStatus_SetEventStatus_Event_Dtc000030: start-on-event=SetEventStatus, operation=Event_Dtc000030.SetEventStatus
        OpEventSetEventStatus_SetEventStatus_Event_Dtc000034: start-on-event=SetEventStatus, operation=Event_Dtc000034.SetEventStatus
        OpEventSetEventStatus_SetEventStatus_Event_Dtc000033: start-on-event=SetEventStatus, operation=Event_Dtc000033.SetEventStatus
        OpEventSetEventStatus_SetEventStatus_Event_Undervoltage: start-on-event=SetEventStatus, operation=Event_Undervoltage.SetEventStatus
        OpEventSetEventStatus_SetEventStatus_Event_CodingEventTransactionFailed: start-on-event=SetEventStatus, operation=Event_CodingEventTransactionFailed.SetEventStatus
        OpEventSetEventStatus_SetEventStatus_Event_FrifENitChA: start-on-event=SetEventStatus, operation=Event_FrifENitChA.SetEventStatus
        OpEventSetEventStatus_SetEventStatus_Event_CansmEBusLpCanOff: start-on-event=SetEventStatus, operation=Event_CansmEBusLpCanOff.SetEventStatus
        OpEventSetEventStatus_SetEventStatus_Event_VsmEventOpmode: start-on-event=SetEventStatus, operation=Event_VsmEventOpmode.SetEventStatus
        OpEventSetEventStatus_SetEventStatus_Event_CantrcvEBusACanError: start-on-event=SetEventStatus, operation=Event_CantrcvEBusACanError.SetEventStatus
        OpEventSetEventStatus_SetEventStatus_Event_DmTestCom: start-on-event=SetEventStatus, operation=Event_DmTestCom.SetEventStatus
        OpEventSetEventStatus_SetEventStatus_Event_CodingEventSignatureError: start-on-event=SetEventStatus, operation=Event_CodingEventSignatureError.SetEventStatus
        OpEventSetEventStatus_SetEventStatus_Event_CodingEventUnqualifiedData: start-on-event=SetEventStatus, operation=Event_CodingEventUnqualifiedData.SetEventStatus
        OpEventSetEventStatus_SetEventStatus_Event_CodingEventInvalidData: start-on-event=SetEventStatus, operation=Event_CodingEventInvalidData.SetEventStatus
        OpEventSetEventStatus_SetEventStatus_Event_CansmEBusB2CanOff: start-on-event=SetEventStatus, operation=Event_CansmEBusB2CanOff.SetEventStatus
        OpEventSetEventStatus_SetEventStatus_Event_Overvoltage: start-on-event=SetEventStatus, operation=Event_Overvoltage.SetEventStatus
        OpEventSetEventStatus_SetEventStatus_Event_CodingEventNotCoded: start-on-event=SetEventStatus, operation=Event_CodingEventNotCoded.SetEventStatus
        OpEventSetEventStatus_SetEventStatus_Event_FrifEAcsChA: start-on-event=SetEventStatus, operation=Event_FrifEAcsChA.SetEventStatus
        OpEventSetEventStatus_SetEventStatus_Event_CantrcvEBusFaCanError: start-on-event=SetEventStatus, operation=Event_CantrcvEBusFaCanError.SetEventStatus
        OpEventSetEventStatus_SetEventStatus_Event_CantrcvEBusLeCanError: start-on-event=SetEventStatus, operation=Event_CantrcvEBusLeCanError.SetEventStatus
        OpEventSetEventStatus_SetEventStatus_Event_CantrcvEBusLpCanError: start-on-event=SetEventStatus, operation=Event_CantrcvEBusLpCanError.SetEventStatus
        OpEventSetEventStatus_SetEventStatus_Event_CantrcvEBusZsgCanError: start-on-event=SetEventStatus, operation=Event_CantrcvEBusZsgCanError.SetEventStatus
        OpEventSetEventStatus_SetEventStatus_Event_EthSignalQualityLow: start-on-event=SetEventStatus, operation=Event_EthSignalQualityLow.SetEventStatus
        OpEventResetEventStatus_ResetEventStatus_Event_FrtrcvEFrErrnTrcv0: start-on-event=ResetEventStatus, operation=Event_FrtrcvEFrErrnTrcv0.ResetEventStatus
        OpEventResetEventStatus_ResetEventStatus_Event_CansmEBusIukCanOff: start-on-event=ResetEventStatus, operation=Event_CansmEBusIukCanOff.ResetEventStatus
        OpEventResetEventStatus_ResetEventStatus_Event_FrtrcvEFrErrnTrcv2: start-on-event=ResetEventStatus, operation=Event_FrtrcvEFrErrnTrcv2.ResetEventStatus
        OpEventResetEventStatus_ResetEventStatus_Event_FrtrcvEFrErrnTrcv1: start-on-event=ResetEventStatus, operation=Event_FrtrcvEFrErrnTrcv1.ResetEventStatus
        OpEventResetEventStatus_ResetEventStatus_Event_FrtrcvEFrErrnTrcv4: start-on-event=ResetEventStatus, operation=Event_FrtrcvEFrErrnTrcv4.ResetEventStatus
        OpEventResetEventStatus_ResetEventStatus_Event_FrtrcvEFrErrnTrcv3: start-on-event=ResetEventStatus, operation=Event_FrtrcvEFrErrnTrcv3.ResetEventStatus
        OpEventResetEventStatus_ResetEventStatus_Event_FrtrcvEFrErrnTrcv6: start-on-event=ResetEventStatus, operation=Event_FrtrcvEFrErrnTrcv6.ResetEventStatus
        OpEventResetEventStatus_ResetEventStatus_Event_FrtrcvEFrErrnTrcv5: start-on-event=ResetEventStatus, operation=Event_FrtrcvEFrErrnTrcv5.ResetEventStatus
        OpEventResetEventStatus_ResetEventStatus_Event_CansmEBusBodyCanOff: start-on-event=ResetEventStatus, operation=Event_CansmEBusBodyCanOff.ResetEventStatus
        OpEventResetEventStatus_ResetEventStatus_Event_CbsReplacementValue: start-on-event=ResetEventStatus, operation=Event_CbsReplacementValue.ResetEventStatus
        OpEventResetEventStatus_ResetEventStatus_Event_CansmEBusLeCanOff: start-on-event=ResetEventStatus, operation=Event_CansmEBusLeCanOff.ResetEventStatus
        OpEventResetEventStatus_ResetEventStatus_Event_CansmEBusZsgCanOff: start-on-event=ResetEventStatus, operation=Event_CansmEBusZsgCanOff.ResetEventStatus
        OpEventResetEventStatus_ResetEventStatus_Event_CodingEventWrongVehicle: start-on-event=ResetEventStatus, operation=Event_CodingEventWrongVehicle.ResetEventStatus
        OpEventResetEventStatus_ResetEventStatus_Event_FrsmEClusterStartup: start-on-event=ResetEventStatus, operation=Event_FrsmEClusterStartup.ResetEventStatus
        OpEventResetEventStatus_ResetEventStatus_Event_CansmEBusACanOff: start-on-event=ResetEventStatus, operation=Event_CansmEBusACanOff.ResetEventStatus
        OpEventResetEventStatus_ResetEventStatus_Event_CansmEBusKCanOff: start-on-event=ResetEventStatus, operation=Event_CansmEBusKCanOff.ResetEventStatus
        OpEventResetEventStatus_ResetEventStatus_Event_CantrcvEBusKCanError: start-on-event=ResetEventStatus, operation=Event_CantrcvEBusKCanError.ResetEventStatus
        OpEventResetEventStatus_ResetEventStatus_Event_FrtrcvEFrBuserrorTrcv0: start-on-event=ResetEventStatus, operation=Event_FrtrcvEFrBuserrorTrcv0.ResetEventStatus
        OpEventResetEventStatus_ResetEventStatus_Event_FrtrcvEFrErrnTrcv7: start-on-event=ResetEventStatus, operation=Event_FrtrcvEFrErrnTrcv7.ResetEventStatus
        OpEventResetEventStatus_ResetEventStatus_Event_CansmEBusFaCanOff: start-on-event=ResetEventStatus, operation=Event_CansmEBusFaCanOff.ResetEventStatus
        OpEventResetEventStatus_ResetEventStatus_Event_CantrcvEBusB2CanError: start-on-event=ResetEventStatus, operation=Event_CantrcvEBusB2CanError.ResetEventStatus
        OpEventResetEventStatus_ResetEventStatus_Event_DtcCd{0605..0607}: start-on-event=ResetEventStatus, operation=Event_DtcCd{0605..0607}.ResetEventStatus
        OpEventResetEventStatus_ResetEventStatus_Event_PiaEIoError: start-on-event=ResetEventStatus, operation=Event_PiaEIoError.ResetEventStatus
        OpEventResetEventStatus_ResetEventStatus_Event_DtcCd0601: start-on-event=ResetEventStatus, operation=Event_DtcCd0601.ResetEventStatus
        OpEventResetEventStatus_ResetEventStatus_Event_SwtExternalCheckFailure: start-on-event=ResetEventStatus, operation=Event_SwtExternalCheckFailure.ResetEventStatus
        OpEventResetEventStatus_ResetEventStatus_Event_CantrcvEBusBodyCanError: start-on-event=ResetEventStatus, operation=Event_CantrcvEBusBodyCanError.ResetEventStatus
        OpEventResetEventStatus_ResetEventStatus_Event_CantrcvEBusIukError: start-on-event=ResetEventStatus, operation=Event_CantrcvEBusIukError.ResetEventStatus
        OpEventResetEventStatus_ResetEventStatus_Event_SwtInternalCheckFailure: start-on-event=ResetEventStatus, operation=Event_SwtInternalCheckFailure.ResetEventStatus
        OpEventResetEventStatus_ResetEventStatus_Event_DmTestAppl: start-on-event=ResetEventStatus, operation=Event_DmTestAppl.ResetEventStatus
        OpEventResetEventStatus_ResetEventStatus_Event_Dtc000032: start-on-event=ResetEventStatus, operation=Event_Dtc000032.ResetEventStatus
        OpEventResetEventStatus_ResetEventStatus_Event_Dtc000031: start-on-event=ResetEventStatus, operation=Event_Dtc000031.ResetEventStatus
        OpEventResetEventStatus_ResetEventStatus_Event_FrsmEClusterSyncLoss: start-on-event=ResetEventStatus, operation=Event_FrsmEClusterSyncLoss.ResetEventStatus
        OpEventResetEventStatus_ResetEventStatus_Event_Dtc000030: start-on-event=ResetEventStatus, operation=Event_Dtc000030.ResetEventStatus
        OpEventResetEventStatus_ResetEventStatus_Event_Dtc000034: start-on-event=ResetEventStatus, operation=Event_Dtc000034.ResetEventStatus
        OpEventResetEventStatus_ResetEventStatus_Event_Dtc000033: start-on-event=ResetEventStatus, operation=Event_Dtc000033.ResetEventStatus
        OpEventResetEventStatus_ResetEventStatus_Event_Undervoltage: start-on-event=ResetEventStatus, operation=Event_Undervoltage.ResetEventStatus
        OpEventResetEventStatus_ResetEventStatus_Event_CodingEventTransactionFailed: start-on-event=ResetEventStatus, operation=Event_CodingEventTransactionFailed.ResetEventStatus
        OpEventResetEventStatus_ResetEventStatus_Event_FrifENitChA: start-on-event=ResetEventStatus, operation=Event_FrifENitChA.ResetEventStatus
        OpEventResetEventStatus_ResetEventStatus_Event_CansmEBusLpCanOff: start-on-event=ResetEventStatus, operation=Event_CansmEBusLpCanOff.ResetEventStatus
        OpEventResetEventStatus_ResetEventStatus_Event_VsmEventOpmode: start-on-event=ResetEventStatus, operation=Event_VsmEventOpmode.ResetEventStatus
        OpEventResetEventStatus_ResetEventStatus_Event_CantrcvEBusACanError: start-on-event=ResetEventStatus, operation=Event_CantrcvEBusACanError.ResetEventStatus
        OpEventResetEventStatus_ResetEventStatus_Event_DmTestCom: start-on-event=ResetEventStatus, operation=Event_DmTestCom.ResetEventStatus
        OpEventResetEventStatus_ResetEventStatus_Event_CodingEventSignatureError: start-on-event=ResetEventStatus, operation=Event_CodingEventSignatureError.ResetEventStatus
        OpEventResetEventStatus_ResetEventStatus_Event_CodingEventUnqualifiedData: start-on-event=ResetEventStatus, operation=Event_CodingEventUnqualifiedData.ResetEventStatus
        OpEventResetEventStatus_ResetEventStatus_Event_CodingEventInvalidData: start-on-event=ResetEventStatus, operation=Event_CodingEventInvalidData.ResetEventStatus
        OpEventResetEventStatus_ResetEventStatus_Event_CansmEBusB2CanOff: start-on-event=ResetEventStatus, operation=Event_CansmEBusB2CanOff.ResetEventStatus
        OpEventResetEventStatus_ResetEventStatus_Event_Overvoltage: start-on-event=ResetEventStatus, operation=Event_Overvoltage.ResetEventStatus
        OpEventResetEventStatus_ResetEventStatus_Event_CodingEventNotCoded: start-on-event=ResetEventStatus, operation=Event_CodingEventNotCoded.ResetEventStatus
        OpEventResetEventStatus_ResetEventStatus_Event_FrifEAcsChA: start-on-event=ResetEventStatus, operation=Event_FrifEAcsChA.ResetEventStatus
        OpEventResetEventStatus_ResetEventStatus_Event_CantrcvEBusFaCanError: start-on-event=ResetEventStatus, operation=Event_CantrcvEBusFaCanError.ResetEventStatus
        OpEventResetEventStatus_ResetEventStatus_Event_CantrcvEBusLeCanError: start-on-event=ResetEventStatus, operation=Event_CantrcvEBusLeCanError.ResetEventStatus
        OpEventResetEventStatus_ResetEventStatus_Event_CantrcvEBusLpCanError: start-on-event=ResetEventStatus, operation=Event_CantrcvEBusLpCanError.ResetEventStatus
        OpEventResetEventStatus_ResetEventStatus_Event_CantrcvEBusZsgCanError: start-on-event=ResetEventStatus, operation=Event_CantrcvEBusZsgCanError.ResetEventStatus
        OpEventResetEventStatus_ResetEventStatus_Event_EthSignalQualityLow: start-on-event=ResetEventStatus, operation=Event_EthSignalQualityLow.ResetEventStatus
        OpEventResetEventDebounceStatus_ResetEventDebounceStatus_Event_FrtrcvEFrErrnTrcv0: start-on-event=ResetEventDebounceStatus, operation=Event_FrtrcvEFrErrnTrcv0.ResetEventDebounceStatus
        OpEventResetEventDebounceStatus_ResetEventDebounceStatus_Event_CansmEBusIukCanOff: start-on-event=ResetEventDebounceStatus, operation=Event_CansmEBusIukCanOff.ResetEventDebounceStatus
        OpEventResetEventDebounceStatus_ResetEventDebounceStatus_Event_FrtrcvEFrErrnTrcv2: start-on-event=ResetEventDebounceStatus, operation=Event_FrtrcvEFrErrnTrcv2.ResetEventDebounceStatus
        OpEventResetEventDebounceStatus_ResetEventDebounceStatus_Event_FrtrcvEFrErrnTrcv1: start-on-event=ResetEventDebounceStatus, operation=Event_FrtrcvEFrErrnTrcv1.ResetEventDebounceStatus
        OpEventResetEventDebounceStatus_ResetEventDebounceStatus_Event_FrtrcvEFrErrnTrcv4: start-on-event=ResetEventDebounceStatus, operation=Event_FrtrcvEFrErrnTrcv4.ResetEventDebounceStatus
        OpEventResetEventDebounceStatus_ResetEventDebounceStatus_Event_FrtrcvEFrErrnTrcv3: start-on-event=ResetEventDebounceStatus, operation=Event_FrtrcvEFrErrnTrcv3.ResetEventDebounceStatus
        OpEventResetEventDebounceStatus_ResetEventDebounceStatus_Event_FrtrcvEFrErrnTrcv6: start-on-event=ResetEventDebounceStatus, operation=Event_FrtrcvEFrErrnTrcv6.ResetEventDebounceStatus
        OpEventResetEventDebounceStatus_ResetEventDebounceStatus_Event_FrtrcvEFrErrnTrcv5: start-on-event=ResetEventDebounceStatus, operation=Event_FrtrcvEFrErrnTrcv5.ResetEventDebounceStatus
        OpEventResetEventDebounceStatus_ResetEventDebounceStatus_Event_CansmEBusBodyCanOff: start-on-event=ResetEventDebounceStatus, operation=Event_CansmEBusBodyCanOff.ResetEventDebounceStatus
        OpEventResetEventDebounceStatus_ResetEventDebounceStatus_Event_CbsReplacementValue: start-on-event=ResetEventDebounceStatus, operation=Event_CbsReplacementValue.ResetEventDebounceStatus
        OpEventResetEventDebounceStatus_ResetEventDebounceStatus_Event_CansmEBusLeCanOff: start-on-event=ResetEventDebounceStatus, operation=Event_CansmEBusLeCanOff.ResetEventDebounceStatus
        OpEventResetEventDebounceStatus_ResetEventDebounceStatus_Event_CansmEBusZsgCanOff: start-on-event=ResetEventDebounceStatus, operation=Event_CansmEBusZsgCanOff.ResetEventDebounceStatus
        OpEventResetEventDebounceStatus_ResetEventDebounceStatus_Event_CodingEventWrongVehicle: start-on-event=ResetEventDebounceStatus, operation=Event_CodingEventWrongVehicle.ResetEventDebounceStatus
        OpEventResetEventDebounceStatus_ResetEventDebounceStatus_Event_FrsmEClusterStartup: start-on-event=ResetEventDebounceStatus, operation=Event_FrsmEClusterStartup.ResetEventDebounceStatus
        OpEventResetEventDebounceStatus_ResetEventDebounceStatus_Event_CansmEBusACanOff: start-on-event=ResetEventDebounceStatus, operation=Event_CansmEBusACanOff.ResetEventDebounceStatus
        OpEventResetEventDebounceStatus_ResetEventDebounceStatus_Event_CansmEBusKCanOff: start-on-event=ResetEventDebounceStatus, operation=Event_CansmEBusKCanOff.ResetEventDebounceStatus
        OpEventResetEventDebounceStatus_ResetEventDebounceStatus_Event_CantrcvEBusKCanError: start-on-event=ResetEventDebounceStatus, operation=Event_CantrcvEBusKCanError.ResetEventDebounceStatus
        OpEventResetEventDebounceStatus_ResetEventDebounceStatus_Event_FrtrcvEFrBuserrorTrcv0: start-on-event=ResetEventDebounceStatus, operation=Event_FrtrcvEFrBuserrorTrcv0.ResetEventDebounceStatus
        OpEventResetEventDebounceStatus_ResetEventDebounceStatus_Event_FrtrcvEFrErrnTrcv7: start-on-event=ResetEventDebounceStatus, operation=Event_FrtrcvEFrErrnTrcv7.ResetEventDebounceStatus
        OpEventResetEventDebounceStatus_ResetEventDebounceStatus_Event_CansmEBusFaCanOff: start-on-event=ResetEventDebounceStatus, operation=Event_CansmEBusFaCanOff.ResetEventDebounceStatus
        OpEventResetEventDebounceStatus_ResetEventDebounceStatus_Event_CantrcvEBusB2CanError: start-on-event=ResetEventDebounceStatus, operation=Event_CantrcvEBusB2CanError.ResetEventDebounceStatus
        OpEventResetEventDebounceStatus_ResetEventDebounceStatus_Event_DtcCd{0605..0607}: start-on-event=ResetEventDebounceStatus, operation=Event_DtcCd{0605..0607}.ResetEventDebounceStatus
        OpEventResetEventDebounceStatus_ResetEventDebounceStatus_Event_PiaEIoError: start-on-event=ResetEventDebounceStatus, operation=Event_PiaEIoError.ResetEventDebounceStatus
        OpEventResetEventDebounceStatus_ResetEventDebounceStatus_Event_DtcCd0601: start-on-event=ResetEventDebounceStatus, operation=Event_DtcCd0601.ResetEventDebounceStatus
        OpEventResetEventDebounceStatus_ResetEventDebounceStatus_Event_SwtExternalCheckFailure: start-on-event=ResetEventDebounceStatus, operation=Event_SwtExternalCheckFailure.ResetEventDebounceStatus
        OpEventResetEventDebounceStatus_ResetEventDebounceStatus_Event_CantrcvEBusBodyCanError: start-on-event=ResetEventDebounceStatus, operation=Event_CantrcvEBusBodyCanError.ResetEventDebounceStatus
        OpEventResetEventDebounceStatus_ResetEventDebounceStatus_Event_CantrcvEBusIukError: start-on-event=ResetEventDebounceStatus, operation=Event_CantrcvEBusIukError.ResetEventDebounceStatus
        OpEventResetEventDebounceStatus_ResetEventDebounceStatus_Event_SwtInternalCheckFailure: start-on-event=ResetEventDebounceStatus, operation=Event_SwtInternalCheckFailure.ResetEventDebounceStatus
        OpEventResetEventDebounceStatus_ResetEventDebounceStatus_Event_DmTestAppl: start-on-event=ResetEventDebounceStatus, operation=Event_DmTestAppl.ResetEventDebounceStatus
        OpEventResetEventDebounceStatus_ResetEventDebounceStatus_Event_Dtc000032: start-on-event=ResetEventDebounceStatus, operation=Event_Dtc000032.ResetEventDebounceStatus
        OpEventResetEventDebounceStatus_ResetEventDebounceStatus_Event_Dtc000031: start-on-event=ResetEventDebounceStatus, operation=Event_Dtc000031.ResetEventDebounceStatus
        OpEventResetEventDebounceStatus_ResetEventDebounceStatus_Event_FrsmEClusterSyncLoss: start-on-event=ResetEventDebounceStatus, operation=Event_FrsmEClusterSyncLoss.ResetEventDebounceStatus
        OpEventResetEventDebounceStatus_ResetEventDebounceStatus_Event_Dtc000030: start-on-event=ResetEventDebounceStatus, operation=Event_Dtc000030.ResetEventDebounceStatus
        OpEventResetEventDebounceStatus_ResetEventDebounceStatus_Event_Dtc000034: start-on-event=ResetEventDebounceStatus, operation=Event_Dtc000034.ResetEventDebounceStatus
        OpEventResetEventDebounceStatus_ResetEventDebounceStatus_Event_Dtc000033: start-on-event=ResetEventDebounceStatus, operation=Event_Dtc000033.ResetEventDebounceStatus
        OpEventResetEventDebounceStatus_ResetEventDebounceStatus_Event_Undervoltage: start-on-event=ResetEventDebounceStatus, operation=Event_Undervoltage.ResetEventDebounceStatus
        OpEventResetEventDebounceStatus_ResetEventDebounceStatus_Event_CodingEventTransactionFailed: start-on-event=ResetEventDebounceStatus, operation=Event_CodingEventTransactionFailed.ResetEventDebounceStatus
        OpEventResetEventDebounceStatus_ResetEventDebounceStatus_Event_FrifENitChA: start-on-event=ResetEventDebounceStatus, operation=Event_FrifENitChA.ResetEventDebounceStatus
        OpEventResetEventDebounceStatus_ResetEventDebounceStatus_Event_CansmEBusLpCanOff: start-on-event=ResetEventDebounceStatus, operation=Event_CansmEBusLpCanOff.ResetEventDebounceStatus
        OpEventResetEventDebounceStatus_ResetEventDebounceStatus_Event_VsmEventOpmode: start-on-event=ResetEventDebounceStatus, operation=Event_VsmEventOpmode.ResetEventDebounceStatus
        OpEventResetEventDebounceStatus_ResetEventDebounceStatus_Event_CantrcvEBusACanError: start-on-event=ResetEventDebounceStatus, operation=Event_CantrcvEBusACanError.ResetEventDebounceStatus
        OpEventResetEventDebounceStatus_ResetEventDebounceStatus_Event_DmTestCom: start-on-event=ResetEventDebounceStatus, operation=Event_DmTestCom.ResetEventDebounceStatus
        OpEventResetEventDebounceStatus_ResetEventDebounceStatus_Event_CodingEventSignatureError: start-on-event=ResetEventDebounceStatus, operation=Event_CodingEventSignatureError.ResetEventDebounceStatus
        OpEventResetEventDebounceStatus_ResetEventDebounceStatus_Event_CodingEventUnqualifiedData: start-on-event=ResetEventDebounceStatus, operation=Event_CodingEventUnqualifiedData.ResetEventDebounceStatus
        OpEventResetEventDebounceStatus_ResetEventDebounceStatus_Event_CodingEventInvalidData: start-on-event=ResetEventDebounceStatus, operation=Event_CodingEventInvalidData.ResetEventDebounceStatus
        OpEventResetEventDebounceStatus_ResetEventDebounceStatus_Event_CansmEBusB2CanOff: start-on-event=ResetEventDebounceStatus, operation=Event_CansmEBusB2CanOff.ResetEventDebounceStatus
        OpEventResetEventDebounceStatus_ResetEventDebounceStatus_Event_Overvoltage: start-on-event=ResetEventDebounceStatus, operation=Event_Overvoltage.ResetEventDebounceStatus
        OpEventResetEventDebounceStatus_ResetEventDebounceStatus_Event_CodingEventNotCoded: start-on-event=ResetEventDebounceStatus, operation=Event_CodingEventNotCoded.ResetEventDebounceStatus
        OpEventResetEventDebounceStatus_ResetEventDebounceStatus_Event_FrifEAcsChA: start-on-event=ResetEventDebounceStatus, operation=Event_FrifEAcsChA.ResetEventDebounceStatus
        OpEventResetEventDebounceStatus_ResetEventDebounceStatus_Event_CantrcvEBusFaCanError: start-on-event=ResetEventDebounceStatus, operation=Event_CantrcvEBusFaCanError.ResetEventDebounceStatus
        OpEventResetEventDebounceStatus_ResetEventDebounceStatus_Event_CantrcvEBusLeCanError: start-on-event=ResetEventDebounceStatus, operation=Event_CantrcvEBusLeCanError.ResetEventDebounceStatus
        OpEventResetEventDebounceStatus_ResetEventDebounceStatus_Event_CantrcvEBusLpCanError: start-on-event=ResetEventDebounceStatus, operation=Event_CantrcvEBusLpCanError.ResetEventDebounceStatus
        OpEventResetEventDebounceStatus_ResetEventDebounceStatus_Event_CantrcvEBusZsgCanError: start-on-event=ResetEventDebounceStatus, operation=Event_CantrcvEBusZsgCanError.ResetEventDebounceStatus
        OpEventResetEventDebounceStatus_ResetEventDebounceStatus_Event_EthSignalQualityLow: start-on-event=ResetEventDebounceStatus, operation=Event_EthSignalQualityLow.ResetEventDebounceStatus
      port-api-options:
        {enable-take-address=true, indirect-api=false, port-defined-argument-value{value=43, value-type=Dem_EventIdType}, port=EvtInfo_FrtrcvEFrErrnTrcv0}
        {enable-take-address=true, indirect-api=false, port-defined-argument-value{value=43, value-type=Dem_EventIdType}, port=Event_FrtrcvEFrErrnTrcv0}
        {enable-take-address=true, indirect-api=false, port-defined-argument-value{value=5, value-type=Dem_EventIdType}, port=EvtInfo_CansmEBusIukCanOff}
        {enable-take-address=true, indirect-api=false, port-defined-argument-value{value=5, value-type=Dem_EventIdType}, port=Event_CansmEBusIukCanOff}
        {enable-take-address=true, indirect-api=false, port-defined-argument-value{value=45, value-type=Dem_EventIdType}, port=EvtInfo_FrtrcvEFrErrnTrcv2}
        {enable-take-address=true, indirect-api=false, port-defined-argument-value{value=45, value-type=Dem_EventIdType}, port=Event_FrtrcvEFrErrnTrcv2}
        {enable-take-address=true, indirect-api=false, port-defined-argument-value{value=44, value-type=Dem_EventIdType}, port=EvtInfo_FrtrcvEFrErrnTrcv1}
        {enable-take-address=true, indirect-api=false, port-defined-argument-value{value=44, value-type=Dem_EventIdType}, port=Event_FrtrcvEFrErrnTrcv1}
        {enable-take-address=true, indirect-api=false, port-defined-argument-value{value=47, value-type=Dem_EventIdType}, port=EvtInfo_FrtrcvEFrErrnTrcv4}
        {enable-take-address=true, indirect-api=false, port-defined-argument-value{value=47, value-type=Dem_EventIdType}, port=Event_FrtrcvEFrErrnTrcv4}
        {enable-take-address=true, indirect-api=false, port-defined-argument-value{value=46, value-type=Dem_EventIdType}, port=EvtInfo_FrtrcvEFrErrnTrcv3}
        {enable-take-address=true, indirect-api=false, port-defined-argument-value{value=46, value-type=Dem_EventIdType}, port=Event_FrtrcvEFrErrnTrcv3}
        {enable-take-address=true, indirect-api=false, port-defined-argument-value{value=49, value-type=Dem_EventIdType}, port=EvtInfo_FrtrcvEFrErrnTrcv6}
        {enable-take-address=true, indirect-api=false, port-defined-argument-value{value=49, value-type=Dem_EventIdType}, port=Event_FrtrcvEFrErrnTrcv6}
        {enable-take-address=true, indirect-api=false, port-defined-argument-value{value=48, value-type=Dem_EventIdType}, port=EvtInfo_FrtrcvEFrErrnTrcv5}
        {enable-take-address=true, indirect-api=false, port-defined-argument-value{value=48, value-type=Dem_EventIdType}, port=Event_FrtrcvEFrErrnTrcv5}
        {enable-take-address=true, indirect-api=false, port-defined-argument-value{value=3, value-type=Dem_EventIdType}, port=EvtInfo_CansmEBusBodyCanOff}
        {enable-take-address=true, indirect-api=false, port-defined-argument-value{value=3, value-type=Dem_EventIdType}, port=Event_CansmEBusBodyCanOff}
        {enable-take-address=true, indirect-api=false, port-defined-argument-value{value=19, value-type=Dem_EventIdType}, port=EvtInfo_CbsReplacementValue}
        {enable-take-address=true, indirect-api=false, port-defined-argument-value{value=19, value-type=Dem_EventIdType}, port=Event_CbsReplacementValue}
        {enable-take-address=true, indirect-api=false, port-defined-argument-value{value=7, value-type=Dem_EventIdType}, port=EvtInfo_CansmEBusLeCanOff}
        {enable-take-address=true, indirect-api=false, port-defined-argument-value{value=7, value-type=Dem_EventIdType}, port=Event_CansmEBusLeCanOff}
        {enable-take-address=true, indirect-api=false, port-defined-argument-value{value=9, value-type=Dem_EventIdType}, port=EvtInfo_CansmEBusZsgCanOff}
        {enable-take-address=true, indirect-api=false, port-defined-argument-value{value=9, value-type=Dem_EventIdType}, port=Event_CansmEBusZsgCanOff}
        {enable-take-address=true, indirect-api=false, port-defined-argument-value{value=25, value-type=Dem_EventIdType}, port=EvtInfo_CodingEventWrongVehicle}
        {enable-take-address=true, indirect-api=false, port-defined-argument-value{value=25, value-type=Dem_EventIdType}, port=Event_CodingEventWrongVehicle}
        {enable-take-address=true, indirect-api=false, port-defined-argument-value{value=40, value-type=Dem_EventIdType}, port=EvtInfo_FrsmEClusterStartup}
        {enable-take-address=true, indirect-api=false, port-defined-argument-value{value=40, value-type=Dem_EventIdType}, port=Event_FrsmEClusterStartup}
        {enable-take-address=true, indirect-api=false, port-defined-argument-value{value=1, value-type=Dem_EventIdType}, port=EvtInfo_CansmEBusACanOff}
        {enable-take-address=true, indirect-api=false, port-defined-argument-value{value=1, value-type=Dem_EventIdType}, port=Event_CansmEBusACanOff}
        {enable-take-address=true, indirect-api=false, port-defined-argument-value{value=6, value-type=Dem_EventIdType}, port=EvtInfo_CansmEBusKCanOff}
        {enable-take-address=true, indirect-api=false, port-defined-argument-value{value=6, value-type=Dem_EventIdType}, port=Event_CansmEBusKCanOff}
        {enable-take-address=true, indirect-api=false, port-defined-argument-value{value=15, value-type=Dem_EventIdType}, port=EvtInfo_CantrcvEBusKCanError}
        {enable-take-address=true, indirect-api=false, port-defined-argument-value{value=15, value-type=Dem_EventIdType}, port=Event_CantrcvEBusKCanError}
        {enable-take-address=true, indirect-api=false, port-defined-argument-value{value=42, value-type=Dem_EventIdType}, port=EvtInfo_FrtrcvEFrBuserrorTrcv0}
        {enable-take-address=true, indirect-api=false, port-defined-argument-value{value=42, value-type=Dem_EventIdType}, port=Event_FrtrcvEFrBuserrorTrcv0}
        {enable-take-address=true, indirect-api=false, port-defined-argument-value{value=50, value-type=Dem_EventIdType}, port=EvtInfo_FrtrcvEFrErrnTrcv7}
        {enable-take-address=true, indirect-api=false, port-defined-argument-value{value=50, value-type=Dem_EventIdType}, port=Event_FrtrcvEFrErrnTrcv7}
        {enable-take-address=true, indirect-api=false, port-defined-argument-value{value=4, value-type=Dem_EventIdType}, port=EvtInfo_CansmEBusFaCanOff}
        {enable-take-address=true, indirect-api=false, port-defined-argument-value{value=4, value-type=Dem_EventIdType}, port=Event_CansmEBusFaCanOff}
        {enable-take-address=true, indirect-api=false, port-defined-argument-value{value=11, value-type=Dem_EventIdType}, port=EvtInfo_CantrcvEBusB2CanError}
        {enable-take-address=true, indirect-api=false, port-defined-argument-value{value=11, value-type=Dem_EventIdType}, port=Event_CantrcvEBusB2CanError}
        {enable-take-address=true, indirect-api=false, port-defined-argument-value{value=34, value-type=Dem_EventIdType}, port=EvtInfo_DtcCd0605}
        {enable-take-address=true, indirect-api=false, port-defined-argument-value{value=34, value-type=Dem_EventIdType}, port=Event_DtcCd0605}
        {enable-take-address=true, indirect-api=false, port-defined-argument-value{value=35, value-type=Dem_EventIdType}, port=EvtInfo_DtcCd0606}
        {enable-take-address=true, indirect-api=false, port-defined-argument-value{value=35, value-type=Dem_EventIdType}, port=Event_DtcCd0606}
        {enable-take-address=true, indirect-api=false, port-defined-argument-value{value=36, value-type=Dem_EventIdType}, port=EvtInfo_DtcCd0607}
        {enable-take-address=true, indirect-api=false, port-defined-argument-value{value=36, value-type=Dem_EventIdType}, port=Event_DtcCd0607}
        {enable-take-address=true, indirect-api=false, port-defined-argument-value{value=54, value-type=Dem_EventIdType}, port=EvtInfo_PiaEIoError}
        {enable-take-address=true, indirect-api=false, port-defined-argument-value{value=54, value-type=Dem_EventIdType}, port=Event_PiaEIoError}
        {enable-take-address=true, indirect-api=false, port-defined-argument-value{value=33, value-type=Dem_EventIdType}, port=EvtInfo_DtcCd0601}
        {enable-take-address=true, indirect-api=false, port-defined-argument-value{value=33, value-type=Dem_EventIdType}, port=Event_DtcCd0601}
        {enable-take-address=true, indirect-api=false, port-defined-argument-value{value=55, value-type=Dem_EventIdType}, port=EvtInfo_SwtExternalCheckFailure}
        {enable-take-address=true, indirect-api=false, port-defined-argument-value{value=55, value-type=Dem_EventIdType}, port=Event_SwtExternalCheckFailure}
        {enable-take-address=true, indirect-api=false, port-defined-argument-value{value=12, value-type=Dem_EventIdType}, port=EvtInfo_CantrcvEBusBodyCanError}
        {enable-take-address=true, indirect-api=false, port-defined-argument-value{value=12, value-type=Dem_EventIdType}, port=Event_CantrcvEBusBodyCanError}
        {enable-take-address=true, indirect-api=false, port-defined-argument-value{value=14, value-type=Dem_EventIdType}, port=EvtInfo_CantrcvEBusIukError}
        {enable-take-address=true, indirect-api=false, port-defined-argument-value{value=14, value-type=Dem_EventIdType}, port=Event_CantrcvEBusIukError}
        {enable-take-address=true, indirect-api=false, port-defined-argument-value{value=56, value-type=Dem_EventIdType}, port=EvtInfo_SwtInternalCheckFailure}
        {enable-take-address=true, indirect-api=false, port-defined-argument-value{value=56, value-type=Dem_EventIdType}, port=Event_SwtInternalCheckFailure}
        {enable-take-address=true, indirect-api=false, port-defined-argument-value{value=26, value-type=Dem_EventIdType}, port=EvtInfo_DmTestAppl}
        {enable-take-address=true, indirect-api=false, port-defined-argument-value{value=26, value-type=Dem_EventIdType}, port=Event_DmTestAppl}
        {enable-take-address=true, indirect-api=false, port-defined-argument-value{value=30, value-type=Dem_EventIdType}, port=EvtInfo_Dtc000032}
        {enable-take-address=true, indirect-api=false, port-defined-argument-value{value=30, value-type=Dem_EventIdType}, port=Event_Dtc000032}
        {enable-take-address=true, indirect-api=false, port-defined-argument-value{value=29, value-type=Dem_EventIdType}, port=EvtInfo_Dtc000031}
        {enable-take-address=true, indirect-api=false, port-defined-argument-value{value=29, value-type=Dem_EventIdType}, port=Event_Dtc000031}
        {enable-take-address=true, indirect-api=false, port-defined-argument-value{value=41, value-type=Dem_EventIdType}, port=EvtInfo_FrsmEClusterSyncLoss}
        {enable-take-address=true, indirect-api=false, port-defined-argument-value{value=41, value-type=Dem_EventIdType}, port=Event_FrsmEClusterSyncLoss}
        {enable-take-address=true, indirect-api=false, port-defined-argument-value{value=28, value-type=Dem_EventIdType}, port=EvtInfo_Dtc000030}
        {enable-take-address=true, indirect-api=false, port-defined-argument-value{value=28, value-type=Dem_EventIdType}, port=Event_Dtc000030}
        {enable-take-address=true, indirect-api=false, port-defined-argument-value{value=32, value-type=Dem_EventIdType}, port=EvtInfo_Dtc000034}
        {enable-take-address=true, indirect-api=false, port-defined-argument-value{value=32, value-type=Dem_EventIdType}, port=Event_Dtc000034}
        {enable-take-address=true, indirect-api=false, port-defined-argument-value{value=31, value-type=Dem_EventIdType}, port=EvtInfo_Dtc000033}
        {enable-take-address=true, indirect-api=false, port-defined-argument-value{value=31, value-type=Dem_EventIdType}, port=Event_Dtc000033}
        {enable-take-address=true, indirect-api=false, port-defined-argument-value{value=58, value-type=Dem_EventIdType}, port=EvtInfo_Undervoltage}
        {enable-take-address=true, indirect-api=false, port-defined-argument-value{value=58, value-type=Dem_EventIdType}, port=Event_Undervoltage}
        {enable-take-address=true, indirect-api=false, port-defined-argument-value{value=23, value-type=Dem_EventIdType}, port=EvtInfo_CodingEventTransactionFailed}
        {enable-take-address=true, indirect-api=false, port-defined-argument-value{value=23, value-type=Dem_EventIdType}, port=Event_CodingEventTransactionFailed}
        {enable-take-address=true, indirect-api=false, port-defined-argument-value{value=39, value-type=Dem_EventIdType}, port=EvtInfo_FrifENitChA}
        {enable-take-address=true, indirect-api=false, port-defined-argument-value{value=39, value-type=Dem_EventIdType}, port=Event_FrifENitChA}
        {enable-take-address=true, indirect-api=false, port-defined-argument-value{value=8, value-type=Dem_EventIdType}, port=EvtInfo_CansmEBusLpCanOff}
        {enable-take-address=true, indirect-api=false, port-defined-argument-value{value=8, value-type=Dem_EventIdType}, port=Event_CansmEBusLpCanOff}
        {enable-take-address=true, indirect-api=false, port-defined-argument-value{value=52, value-type=Dem_EventIdType}, port=EvtInfo_NVM_E_HARDWARE}
        {enable-take-address=true, indirect-api=false, port-defined-argument-value{value=59, value-type=Dem_EventIdType}, port=EvtInfo_VsmEventOpmode}
        {enable-take-address=true, indirect-api=false, port-defined-argument-value{value=59, value-type=Dem_EventIdType}, port=Event_VsmEventOpmode}
        {enable-take-address=true, indirect-api=false, port-defined-argument-value{value=51, value-type=Dem_EventIdType}, port=EvtInfo_LIN_E_TIMEOUT}
        {enable-take-address=true, indirect-api=false, port-defined-argument-value{value=10, value-type=Dem_EventIdType}, port=EvtInfo_CantrcvEBusACanError}
        {enable-take-address=true, indirect-api=false, port-defined-argument-value{value=10, value-type=Dem_EventIdType}, port=Event_CantrcvEBusACanError}
        {enable-take-address=true, indirect-api=false, port-defined-argument-value{value=57, value-type=Dem_EventIdType}, port=EvtInfo_UDPNM_E_TCPIP_TRANSMIT_ERROR}
        {enable-take-address=true, indirect-api=false, port-defined-argument-value{value=27, value-type=Dem_EventIdType}, port=EvtInfo_DmTestCom}
        {enable-take-address=true, indirect-api=false, port-defined-argument-value{value=27, value-type=Dem_EventIdType}, port=Event_DmTestCom}
        {enable-take-address=true, indirect-api=false, port-defined-argument-value{value=22, value-type=Dem_EventIdType}, port=EvtInfo_CodingEventSignatureError}
        {enable-take-address=true, indirect-api=false, port-defined-argument-value{value=22, value-type=Dem_EventIdType}, port=Event_CodingEventSignatureError}
        {enable-take-address=true, indirect-api=false, port-defined-argument-value{value=24, value-type=Dem_EventIdType}, port=EvtInfo_CodingEventUnqualifiedData}
        {enable-take-address=true, indirect-api=false, port-defined-argument-value{value=24, value-type=Dem_EventIdType}, port=Event_CodingEventUnqualifiedData}
        {enable-take-address=true, indirect-api=false, port-defined-argument-value{value=20, value-type=Dem_EventIdType}, port=EvtInfo_CodingEventInvalidData}
        {enable-take-address=true, indirect-api=false, port-defined-argument-value{value=20, value-type=Dem_EventIdType}, port=Event_CodingEventInvalidData}
        {enable-take-address=true, indirect-api=false, port-defined-argument-value{value=2, value-type=Dem_EventIdType}, port=EvtInfo_CansmEBusB2CanOff}
        {enable-take-address=true, indirect-api=false, port-defined-argument-value{value=2, value-type=Dem_EventIdType}, port=Event_CansmEBusB2CanOff}
        {enable-take-address=true, indirect-api=false, port-defined-argument-value{value=53, value-type=Dem_EventIdType}, port=EvtInfo_Overvoltage}
        {enable-take-address=true, indirect-api=false, port-defined-argument-value{value=53, value-type=Dem_EventIdType}, port=Event_Overvoltage}
        {enable-take-address=true, indirect-api=false, port-defined-argument-value{value=21, value-type=Dem_EventIdType}, port=EvtInfo_CodingEventNotCoded}
        {enable-take-address=true, indirect-api=false, port-defined-argument-value{value=21, value-type=Dem_EventIdType}, port=Event_CodingEventNotCoded}
        {enable-take-address=true, indirect-api=false, port-defined-argument-value{value=38, value-type=Dem_EventIdType}, port=EvtInfo_FrifEAcsChA}
        {enable-take-address=true, indirect-api=false, port-defined-argument-value{value=38, value-type=Dem_EventIdType}, port=Event_FrifEAcsChA}
        {enable-take-address=true, indirect-api=false, port-defined-argument-value{value=13, value-type=Dem_EventIdType}, port=EvtInfo_CantrcvEBusFaCanError}
        {enable-take-address=true, indirect-api=false, port-defined-argument-value{value=13, value-type=Dem_EventIdType}, port=Event_CantrcvEBusFaCanError}
        {enable-take-address=true, indirect-api=false, port-defined-argument-value{value=16, value-type=Dem_EventIdType}, port=EvtInfo_CantrcvEBusLeCanError}
        {enable-take-address=true, indirect-api=false, port-defined-argument-value{value=16, value-type=Dem_EventIdType}, port=Event_CantrcvEBusLeCanError}
        {enable-take-address=true, indirect-api=false, port-defined-argument-value{value=17, value-type=Dem_EventIdType}, port=EvtInfo_CantrcvEBusLpCanError}
        {enable-take-address=true, indirect-api=false, port-defined-argument-value{value=17, value-type=Dem_EventIdType}, port=Event_CantrcvEBusLpCanError}
        {enable-take-address=true, indirect-api=false, port-defined-argument-value{value=18, value-type=Dem_EventIdType}, port=EvtInfo_CantrcvEBusZsgCanError}
        {enable-take-address=true, indirect-api=false, port-defined-argument-value{value=18, value-type=Dem_EventIdType}, port=Event_CantrcvEBusZsgCanError}
        {enable-take-address=true, indirect-api=false, port-defined-argument-value{value=37, value-type=Dem_EventIdType}, port=EvtInfo_EthSignalQualityLow}
        {enable-take-address=true, indirect-api=false, port-defined-argument-value{value=37, value-type=Dem_EventIdType}, port=Event_EthSignalQualityLow}
        {enable-take-address=true, indirect-api=false, port-defined-argument-value{value=60, value-type=Dem_EventIdType}, port=EvtInfo_DemEventParameter_FlsConfigSet_FLS_E_COMPARE_FAILED}
        {enable-take-address=true, indirect-api=false, port-defined-argument-value{value=64, value-type=Dem_EventIdType}, port=EvtInfo_DemEventParameter_FlsConfigSet_FLS_E_ERASE_FAILED}
        {enable-take-address=true, indirect-api=false, port-defined-argument-value{value=68, value-type=Dem_EventIdType}, port=EvtInfo_DemEventParameter_FlsConfigSet_FLS_E_READ_FAILED}
        {enable-take-address=true, indirect-api=false, port-defined-argument-value{value=69, value-type=Dem_EventIdType}, port=EvtInfo_DemEventParameter_FlsConfigSet_FLS_E_WRITE_FAILED}
        {enable-take-address=true, indirect-api=false, port-defined-argument-value{value=70, value-type=Dem_EventIdType}, port=EvtInfo_DemEventParameter_FlsConfigSet_FLS_E_READ_DED_FAILED}
        {enable-take-address=true, indirect-api=false, port-defined-argument-value{value=71, value-type=Dem_EventIdType}, port=EvtInfo_DemEventParameter_FlsConfigSet_FLS_E_UNEXPECTED_FLASH_ID}
        {enable-take-address=true, indirect-api=false, port-defined-argument-value{value=61, value-type=Dem_EventIdType}, port=EvtInfo_DemEventParameter_FlsConfigSet_MCU_E_CLOCK_FAILED}
        {enable-take-address=true, indirect-api=false, port-defined-argument-value{value=62, value-type=Dem_EventIdType}, port=EvtInfo_DemEventParameter_FlsConfigSet_MCU_E_HW_FAILED}
        {enable-take-address=true, indirect-api=false, port-defined-argument-value{value=63, value-type=Dem_EventIdType}, port=EvtInfo_DemEventParameter_FlsConfigSet_MCU_E_STARTUP_FAILED}
        {enable-take-address=true, indirect-api=false, port-defined-argument-value{value=65, value-type=Dem_EventIdType}, port=EvtInfo_DemEventParameter_FlsConfigSet_FLS_E_ECC_FAILED}
        {enable-take-address=true, indirect-api=false, port-defined-argument-value{value=66, value-type=Dem_EventIdType}, port=EvtInfo_DemEventParameter_FlsConfigSet_FLS_E_VRFY_FAILED}
        {enable-take-address=true, indirect-api=false, port-defined-argument-value{value=67, value-type=Dem_EventIdType}, port=EvtInfo_DemEventParameter_FlsConfigSet_FLS_E_INT_FAILED}
        {enable-take-address=true, indirect-api=false, port-defined-argument-value{value=72, value-type=Dem_EventIdType}, port=EvtInfo_DemEventParameter_FlsConfigSet_FLS_E_HW_FAILED}
        enable-take-address=true, indirect-api=false, port=DemSatellite_0/GeneralEventInfo
      15 x runnable:
        Dem_SatelliteMainFunction
        GetEventUdsStatus: can-be-invoked-concurrently=true, symbol=Dem_GetEventUdsStatus
        GetEventStatus: can-be-invoked-concurrently=true, symbol=Dem_GetEventUdsStatus
        GetEventFailed: can-be-invoked-concurrently=true, symbol=Dem_GetEventFailed
        GetEventTested: can-be-invoked-concurrently=true, symbol=Dem_GetEventTested
        GetDTCOfEvent: can-be-invoked-concurrently=true, symbol=Dem_GetDTCOfEvent
        GetFaultDetectionCounter: can-be-invoked-concurrently=true, symbol=Dem_GetFaultDetectionCounter
        GetEventFreezeFrameDataEx: can-be-invoked-concurrently=true, symbol=Dem_GetEventFreezeFrameDataEx
        GetEventExtendedDataRecordEx: can-be-invoked-concurrently=true, symbol=Dem_GetEventExtendedDataRecordEx
        GetEventEnableCondition: can-be-invoked-concurrently=true, symbol=Dem_GetEventEnableCondition
        GetDebouncingOfEvent: can-be-invoked-concurrently=true, symbol=Dem_GetDebouncingOfEvent
        GetMonitorStatus: can-be-invoked-concurrently=true, symbol=Dem_GetMonitorStatus
        SetEventStatus: can-be-invoked-concurrently=true, symbol=Dem_SetEventStatus
        ResetEventStatus: can-be-invoked-concurrently=true, symbol=Dem_ResetEventStatus
        ResetEventDebounceStatus: can-be-invoked-concurrently=true, symbol=Dem_ResetEventDebounceStatus
  swc implementation DemSatellite_0Implementation: programming-language=C, behavior=DemSatellite_0InternalBehavior
