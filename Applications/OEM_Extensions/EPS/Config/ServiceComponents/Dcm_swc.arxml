[part 1 of 2: packages /MICROSAR/Dcm_swc to /MICROSAR/Dcm_swc/Interfaces]
AUTOSAR XML (schema 4-3-0)
package /MICROSAR/Dcm_swc
  6 x mode declaration group, all with category=EXPLICIT_ORDER:
    DcmControlDtcSetting: initial-mode=ENABLEDTCSETTING, on-transition-value=2
      mode ENABLEDTCSETTING: value=0
      mode DISABLEDTCSETTING: value=1
    DcmEcuReset: initial-mode=NONE, on-transition-value=7
      7 x mode:
        NONE: value=0
        HARD: value=1
        KEYONOFF: value=2
        SOFT: value=3
        JUMPTOBOOTLOADER: value=4
        JUMPTOSYSSUPPLIERBOOTLOADER: value=5
        EXECUTE: value=6
    DcmModeRapidPowerShutDown: initial-mode=ENABLE_RAPIDPOWERSHUTDOWN, on-transition-value=2
      mode ENABLE_RAPIDPOWERSHUTDOWN: value=0
      mode DISABLE_RAPIDPOWERSHUTDOWN: value=1
    DcmDiagnosticSessionControl: initial-mode=DEFAULT_SESSION, on-transition-value=255
      6 x mode:
        DEFAULT_SESSION: value=1
        PROGRAMMING_SESSION: value=2
        EXTENDED_SESSION: value=3
        DcmDspSessionRow_CODING_SESSION: value=65
        DcmDspSessionRow_SWT_SESSION: value=66
        DcmDspSessionRow_HDD_DOWNLOAD_SESSION: value=67
    DcmCommunicationControl: initial-mode=DCM_ENABLE_RX_TX_NORM, on-transition-value=12
      12 x mode:
        DCM_ENABLE_RX_TX_NORM: value=0
        DCM_ENABLE_RX_DISABLE_TX_NORM: value=1
        DCM_DISABLE_RX_ENABLE_TX_NORM: value=2
        DCM_DISABLE_RX_TX_NORMAL: value=3
        DCM_ENABLE_RX_TX_NM: value=4
        DCM_ENABLE_RX_DISABLE_TX_NM: value=5
        DCM_DISABLE_RX_ENABLE_TX_NM: value=6
        DCM_DISABLE_RX_TX_NM: value=7
        DCM_ENABLE_RX_TX_NORM_NM: value=8
        DCM_ENABLE_RX_DISABLE_TX_NORM_NM: value=9
        DCM_DISABLE_RX_ENABLE_TX_NORM_NM: value=10
        DCM_DISABLE_RX_TX_NORM_NM: value=11
    DcmResponseOnEvent: initial-mode=EVENT_CLEARED, on-transition-value=3
      mode EVENT_STARTED: value=0
      mode EVENT_STOPPED: value=1
      mode EVENT_CLEARED: value=2
  data type mapping set DcmMappingSet  # Contains mapping for ModeDeclarationGroups which are provided by Dcm.
    mode-request-type-maps:
      implementation-data-type=Dcm_ControlDtcSettingType, mode-group=DcmControlDtcSetting
      implementation-data-type=Dcm_EcuResetType, mode-group=DcmEcuReset
      implementation-data-type=Dcm_ModeRapidPowerShutDownType, mode-group=DcmModeRapidPowerShutDown
      implementation-data-type=Dcm_DiagnosticSessionControlType, mode-group=DcmDiagnosticSessionControl
      implementation-data-type=Dcm_CommunicationModeType, mode-group=DcmCommunicationControl
      implementation-data-type=Dcm_ResponseOnEventType, mode-group=DcmResponseOnEvent
package /MICROSAR/Dcm_swc/DataTypes
  40 x impl type:
    Dcm_ConfirmationStatusType: compu {0=DCM_RES_POS_OK, 1=DCM_RES_POS_NOT_OK, 2=DCM_RES_NEG_OK, 3=DCM_RES_NEG_NOT_OK}, implementation-data-type=uint8
    Dcm_OpStatusType: compu {0=DCM_INITIAL, 1=DCM_PENDING, 2=DCM_CANCEL, 3=DCM_FORCE_RCRRP_OK, 64=DCM_FORCE_RCRRP_NOT_OK}, implementation-data-type=uint8
    Dcm_DidSupportedType: compu {0=DCM_DID_SUPPORTED, 1=DCM_DID_NOT_SUPPORTED}, implementation-data-type=uint8
    Dcm_NegativeResponseCodeType: compu {0=DCM_E_POSITIVERESPONSE, 16=DCM_E_GENERALREJECT, 17=DCM_E_SERVICENOTSUPPORTED, 18=DCM_E_SUBFUNCTIONNOTSUPPORTED, 19=DCM_E_INCORRECTMESSAGELENGTHORINVALIDFORMAT, 20=DCM_E_RESPONSETOOLONG, 33=DCM_E_BUSYREPEATREQUEST, 34=DCM_E_CONDITIONSNOTCORRECT, 36=DCM_E_REQUESTSEQUENCEERROR, 37=DCM_E_NORESPONSEFROMSUBNETCOMPONENT, 38=DCM_E_FAILUREPREVENTSEXECUTIONOFREQUESTEDACTION, 49=DCM_E_REQUESTOUTOFRANGE, 51=DCM_E_SECURITYACCESSDENIED, 53=DCM_E_INVALIDKEY, 54=DCM_E_EXCEEDNUMBEROFATTEMPTS, 55=DCM_E_REQUIREDTIMEDELAYNOTEXPIRED, 112=DCM_E_UPLOADDOWNLOADNOTACCEPTED, 113=DCM_E_TRANSFERDATASUSPENDED, 114=DCM_E_GENERALPROGRAMMINGFAILURE, 115=DCM_E_WRONGBLOCKSEQUENCECOUNTER, 120=DCM_E_REQUESTCORRECTLYRECEIVEDRESPONSEPENDING, 126=DCM_E_SUBFUNCTIONNOTSUPPORTEDINACTIVESESSION, 127=DCM_E_SERVICENOTSUPPORTEDINACTIVESESSION, 129=DCM_E_RPMTOOHIGH, 130=DCM_E_RPMTOOLOW, 131=DCM_E_ENGINEISRUNNING, 132=DCM_E_ENGINEISNOTRUNNING, 133=DCM_E_ENGINERUNTIMETOOLOW, 134=DCM_E_TEMPERATURETOOHIGH, 135=DCM_E_TEMPERATURETOOLOW, 136=DCM_E_VEHICLESPEEDTOOHIGH, 137=DCM_E_VEHICLESPEEDTOOLOW, 138=DCM_E_THROTTLE_PEDALTOOHIGH, 139=DCM_E_THROTTLE_PEDALTOOLOW, 140=DCM_E_TRANSMISSIONRANGENOTINNEUTRAL, 141=DCM_E_TRANSMISSIONRANGENOTINGEAR, 143=DCM_E_BRAKESWITCH_NOTCLOSED, 144=DCM_E_SHIFTERLEVERNOTINPARK, 145=DCM_E_TORQUECONVERTERCLUTCHLOCKED, 146=DCM_E_VOLTAGETOOHIGH, 147=DCM_E_VOLTAGETOOLOW, 240..249=DCM_E_VMSCNC_0..DCM_E_VMSCNC_9, 250=DCM_E_VMSCNC_A, 251=DCM_E_VMSCNC_B, 252=DCM_E_VMSCNC_C, 253=DCM_E_VMSCNC_D, 254=DCM_E_VMSCNC_E}, implementation-data-type=uint8
    Dcm_ProtocolType: compu {0=DCM_OBD_ON_CAN, 1=DCM_OBD_ON_FLEXRAY, 2=DCM_OBD_ON_IP, 3=DCM_UDS_ON_CAN, 4=DCM_UDS_ON_FLEXRAY, 5=DCM_UDS_ON_IP, 12=DCM_NO_ACTIVE_PROTOCOL, 240..254=DCM_SUPPLIER_1..DCM_SUPPLIER_15}, implementation-data-type=uint8
    Dcm_RequestKindType: compu {0=DCM_REQ_KIND_NONE, 1=DCM_REQ_KIND_EXTERNAL, 2=DCM_REQ_KIND_ROE}, implementation-data-type=uint8
    Dcm_SecLevelType: compu {0=DCM_SEC_LEV_LOCKED, 1=DCM_SEC_LEV_L1, 2=DCM_SEC_LEV_L2, 9=DCM_SEC_LEV_L9, 10=DCM_SEC_LEV_L10}, implementation-data-type=uint8
    Dcm_SesCtrlType: compu {1=DCM_DEFAULT_SESSION, 2=DCM_PROGRAMMING_SESSION, 3=DCM_EXTENDED_DIAGNOSTIC_SESSION, 65=DCM_DcmDspSessionRow_CODING_SESSION, 66=DCM_DcmDspSessionRow_SWT_SESSION, 67=DCM_DcmDspSessionRow_HDD_DOWNLOAD_SESSION}, implementation-data-type=uint8
    Dem_DTCFormatType: compu {0=DEM_DTC_FORMAT_OBD, 1=DEM_DTC_FORMAT_UDS, 2=DEM_DTC_FORMAT_J1939}, implementation-data-type=uint8
    Dem_DTCKindType: compu {1=DEM_DTC_KIND_ALL_DTCS, 2=DEM_DTC_KIND_EMISSION_REL_DTCS}, implementation-data-type=uint8
    Dem_DTCGroupType: range raw 0..16777215, implementation-data-type=uint32
    Dem_DTCOriginType: compu {1=DEM_DTC_ORIGIN_PRIMARY_MEMORY, 2=DEM_DTC_ORIGIN_MIRROR_MEMORY, 3=DEM_DTC_ORIGIN_PERMANENT_MEMORY, 4=DEM_DTC_ORIGIN_SECONDARY_MEMORY}, implementation-data-type=uint8
    Dcm_ControlDtcSettingType: compu {0=DCM_ENUM_ENABLEDTCSETTING, 1=DCM_ENUM_DISABLEDTCSETTING}, implementation-data-type=uint8
    Dcm_EcuResetType: compu {0=DCM_ENUM_NONE, 1=DCM_ENUM_HARD, 2=DCM_ENUM_KEYONOFF, 3=DCM_ENUM_SOFT, 4=DCM_ENUM_JUMPTOBOOTLOADER, 5=DCM_ENUM_JUMPTOSYSSUPPLIERBOOTLOADER, 6=DCM_ENUM_EXECUTE}, implementation-data-type=uint8
    Dcm_ModeRapidPowerShutDownType: compu {0=DCM_ENUM_ENABLE_RAPIDPOWERSHUTDOWN, 1=DCM_ENUM_DISABLE_RAPIDPOWERSHUTDOWN}, implementation-data-type=uint8
    Dcm_DiagnosticSessionControlType: compu {1=DCM_ENUM_DEFAULT_SESSION, 2=DCM_ENUM_PROGRAMMING_SESSION, 3=DCM_ENUM_EXTENDED_SESSION, 65=DCM_ENUM_DcmDspSessionRow_CODING_SESSION, 66=DCM_ENUM_DcmDspSessionRow_SWT_SESSION, 67=DCM_ENUM_DcmDspSessionRow_HDD_DOWNLOAD_SESSION}, implementation-data-type=uint8
    Dcm_CommunicationModeType: compu {0=DCM_ENABLE_RX_TX_NORM, 1=DCM_ENABLE_RX_DISABLE_TX_NORM, 2=DCM_DISABLE_RX_ENABLE_TX_NORM, 3=DCM_DISABLE_RX_TX_NORMAL, 4=DCM_ENABLE_RX_TX_NM, 5=DCM_ENABLE_RX_DISABLE_TX_NM, 6=DCM_DISABLE_RX_ENABLE_TX_NM, 7=DCM_DISABLE_RX_TX_NM, 8=DCM_ENABLE_RX_TX_NORM_NM, 9=DCM_ENABLE_RX_DISABLE_TX_NORM_NM, 10=DCM_DISABLE_RX_ENABLE_TX_NORM_NM, 11=DCM_DISABLE_RX_TX_NORM_NM}, implementation-data-type=uint8
    Dcm_ResponseOnEventType: compu {0=DCM_ENUM_EVENT_STARTED, 1=DCM_ENUM_EVENT_STOPPED, 2=DCM_ENUM_EVENT_CLEARED}, implementation-data-type=uint8
    Dcm_Data8195ByteType: category=ARRAY, sw-calibration-access=READ-ONLY
      element Dcm_Data8195ByteTypeElement: array-size=8195, array-size-semantics=FIXED-SIZE, implementation-data-type=uint8
    Dcm_Data4ByteType: category=ARRAY, sw-calibration-access=READ-ONLY
      element Dcm_Data4ByteTypeElement: array-size=4, array-size-semantics=FIXED-SIZE, implementation-data-type=uint8
    Dcm_Data8ByteType: category=ARRAY, sw-calibration-access=READ-ONLY
      element Dcm_Data8ByteTypeElement: array-size=8, array-size-semantics=FIXED-SIZE, implementation-data-type=uint8
    Dcm_Data132ByteType: category=ARRAY, sw-calibration-access=READ-ONLY
      element Dcm_Data132ByteTypeElement: array-size=132, array-size-semantics=FIXED-SIZE, implementation-data-type=uint8
    Dcm_Data256ByteType: category=ARRAY, sw-calibration-access=READ-ONLY
      element Dcm_Data256ByteTypeElement: array-size=256, array-size-semantics=FIXED-SIZE, implementation-data-type=uint8
    Dcm_Data16ByteType: category=ARRAY, sw-calibration-access=READ-ONLY
      element Dcm_Data16ByteTypeElement: array-size=16, array-size-semantics=FIXED-SIZE, implementation-data-type=uint8
    Dcm_Data20ByteType: category=ARRAY, sw-calibration-access=READ-ONLY
      element Dcm_Data20ByteTypeElement: array-size=20, array-size-semantics=FIXED-SIZE, implementation-data-type=uint8
    Dcm_Data99ByteType: category=ARRAY, sw-calibration-access=READ-ONLY
      element Dcm_Data99ByteTypeElement: array-size=99, array-size-semantics=FIXED-SIZE, implementation-data-type=uint8
    Dcm_Data6ByteType: category=ARRAY, sw-calibration-access=READ-ONLY
      element Dcm_Data6ByteTypeElement: array-size=6, array-size-semantics=FIXED-SIZE, implementation-data-type=uint8
    Dcm_Data49ByteType: category=ARRAY, sw-calibration-access=READ-ONLY
      element Dcm_Data49ByteTypeElement: array-size=49, array-size-semantics=FIXED-SIZE, implementation-data-type=uint8
    Dcm_Data1ByteType: category=ARRAY, sw-calibration-access=READ-ONLY
      element Dcm_Data1ByteTypeElement: array-size=1, array-size-semantics=FIXED-SIZE, implementation-data-type=uint8
    Dcm_Data8192ByteType: category=ARRAY, sw-calibration-access=READ-ONLY
      element Dcm_Data8192ByteTypeElement: array-size=8192, array-size-semantics=FIXED-SIZE, implementation-data-type=uint8
    Dcm_Data2ByteType: category=ARRAY, sw-calibration-access=READ-ONLY
      element Dcm_Data2ByteTypeElement: array-size=2, array-size-semantics=FIXED-SIZE, implementation-data-type=uint8
    Dcm_Data109ByteType: category=ARRAY, sw-calibration-access=READ-ONLY
      element Dcm_Data109ByteTypeElement: array-size=109, array-size-semantics=FIXED-SIZE, implementation-data-type=uint8
    Dcm_Data3ByteType: category=ARRAY, sw-calibration-access=READ-ONLY
      element Dcm_Data3ByteTypeElement: array-size=3, array-size-semantics=FIXED-SIZE, implementation-data-type=uint8
    Dcm_Data10ByteType: category=ARRAY, sw-calibration-access=READ-ONLY
      element Dcm_Data10ByteTypeElement: array-size=10, array-size-semantics=FIXED-SIZE, implementation-data-type=uint8
    Dcm_Data21ByteType: category=ARRAY, sw-calibration-access=READ-ONLY
      element Dcm_Data21ByteTypeElement: array-size=21, array-size-semantics=FIXED-SIZE, implementation-data-type=uint8
    Dcm_Data12ByteType: category=ARRAY, sw-calibration-access=READ-ONLY
      element Dcm_Data12ByteTypeElement: array-size=12, array-size-semantics=FIXED-SIZE, implementation-data-type=uint8
    Dcm_Data17ByteType: category=ARRAY, sw-calibration-access=READ-ONLY
      element Dcm_Data17ByteTypeElement: array-size=17, array-size-semantics=FIXED-SIZE, implementation-data-type=uint8
    Dcm_Data156ByteType: category=ARRAY, sw-calibration-access=READ-ONLY
      element Dcm_Data156ByteTypeElement: array-size=156, array-size-semantics=FIXED-SIZE, implementation-data-type=uint8
    Dcm_Data28ByteType: category=ARRAY, sw-calibration-access=READ-ONLY
      element Dcm_Data28ByteTypeElement: array-size=28, array-size-semantics=FIXED-SIZE, implementation-data-type=uint8
    Dcm_Data250ByteType: category=ARRAY, sw-calibration-access=READ-ONLY
      element Dcm_Data250ByteTypeElement: array-size=250, array-size-semantics=FIXED-SIZE, implementation-data-type=uint8
package /MICROSAR/Dcm_swc/Interfaces
  6 x mode switch interface, all with is-service=true, service-kind=DIAGNOSTIC-COMMUNICATION-MANAGER:
    DcmControlDtcSetting
      mode group DcmControlDtcSetting: type=DcmControlDtcSetting
    DcmEcuReset
      mode group DcmEcuReset: type=DcmEcuReset
    DcmModeRapidPowerShutDown
      mode group DcmModeRapidPowerShutDown: type=DcmModeRapidPowerShutDown
    DcmDiagnosticSessionControl
      mode group DcmDiagnosticSessionControl: type=DcmDiagnosticSessionControl
    DcmCommunicationControl_ComMConf_ComMChannel_A_FlexRay_5b5a9ac2
      mode group DcmCommunicationControl_ComMConf_ComMChannel_A_FlexRay_5b5a9ac2: type=DcmCommunicationControl
    DcmResponseOnEvent_DcmDspRoeEvent
      mode group DcmResponseOnEvent_DcmDspRoeEvent: type=DcmResponseOnEvent
  170 x client server interface, all with is-service=true, service-kind=DIAGNOSTIC-COMMUNICATION-MANAGER:
    DCMServices
      6 x operation:
        GetActiveProtocol: possible-error=E_OK
          arg ActiveProtocol: type=Dcm_ProtocolType, direction=OUT
        GetSesCtrlType: possible-error=E_OK
          arg SesCtrlType: type=Dcm_SesCtrlType, direction=OUT
        ResetToDefaultSession: possible-error=E_OK
        GetSecurityLevel: possible-error=E_OK
          arg SecLevel: type=Dcm_SecLevelType, direction=OUT
        SetActiveDiagnostic: possible-error=E_OK
          arg active: type=boolean, direction=IN
        GetRequestKind: possible-error=DCMServices/E_NOT_OK
          arg TesterSourceAddress: type=uint16, direction=IN
          arg RequestKind: type=Dcm_RequestKindType, direction=OUT
      error E_OK: error-code=0
      error E_NOT_OK: error-code=1
    DCM_Roe
      operation TriggerOnEvent: possible-error=DCM_Roe/E_NOT_OK
      error E_NOT_OK: error-code=1
    ServiceRequestNotification
      operation Indication: possible-error=[ServiceRequestNotification/E_NOT_OK, E_REQUEST_NOT_ACCEPTED]
        6 x arg:
          SID: type=uint8, direction=IN
          RequestData: type=Dcm_Data8195ByteType, direction=IN
          DataSize: type=uint16, direction=IN
          ReqType: type=uint8, direction=IN
          SourceAddress: type=uint16, direction=IN
          ErrorCode: type=Dcm_NegativeResponseCodeType, direction=OUT
      operation Confirmation: possible-error=ServiceRequestNotification/E_NOT_OK
        4 x arg, all with direction=IN:
          SID: type=uint8
          ReqType: type=uint8
          SourceAddress: type=uint16
          ConfirmationStatus: type=Dcm_ConfirmationStatusType
      error E_NOT_OK: error-code=1
      error E_REQUEST_NOT_ACCEPTED: error-code=8
    SecurityAccess_DcmDspSecurityRow_Coding
      operation GetSeed: possible-error=[SecurityAccess_DcmDspSecurityRow_Coding/E_NOT_OK, SecurityAccess_DcmDspSecurityRow_Coding/DCM_E_PENDING]
        4 x arg:
          SecurityAccessDataRecord: type=Dcm_Data4ByteType, direction=IN
          OpStatus: type=Dcm_OpStatusType, direction=IN
          Seed: type=Dcm_Data8ByteType, direction=OUT
          ErrorCode: type=Dcm_NegativeResponseCodeType, direction=OUT
      operation CompareKey: possible-error=[SecurityAccess_DcmDspSecurityRow_Coding/E_NOT_OK, SecurityAccess_DcmDspSecurityRow_Coding/DCM_E_PENDING, SecurityAccess_DcmDspSecurityRow_Coding/DCM_E_COMPARE_KEY_FAILED]
        arg Key: type=Dcm_Data132ByteType, direction=IN
        arg OpStatus: type=Dcm_OpStatusType, direction=IN
        arg ErrorCode: type=Dcm_NegativeResponseCodeType, direction=OUT
      error E_NOT_OK: error-code=1
      error DCM_E_PENDING: error-code=10
      error DCM_E_COMPARE_KEY_FAILED: error-code=11
    SecurityAccess_DcmDspSecurityRow_level2
      operation GetSeed: possible-error=[SecurityAccess_DcmDspSecurityRow_level2/E_NOT_OK, SecurityAccess_DcmDspSecurityRow_level2/DCM_E_PENDING]
        arg OpStatus: type=Dcm_OpStatusType, direction=IN
        arg Seed: type=Dcm_Data4ByteType, direction=OUT
        arg ErrorCode: type=Dcm_NegativeResponseCodeType, direction=OUT
      operation CompareKey: possible-error=[SecurityAccess_DcmDspSecurityRow_level2/E_NOT_OK, SecurityAccess_DcmDspSecurityRow_level2/DCM_E_PENDING, SecurityAccess_DcmDspSecurityRow_level2/DCM_E_COMPARE_KEY_FAILED]
        arg Key: type=Dcm_Data4ByteType, direction=IN
        arg OpStatus: type=Dcm_OpStatusType, direction=IN
        arg ErrorCode: type=Dcm_NegativeResponseCodeType, direction=OUT
      error E_NOT_OK: error-code=1
      error DCM_E_PENDING: error-code=10
      error DCM_E_COMPARE_KEY_FAILED: error-code=11
    SecurityAccess_DcmDspSecurityRow_Programming_HDD
      operation GetSeed: possible-error=[SecurityAccess_DcmDspSecurityRow_Programming_HDD/E_NOT_OK, SecurityAccess_DcmDspSecurityRow_Programming_HDD/DCM_E_PENDING]
        4 x arg:
          SecurityAccessDataRecord: type=Dcm_Data4ByteType, direction=IN
          OpStatus: type=Dcm_OpStatusType, direction=IN
          Seed: type=Dcm_Data8ByteType, direction=OUT
          ErrorCode: type=Dcm_NegativeResponseCodeType, direction=OUT
      operation CompareKey: possible-error=[SecurityAccess_DcmDspSecurityRow_Programming_HDD/E_NOT_OK, SecurityAccess_DcmDspSecurityRow_Programming_HDD/DCM_E_PENDING, SecurityAccess_DcmDspSecurityRow_Programming_HDD/DCM_E_COMPARE_KEY_FAILED]
        arg Key: type=Dcm_Data4ByteType, direction=IN
        arg OpStatus: type=Dcm_OpStatusType, direction=IN
        arg ErrorCode: type=Dcm_NegativeResponseCodeType, direction=OUT
      error E_NOT_OK: error-code=1
      error DCM_E_PENDING: error-code=10
      error DCM_E_COMPARE_KEY_FAILED: error-code=11
    SecurityAccess_DcmDspSecurityRow_Swt
      operation GetSeed: possible-error=[SecurityAccess_DcmDspSecurityRow_Swt/E_NOT_OK, SecurityAccess_DcmDspSecurityRow_Swt/DCM_E_PENDING]
        4 x arg:
          SecurityAccessDataRecord: type=Dcm_Data4ByteType, direction=IN
          OpStatus: type=Dcm_OpStatusType, direction=IN
          Seed: type=Dcm_Data8ByteType, direction=OUT
          ErrorCode: type=Dcm_NegativeResponseCodeType, direction=OUT
      operation CompareKey: possible-error=[SecurityAccess_DcmDspSecurityRow_Swt/E_NOT_OK, SecurityAccess_DcmDspSecurityRow_Swt/DCM_E_PENDING, SecurityAccess_DcmDspSecurityRow_Swt/DCM_E_COMPARE_KEY_FAILED]
        arg Key: type=Dcm_Data132ByteType, direction=IN
        arg OpStatus: type=Dcm_OpStatusType, direction=IN
        arg ErrorCode: type=Dcm_NegativeResponseCodeType, direction=OUT
      error E_NOT_OK: error-code=1
      error DCM_E_PENDING: error-code=10
      error DCM_E_COMPARE_KEY_FAILED: error-code=11
    RoutineServices_DcmDspRoutine_RcCppc
      operation Start: possible-error=[RoutineServices_DcmDspRoutine_RcCppc/E_NOT_OK, RoutineServices_DcmDspRoutine_RcCppc/DCM_E_PENDING, RoutineServices_DcmDspRoutine_RcCppc/DCM_E_FORCE_RCRRP]
        4 x arg:
          OpStatus: type=Dcm_OpStatusType, direction=IN
          DcmDspStartRoutineOutSignal_dataOut: type=Dcm_Data256ByteType, direction=OUT
          DataLength: type=uint16, direction=OUT
          ErrorCode: type=Dcm_NegativeResponseCodeType, direction=OUT
      error E_NOT_OK: error-code=1
      error DCM_E_PENDING: error-code=10
      error DCM_E_FORCE_RCRRP: error-code=12
    RoutineServices_DcmDspRoutine_RcHdddRi4002
      operation Start: possible-error=[RoutineServices_DcmDspRoutine_RcHdddRi4002/E_NOT_OK, RoutineServices_DcmDspRoutine_RcHdddRi4002/DCM_E_PENDING, RoutineServices_DcmDspRoutine_RcHdddRi4002/DCM_E_FORCE_RCRRP]
        arg OpStatus: type=Dcm_OpStatusType, direction=IN
        arg ErrorCode: type=Dcm_NegativeResponseCodeType, direction=OUT
      error E_NOT_OK: error-code=1
      error DCM_E_PENDING: error-code=10
      error DCM_E_FORCE_RCRRP: error-code=12
    RoutineServices_DcmDspRoutine_RcRswedi
      operation Start: possible-error=[RoutineServices_DcmDspRoutine_RcRswedi/E_NOT_OK, RoutineServices_DcmDspRoutine_RcRswedi/DCM_E_PENDING, RoutineServices_DcmDspRoutine_RcRswedi/DCM_E_FORCE_RCRRP]
        5 x arg:
          DcmDspStartRoutineInSignal_DataIn: type=Dcm_Data8ByteType, direction=IN
          OpStatus: type=Dcm_OpStatusType, direction=IN
          DcmDspStartRoutineOutSignal_DataOut: type=Dcm_Data16ByteType, direction=OUT
          DataLength: type=uint16, direction=INOUT
          ErrorCode: type=Dcm_NegativeResponseCodeType, direction=OUT
      error E_NOT_OK: error-code=1
      error DCM_E_PENDING: error-code=10
      error DCM_E_FORCE_RCRRP: error-code=12
    RoutineServices_DcmDspRoutine_RcCpp
      operation Start: possible-error=[RoutineServices_DcmDspRoutine_RcCpp/E_NOT_OK, RoutineServices_DcmDspRoutine_RcCpp/DCM_E_PENDING, RoutineServices_DcmDspRoutine_RcCpp/DCM_E_FORCE_RCRRP]
        5 x arg:
          DcmDspStartRoutineInSignal_RcCppRsr: type=uint8, direction=IN
          OpStatus: type=Dcm_OpStatusType, direction=IN
          DcmDspStartRoutineOutSignal_StatDuration: type=uint16, direction=OUT
          DcmDspStartRoutineOutSignal_StatApprovalChargingState: type=uint8, direction=OUT
          ErrorCode: type=Dcm_NegativeResponseCodeType, direction=OUT
      error E_NOT_OK: error-code=1
      error DCM_E_PENDING: error-code=10
      error DCM_E_FORCE_RCRRP: error-code=12
    RoutineServices_DcmDspRoutine_FsN30X
      operation Start: possible-error=[RoutineServices_DcmDspRoutine_FsN30X/E_NOT_OK, RoutineServices_DcmDspRoutine_FsN30X/DCM_E_PENDING, RoutineServices_DcmDspRoutine_FsN30X/DCM_E_FORCE_RCRRP]
        8 x arg:
          DcmDspStartRoutineInSignal_Par4Req: type=uint8, direction=IN
          DcmDspStartRoutineInSignal_Id: type=uint8, direction=IN
          DcmDspStartRoutineInSignal_Par6Req: type=uint8, direction=IN
          DcmDspStartRoutineInSignal_Len: type=uint16, direction=IN
          DcmDspStartRoutineInSignal_Enc: type=uint8, direction=IN
          OpStatus: type=Dcm_OpStatusType, direction=IN
          DcmDspStartRoutineOutSignal_Par4Resp: type=uint8, direction=OUT
          ErrorCode: type=Dcm_NegativeResponseCodeType, direction=OUT
      operation RequestResults: possible-error=[RoutineServices_DcmDspRoutine_FsN30X/E_NOT_OK, RoutineServices_DcmDspRoutine_FsN30X/DCM_E_PENDING, RoutineServices_DcmDspRoutine_FsN30X/DCM_E_FORCE_RCRRP]
        5 x arg:
          OpStatus: type=Dcm_OpStatusType, direction=IN
          DcmDspRequestRoutineResultsOutSignal_Par4Resp: type=uint8, direction=OUT
          DcmDspRequestRoutineResultsOutSignal_R1R2R3: type=Dcm_Data4ByteType, direction=OUT
          DataLength: type=uint16, direction=OUT
          ErrorCode: type=Dcm_NegativeResponseCodeType, direction=OUT
      error E_NOT_OK: error-code=1
      error DCM_E_PENDING: error-code=10
      error DCM_E_FORCE_RCRRP: error-code=12
    RoutineServices_DcmDspRoutine_FsN70X
      operation Start: possible-error=[RoutineServices_DcmDspRoutine_FsN70X/E_NOT_OK, RoutineServices_DcmDspRoutine_FsN70X/DCM_E_PENDING, RoutineServices_DcmDspRoutine_FsN70X/DCM_E_FORCE_RCRRP]
        5 x arg:
          DcmDspStartRoutineInSignal_Par4Req: type=uint8, direction=IN
          DcmDspStartRoutineInSignal_Adr: type=uint8, direction=IN
          OpStatus: type=Dcm_OpStatusType, direction=IN
          DcmDspStartRoutineOutSignal_Par4Resp: type=uint8, direction=OUT
          ErrorCode: type=Dcm_NegativeResponseCodeType, direction=OUT
      operation RequestResults: possible-error=[RoutineServices_DcmDspRoutine_FsN70X/E_NOT_OK, RoutineServices_DcmDspRoutine_FsN70X/DCM_E_PENDING, RoutineServices_DcmDspRoutine_FsN70X/DCM_E_FORCE_RCRRP]
        4 x arg:
          OpStatus: type=Dcm_OpStatusType, direction=IN
          DcmDspRequestRoutineResultsOutSignal_Par4Resp: type=uint8, direction=OUT
          DcmDspRequestRoutineResultsOutSignal_Result: type=uint8, direction=OUT
          ErrorCode: type=Dcm_NegativeResponseCodeType, direction=OUT
      error E_NOT_OK: error-code=1
      error DCM_E_PENDING: error-code=10
      error DCM_E_FORCE_RCRRP: error-code=12
    RoutineServices_DcmDspRoutine_FsMsmN300XTeleservice
      operation Start: possible-error=[RoutineServices_DcmDspRoutine_FsMsmN300XTeleservice/E_NOT_OK, RoutineServices_DcmDspRoutine_FsMsmN300XTeleservice/DCM_E_PENDING, RoutineServices_DcmDspRoutine_FsMsmN300XTeleservice/DCM_E_FORCE_RCRRP]
        8 x arg:
          DcmDspStartRoutineInSignal_Par4Req: type=uint8, direction=IN
          DcmDspStartRoutineInSignal_Id: type=uint8, direction=IN
          DcmDspStartRoutineInSignal_Par{6..8}Req: type=uint8, direction=IN
          OpStatus: type=Dcm_OpStatusType, direction=IN
          DcmDspStartRoutineOutSignal_Par4Resp: type=uint8, direction=OUT
          ErrorCode: type=Dcm_NegativeResponseCodeType, direction=OUT
      operation RequestResults: possible-error=[RoutineServices_DcmDspRoutine_FsMsmN300XTeleservice/E_NOT_OK, RoutineServices_DcmDspRoutine_FsMsmN300XTeleservice/DCM_E_PENDING, RoutineServices_DcmDspRoutine_FsMsmN300XTeleservice/DCM_E_FORCE_RCRRP]
        8 x arg:
          OpStatus: type=Dcm_OpStatusType, direction=IN
          DcmDspRequestRoutineResultsOutSignal_Par4Resp: type=uint8, direction=OUT
          DcmDspRequestRoutineResultsOutSignal_IdResp: type=uint8, direction=OUT
          DcmDspRequestRoutineResultsOutSignal_Par6Resp: type=uint8, direction=OUT
          DcmDspRequestRoutineResultsOutSignal_Len: type=uint16, direction=OUT
          DcmDspRequestRoutineResultsOutSignal_Zufallszahl: type=Dcm_Data20ByteType, direction=OUT
          DataLength: type=uint16, direction=OUT
          ErrorCode: type=Dcm_NegativeResponseCodeType, direction=OUT
      error E_NOT_OK: error-code=1
      error DCM_E_PENDING: error-code=10
      error DCM_E_FORCE_RCRRP: error-code=12
    RoutineServices_DcmDspRoutine_FsMsmN220X
      operation Start: possible-error=[RoutineServices_DcmDspRoutine_FsMsmN220X/E_NOT_OK, RoutineServices_DcmDspRoutine_FsMsmN220X/DCM_E_PENDING, RoutineServices_DcmDspRoutine_FsMsmN220X/DCM_E_FORCE_RCRRP]
        6 x arg:
          DcmDspStartRoutineInSignal_Par3Req: type=uint8, direction=IN
          DcmDspStartRoutineInSignal_Par4Req: type=uint8, direction=IN
          OpStatus: type=Dcm_OpStatusType, direction=IN
          DcmDspStartRoutineOutSignal_Par3Resp: type=uint8, direction=OUT
          DcmDspStartRoutineOutSignal_Par4Resp: type=uint8, direction=OUT
          ErrorCode: type=Dcm_NegativeResponseCodeType, direction=OUT
      error E_NOT_OK: error-code=1
      error DCM_E_PENDING: error-code=10
      error DCM_E_FORCE_RCRRP: error-code=12
    RoutineServices_DcmDspRoutine_FsN31034
      operation Start: possible-error=[RoutineServices_DcmDspRoutine_FsN31034/E_NOT_OK, RoutineServices_DcmDspRoutine_FsN31034/DCM_E_PENDING, RoutineServices_DcmDspRoutine_FsN31034/DCM_E_FORCE_RCRRP]
        7 x arg:
          DcmDspStartRoutineInSignal_Par4Req: type=uint8, direction=IN
          DcmDspStartRoutineInSignal_Par5: type=uint8, direction=IN
          DcmDspStartRoutineInSignal_Len: type=uint16, direction=IN
          DcmDspStartRoutineInSignal_Data: type=uint8, direction=IN
          OpStatus: type=Dcm_OpStatusType, direction=IN
          DcmDspStartRoutineOutSignal_Par4Resp: type=uint8, direction=OUT
          ErrorCode: type=Dcm_NegativeResponseCodeType, direction=OUT
      error E_NOT_OK: error-code=1
      error DCM_E_PENDING: error-code=10
      error DCM_E_FORCE_RCRRP: error-code=12
    RoutineServices_DcmDspRoutine_FsN5005
      operation Start: possible-error=[RoutineServices_DcmDspRoutine_FsN5005/E_NOT_OK, RoutineServices_DcmDspRoutine_FsN5005/DCM_E_PENDING, RoutineServices_DcmDspRoutine_FsN5005/DCM_E_FORCE_RCRRP]
        6 x arg:
          DcmDspStartRoutineInSignal_Len: type=uint8, direction=IN
          DcmDspStartRoutineInSignal_Adr: type=uint8, direction=IN
          OpStatus: type=Dcm_OpStatusType, direction=IN
          DcmDspStartRoutineOutSignal_Res1: type=uint8, direction=OUT
          DcmDspStartRoutineOutSignal_Res2: type=uint8, direction=OUT
          ErrorCode: type=Dcm_NegativeResponseCodeType, direction=OUT
      operation RequestResults: possible-error=[RoutineServices_DcmDspRoutine_FsN5005/E_NOT_OK, RoutineServices_DcmDspRoutine_FsN5005/DCM_E_PENDING, RoutineServices_DcmDspRoutine_FsN5005/DCM_E_FORCE_RCRRP]
        6 x arg:
          OpStatus: type=Dcm_OpStatusType, direction=IN
          DcmDspRequestRoutineResultsOutSignal_Res1: type=uint8, direction=OUT
          DcmDspRequestRoutineResultsOutSignal_Res2: type=uint8, direction=OUT
          DcmDspRequestRoutineResultsOutSignal_Len: type=uint8, direction=OUT
          DcmDspRequestRoutineResultsOutSignal_SgMitFehlern: type=uint8, direction=OUT
          ErrorCode: type=Dcm_NegativeResponseCodeType, direction=OUT
      error E_NOT_OK: error-code=1
      error DCM_E_PENDING: error-code=10
      error DCM_E_FORCE_RCRRP: error-code=12
    RoutineServices_DcmDspRoutine_FsMsmN101AbfrageFzgsec
      operation Start: possible-error=[RoutineServices_DcmDspRoutine_FsMsmN101AbfrageFzgsec/E_NOT_OK, RoutineServices_DcmDspRoutine_FsMsmN101AbfrageFzgsec/DCM_E_PENDING, RoutineServices_DcmDspRoutine_FsMsmN101AbfrageFzgsec/DCM_E_FORCE_RCRRP]
        6 x arg:
          DcmDspStartRoutineInSignal_FunktionsId: type=uint8, direction=IN
          OpStatus: type=Dcm_OpStatusType, direction=IN
          DcmDspStartRoutineOutSignal_Res1: type=uint8, direction=OUT
          DcmDspStartRoutineOutSignal_Res2: type=uint8, direction=OUT
          DcmDspStartRoutineOutSignal_State: type=uint8, direction=OUT
          ErrorCode: type=Dcm_NegativeResponseCodeType, direction=OUT
      error E_NOT_OK: error-code=1
      error DCM_E_PENDING: error-code=10
      error DCM_E_FORCE_RCRRP: error-code=12
    RoutineServices_DcmDspRoutine_FsMsmN111
      operation Start: possible-error=[RoutineServices_DcmDspRoutine_FsMsmN111/E_NOT_OK, RoutineServices_DcmDspRoutine_FsMsmN111/DCM_E_PENDING, RoutineServices_DcmDspRoutine_FsMsmN111/DCM_E_FORCE_RCRRP]
        8 x arg:
          DcmDspStartRoutineInSignal_ParameterId: type=uint8, direction=IN
          DcmDspStartRoutineInSignal_FscsmId: type=uint8, direction=IN
          OpStatus: type=Dcm_OpStatusType, direction=IN
          DcmDspStartRoutineOutSignal_Res1: type=uint8, direction=OUT
          DcmDspStartRoutineOutSignal_Res2: type=uint8, direction=OUT
          DcmDspStartRoutineOutSignal_Len: type=uint8, direction=OUT
          DcmDspStartRoutineOutSignal_Data: type=uint8, direction=OUT
          ErrorCode: type=Dcm_NegativeResponseCodeType, direction=OUT
      error E_NOT_OK: error-code=1
      error DCM_E_PENDING: error-code=10
      error DCM_E_FORCE_RCRRP: error-code=12
    RoutineServices_DcmDspRoutine_FsN7112
      operation Start: possible-error=[RoutineServices_DcmDspRoutine_FsN7112/E_NOT_OK, RoutineServices_DcmDspRoutine_FsN7112/DCM_E_PENDING, RoutineServices_DcmDspRoutine_FsN7112/DCM_E_FORCE_RCRRP]
        6 x arg:
          DcmDspStartRoutineInSignal_Challenge: type=Dcm_Data16ByteType, direction=IN
          OpStatus: type=Dcm_OpStatusType, direction=IN
          DcmDspStartRoutineOutSignal_Result1: type=uint8, direction=OUT
          DcmDspStartRoutineOutSignal_Result2: type=uint8, direction=OUT
          DataLength: type=uint16, direction=IN
          ErrorCode: type=Dcm_NegativeResponseCodeType, direction=OUT
      operation RequestResults: possible-error=[RoutineServices_DcmDspRoutine_FsN7112/E_NOT_OK, RoutineServices_DcmDspRoutine_FsN7112/DCM_E_PENDING, RoutineServices_DcmDspRoutine_FsN7112/DCM_E_FORCE_RCRRP]
        6 x arg:
          OpStatus: type=Dcm_OpStatusType, direction=IN
          DcmDspRequestRoutineResultsOutSignal_Result1: type=uint8, direction=OUT
          DcmDspRequestRoutineResultsOutSignal_Result2: type=uint8, direction=OUT
          DcmDspRequestRoutineResultsOutSignal_ResultResponse: type=Dcm_Data16ByteType, direction=OUT
          DataLength: type=uint16, direction=OUT
          ErrorCode: type=Dcm_NegativeResponseCodeType, direction=OUT
      error E_NOT_OK: error-code=1
      error DCM_E_PENDING: error-code=10
      error DCM_E_FORCE_RCRRP: error-code=12
    RoutineServices_DcmDspRoutine_FsMsmN102
      operation Start: possible-error=[RoutineServices_DcmDspRoutine_FsMsmN102/E_NOT_OK, RoutineServices_DcmDspRoutine_FsMsmN102/DCM_E_PENDING, RoutineServices_DcmDspRoutine_FsMsmN102/DCM_E_FORCE_RCRRP]
        6 x arg:
          DcmDspStartRoutineInSignal_FunktionsId: type=uint8, direction=IN
          OpStatus: type=Dcm_OpStatusType, direction=IN
          DcmDspStartRoutineOutSignal_Res1: type=uint8, direction=OUT
          DcmDspStartRoutineOutSignal_Res2: type=uint8, direction=OUT
          DcmDspStartRoutineOutSignal_State: type=uint8, direction=OUT
          ErrorCode: type=Dcm_NegativeResponseCodeType, direction=OUT
      error E_NOT_OK: error-code=1
      error DCM_E_PENDING: error-code=10
      error DCM_E_FORCE_RCRRP: error-code=12
    RoutineServices_DcmDspRoutine_FsN251
      operation Start: possible-error=[RoutineServices_DcmDspRoutine_FsN251/E_NOT_OK, RoutineServices_DcmDspRoutine_FsN251/DCM_E_PENDING, RoutineServices_DcmDspRoutine_FsN251/DCM_E_FORCE_RCRRP]
        6 x arg:
          DcmDspStartRoutineInSignal_Len: type=uint8, direction=IN
          DcmDspStartRoutineInSignal_Adr: type=uint8, direction=IN
          OpStatus: type=Dcm_OpStatusType, direction=IN
          DcmDspStartRoutineOutSignal_Res1: type=uint8, direction=OUT
          DcmDspStartRoutineOutSignal_Res2: type=uint8, direction=OUT
          ErrorCode: type=Dcm_NegativeResponseCodeType, direction=OUT
      error E_NOT_OK: error-code=1
      error DCM_E_PENDING: error-code=10
      error DCM_E_FORCE_RCRRP: error-code=12
    RoutineServices_DcmDspRoutine_FsN252
      operation Start: possible-error=[RoutineServices_DcmDspRoutine_FsN252/E_NOT_OK, RoutineServices_DcmDspRoutine_FsN252/DCM_E_PENDING, RoutineServices_DcmDspRoutine_FsN252/DCM_E_FORCE_RCRRP]
        6 x arg:
          DcmDspStartRoutineInSignal_DataToCompare: type=Dcm_Data16ByteType, direction=IN
          OpStatus: type=Dcm_OpStatusType, direction=IN
          DcmDspStartRoutineOutSignal_Result1: type=uint8, direction=OUT
          DcmDspStartRoutineOutSignal_Result2: type=uint8, direction=OUT
          DataLength: type=uint16, direction=IN
          ErrorCode: type=Dcm_NegativeResponseCodeType, direction=OUT
      error E_NOT_OK: error-code=1
      error DCM_E_PENDING: error-code=10
      error DCM_E_FORCE_RCRRP: error-code=12
    RoutineServices_DcmDspRoutine_FsN5012
      operation Start: possible-error=[RoutineServices_DcmDspRoutine_FsN5012/E_NOT_OK, RoutineServices_DcmDspRoutine_FsN5012/DCM_E_PENDING, RoutineServices_DcmDspRoutine_FsN5012/DCM_E_FORCE_RCRRP]
        4 x arg:
          OpStatus: type=Dcm_OpStatusType, direction=IN
          DcmDspStartRoutineOutSignal_Result1: type=uint8, direction=OUT
          DcmDspStartRoutineOutSignal_Result2: type=uint8, direction=OUT
          ErrorCode: type=Dcm_NegativeResponseCodeType, direction=OUT
      operation RequestResults: possible-error=[RoutineServices_DcmDspRoutine_FsN5012/E_NOT_OK, RoutineServices_DcmDspRoutine_FsN5012/DCM_E_PENDING, RoutineServices_DcmDspRoutine_FsN5012/DCM_E_FORCE_RCRRP]
        6 x arg:
          OpStatus: type=Dcm_OpStatusType, direction=IN
          DcmDspRequestRoutineResultsOutSignal_Result1: type=uint8, direction=OUT
          DcmDspRequestRoutineResultsOutSignal_Result2: type=uint8, direction=OUT
          DcmDspRequestRoutineResultsOutSignal_RandomNumberFscsm: type=Dcm_Data16ByteType, direction=OUT
          DataLength: type=uint16, direction=OUT
          ErrorCode: type=Dcm_NegativeResponseCodeType, direction=OUT
      error E_NOT_OK: error-code=1
      error DCM_E_PENDING: error-code=10
      error DCM_E_FORCE_RCRRP: error-code=12
    RoutineServices_DcmDspRoutine_FsN5034
      operation Start: possible-error=[RoutineServices_DcmDspRoutine_FsN5034/E_NOT_OK, RoutineServices_DcmDspRoutine_FsN5034/DCM_E_PENDING, RoutineServices_DcmDspRoutine_FsN5034/DCM_E_FORCE_RCRRP]
        6 x arg:
          DcmDspStartRoutineInSignal_Data: type=Dcm_Data99ByteType, direction=IN
          OpStatus: type=Dcm_OpStatusType, direction=IN
          DcmDspStartRoutineOutSignal_Result1: type=uint8, direction=OUT
          DcmDspStartRoutineOutSignal_Result2: type=uint8, direction=OUT
          DataLength: type=uint16, direction=IN
          ErrorCode: type=Dcm_NegativeResponseCodeType, direction=OUT
      operation RequestResults: possible-error=[RoutineServices_DcmDspRoutine_FsN5034/E_NOT_OK, RoutineServices_DcmDspRoutine_FsN5034/DCM_E_PENDING, RoutineServices_DcmDspRoutine_FsN5034/DCM_E_FORCE_RCRRP]
        4 x arg:
          OpStatus: type=Dcm_OpStatusType, direction=IN
          DcmDspRequestRoutineResultsOutSignal_Result1: type=uint8, direction=OUT
          DcmDspRequestRoutineResultsOutSignal_Result2: type=uint8, direction=OUT
          ErrorCode: type=Dcm_NegativeResponseCodeType, direction=OUT
      error E_NOT_OK: error-code=1
      error DCM_E_PENDING: error-code=10
      error DCM_E_FORCE_RCRRP: error-code=12
    RoutineServices_DcmDspRoutine_DiagCommLoopback
      operation Start: possible-error=[RoutineServices_DcmDspRoutine_DiagCommLoopback/E_NOT_OK, RoutineServices_DcmDspRoutine_DiagCommLoopback/DCM_E_PENDING, RoutineServices_DcmDspRoutine_DiagCommLoopback/DCM_E_FORCE_RCRRP]
        5 x arg:
          DcmDspStartRoutineInSignal_dataIn: type=Dcm_Data16ByteType, direction=IN
          OpStatus: type=Dcm_OpStatusType, direction=IN
          DcmDspStartRoutineOutSignal_dataOut: type=Dcm_Data16ByteType, direction=OUT
          DataLength: type=uint16, direction=INOUT
          ErrorCode: type=Dcm_NegativeResponseCodeType, direction=OUT
      error E_NOT_OK: error-code=1
      error DCM_E_PENDING: error-code=10
      error DCM_E_FORCE_RCRRP: error-code=12
    RoutineServices_DcmDspRoutine_DmClientTriggerDtcEntry
      operation Start: possible-error=[RoutineServices_DcmDspRoutine_DmClientTriggerDtcEntry/E_NOT_OK, RoutineServices_DcmDspRoutine_DmClientTriggerDtcEntry/DCM_E_PENDING, RoutineServices_DcmDspRoutine_DmClientTriggerDtcEntry/DCM_E_FORCE_RCRRP]
        7 x arg:
          DcmDspStartRoutineInSignal_DTCType: type=uint8, direction=IN
          OpStatus: type=Dcm_OpStatusType, direction=IN
          DcmDspStartRoutineOutSignal_DTCTypeOut: type=uint8, direction=OUT
          DcmDspStartRoutineOutSignal_DTCByte{1..3}: type=uint8, direction=OUT
          ErrorCode: type=Dcm_NegativeResponseCodeType, direction=OUT
      error E_NOT_OK: error-code=1
      error DCM_E_PENDING: error-code=10
      error DCM_E_FORCE_RCRRP: error-code=12
    RoutineServices_DcmDspRoutine_SteuernDmFssMaster
      operation Start: possible-error=[RoutineServices_DcmDspRoutine_SteuernDmFssMaster/E_NOT_OK, RoutineServices_DcmDspRoutine_SteuernDmFssMaster/DCM_E_PENDING, RoutineServices_DcmDspRoutine_SteuernDmFssMaster/DCM_E_FORCE_RCRRP]
        4 x arg:
          DcmDspStartRoutineInSignal_ArgSignal: type=uint8, direction=IN
          OpStatus: type=Dcm_OpStatusType, direction=IN
          DcmDspStartRoutineOutSignal_StatSignal: type=uint8, direction=OUT
          ErrorCode: type=Dcm_NegativeResponseCodeType, direction=OUT
      operation Stop: possible-error=[RoutineServices_DcmDspRoutine_SteuernDmFssMaster/E_NOT_OK, RoutineServices_DcmDspRoutine_SteuernDmFssMaster/DCM_E_PENDING, RoutineServices_DcmDspRoutine_SteuernDmFssMaster/DCM_E_FORCE_RCRRP]
        arg OpStatus: type=Dcm_OpStatusType, direction=IN
        arg ErrorCode: type=Dcm_NegativeResponseCodeType, direction=OUT
      error E_NOT_OK: error-code=1
      error DCM_E_PENDING: error-code=10
      error DCM_E_FORCE_RCRRP: error-code=12
    RoutineServices_DcmDspRoutine_CheckCodingSignature
      operation Start: possible-error=[RoutineServices_DcmDspRoutine_CheckCodingSignature/E_NOT_OK, RoutineServices_DcmDspRoutine_CheckCodingSignature/DCM_E_PENDING, RoutineServices_DcmDspRoutine_CheckCodingSignature/DCM_E_FORCE_RCRRP]
        arg OpStatus: type=Dcm_OpStatusType, direction=IN
        arg DcmDspStartRoutineOutSignal_DataOutX: type=uint8, direction=OUT
        arg ErrorCode: type=Dcm_NegativeResponseCodeType, direction=OUT
      error E_NOT_OK: error-code=1
      error DCM_E_PENDING: error-code=10
      error DCM_E_FORCE_RCRRP: error-code=12
    RoutineServices_DcmDspRoutine_IsLoeschen
      operation Start: possible-error=[RoutineServices_DcmDspRoutine_IsLoeschen/E_NOT_OK, RoutineServices_DcmDspRoutine_IsLoeschen/DCM_E_PENDING, RoutineServices_DcmDspRoutine_IsLoeschen/DCM_E_FORCE_RCRRP]
        arg OpStatus: type=Dcm_OpStatusType, direction=IN
        arg ErrorCode: type=Dcm_NegativeResponseCodeType, direction=OUT
      error E_NOT_OK: error-code=1
      error DCM_E_PENDING: error-code=10
      error DCM_E_FORCE_RCRRP: error-code=12
    RoutineServices_DcmDspRoutine_Energiesparmode
      operation Start: possible-error=[RoutineServices_DcmDspRoutine_Energiesparmode/E_NOT_OK, RoutineServices_DcmDspRoutine_Energiesparmode/DCM_E_PENDING, RoutineServices_DcmDspRoutine_Energiesparmode/DCM_E_FORCE_RCRRP]
        arg DcmDspStartRoutineInSignal_OperatingMode: type=uint8, direction=IN
        arg OpStatus: type=Dcm_OpStatusType, direction=IN
        arg ErrorCode: type=Dcm_NegativeResponseCodeType, direction=OUT
      error E_NOT_OK: error-code=1
      error DCM_E_PENDING: error-code=10
      error DCM_E_FORCE_RCRRP: error-code=12
    RoutineServices_DcmDspRoutine_Swt
      operation Start: possible-error=[RoutineServices_DcmDspRoutine_Swt/E_NOT_OK, RoutineServices_DcmDspRoutine_Swt/DCM_E_PENDING, RoutineServices_DcmDspRoutine_Swt/DCM_E_FORCE_RCRRP]
        8 x arg:
          DcmDspStartRoutineInSignal_RCOption: type=uint8, direction=IN
          DcmDspStartRoutineInSignal_DataIn: type=Dcm_Data16ByteType, direction=IN
          OpStatus: type=Dcm_OpStatusType, direction=IN
          DcmDspStartRoutineOutSignal_RCOptionOut: type=uint8, direction=OUT
          DcmDspStartRoutineOutSignal_ReturnCode: type=uint8, direction=OUT
          DcmDspStartRoutineOutSignal_DataOut: type=Dcm_Data16ByteType, direction=OUT
          DataLength: type=uint16, direction=INOUT
          ErrorCode: type=Dcm_NegativeResponseCodeType, direction=OUT
      error E_NOT_OK: error-code=1
      error DCM_E_PENDING: error-code=10
      error DCM_E_FORCE_RCRRP: error-code=12
    RoutineServices_DcmDspRoutine_IndividualDatenRettung
      operation Start: possible-error=[RoutineServices_DcmDspRoutine_IndividualDatenRettung/E_NOT_OK, RoutineServices_DcmDspRoutine_IndividualDatenRettung/DCM_E_PENDING, RoutineServices_DcmDspRoutine_IndividualDatenRettung/DCM_E_FORCE_RCRRP]
        4 x arg:
          DcmDspStartRoutineInSignal: type=uint8, direction=IN
          OpStatus: type=Dcm_OpStatusType, direction=IN
          DcmDspStartRoutineOutSignal: type=uint8, direction=OUT
          ErrorCode: type=Dcm_NegativeResponseCodeType, direction=OUT
      error E_NOT_OK: error-code=1
      error DCM_E_PENDING: error-code=10
      error DCM_E_FORCE_RCRRP: error-code=12
    RoutineServices_DcmDspRoutine_ControlExtendedEnergySavingState
      operation Start: possible-error=[RoutineServices_DcmDspRoutine_ControlExtendedEnergySavingState/E_NOT_OK, RoutineServices_DcmDspRoutine_ControlExtendedEnergySavingState/DCM_E_PENDING, RoutineServices_DcmDspRoutine_ControlExtendedEnergySavingState/DCM_E_FORCE_RCRRP]
        arg DcmDspStartRoutineInSignal_ExtendedOperatingMode: type=uint8, direction=IN
        arg OpStatus: type=Dcm_OpStatusType, direction=IN
        arg ErrorCode: type=Dcm_NegativeResponseCodeType, direction=OUT
      error E_NOT_OK: error-code=1
      error DCM_E_PENDING: error-code=10
      error DCM_E_FORCE_RCRRP: error-code=12
    RoutineServices_DcmDspRoutine_StartSystime
      operation Start: possible-error=[RoutineServices_DcmDspRoutine_StartSystime/E_NOT_OK, RoutineServices_DcmDspRoutine_StartSystime/DCM_E_PENDING, RoutineServices_DcmDspRoutine_StartSystime/DCM_E_FORCE_RCRRP]
        arg OpStatus: type=Dcm_OpStatusType, direction=IN
        arg ErrorCode: type=Dcm_NegativeResponseCodeType, direction=OUT
      error E_NOT_OK: error-code=1
      error DCM_E_PENDING: error-code=10
      error DCM_E_FORCE_RCRRP: error-code=12
    RoutineServices_DcmDspRoutine_ActivateZgwCodingmode
      operation Start: possible-error=[RoutineServices_DcmDspRoutine_ActivateZgwCodingmode/E_NOT_OK, RoutineServices_DcmDspRoutine_ActivateZgwCodingmode/DCM_E_PENDING, RoutineServices_DcmDspRoutine_ActivateZgwCodingmode/DCM_E_FORCE_RCRRP]
        arg OpStatus: type=Dcm_OpStatusType, direction=IN
        arg ErrorCode: type=Dcm_NegativeResponseCodeType, direction=OUT
      error E_NOT_OK: error-code=1
      error DCM_E_PENDING: error-code=10
      error DCM_E_FORCE_RCRRP: error-code=12
    RoutineServices_DcmDspRoutine_ActivateZgwFlashmode
      operation Start: possible-error=[RoutineServices_DcmDspRoutine_ActivateZgwFlashmode/E_NOT_OK, RoutineServices_DcmDspRoutine_ActivateZgwFlashmode/DCM_E_PENDING, RoutineServices_DcmDspRoutine_ActivateZgwFlashmode/DCM_E_FORCE_RCRRP]
        arg OpStatus: type=Dcm_OpStatusType, direction=IN
        arg ErrorCode: type=Dcm_NegativeResponseCodeType, direction=OUT
      error E_NOT_OK: error-code=1
      error DCM_E_PENDING: error-code=10
      error DCM_E_FORCE_RCRRP: error-code=12
    RoutineServices_DcmDspRoutine_ActivateZgwApplicationmode
      operation Start: possible-error=[RoutineServices_DcmDspRoutine_ActivateZgwApplicationmode/E_NOT_OK, RoutineServices_DcmDspRoutine_ActivateZgwApplicationmode/DCM_E_PENDING, RoutineServices_DcmDspRoutine_ActivateZgwApplicationmode/DCM_E_FORCE_RCRRP]
        arg OpStatus: type=Dcm_OpStatusType, direction=IN
        arg ErrorCode: type=Dcm_NegativeResponseCodeType, direction=OUT
      error E_NOT_OK: error-code=1
      error DCM_E_PENDING: error-code=10
      error DCM_E_FORCE_RCRRP: error-code=12
    RoutineServices_DcmDspRoutine_SetDefaultBus
      operation Start: possible-error=[RoutineServices_DcmDspRoutine_SetDefaultBus/E_NOT_OK, RoutineServices_DcmDspRoutine_SetDefaultBus/DCM_E_PENDING, RoutineServices_DcmDspRoutine_SetDefaultBus/DCM_E_FORCE_RCRRP]
        arg DcmDspStartRoutineInSignal_ZustandDefaultBus: type=uint8, direction=IN
        arg OpStatus: type=Dcm_OpStatusType, direction=IN
        arg ErrorCode: type=Dcm_NegativeResponseCodeType, direction=OUT
      error E_NOT_OK: error-code=1
      error DCM_E_PENDING: error-code=10
      error DCM_E_FORCE_RCRRP: error-code=12
    RoutineServices_DcmDspRoutine_GetActualConfig
      operation Start: possible-error=[RoutineServices_DcmDspRoutine_GetActualConfig/E_NOT_OK, RoutineServices_DcmDspRoutine_GetActualConfig/DCM_E_PENDING, RoutineServices_DcmDspRoutine_GetActualConfig/DCM_E_FORCE_RCRRP]
        4 x arg:
          OpStatus: type=Dcm_OpStatusType, direction=IN
          DcmDspStartRoutineOutSignal_StatIdsWert: type=uint8, direction=OUT
          DcmDspStartRoutineOutSignal_EcuAddress: type=uint8, direction=OUT
          ErrorCode: type=Dcm_NegativeResponseCodeType, direction=OUT
      error E_NOT_OK: error-code=1
      error DCM_E_PENDING: error-code=10
      error DCM_E_FORCE_RCRRP: error-code=12
    RoutineServices_DcmDspRoutine_EraseIdrData
      operation Start: possible-error=[RoutineServices_DcmDspRoutine_EraseIdrData/E_NOT_OK, RoutineServices_DcmDspRoutine_EraseIdrData/DCM_E_PENDING, RoutineServices_DcmDspRoutine_EraseIdrData/DCM_E_FORCE_RCRRP]
        arg OpStatus: type=Dcm_OpStatusType, direction=IN
        arg DcmDspStartRoutineOutSignal_routineResult: type=uint8, direction=OUT
        arg ErrorCode: type=Dcm_NegativeResponseCodeType, direction=OUT
      error E_NOT_OK: error-code=1
      error DCM_E_PENDING: error-code=10
      error DCM_E_FORCE_RCRRP: error-code=12
    RoutineServices_DcmDspRoutine_InitLinSlave
      operation Start: possible-error=[RoutineServices_DcmDspRoutine_InitLinSlave/E_NOT_OK, RoutineServices_DcmDspRoutine_InitLinSlave/DCM_E_PENDING, RoutineServices_DcmDspRoutine_InitLinSlave/DCM_E_FORCE_RCRRP]
        arg OpStatus: type=Dcm_OpStatusType, direction=IN
        arg DcmDspStartRoutineOutSignal_Status: type=uint8, direction=OUT
        arg ErrorCode: type=Dcm_NegativeResponseCodeType, direction=OUT
      error E_NOT_OK: error-code=1
      error DCM_E_PENDING: error-code=10
      error DCM_E_FORCE_RCRRP: error-code=12
    RoutineServices_DcmDspRoutine_RequestPreferredProtocol
      operation Start: possible-error=[RoutineServices_DcmDspRoutine_RequestPreferredProtocol/E_NOT_OK, RoutineServices_DcmDspRoutine_RequestPreferredProtocol/DCM_E_PENDING, RoutineServices_DcmDspRoutine_RequestPreferredProtocol/DCM_E_FORCE_RCRRP]
        6 x arg:
          DcmDspStartRoutineInSignal_SgbmId: type=Dcm_Data8ByteType, direction=IN
          OpStatus: type=Dcm_OpStatusType, direction=IN
          DcmDspStartRoutineOutSignal_AnzahlItems: type=uint8, direction=OUT
          DcmDspStartRoutineOutSignal_FpRpp31011021Eopfld: type=Dcm_Data16ByteType, direction=OUT
          DataLength: type=uint16, direction=IN
          ErrorCode: type=Dcm_NegativeResponseCodeType, direction=OUT
      error E_NOT_OK: error-code=1
      error DCM_E_PENDING: error-code=10
      error DCM_E_FORCE_RCRRP: error-code=12
    RoutineServices_DcmDspRoutine_CheckHttpConnection
      operation Start: possible-error=[RoutineServices_DcmDspRoutine_CheckHttpConnection/E_NOT_OK, RoutineServices_DcmDspRoutine_CheckHttpConnection/DCM_E_PENDING, RoutineServices_DcmDspRoutine_CheckHttpConnection/DCM_E_FORCE_RCRRP]
        6 x arg:
          DcmDspStartRoutineInSignal_TimeOutTime: type=uint32, direction=IN
          DcmDspStartRoutineInSignal_ServerUrl: type=uint8, direction=IN
          OpStatus: type=Dcm_OpStatusType, direction=IN
          DcmDspStartRoutineOutSignal_HttpConnectionStatus: type=uint8, direction=OUT
          DcmDspStartRoutineOutSignal_HttpResponseCode: type=uint16, direction=OUT
          ErrorCode: type=Dcm_NegativeResponseCodeType, direction=OUT
      error E_NOT_OK: error-code=1
      error DCM_E_PENDING: error-code=10
      error DCM_E_FORCE_RCRRP: error-code=12
    RoutineServices_DcmDspRoutine_ExternalHsfz
      operation Start: possible-error=[RoutineServices_DcmDspRoutine_ExternalHsfz/E_NOT_OK, RoutineServices_DcmDspRoutine_ExternalHsfz/DCM_E_PENDING, RoutineServices_DcmDspRoutine_ExternalHsfz/DCM_E_FORCE_RCRRP]
        arg DcmDspStartRoutineInSignal_Activation: type=uint8, direction=IN
        arg OpStatus: type=Dcm_OpStatusType, direction=IN
        arg ErrorCode: type=Dcm_NegativeResponseCodeType, direction=OUT
      error E_NOT_OK: error-code=1
      error DCM_E_PENDING: error-code=10
      error DCM_E_FORCE_RCRRP: error-code=12
    RoutineServices_DcmDspRoutine_ResetAktivierungsleitung
      operation Start: possible-error=[RoutineServices_DcmDspRoutine_ResetAktivierungsleitung/E_NOT_OK, RoutineServices_DcmDspRoutine_ResetAktivierungsleitung/DCM_E_PENDING, RoutineServices_DcmDspRoutine_ResetAktivierungsleitung/DCM_E_FORCE_RCRRP]
        arg OpStatus: type=Dcm_OpStatusType, direction=IN
        arg ErrorCode: type=Dcm_NegativeResponseCodeType, direction=OUT
      error E_NOT_OK: error-code=1
      error DCM_E_PENDING: error-code=10
      error DCM_E_FORCE_RCRRP: error-code=12
    RoutineServices_DcmDspRoutine_EthReadPhyRegister
      operation Start: possible-error=[RoutineServices_DcmDspRoutine_EthReadPhyRegister/E_NOT_OK, RoutineServices_DcmDspRoutine_EthReadPhyRegister/DCM_E_PENDING, RoutineServices_DcmDspRoutine_EthReadPhyRegister/DCM_E_FORCE_RCRRP]
        6 x arg:
          DcmDspStartRoutineInSignal_RegReadRange: type=uint8, direction=IN
          DcmDspStartRoutineInSignal_Data: type=uint8, direction=IN
          OpStatus: type=Dcm_OpStatusType, direction=IN
          DcmDspStartRoutineOutSignal_StatRegReadOk: type=uint8, direction=OUT
          DcmDspStartRoutineOutSignal_StatRegReadData: type=Dcm_Data16ByteType, direction=OUT
          ErrorCode: type=Dcm_NegativeResponseCodeType, direction=OUT
      error E_NOT_OK: error-code=1
      error DCM_E_PENDING: error-code=10
      error DCM_E_FORCE_RCRRP: error-code=12
    RoutineServices_DcmDspRoutine_EthArlTable
      operation Start: possible-error=[RoutineServices_DcmDspRoutine_EthArlTable/E_NOT_OK, RoutineServices_DcmDspRoutine_EthArlTable/DCM_E_PENDING, RoutineServices_DcmDspRoutine_EthArlTable/DCM_E_FORCE_RCRRP]
        5 x arg:
          DcmDspStartRoutineInSignal_PortIndex: type=uint8, direction=IN
          OpStatus: type=Dcm_OpStatusType, direction=IN
          DcmDspStartRoutineOutSignal_StatNumArlVlanIdEntriesWert: type=uint8, direction=OUT
          DcmDspStartRoutineOutSignal_StatArlVlanIdEntries: type=uint8, direction=OUT
          ErrorCode: type=Dcm_NegativeResponseCodeType, direction=OUT
      error E_NOT_OK: error-code=1
      error DCM_E_PENDING: error-code=10
      error DCM_E_FORCE_RCRRP: error-code=12
    RoutineServices_DcmDspRoutine_EthArpTable
      operation Start: possible-error=[RoutineServices_DcmDspRoutine_EthArpTable/E_NOT_OK, RoutineServices_DcmDspRoutine_EthArpTable/DCM_E_PENDING, RoutineServices_DcmDspRoutine_EthArpTable/DCM_E_FORCE_RCRRP]
        6 x arg:
          DcmDspStartRoutineInSignal_IpVersion: type=uint8, direction=IN
          DcmDspStartRoutineInSignal_ArpTableForIpAddress: type=uint8, direction=IN
          OpStatus: type=Dcm_OpStatusType, direction=IN
          DcmDspStartRoutineOutSignal_StatNumArpEntriesWert: type=uint8, direction=OUT
          DcmDspStartRoutineOutSignal_StatArpIpMacEntries: type=uint8, direction=OUT
          ErrorCode: type=Dcm_NegativeResponseCodeType, direction=OUT
      error E_NOT_OK: error-code=1
      error DCM_E_PENDING: error-code=10
      error DCM_E_FORCE_RCRRP: error-code=12
    RoutineServices_DcmDspRoutine_EthPhySwitchEngineReset
      operation Start: possible-error=[RoutineServices_DcmDspRoutine_EthPhySwitchEngineReset/E_NOT_OK, RoutineServices_DcmDspRoutine_EthPhySwitchEngineReset/DCM_E_PENDING, RoutineServices_DcmDspRoutine_EthPhySwitchEngineReset/DCM_E_FORCE_RCRRP]
        5 x arg:
          DcmDspStartRoutineInSignal_PortIndex: type=uint8, direction=IN
          DcmDspStartRoutineInSignal_StopPhyForT: type=uint8, direction=IN
          OpStatus: type=Dcm_OpStatusType, direction=IN
          DcmDspStartRoutineOutSignal_StatPhyReset: type=uint8, direction=OUT
          ErrorCode: type=Dcm_NegativeResponseCodeType, direction=OUT
      error E_NOT_OK: error-code=1
      error DCM_E_PENDING: error-code=10
      error DCM_E_FORCE_RCRRP: error-code=12
    RoutineServices_DcmDspRoutine_EthIpConfiguration
      operation Start: possible-error=[RoutineServices_DcmDspRoutine_EthIpConfiguration/E_NOT_OK, RoutineServices_DcmDspRoutine_EthIpConfiguration/DCM_E_PENDING, RoutineServices_DcmDspRoutine_EthIpConfiguration/DCM_E_FORCE_RCRRP]
        6 x arg:
          DcmDspStartRoutineInSignal_InternalExternalAddress: type=uint8, direction=IN
          DcmDspStartRoutineInSignal_TriggerGratuitousArp: type=uint8, direction=IN
          OpStatus: type=Dcm_OpStatusType, direction=IN
          DcmDspStartRoutineOutSignal_EcuType: type=uint8, direction=OUT
          DcmDspStartRoutineOutSignal_StatEthIpConfiguration: type=uint8, direction=OUT
          ErrorCode: type=Dcm_NegativeResponseCodeType, direction=OUT
      error E_NOT_OK: error-code=1
      error DCM_E_PENDING: error-code=10
      error DCM_E_FORCE_RCRRP: error-code=12
    RoutineServices_DcmDspRoutine_EthPhyIdentifier
      operation Start: possible-error=[RoutineServices_DcmDspRoutine_EthPhyIdentifier/E_NOT_OK, RoutineServices_DcmDspRoutine_EthPhyIdentifier/DCM_E_PENDING, RoutineServices_DcmDspRoutine_EthPhyIdentifier/DCM_E_FORCE_RCRRP]
        5 x arg:
          DcmDspStartRoutineInSignal_PortIndex: type=uint8, direction=IN
          OpStatus: type=Dcm_OpStatusType, direction=IN
          DcmDspStartRoutineOutSignal_StatOuiData: type=Dcm_Data6ByteType, direction=OUT
          DataLength: type=uint16, direction=OUT
          ErrorCode: type=Dcm_NegativeResponseCodeType, direction=OUT
      error E_NOT_OK: error-code=1
      error DCM_E_PENDING: error-code=10
      error DCM_E_FORCE_RCRRP: error-code=12
    RoutineServices_DcmDspRoutine_EthGetPortTxRxStats
      operation Start: possible-error=[RoutineServices_DcmDspRoutine_EthGetPortTxRxStats/E_NOT_OK, RoutineServices_DcmDspRoutine_EthGetPortTxRxStats/DCM_E_PENDING, RoutineServices_DcmDspRoutine_EthGetPortTxRxStats/DCM_E_FORCE_RCRRP]
        9 x arg:
          DcmDspStartRoutineInSignal_PortIndex: type=uint8, direction=IN
          OpStatus: type=Dcm_OpStatusType, direction=IN
          DcmDspStartRoutineOutSignal_StatNumberOfTransmittedPacketsWert: type=uint32, direction=OUT
          DcmDspStartRoutineOutSignal_StatBytesSentWert: type=uint32, direction=OUT
          DcmDspStartRoutineOutSignal_StatNumberOfDroppedTxPacketsWert: type=uint32, direction=OUT
          DcmDspStartRoutineOutSignal_StatNumberOfReceivedPacketsWert: type=uint32, direction=OUT
          DcmDspStartRoutineOutSignal_StatStatBytesReceivedWert: type=uint32, direction=OUT
          DcmDspStartRoutineOutSignal_StatNumberOfDroppedRxPacketsWert: type=uint32, direction=OUT
          ErrorCode: type=Dcm_NegativeResponseCodeType, direction=OUT
      error E_NOT_OK: error-code=1
      error DCM_E_PENDING: error-code=10
      error DCM_E_FORCE_RCRRP: error-code=12
    RoutineServices_DcmDspRoutine_EthResetPortTxRxStats
      operation Start: possible-error=[RoutineServices_DcmDspRoutine_EthResetPortTxRxStats/E_NOT_OK, RoutineServices_DcmDspRoutine_EthResetPortTxRxStats/DCM_E_PENDING, RoutineServices_DcmDspRoutine_EthResetPortTxRxStats/DCM_E_FORCE_RCRRP]
        arg OpStatus: type=Dcm_OpStatusType, direction=IN
        arg ErrorCode: type=Dcm_NegativeResponseCodeType, direction=OUT
      error E_NOT_OK: error-code=1
      error DCM_E_PENDING: error-code=10
      error DCM_E_FORCE_RCRRP: error-code=12
    RoutineServices_DcmDspRoutine_EthEnableTestMode
      operation Start: possible-error=[RoutineServices_DcmDspRoutine_EthEnableTestMode/E_NOT_OK, RoutineServices_DcmDspRoutine_EthEnableTestMode/DCM_E_PENDING, RoutineServices_DcmDspRoutine_EthEnableTestMode/DCM_E_FORCE_RCRRP]
        6 x arg:
          DcmDspStartRoutineInSignal_PortIndex: type=uint8, direction=IN
          DcmDspStartRoutineInSignal_TestDuration: type=uint8, direction=IN
          DcmDspStartRoutineInSignal_TestModeId: type=uint8, direction=IN
          OpStatus: type=Dcm_OpStatusType, direction=IN
          DcmDspStartRoutineOutSignal_StatPhyTestMode: type=uint8, direction=OUT
          ErrorCode: type=Dcm_NegativeResponseCodeType, direction=OUT
      error E_NOT_OK: error-code=1
      error DCM_E_PENDING: error-code=10
      error DCM_E_FORCE_RCRRP: error-code=12
    RoutineServices_DcmDspRoutine_EthWritePhyRegister
      operation Start: possible-error=[RoutineServices_DcmDspRoutine_EthWritePhyRegister/E_NOT_OK, RoutineServices_DcmDspRoutine_EthWritePhyRegister/DCM_E_PENDING, RoutineServices_DcmDspRoutine_EthWritePhyRegister/DCM_E_FORCE_RCRRP]
        5 x arg:
          DcmDspStartRoutineInSignal_RegWriteProtect: type=uint8, direction=IN
          DcmDspStartRoutineInSignal_Data: type=uint8, direction=IN
          OpStatus: type=Dcm_OpStatusType, direction=IN
          DcmDspStartRoutineOutSignal_StatRegWriteOk: type=uint8, direction=OUT
          ErrorCode: type=Dcm_NegativeResponseCodeType, direction=OUT
      error E_NOT_OK: error-code=1
      error DCM_E_PENDING: error-code=10
      error DCM_E_FORCE_RCRRP: error-code=12
    RoutineServices_DcmDspRoutine_EthExtendedArlTable
      operation Start: possible-error=[RoutineServices_DcmDspRoutine_EthExtendedArlTable/E_NOT_OK, RoutineServices_DcmDspRoutine_EthExtendedArlTable/DCM_E_PENDING, RoutineServices_DcmDspRoutine_EthExtendedArlTable/DCM_E_FORCE_RCRRP]
        4 x arg:
          OpStatus: type=Dcm_OpStatusType, direction=IN
          DcmDspStartRoutineOutSignal_StatNumArlVlanIdEntriesWert: type=uint8, direction=OUT
          DcmDspStartRoutineOutSignal_StatExtendedArlVlanIdEntries: type=uint8, direction=OUT
          ErrorCode: type=Dcm_NegativeResponseCodeType, direction=OUT
      error E_NOT_OK: error-code=1
      error DCM_E_PENDING: error-code=10
      error DCM_E_FORCE_RCRRP: error-code=12
    RoutineServices_DcmDspRoutine_EthGetDhcpStatus
      operation Start: possible-error=[RoutineServices_DcmDspRoutine_EthGetDhcpStatus/E_NOT_OK, RoutineServices_DcmDspRoutine_EthGetDhcpStatus/DCM_E_PENDING, RoutineServices_DcmDspRoutine_EthGetDhcpStatus/DCM_E_FORCE_RCRRP]
        4 x arg:
          DcmDspStartRoutineInSignal_NwInterfaceIndex: type=uint8, direction=IN
          OpStatus: type=Dcm_OpStatusType, direction=IN
          DcmDspStartRoutineOutSignal_StatDhcpClientState: type=uint8, direction=OUT
          ErrorCode: type=Dcm_NegativeResponseCodeType, direction=OUT
      error E_NOT_OK: error-code=1
      error DCM_E_PENDING: error-code=10
      error DCM_E_FORCE_RCRRP: error-code=12
    RoutineServices_DcmDspRoutine_EthGetEthernetSwitches
      operation Start: possible-error=[RoutineServices_DcmDspRoutine_EthGetEthernetSwitches/E_NOT_OK, RoutineServices_DcmDspRoutine_EthGetEthernetSwitches/DCM_E_PENDING, RoutineServices_DcmDspRoutine_EthGetEthernetSwitches/DCM_E_FORCE_RCRRP]
        4 x arg:
          OpStatus: type=Dcm_OpStatusType, direction=IN
          DcmDspStartRoutineOutSignal_StatNumEthSwitchEntriesWert: type=uint8, direction=OUT
          DcmDspStartRoutineOutSignal_StatEthSwitchEntries: type=uint8, direction=OUT
          ErrorCode: type=Dcm_NegativeResponseCodeType, direction=OUT
      error E_NOT_OK: error-code=1
      error DCM_E_PENDING: error-code=10
      error DCM_E_FORCE_RCRRP: error-code=12
    RoutineServices_DcmDspRoutine_EthGetSwitchVlanConfiguration
      operation Start: possible-error=[RoutineServices_DcmDspRoutine_EthGetSwitchVlanConfiguration/E_NOT_OK, RoutineServices_DcmDspRoutine_EthGetSwitchVlanConfiguration/DCM_E_PENDING, RoutineServices_DcmDspRoutine_EthGetSwitchVlanConfiguration/DCM_E_FORCE_RCRRP]
        5 x arg:
          DcmDspStartRoutineInSignal_SwitchIndex: type=uint8, direction=IN
          OpStatus: type=Dcm_OpStatusType, direction=IN
          DcmDspStartRoutineOutSignal_StatNumVlanConfigurationEntriesWert: type=uint8, direction=OUT
          DcmDspStartRoutineOutSignal_StatVlanConfigEntries: type=uint8, direction=OUT
          ErrorCode: type=Dcm_NegativeResponseCodeType, direction=OUT
      error E_NOT_OK: error-code=1
      error DCM_E_PENDING: error-code=10
      error DCM_E_FORCE_RCRRP: error-code=12
    RoutineServices_DcmDspRoutine_FehlerspeicherEndeWerksablauf
      operation Start: possible-error=[RoutineServices_DcmDspRoutine_FehlerspeicherEndeWerksablauf/E_NOT_OK, RoutineServices_DcmDspRoutine_FehlerspeicherEndeWerksablauf/DCM_E_PENDING, RoutineServices_DcmDspRoutine_FehlerspeicherEndeWerksablauf/DCM_E_FORCE_RCRRP]
        arg OpStatus: type=Dcm_OpStatusType, direction=IN
        arg ErrorCode: type=Dcm_NegativeResponseCodeType, direction=OUT
      operation RequestResults: possible-error=[RoutineServices_DcmDspRoutine_FehlerspeicherEndeWerksablauf/E_NOT_OK, RoutineServices_DcmDspRoutine_FehlerspeicherEndeWerksablauf/DCM_E_PENDING, RoutineServices_DcmDspRoutine_FehlerspeicherEndeWerksablauf/DCM_E_FORCE_RCRRP]
        arg OpStatus: type=Dcm_OpStatusType, direction=IN
        arg DcmDspRequestRoutineResultsOutSignal_StatFsEndeWabl: type=uint8, direction=OUT
        arg ErrorCode: type=Dcm_NegativeResponseCodeType, direction=OUT
      error E_NOT_OK: error-code=1
      error DCM_E_PENDING: error-code=10
      error DCM_E_FORCE_RCRRP: error-code=12
    RoutineServices_DcmDspRoutine_AblageSystemkontext
      operation Start: possible-error=[RoutineServices_DcmDspRoutine_AblageSystemkontext/E_NOT_OK, RoutineServices_DcmDspRoutine_AblageSystemkontext/DCM_E_PENDING, RoutineServices_DcmDspRoutine_AblageSystemkontext/DCM_E_FORCE_RCRRP]
        5 x arg:
          DcmDspStartRoutineInSignal_Function: type=uint8, direction=IN
          OpStatus: type=Dcm_OpStatusType, direction=IN
          DcmDspStartRoutineOutSignal_StatFunction: type=uint8, direction=OUT
          DcmDspStartRoutineOutSignal_StatDmLockState: type=uint8, direction=OUT
          ErrorCode: type=Dcm_NegativeResponseCodeType, direction=OUT
      error E_NOT_OK: error-code=1
      error DCM_E_PENDING: error-code=10
      error DCM_E_FORCE_RCRRP: error-code=12
    RoutineServices_DcmDspRoutine_InitLinBus
      operation Start: possible-error=[RoutineServices_DcmDspRoutine_InitLinBus/E_NOT_OK, RoutineServices_DcmDspRoutine_InitLinBus/DCM_E_PENDING, RoutineServices_DcmDspRoutine_InitLinBus/DCM_E_FORCE_RCRRP]
        arg OpStatus: type=Dcm_OpStatusType, direction=IN
        arg ErrorCode: type=Dcm_NegativeResponseCodeType, direction=OUT
      error E_NOT_OK: error-code=1
      error DCM_E_PENDING: error-code=10
      error DCM_E_FORCE_RCRRP: error-code=12
    RoutineServices_DcmDspRoutine_RamDatenSchreiben
      operation Start: possible-error=[RoutineServices_DcmDspRoutine_RamDatenSchreiben/E_NOT_OK, RoutineServices_DcmDspRoutine_RamDatenSchreiben/DCM_E_PENDING, RoutineServices_DcmDspRoutine_RamDatenSchreiben/DCM_E_FORCE_RCRRP]
        arg OpStatus: type=Dcm_OpStatusType, direction=IN
        arg ErrorCode: type=Dcm_NegativeResponseCodeType, direction=OUT
      operation RequestResults: possible-error=[RoutineServices_DcmDspRoutine_RamDatenSchreiben/E_NOT_OK, RoutineServices_DcmDspRoutine_RamDatenSchreiben/DCM_E_PENDING, RoutineServices_DcmDspRoutine_RamDatenSchreiben/DCM_E_FORCE_RCRRP]
        arg OpStatus: type=Dcm_OpStatusType, direction=IN
        arg DcmDspRequestRoutineResultsOutSignal_StatRamDatenSchreiben: type=uint8, direction=OUT
        arg ErrorCode: type=Dcm_NegativeResponseCodeType, direction=OUT
      error E_NOT_OK: error-code=1
      error DCM_E_PENDING: error-code=10
      error DCM_E_FORCE_RCRRP: error-code=12
    RoutineServices_DcmDspRoutine_RcPad
      operation Start: possible-error=[RoutineServices_DcmDspRoutine_RcPad/E_NOT_OK, RoutineServices_DcmDspRoutine_RcPad/DCM_E_PENDING, RoutineServices_DcmDspRoutine_RcPad/DCM_E_FORCE_RCRRP]
        8 x arg:
          DcmDspStartRoutineInSignal_Dpt: type=uint8, direction=IN
          DcmDspStartRoutineInSignal_Rsvd: type=uint8, direction=IN
          DcmDspStartRoutineInSignal_MoiAfid: type=uint8, direction=IN
          DcmDspStartRoutineInSignal_MemObjIdent: type=uint8, direction=IN
          DcmDspStartRoutineInSignal_AppSpecificParam: type=uint8, direction=IN
          OpStatus: type=Dcm_OpStatusType, direction=IN
          DcmDspStartRoutineOutSignal_Rs: type=uint8, direction=OUT
          ErrorCode: type=Dcm_NegativeResponseCodeType, direction=OUT
      error E_NOT_OK: error-code=1
      error DCM_E_PENDING: error-code=10
      error DCM_E_FORCE_RCRRP: error-code=12
    DataServices_DcmDspData_SvkBackup39
      operation ReadData: possible-error=[DataServices_DcmDspData_SvkBackup39/E_NOT_OK, DataServices_DcmDspData_SvkBackup39/DCM_E_PENDING]
        arg OpStatus: type=Dcm_OpStatusType, direction=IN
        arg Data: type=Dcm_Data49ByteType, direction=OUT
      operation ConditionCheckRead: possible-error=[DataServices_DcmDspData_SvkBackup39/E_NOT_OK, DataServices_DcmDspData_SvkBackup39/DCM_E_PENDING]
        arg OpStatus: type=Dcm_OpStatusType, direction=IN
        arg ErrorCode: type=Dcm_NegativeResponseCodeType, direction=OUT
      error E_NOT_OK: error-code=1
      error DCM_E_PENDING: error-code=10
    DataServices_DcmDspData_SvkBackup38
      operation ReadData: possible-error=[DataServices_DcmDspData_SvkBackup38/E_NOT_OK, DataServices_DcmDspData_SvkBackup38/DCM_E_PENDING]
        arg OpStatus: type=Dcm_OpStatusType, direction=IN
        arg Data: type=Dcm_Data49ByteType, direction=OUT
      operation ConditionCheckRead: possible-error=[DataServices_DcmDspData_SvkBackup38/E_NOT_OK, DataServices_DcmDspData_SvkBackup38/DCM_E_PENDING]
        arg OpStatus: type=Dcm_OpStatusType, direction=IN
        arg ErrorCode: type=Dcm_NegativeResponseCodeType, direction=OUT
      error E_NOT_OK: error-code=1
      error DCM_E_PENDING: error-code=10
    DataServices_DcmDspData_SvkBackup37
      operation ReadData: possible-error=[DataServices_DcmDspData_SvkBackup37/E_NOT_OK, DataServices_DcmDspData_SvkBackup37/DCM_E_PENDING]
        arg OpStatus: type=Dcm_OpStatusType, direction=IN
        arg Data: type=Dcm_Data49ByteType, direction=OUT
      operation ConditionCheckRead: possible-error=[DataServices_DcmDspData_SvkBackup37/E_NOT_OK, DataServices_DcmDspData_SvkBackup37/DCM_E_PENDING]
        arg OpStatus: type=Dcm_OpStatusType, direction=IN
        arg ErrorCode: type=Dcm_NegativeResponseCodeType, direction=OUT
      error E_NOT_OK: error-code=1
      error DCM_E_PENDING: error-code=10
    DataServices_DcmDspData_SvkBackup36
      operation ReadData: possible-error=[DataServices_DcmDspData_SvkBackup36/E_NOT_OK, DataServices_DcmDspData_SvkBackup36/DCM_E_PENDING]
        arg OpStatus: type=Dcm_OpStatusType, direction=IN
        arg Data: type=Dcm_Data49ByteType, direction=OUT
      operation ConditionCheckRead: possible-error=[DataServices_DcmDspData_SvkBackup36/E_NOT_OK, DataServices_DcmDspData_SvkBackup36/DCM_E_PENDING]
        arg OpStatus: type=Dcm_OpStatusType, direction=IN
        arg ErrorCode: type=Dcm_NegativeResponseCodeType, direction=OUT
      error E_NOT_OK: error-code=1
      error DCM_E_PENDING: error-code=10
    DataServices_DcmDspData_SvkBackup35
      operation ReadData: possible-error=[DataServices_DcmDspData_SvkBackup35/E_NOT_OK, DataServices_DcmDspData_SvkBackup35/DCM_E_PENDING]
        arg OpStatus: type=Dcm_OpStatusType, direction=IN
        arg Data: type=Dcm_Data49ByteType, direction=OUT
      operation ConditionCheckRead: possible-error=[DataServices_DcmDspData_SvkBackup35/E_NOT_OK, DataServices_DcmDspData_SvkBackup35/DCM_E_PENDING]
        arg OpStatus: type=Dcm_OpStatusType, direction=IN
        arg ErrorCode: type=Dcm_NegativeResponseCodeType, direction=OUT
      error E_NOT_OK: error-code=1
      error DCM_E_PENDING: error-code=10
    DataServices_DcmDspData_SvkBackup34
      operation ReadData: possible-error=[DataServices_DcmDspData_SvkBackup34/E_NOT_OK, DataServices_DcmDspData_SvkBackup34/DCM_E_PENDING]
        arg OpStatus: type=Dcm_OpStatusType, direction=IN
        arg Data: type=Dcm_Data49ByteType, direction=OUT
      operation ConditionCheckRead: possible-error=[DataServices_DcmDspData_SvkBackup34/E_NOT_OK, DataServices_DcmDspData_SvkBackup34/DCM_E_PENDING]
        arg OpStatus: type=Dcm_OpStatusType, direction=IN
        arg ErrorCode: type=Dcm_NegativeResponseCodeType, direction=OUT
      error E_NOT_OK: error-code=1
      error DCM_E_PENDING: error-code=10
    DataServices_DcmDspData_SvkBackup33
      operation ReadData: possible-error=[DataServices_DcmDspData_SvkBackup33/E_NOT_OK, DataServices_DcmDspData_SvkBackup33/DCM_E_PENDING]
        arg OpStatus: type=Dcm_OpStatusType, direction=IN
        arg Data: type=Dcm_Data49ByteType, direction=OUT
      operation ConditionCheckRead: possible-error=[DataServices_DcmDspData_SvkBackup33/E_NOT_OK, DataServices_DcmDspData_SvkBackup33/DCM_E_PENDING]
        arg OpStatus: type=Dcm_OpStatusType, direction=IN
        arg ErrorCode: type=Dcm_NegativeResponseCodeType, direction=OUT
      error E_NOT_OK: error-code=1
      error DCM_E_PENDING: error-code=10
    DataServices_DcmDspData_SvkBackup32
      operation ReadData: possible-error=[DataServices_DcmDspData_SvkBackup32/E_NOT_OK, DataServices_DcmDspData_SvkBackup32/DCM_E_PENDING]
        arg OpStatus: type=Dcm_OpStatusType, direction=IN
        arg Data: type=Dcm_Data49ByteType, direction=OUT
      operation ConditionCheckRead: possible-error=[DataServices_DcmDspData_SvkBackup32/E_NOT_OK, DataServices_DcmDspData_SvkBackup32/DCM_E_PENDING]
        arg OpStatus: type=Dcm_OpStatusType, direction=IN
        arg ErrorCode: type=Dcm_NegativeResponseCodeType, direction=OUT
      error E_NOT_OK: error-code=1
      error DCM_E_PENDING: error-code=10
    DataServices_DcmDspData_SvkBackup31
      operation ReadData: possible-error=[DataServices_DcmDspData_SvkBackup31/E_NOT_OK, DataServices_DcmDspData_SvkBackup31/DCM_E_PENDING]
        arg OpStatus: type=Dcm_OpStatusType, direction=IN
        arg Data: type=Dcm_Data49ByteType, direction=OUT
      operation ConditionCheckRead: possible-error=[DataServices_DcmDspData_SvkBackup31/E_NOT_OK, DataServices_DcmDspData_SvkBackup31/DCM_E_PENDING]
        arg OpStatus: type=Dcm_OpStatusType, direction=IN
        arg ErrorCode: type=Dcm_NegativeResponseCodeType, direction=OUT
      error E_NOT_OK: error-code=1
      error DCM_E_PENDING: error-code=10
    DataServices_DcmDspData_SvkBackup30
      operation ReadData: possible-error=[DataServices_DcmDspData_SvkBackup30/E_NOT_OK, DataServices_DcmDspData_SvkBackup30/DCM_E_PENDING]
        arg OpStatus: type=Dcm_OpStatusType, direction=IN
        arg Data: type=Dcm_Data49ByteType, direction=OUT
      operation ConditionCheckRead: possible-error=[DataServices_DcmDspData_SvkBackup30/E_NOT_OK, DataServices_DcmDspData_SvkBackup30/DCM_E_PENDING]
        arg OpStatus: type=Dcm_OpStatusType, direction=IN
        arg ErrorCode: type=Dcm_NegativeResponseCodeType, direction=OUT
      error E_NOT_OK: error-code=1
      error DCM_E_PENDING: error-code=10
    DataServices_DcmDspData_EthGetNumberOfPorts
      operation ReadData: possible-error=[DataServices_DcmDspData_EthGetNumberOfPorts/E_NOT_OK, DataServices_DcmDspData_EthGetNumberOfPorts/DCM_E_PENDING]
        arg OpStatus: type=Dcm_OpStatusType, direction=IN
        arg Data: type=Dcm_Data1ByteType, direction=OUT
      operation ConditionCheckRead: possible-error=[DataServices_DcmDspData_EthGetNumberOfPorts/E_NOT_OK, DataServices_DcmDspData_EthGetNumberOfPorts/DCM_E_PENDING]
        arg OpStatus: type=Dcm_OpStatusType, direction=IN
        arg ErrorCode: type=Dcm_NegativeResponseCodeType, direction=OUT
      error E_NOT_OK: error-code=1
      error DCM_E_PENDING: error-code=10
    DataServices_DcmDspData_SvkBackup28
      operation ReadData: possible-error=[DataServices_DcmDspData_SvkBackup28/E_NOT_OK, DataServices_DcmDspData_SvkBackup28/DCM_E_PENDING]
        arg OpStatus: type=Dcm_OpStatusType, direction=IN
        arg Data: type=Dcm_Data49ByteType, direction=OUT
      operation ConditionCheckRead: possible-error=[DataServices_DcmDspData_SvkBackup28/E_NOT_OK, DataServices_DcmDspData_SvkBackup28/DCM_E_PENDING]
        arg OpStatus: type=Dcm_OpStatusType, direction=IN
        arg ErrorCode: type=Dcm_NegativeResponseCodeType, direction=OUT
      error E_NOT_OK: error-code=1
      error DCM_E_PENDING: error-code=10
    DataServices_DcmDspData_SvkBackup27
      operation ReadData: possible-error=[DataServices_DcmDspData_SvkBackup27/E_NOT_OK, DataServices_DcmDspData_SvkBackup27/DCM_E_PENDING]
        arg OpStatus: type=Dcm_OpStatusType, direction=IN
        arg Data: type=Dcm_Data49ByteType, direction=OUT
      operation ConditionCheckRead: possible-error=[DataServices_DcmDspData_SvkBackup27/E_NOT_OK, DataServices_DcmDspData_SvkBackup27/DCM_E_PENDING]
        arg OpStatus: type=Dcm_OpStatusType, direction=IN
        arg ErrorCode: type=Dcm_NegativeResponseCodeType, direction=OUT
      error E_NOT_OK: error-code=1
      error DCM_E_PENDING: error-code=10
    DataServices_DcmDspData_SvkBackup26
      operation ReadData: possible-error=[DataServices_DcmDspData_SvkBackup26/E_NOT_OK, DataServices_DcmDspData_SvkBackup26/DCM_E_PENDING]
        arg OpStatus: type=Dcm_OpStatusType, direction=IN
        arg Data: type=Dcm_Data49ByteType, direction=OUT
      operation ConditionCheckRead: possible-error=[DataServices_DcmDspData_SvkBackup26/E_NOT_OK, DataServices_DcmDspData_SvkBackup26/DCM_E_PENDING]
        arg OpStatus: type=Dcm_OpStatusType, direction=IN
        arg ErrorCode: type=Dcm_NegativeResponseCodeType, direction=OUT
      error E_NOT_OK: error-code=1
      error DCM_E_PENDING: error-code=10
    DataServices_DcmDspData_SvkBackup25
      operation ReadData: possible-error=[DataServices_DcmDspData_SvkBackup25/E_NOT_OK, DataServices_DcmDspData_SvkBackup25/DCM_E_PENDING]
        arg OpStatus: type=Dcm_OpStatusType, direction=IN
        arg Data: type=Dcm_Data49ByteType, direction=OUT
      operation ConditionCheckRead: possible-error=[DataServices_DcmDspData_SvkBackup25/E_NOT_OK, DataServices_DcmDspData_SvkBackup25/DCM_E_PENDING]
        arg OpStatus: type=Dcm_OpStatusType, direction=IN
        arg ErrorCode: type=Dcm_NegativeResponseCodeType, direction=OUT
      error E_NOT_OK: error-code=1
      error DCM_E_PENDING: error-code=10
    DataServices_DcmDspData_SvkBackup24
      operation ReadData: possible-error=[DataServices_DcmDspData_SvkBackup24/E_NOT_OK, DataServices_DcmDspData_SvkBackup24/DCM_E_PENDING]
        arg OpStatus: type=Dcm_OpStatusType, direction=IN
        arg Data: type=Dcm_Data49ByteType, direction=OUT
      operation ConditionCheckRead: possible-error=[DataServices_DcmDspData_SvkBackup24/E_NOT_OK, DataServices_DcmDspData_SvkBackup24/DCM_E_PENDING]
        arg OpStatus: type=Dcm_OpStatusType, direction=IN
        arg ErrorCode: type=Dcm_NegativeResponseCodeType, direction=OUT
      error E_NOT_OK: error-code=1
      error DCM_E_PENDING: error-code=10
    DataServices_DcmDspData_SvkBackup23
      operation ReadData: possible-error=[DataServices_DcmDspData_SvkBackup23/E_NOT_OK, DataServices_DcmDspData_SvkBackup23/DCM_E_PENDING]
        arg OpStatus: type=Dcm_OpStatusType, direction=IN
        arg Data: type=Dcm_Data49ByteType, direction=OUT
      operation ConditionCheckRead: possible-error=[DataServices_DcmDspData_SvkBackup23/E_NOT_OK, DataServices_DcmDspData_SvkBackup23/DCM_E_PENDING]
        arg OpStatus: type=Dcm_OpStatusType, direction=IN
        arg ErrorCode: type=Dcm_NegativeResponseCodeType, direction=OUT
      error E_NOT_OK: error-code=1
      error DCM_E_PENDING: error-code=10
    DataServices_DcmDspData_SvkBackup22
      operation ReadData: possible-error=[DataServices_DcmDspData_SvkBackup22/E_NOT_OK, DataServices_DcmDspData_SvkBackup22/DCM_E_PENDING]
        arg OpStatus: type=Dcm_OpStatusType, direction=IN
        arg Data: type=Dcm_Data49ByteType, direction=OUT
      operation ConditionCheckRead: possible-error=[DataServices_DcmDspData_SvkBackup22/E_NOT_OK, DataServices_DcmDspData_SvkBackup22/DCM_E_PENDING]
        arg OpStatus: type=Dcm_OpStatusType, direction=IN
        arg ErrorCode: type=Dcm_NegativeResponseCodeType, direction=OUT
      error E_NOT_OK: error-code=1
      error DCM_E_PENDING: error-code=10
    DataServices_DcmDspData_SvkBackup21
      operation ReadData: possible-error=[DataServices_DcmDspData_SvkBackup21/E_NOT_OK, DataServices_DcmDspData_SvkBackup21/DCM_E_PENDING]
        arg OpStatus: type=Dcm_OpStatusType, direction=IN
        arg Data: type=Dcm_Data49ByteType, direction=OUT
      operation ConditionCheckRead: possible-error=[DataServices_DcmDspData_SvkBackup21/E_NOT_OK, DataServices_DcmDspData_SvkBackup21/DCM_E_PENDING]
        arg OpStatus: type=Dcm_OpStatusType, direction=IN
        arg ErrorCode: type=Dcm_NegativeResponseCodeType, direction=OUT
      error E_NOT_OK: error-code=1
      error DCM_E_PENDING: error-code=10
    DataServices_DcmDspData_SvkBackup20
      operation ReadData: possible-error=[DataServices_DcmDspData_SvkBackup20/E_NOT_OK, DataServices_DcmDspData_SvkBackup20/DCM_E_PENDING]
        arg OpStatus: type=Dcm_OpStatusType, direction=IN
        arg Data: type=Dcm_Data49ByteType, direction=OUT
      operation ConditionCheckRead: possible-error=[DataServices_DcmDspData_SvkBackup20/E_NOT_OK, DataServices_DcmDspData_SvkBackup20/DCM_E_PENDING]
        arg OpStatus: type=Dcm_OpStatusType, direction=IN
        arg ErrorCode: type=Dcm_NegativeResponseCodeType, direction=OUT
      error E_NOT_OK: error-code=1
      error DCM_E_PENDING: error-code=10
    DataServices_DcmDspData_SvkBackup29
      operation ReadData: possible-error=[DataServices_DcmDspData_SvkBackup29/E_NOT_OK, DataServices_DcmDspData_SvkBackup29/DCM_E_PENDING]
        arg OpStatus: type=Dcm_OpStatusType, direction=IN
        arg Data: type=Dcm_Data49ByteType, direction=OUT
      operation ConditionCheckRead: possible-error=[DataServices_DcmDspData_SvkBackup29/E_NOT_OK, DataServices_DcmDspData_SvkBackup29/DCM_E_PENDING]
        arg OpStatus: type=Dcm_OpStatusType, direction=IN
        arg ErrorCode: type=Dcm_NegativeResponseCodeType, direction=OUT
      error E_NOT_OK: error-code=1
      error DCM_E_PENDING: error-code=10
    DataServices_DcmDspData_ListManipulationSecurityArtifact
      operation ReadData: possible-error=[DataServices_DcmDspData_ListManipulationSecurityArtifact/E_NOT_OK, DataServices_DcmDspData_ListManipulationSecurityArtifact/DCM_E_PENDING]
        arg OpStatus: type=Dcm_OpStatusType, direction=IN
        arg Data: type=Dcm_Data8192ByteType, direction=OUT
      operation ConditionCheckRead: possible-error=[DataServices_DcmDspData_ListManipulationSecurityArtifact/E_NOT_OK, DataServices_DcmDspData_ListManipulationSecurityArtifact/DCM_E_PENDING]
        arg OpStatus: type=Dcm_OpStatusType, direction=IN
        arg ErrorCode: type=Dcm_NegativeResponseCodeType, direction=OUT
      error E_NOT_OK: error-code=1
      error DCM_E_PENDING: error-code=10
    DataServices_DcmDspData_SvkBackup17
      operation ReadData: possible-error=[DataServices_DcmDspData_SvkBackup17/E_NOT_OK, DataServices_DcmDspData_SvkBackup17/DCM_E_PENDING]
        arg OpStatus: type=Dcm_OpStatusType, direction=IN
        arg Data: type=Dcm_Data49ByteType, direction=OUT
      operation ConditionCheckRead: possible-error=[DataServices_DcmDspData_SvkBackup17/E_NOT_OK, DataServices_DcmDspData_SvkBackup17/DCM_E_PENDING]
        arg OpStatus: type=Dcm_OpStatusType, direction=IN
        arg ErrorCode: type=Dcm_NegativeResponseCodeType, direction=OUT
      error E_NOT_OK: error-code=1
      error DCM_E_PENDING: error-code=10
    DataServices_DcmDspData_SvkBackup16
      operation ReadData: possible-error=[DataServices_DcmDspData_SvkBackup16/E_NOT_OK, DataServices_DcmDspData_SvkBackup16/DCM_E_PENDING]
        arg OpStatus: type=Dcm_OpStatusType, direction=IN
        arg Data: type=Dcm_Data49ByteType, direction=OUT
      operation ConditionCheckRead: possible-error=[DataServices_DcmDspData_SvkBackup16/E_NOT_OK, DataServices_DcmDspData_SvkBackup16/DCM_E_PENDING]
        arg OpStatus: type=Dcm_OpStatusType, direction=IN
        arg ErrorCode: type=Dcm_NegativeResponseCodeType, direction=OUT
      error E_NOT_OK: error-code=1
      error DCM_E_PENDING: error-code=10
    DataServices_DcmDspData_SvkBackup15
      operation ReadData: possible-error=[DataServices_DcmDspData_SvkBackup15/E_NOT_OK, DataServices_DcmDspData_SvkBackup15/DCM_E_PENDING]
        arg OpStatus: type=Dcm_OpStatusType, direction=IN
        arg Data: type=Dcm_Data49ByteType, direction=OUT
      operation ConditionCheckRead: possible-error=[DataServices_DcmDspData_SvkBackup15/E_NOT_OK, DataServices_DcmDspData_SvkBackup15/DCM_E_PENDING]
        arg OpStatus: type=Dcm_OpStatusType, direction=IN
        arg ErrorCode: type=Dcm_NegativeResponseCodeType, direction=OUT
      error E_NOT_OK: error-code=1
      error DCM_E_PENDING: error-code=10
    DataServices_DcmDspData_SvkBackup14
      operation ReadData: possible-error=[DataServices_DcmDspData_SvkBackup14/E_NOT_OK, DataServices_DcmDspData_SvkBackup14/DCM_E_PENDING]
        arg OpStatus: type=Dcm_OpStatusType, direction=IN
        arg Data: type=Dcm_Data49ByteType, direction=OUT
      operation ConditionCheckRead: possible-error=[DataServices_DcmDspData_SvkBackup14/E_NOT_OK, DataServices_DcmDspData_SvkBackup14/DCM_E_PENDING]
        arg OpStatus: type=Dcm_OpStatusType, direction=IN
        arg ErrorCode: type=Dcm_NegativeResponseCodeType, direction=OUT
      error E_NOT_OK: error-code=1
      error DCM_E_PENDING: error-code=10
    DataServices_DcmDspData_SvkBackup13
      operation ReadData: possible-error=[DataServices_DcmDspData_SvkBackup13/E_NOT_OK, DataServices_DcmDspData_SvkBackup13/DCM_E_PENDING]
        arg OpStatus: type=Dcm_OpStatusType, direction=IN
        arg Data: type=Dcm_Data49ByteType, direction=OUT
      operation ConditionCheckRead: possible-error=[DataServices_DcmDspData_SvkBackup13/E_NOT_OK, DataServices_DcmDspData_SvkBackup13/DCM_E_PENDING]
        arg OpStatus: type=Dcm_OpStatusType, direction=IN
        arg ErrorCode: type=Dcm_NegativeResponseCodeType, direction=OUT
      error E_NOT_OK: error-code=1
      error DCM_E_PENDING: error-code=10
    DataServices_DcmDspData_SvkBackup12
      operation ReadData: possible-error=[DataServices_DcmDspData_SvkBackup12/E_NOT_OK, DataServices_DcmDspData_SvkBackup12/DCM_E_PENDING]
        arg OpStatus: type=Dcm_OpStatusType, direction=IN
        arg Data: type=Dcm_Data49ByteType, direction=OUT
      operation ConditionCheckRead: possible-error=[DataServices_DcmDspData_SvkBackup12/E_NOT_OK, DataServices_DcmDspData_SvkBackup12/DCM_E_PENDING]
        arg OpStatus: type=Dcm_OpStatusType, direction=IN
        arg ErrorCode: type=Dcm_NegativeResponseCodeType, direction=OUT
      error E_NOT_OK: error-code=1
      error DCM_E_PENDING: error-code=10
    DataServices_DcmDspData_SvkBackup11
      operation ReadData: possible-error=[DataServices_DcmDspData_SvkBackup11/E_NOT_OK, DataServices_DcmDspData_SvkBackup11/DCM_E_PENDING]
        arg OpStatus: type=Dcm_OpStatusType, direction=IN
        arg Data: type=Dcm_Data49ByteType, direction=OUT
      operation ConditionCheckRead: possible-error=[DataServices_DcmDspData_SvkBackup11/E_NOT_OK, DataServices_DcmDspData_SvkBackup11/DCM_E_PENDING]
        arg OpStatus: type=Dcm_OpStatusType, direction=IN
        arg ErrorCode: type=Dcm_NegativeResponseCodeType, direction=OUT
      error E_NOT_OK: error-code=1
      error DCM_E_PENDING: error-code=10
    DataServices_DcmDspData_SvkBackup10
      operation ReadData: possible-error=[DataServices_DcmDspData_SvkBackup10/E_NOT_OK, DataServices_DcmDspData_SvkBackup10/DCM_E_PENDING]
        arg OpStatus: type=Dcm_OpStatusType, direction=IN
        arg Data: type=Dcm_Data49ByteType, direction=OUT
      operation ConditionCheckRead: possible-error=[DataServices_DcmDspData_SvkBackup10/E_NOT_OK, DataServices_DcmDspData_SvkBackup10/DCM_E_PENDING]
        arg OpStatus: type=Dcm_OpStatusType, direction=IN
        arg ErrorCode: type=Dcm_NegativeResponseCodeType, direction=OUT
      error E_NOT_OK: error-code=1
      error DCM_E_PENDING: error-code=10
    DataServices_DcmDspData_SvkBackup19
      operation ReadData: possible-error=[DataServices_DcmDspData_SvkBackup19/E_NOT_OK, DataServices_DcmDspData_SvkBackup19/DCM_E_PENDING]
        arg OpStatus: type=Dcm_OpStatusType, direction=IN
        arg Data: type=Dcm_Data49ByteType, direction=OUT
      operation ConditionCheckRead: possible-error=[DataServices_DcmDspData_SvkBackup19/E_NOT_OK, DataServices_DcmDspData_SvkBackup19/DCM_E_PENDING]
        arg OpStatus: type=Dcm_OpStatusType, direction=IN
        arg ErrorCode: type=Dcm_NegativeResponseCodeType, direction=OUT
      error E_NOT_OK: error-code=1
      error DCM_E_PENDING: error-code=10
    DataServices_DcmDspData_SvkBackup18
      operation ReadData: possible-error=[DataServices_DcmDspData_SvkBackup18/E_NOT_OK, DataServices_DcmDspData_SvkBackup18/DCM_E_PENDING]
        arg OpStatus: type=Dcm_OpStatusType, direction=IN
        arg Data: type=Dcm_Data49ByteType, direction=OUT
      operation ConditionCheckRead: possible-error=[DataServices_DcmDspData_SvkBackup18/E_NOT_OK, DataServices_DcmDspData_SvkBackup18/DCM_E_PENDING]
        arg OpStatus: type=Dcm_OpStatusType, direction=IN
        arg ErrorCode: type=Dcm_NegativeResponseCodeType, direction=OUT
      error E_NOT_OK: error-code=1
      error DCM_E_PENDING: error-code=10
    DataServices_DcmDspData_SvkBackup06
      operation ReadData: possible-error=[DataServices_DcmDspData_SvkBackup06/E_NOT_OK, DataServices_DcmDspData_SvkBackup06/DCM_E_PENDING]
        arg OpStatus: type=Dcm_OpStatusType, direction=IN
        arg Data: type=Dcm_Data49ByteType, direction=OUT
      operation ConditionCheckRead: possible-error=[DataServices_DcmDspData_SvkBackup06/E_NOT_OK, DataServices_DcmDspData_SvkBackup06/DCM_E_PENDING]
        arg OpStatus: type=Dcm_OpStatusType, direction=IN
        arg ErrorCode: type=Dcm_NegativeResponseCodeType, direction=OUT
      error E_NOT_OK: error-code=1
      error DCM_E_PENDING: error-code=10
    DataServices_DcmDspData_SvkBackup05
      operation ReadData: possible-error=[DataServices_DcmDspData_SvkBackup05/E_NOT_OK, DataServices_DcmDspData_SvkBackup05/DCM_E_PENDING]
        arg OpStatus: type=Dcm_OpStatusType, direction=IN
        arg Data: type=Dcm_Data49ByteType, direction=OUT
      operation ConditionCheckRead: possible-error=[DataServices_DcmDspData_SvkBackup05/E_NOT_OK, DataServices_DcmDspData_SvkBackup05/DCM_E_PENDING]
        arg OpStatus: type=Dcm_OpStatusType, direction=IN
        arg ErrorCode: type=Dcm_NegativeResponseCodeType, direction=OUT
      error E_NOT_OK: error-code=1
      error DCM_E_PENDING: error-code=10
    DataServices_DcmDspData_SvkBackup04
      operation ReadData: possible-error=[DataServices_DcmDspData_SvkBackup04/E_NOT_OK, DataServices_DcmDspData_SvkBackup04/DCM_E_PENDING]
        arg OpStatus: type=Dcm_OpStatusType, direction=IN
        arg Data: type=Dcm_Data49ByteType, direction=OUT
      operation ConditionCheckRead: possible-error=[DataServices_DcmDspData_SvkBackup04/E_NOT_OK, DataServices_DcmDspData_SvkBackup04/DCM_E_PENDING]
        arg OpStatus: type=Dcm_OpStatusType, direction=IN
        arg ErrorCode: type=Dcm_NegativeResponseCodeType, direction=OUT
      error E_NOT_OK: error-code=1
      error DCM_E_PENDING: error-code=10
    DataServices_DcmDspData_SvkBackup03
      operation ReadData: possible-error=[DataServices_DcmDspData_SvkBackup03/E_NOT_OK, DataServices_DcmDspData_SvkBackup03/DCM_E_PENDING]
        arg OpStatus: type=Dcm_OpStatusType, direction=IN
        arg Data: type=Dcm_Data49ByteType, direction=OUT
      operation ConditionCheckRead: possible-error=[DataServices_DcmDspData_SvkBackup03/E_NOT_OK, DataServices_DcmDspData_SvkBackup03/DCM_E_PENDING]
        arg OpStatus: type=Dcm_OpStatusType, direction=IN
        arg ErrorCode: type=Dcm_NegativeResponseCodeType, direction=OUT
      error E_NOT_OK: error-code=1
      error DCM_E_PENDING: error-code=10
    DataServices_DcmDspData_SvkBackup02
      operation ReadData: possible-error=[DataServices_DcmDspData_SvkBackup02/E_NOT_OK, DataServices_DcmDspData_SvkBackup02/DCM_E_PENDING]
        arg OpStatus: type=Dcm_OpStatusType, direction=IN
        arg Data: type=Dcm_Data49ByteType, direction=OUT
      operation ConditionCheckRead: possible-error=[DataServices_DcmDspData_SvkBackup02/E_NOT_OK, DataServices_DcmDspData_SvkBackup02/DCM_E_PENDING]
        arg OpStatus: type=Dcm_OpStatusType, direction=IN
        arg ErrorCode: type=Dcm_NegativeResponseCodeType, direction=OUT
      error E_NOT_OK: error-code=1
      error DCM_E_PENDING: error-code=10
    DataServices_DcmDspData_SvkBackup01
      operation ReadData: possible-error=[DataServices_DcmDspData_SvkBackup01/E_NOT_OK, DataServices_DcmDspData_SvkBackup01/DCM_E_PENDING]
        arg OpStatus: type=Dcm_OpStatusType, direction=IN
        arg Data: type=Dcm_Data49ByteType, direction=OUT
      operation ConditionCheckRead: possible-error=[DataServices_DcmDspData_SvkBackup01/E_NOT_OK, DataServices_DcmDspData_SvkBackup01/DCM_E_PENDING]
        arg OpStatus: type=Dcm_OpStatusType, direction=IN
        arg ErrorCode: type=Dcm_NegativeResponseCodeType, direction=OUT
      error E_NOT_OK: error-code=1
      error DCM_E_PENDING: error-code=10
    DataServices_DcmDspData_StatusSystime
      operation ReadData: possible-error=[DataServices_DcmDspData_StatusSystime/E_NOT_OK, DataServices_DcmDspData_StatusSystime/DCM_E_PENDING]
        arg OpStatus: type=Dcm_OpStatusType, direction=IN
        arg Data: type=Dcm_Data4ByteType, direction=OUT
      operation ConditionCheckRead: possible-error=[DataServices_DcmDspData_StatusSystime/E_NOT_OK, DataServices_DcmDspData_StatusSystime/DCM_E_PENDING]
        arg OpStatus: type=Dcm_OpStatusType, direction=IN
        arg ErrorCode: type=Dcm_NegativeResponseCodeType, direction=OUT
      error E_NOT_OK: error-code=1
      error DCM_E_PENDING: error-code=10
    DataServices_DcmDspData_SvkBackup09
      operation ReadData: possible-error=[DataServices_DcmDspData_SvkBackup09/E_NOT_OK, DataServices_DcmDspData_SvkBackup09/DCM_E_PENDING]
        arg OpStatus: type=Dcm_OpStatusType, direction=IN
        arg Data: type=Dcm_Data49ByteType, direction=OUT
      operation ConditionCheckRead: possible-error=[DataServices_DcmDspData_SvkBackup09/E_NOT_OK, DataServices_DcmDspData_SvkBackup09/DCM_E_PENDING]
        arg OpStatus: type=Dcm_OpStatusType, direction=IN
        arg ErrorCode: type=Dcm_NegativeResponseCodeType, direction=OUT
      error E_NOT_OK: error-code=1
      error DCM_E_PENDING: error-code=10
    DataServices_DcmDspData_SvkBackup08
      operation ReadData: possible-error=[DataServices_DcmDspData_SvkBackup08/E_NOT_OK, DataServices_DcmDspData_SvkBackup08/DCM_E_PENDING]
        arg OpStatus: type=Dcm_OpStatusType, direction=IN
        arg Data: type=Dcm_Data49ByteType, direction=OUT
      operation ConditionCheckRead: possible-error=[DataServices_DcmDspData_SvkBackup08/E_NOT_OK, DataServices_DcmDspData_SvkBackup08/DCM_E_PENDING]
        arg OpStatus: type=Dcm_OpStatusType, direction=IN
        arg ErrorCode: type=Dcm_NegativeResponseCodeType, direction=OUT
      error E_NOT_OK: error-code=1
      error DCM_E_PENDING: error-code=10
    DataServices_DcmDspData_SvkBackup07
      operation ReadData: possible-error=[DataServices_DcmDspData_SvkBackup07/E_NOT_OK, DataServices_DcmDspData_SvkBackup07/DCM_E_PENDING]
        arg OpStatus: type=Dcm_OpStatusType, direction=IN
        arg Data: type=Dcm_Data49ByteType, direction=OUT
      operation ConditionCheckRead: possible-error=[DataServices_DcmDspData_SvkBackup07/E_NOT_OK, DataServices_DcmDspData_SvkBackup07/DCM_E_PENDING]
        arg OpStatus: type=Dcm_OpStatusType, direction=IN
        arg ErrorCode: type=Dcm_NegativeResponseCodeType, direction=OUT
      error E_NOT_OK: error-code=1
      error DCM_E_PENDING: error-code=10
    DataServices_DcmDspData_HddDownloadTimeToCompletion
      operation ReadData: possible-error=[DataServices_DcmDspData_HddDownloadTimeToCompletion/E_NOT_OK, DataServices_DcmDspData_HddDownloadTimeToCompletion/DCM_E_PENDING]
        arg OpStatus: type=Dcm_OpStatusType, direction=IN
        arg Data: type=Dcm_Data4ByteType, direction=OUT
      operation ConditionCheckRead: possible-error=[DataServices_DcmDspData_HddDownloadTimeToCompletion/E_NOT_OK, DataServices_DcmDspData_HddDownloadTimeToCompletion/DCM_E_PENDING]
        arg OpStatus: type=Dcm_OpStatusType, direction=IN
        arg ErrorCode: type=Dcm_NegativeResponseCodeType, direction=OUT
      error E_NOT_OK: error-code=1
      error DCM_E_PENDING: error-code=10
    DataServices_DcmDspData_StatusDmFssMaster
      operation ReadData: possible-error=[DataServices_DcmDspData_StatusDmFssMaster/E_NOT_OK, DataServices_DcmDspData_StatusDmFssMaster/DCM_E_PENDING]
        arg OpStatus: type=Dcm_OpStatusType, direction=IN
        arg Data: type=Dcm_Data2ByteType, direction=OUT
      operation ConditionCheckRead: possible-error=[DataServices_DcmDspData_StatusDmFssMaster/E_NOT_OK, DataServices_DcmDspData_StatusDmFssMaster/DCM_E_PENDING]
        arg OpStatus: type=Dcm_OpStatusType, direction=IN
        arg ErrorCode: type=Dcm_NegativeResponseCodeType, direction=OUT
      error E_NOT_OK: error-code=1
      error DCM_E_PENDING: error-code=10
    DataServices_DcmDspData_HddDownloadStatus
      operation ReadData: possible-error=[DataServices_DcmDspData_HddDownloadStatus/E_NOT_OK, DataServices_DcmDspData_HddDownloadStatus/DCM_E_PENDING]
        arg OpStatus: type=Dcm_OpStatusType, direction=IN
        arg Data: type=Dcm_Data8192ByteType, direction=OUT
      operation ConditionCheckRead: possible-error=[DataServices_DcmDspData_HddDownloadStatus/E_NOT_OK, DataServices_DcmDspData_HddDownloadStatus/DCM_E_PENDING]
        arg OpStatus: type=Dcm_OpStatusType, direction=IN
        arg ErrorCode: type=Dcm_NegativeResponseCodeType, direction=OUT
      error E_NOT_OK: error-code=1
      error DCM_E_PENDING: error-code=10
    DataServices_DcmDspData_SvkAktuell
      operation ReadData: possible-error=[DataServices_DcmDspData_SvkAktuell/E_NOT_OK, DataServices_DcmDspData_SvkAktuell/DCM_E_PENDING]
        arg OpStatus: type=Dcm_OpStatusType, direction=IN
        arg Data: type=Dcm_Data109ByteType, direction=OUT
      operation ReadDataLength: possible-error=[DataServices_DcmDspData_SvkAktuell/E_NOT_OK, DataServices_DcmDspData_SvkAktuell/DCM_E_PENDING]
        arg OpStatus: type=Dcm_OpStatusType, direction=IN
        arg DataLength: type=uint16, direction=OUT
      operation ConditionCheckRead: possible-error=[DataServices_DcmDspData_SvkAktuell/E_NOT_OK, DataServices_DcmDspData_SvkAktuell/DCM_E_PENDING]
        arg OpStatus: type=Dcm_OpStatusType, direction=IN
        arg ErrorCode: type=Dcm_NegativeResponseCodeType, direction=OUT
      error E_NOT_OK: error-code=1
      error DCM_E_PENDING: error-code=10
    DataServices_DcmDspData_Readhwmodificationindex
      operation ReadData: possible-error=DataServices_DcmDspData_Readhwmodificationindex/E_NOT_OK
        arg Data: type=Dcm_Data2ByteType, direction=OUT
      error E_NOT_OK: error-code=1
    DataServices_DcmDspData_SensorenAnzahlLesen
      operation ReadData: possible-error=[DataServices_DcmDspData_SensorenAnzahlLesen/E_NOT_OK, DataServices_DcmDspData_SensorenAnzahlLesen/DCM_E_PENDING]
        arg OpStatus: type=Dcm_OpStatusType, direction=IN
        arg Data: type=Dcm_Data1ByteType, direction=OUT
      operation ConditionCheckRead: possible-error=[DataServices_DcmDspData_SensorenAnzahlLesen/E_NOT_OK, DataServices_DcmDspData_SensorenAnzahlLesen/DCM_E_PENDING]
        arg OpStatus: type=Dcm_OpStatusType, direction=IN
        arg ErrorCode: type=Dcm_NegativeResponseCodeType, direction=OUT
      error E_NOT_OK: error-code=1
      error DCM_E_PENDING: error-code=10
    DataServices_DcmDspData_IndivDataTable
      operation ReadData: possible-error=DataServices_DcmDspData_IndivDataTable/E_NOT_OK
        arg Data: type=Dcm_Data10ByteType, direction=OUT
      error E_NOT_OK: error-code=1
    DataServices_DcmDspData_DmDtcAktiveMeldung
      operation ReadData: possible-error=DataServices_DcmDspData_DmDtcAktiveMeldung/E_NOT_OK
        arg Data: type=Dcm_Data21ByteType, direction=OUT
      operation ReadDataLength: possible-error=DataServices_DcmDspData_DmDtcAktiveMeldung/E_NOT_OK
        arg DataLength: type=uint16, direction=OUT
      operation ConditionCheckRead: possible-error=DataServices_DcmDspData_DmDtcAktiveMeldung/E_NOT_OK
        arg ErrorCode: type=Dcm_NegativeResponseCodeType, direction=OUT
      error E_NOT_OK: error-code=1
    DataServices_DcmDspData_SwfkDeleteSupported
      operation ReadData: possible-error=DataServices_DcmDspData_SwfkDeleteSupported/E_NOT_OK
        arg Data: type=Dcm_Data1ByteType, direction=OUT
      error E_NOT_OK: error-code=1
    DataServices_DcmDspData_FlashTimingParameter
      operation ReadData: possible-error=DataServices_DcmDspData_FlashTimingParameter/E_NOT_OK
        arg Data: type=Dcm_Data12ByteType, direction=OUT
      error E_NOT_OK: error-code=1
    DataServices_DcmDspData_ListManipulationApplicationData
      operation ReadData: possible-error=[DataServices_DcmDspData_ListManipulationApplicationData/E_NOT_OK, DataServices_DcmDspData_ListManipulationApplicationData/DCM_E_PENDING]
        arg OpStatus: type=Dcm_OpStatusType, direction=IN
        arg Data: type=Dcm_Data8192ByteType, direction=OUT
      operation ConditionCheckRead: possible-error=[DataServices_DcmDspData_ListManipulationApplicationData/E_NOT_OK, DataServices_DcmDspData_ListManipulationApplicationData/DCM_E_PENDING]
        arg OpStatus: type=Dcm_OpStatusType, direction=IN
        arg ErrorCode: type=Dcm_NegativeResponseCodeType, direction=OUT
      error E_NOT_OK: error-code=1
      error DCM_E_PENDING: error-code=10
    DataServices_DcmDspData_Vin
      operation ReadData: possible-error=[DataServices_DcmDspData_Vin/E_NOT_OK, DataServices_DcmDspData_Vin/DCM_E_PENDING]
        arg OpStatus: type=Dcm_OpStatusType, direction=IN
        arg Data: type=Dcm_Data17ByteType, direction=OUT
      operation ConditionCheckRead: possible-error=[DataServices_DcmDspData_Vin/E_NOT_OK, DataServices_DcmDspData_Vin/DCM_E_PENDING]
        arg OpStatus: type=Dcm_OpStatusType, direction=IN
        arg ErrorCode: type=Dcm_NegativeResponseCodeType, direction=OUT
      error E_NOT_OK: error-code=1
      error DCM_E_PENDING: error-code=10
    DataServices_DcmDspData_EnergySavingState
      operation ReadData: possible-error=DataServices_DcmDspData_EnergySavingState/E_NOT_OK
        arg Data: type=Dcm_Data1ByteType, direction=OUT
      operation ConditionCheckRead: possible-error=DataServices_DcmDspData_EnergySavingState/E_NOT_OK
        arg ErrorCode: type=Dcm_NegativeResponseCodeType, direction=OUT
      error E_NOT_OK: error-code=1
    DataServices_DcmDspData_ReadActiveSessionState
      operation ReadData: possible-error=DataServices_DcmDspData_ReadActiveSessionState/E_NOT_OK
        arg Data: type=Dcm_Data4ByteType, direction=OUT
      operation ConditionCheckRead: possible-error=DataServices_DcmDspData_ReadActiveSessionState/E_NOT_OK
        arg ErrorCode: type=Dcm_NegativeResponseCodeType, direction=OUT
      error E_NOT_OK: error-code=1
    DataServices_DcmDspData_EthPhyLinkState
      operation ReadData: possible-error=[DataServices_DcmDspData_EthPhyLinkState/E_NOT_OK, DataServices_DcmDspData_EthPhyLinkState/DCM_E_PENDING]
        arg OpStatus: type=Dcm_OpStatusType, direction=IN
        arg Data: type=Dcm_Data3ByteType, direction=OUT
      operation ConditionCheckRead: possible-error=[DataServices_DcmDspData_EthPhyLinkState/E_NOT_OK, DataServices_DcmDspData_EthPhyLinkState/DCM_E_PENDING]
        arg OpStatus: type=Dcm_OpStatusType, direction=IN
        arg ErrorCode: type=Dcm_NegativeResponseCodeType, direction=OUT
      error E_NOT_OK: error-code=1
      error DCM_E_PENDING: error-code=10
    DataServices_DcmDspData_EthSignalQuality
      operation ReadData: possible-error=[DataServices_DcmDspData_EthSignalQuality/E_NOT_OK, DataServices_DcmDspData_EthSignalQuality/DCM_E_PENDING]
        arg OpStatus: type=Dcm_OpStatusType, direction=IN
        arg Data: type=Dcm_Data8192ByteType, direction=OUT
      operation ConditionCheckRead: possible-error=[DataServices_DcmDspData_EthSignalQuality/E_NOT_OK, DataServices_DcmDspData_EthSignalQuality/DCM_E_PENDING]
        arg OpStatus: type=Dcm_OpStatusType, direction=IN
        arg ErrorCode: type=Dcm_NegativeResponseCodeType, direction=OUT
      error E_NOT_OK: error-code=1
      error DCM_E_PENDING: error-code=10
    DataServices_DcmDspData_ListManipulationSw
      operation ReadData: possible-error=[DataServices_DcmDspData_ListManipulationSw/E_NOT_OK, DataServices_DcmDspData_ListManipulationSw/DCM_E_PENDING]
        arg OpStatus: type=Dcm_OpStatusType, direction=IN
        arg Data: type=Dcm_Data8192ByteType, direction=OUT
      operation ConditionCheckRead: possible-error=[DataServices_DcmDspData_ListManipulationSw/E_NOT_OK, DataServices_DcmDspData_ListManipulationSw/DCM_E_PENDING]
        arg OpStatus: type=Dcm_OpStatusType, direction=IN
        arg ErrorCode: type=Dcm_NegativeResponseCodeType, direction=OUT
      error E_NOT_OK: error-code=1
      error DCM_E_PENDING: error-code=10
    DataServices_DcmDspData_Herstelldatum
      operation ReadData: possible-error=DataServices_DcmDspData_Herstelldatum/E_NOT_OK
        arg Data: type=Dcm_Data3ByteType, direction=OUT
      error E_NOT_OK: error-code=1
    DataServices_DcmDspData_Sekundaererfehlerspeicher
      operation ReadData: possible-error=[DataServices_DcmDspData_Sekundaererfehlerspeicher/E_NOT_OK, DataServices_DcmDspData_Sekundaererfehlerspeicher/DCM_E_PENDING]
        arg OpStatus: type=Dcm_OpStatusType, direction=IN
        arg Data: type=Dcm_Data8192ByteType, direction=OUT
      operation ConditionCheckRead: possible-error=[DataServices_DcmDspData_Sekundaererfehlerspeicher/E_NOT_OK, DataServices_DcmDspData_Sekundaererfehlerspeicher/DCM_E_PENDING]
        arg OpStatus: type=Dcm_OpStatusType, direction=IN
        arg ErrorCode: type=Dcm_NegativeResponseCodeType, direction=OUT
      error E_NOT_OK: error-code=1
      error DCM_E_PENDING: error-code=10
    DataServices_DcmDspData_SystemSupplierIdentifier
      operation ReadData: possible-error=[DataServices_DcmDspData_SystemSupplierIdentifier/E_NOT_OK, DataServices_DcmDspData_SystemSupplierIdentifier/DCM_E_PENDING]
        arg OpStatus: type=Dcm_OpStatusType, direction=IN
        arg Data: type=Dcm_Data3ByteType, direction=OUT
      operation ConditionCheckRead: possible-error=[DataServices_DcmDspData_SystemSupplierIdentifier/E_NOT_OK, DataServices_DcmDspData_SystemSupplierIdentifier/DCM_E_PENDING]
        arg OpStatus: type=Dcm_OpStatusType, direction=IN
        arg ErrorCode: type=Dcm_NegativeResponseCodeType, direction=OUT
      error E_NOT_OK: error-code=1
      error DCM_E_PENDING: error-code=10
    DataServices_DcmDspData_MileKmEeprom
      operation ReadData: possible-error=[DataServices_DcmDspData_MileKmEeprom/E_NOT_OK, DataServices_DcmDspData_MileKmEeprom/DCM_E_PENDING]
        arg OpStatus: type=Dcm_OpStatusType, direction=IN
        arg Data: type=Dcm_Data3ByteType, direction=OUT
      operation ConditionCheckRead: possible-error=[DataServices_DcmDspData_MileKmEeprom/E_NOT_OK, DataServices_DcmDspData_MileKmEeprom/DCM_E_PENDING]
        arg OpStatus: type=Dcm_OpStatusType, direction=IN
        arg ErrorCode: type=Dcm_NegativeResponseCodeType, direction=OUT
      error E_NOT_OK: error-code=1
      error DCM_E_PENDING: error-code=10
    DataServices_DcmDspData_ListManipulationGeneral
      operation ReadData: possible-error=[DataServices_DcmDspData_ListManipulationGeneral/E_NOT_OK, DataServices_DcmDspData_ListManipulationGeneral/DCM_E_PENDING]
        arg OpStatus: type=Dcm_OpStatusType, direction=IN
        arg Data: type=Dcm_Data8192ByteType, direction=OUT
      operation ConditionCheckRead: possible-error=[DataServices_DcmDspData_ListManipulationGeneral/E_NOT_OK, DataServices_DcmDspData_ListManipulationGeneral/DCM_E_PENDING]
        arg OpStatus: type=Dcm_OpStatusType, direction=IN
        arg ErrorCode: type=Dcm_NegativeResponseCodeType, direction=OUT
      error E_NOT_OK: error-code=1
      error DCM_E_PENDING: error-code=10
    DataServices_DcmDspData_SvkWerk
      operation ReadData: possible-error=[DataServices_DcmDspData_SvkWerk/E_NOT_OK, DataServices_DcmDspData_SvkWerk/DCM_E_PENDING]
        arg OpStatus: type=Dcm_OpStatusType, direction=IN
        arg Data: type=Dcm_Data49ByteType, direction=OUT
      operation ConditionCheckRead: possible-error=[DataServices_DcmDspData_SvkWerk/E_NOT_OK, DataServices_DcmDspData_SvkWerk/DCM_E_PENDING]
        arg OpStatus: type=Dcm_OpStatusType, direction=IN
        arg ErrorCode: type=Dcm_NegativeResponseCodeType, direction=OUT
      error E_NOT_OK: error-code=1
      error DCM_E_PENDING: error-code=10
    DataServices_DcmDspData_ProgrammingCounterMaxValue
      operation ReadData: possible-error=DataServices_DcmDspData_ProgrammingCounterMaxValue/E_NOT_OK
        arg Data: type=Dcm_Data2ByteType, direction=OUT
      error E_NOT_OK: error-code=1
    DataServices_DcmDspData_EcuSerialNumber
      operation ReadData: possible-error=DataServices_DcmDspData_EcuSerialNumber/E_NOT_OK
        arg Data: type=Dcm_Data10ByteType, direction=OUT
      error E_NOT_OK: error-code=1
    DataServices_DcmDspData_SgbdIdx
      operation ReadData: possible-error=DataServices_DcmDspData_SgbdIdx/E_NOT_OK
        arg Data: type=Dcm_Data3ByteType, direction=OUT
      error E_NOT_OK: error-code=1
    DataServices_DcmDspData_ZgwZertifikat
      operation ReadData: possible-error=[DataServices_DcmDspData_ZgwZertifikat/E_NOT_OK, DataServices_DcmDspData_ZgwZertifikat/DCM_E_PENDING]
        arg OpStatus: type=Dcm_OpStatusType, direction=IN
        arg Data: type=Dcm_Data8192ByteType, direction=OUT
      operation ConditionCheckRead: possible-error=[DataServices_DcmDspData_ZgwZertifikat/E_NOT_OK, DataServices_DcmDspData_ZgwZertifikat/DCM_E_PENDING]
        arg OpStatus: type=Dcm_OpStatusType, direction=IN
        arg ErrorCode: type=Dcm_NegativeResponseCodeType, direction=OUT
      error E_NOT_OK: error-code=1
      error DCM_E_PENDING: error-code=10
    DataServices_DcmDspData_ListManipulationSecureBoot
      operation ReadData: possible-error=[DataServices_DcmDspData_ListManipulationSecureBoot/E_NOT_OK, DataServices_DcmDspData_ListManipulationSecureBoot/DCM_E_PENDING]
        arg OpStatus: type=Dcm_OpStatusType, direction=IN
        arg Data: type=Dcm_Data8192ByteType, direction=OUT
      operation ConditionCheckRead: possible-error=[DataServices_DcmDspData_ListManipulationSecureBoot/E_NOT_OK, DataServices_DcmDspData_ListManipulationSecureBoot/DCM_E_PENDING]
        arg OpStatus: type=Dcm_OpStatusType, direction=IN
        arg ErrorCode: type=Dcm_NegativeResponseCodeType, direction=OUT
      error E_NOT_OK: error-code=1
      error DCM_E_PENDING: error-code=10
    DataServices_DcmDspData_DmIsDtcActiveResponse
      operation ReadData: possible-error=DataServices_DcmDspData_DmIsDtcActiveResponse/E_NOT_OK
        arg Data: type=Dcm_Data156ByteType, direction=OUT
      operation ReadDataLength: possible-error=DataServices_DcmDspData_DmIsDtcActiveResponse/E_NOT_OK
        arg DataLength: type=uint16, direction=OUT
      operation ConditionCheckRead: possible-error=DataServices_DcmDspData_DmIsDtcActiveResponse/E_NOT_OK
        arg ErrorCode: type=Dcm_NegativeResponseCodeType, direction=OUT
      error E_NOT_OK: error-code=1
    DataServices_DcmDspData_ExtendedEnergySavingState
      operation ReadData: possible-error=DataServices_DcmDspData_ExtendedEnergySavingState/E_NOT_OK
        arg Data: type=Dcm_Data1ByteType, direction=OUT
      operation ConditionCheckRead: possible-error=DataServices_DcmDspData_ExtendedEnergySavingState/E_NOT_OK
        arg ErrorCode: type=Dcm_NegativeResponseCodeType, direction=OUT
      error E_NOT_OK: error-code=1
    DataServices_DcmDspData_SvkBackup61
      operation ReadData: possible-error=[DataServices_DcmDspData_SvkBackup61/E_NOT_OK, DataServices_DcmDspData_SvkBackup61/DCM_E_PENDING]
        arg OpStatus: type=Dcm_OpStatusType, direction=IN
        arg Data: type=Dcm_Data49ByteType, direction=OUT
      operation ConditionCheckRead: possible-error=[DataServices_DcmDspData_SvkBackup61/E_NOT_OK, DataServices_DcmDspData_SvkBackup61/DCM_E_PENDING]
        arg OpStatus: type=Dcm_OpStatusType, direction=IN
        arg ErrorCode: type=Dcm_NegativeResponseCodeType, direction=OUT
      error E_NOT_OK: error-code=1
      error DCM_E_PENDING: error-code=10
    DataServices_DcmDspData_PiaProfile0
      4 x operation, all with possible-error=[DataServices_DcmDspData_PiaProfile0/E_NOT_OK, DataServices_DcmDspData_PiaProfile0/DCM_E_PENDING]:
        ReadData
          arg OpStatus: type=Dcm_OpStatusType, direction=IN
          arg Data: type=Dcm_Data28ByteType, direction=OUT
        ReadDataLength
          arg OpStatus: type=Dcm_OpStatusType, direction=IN
          arg DataLength: type=uint16, direction=OUT
        ConditionCheckRead
          arg OpStatus: type=Dcm_OpStatusType, direction=IN
          arg ErrorCode: type=Dcm_NegativeResponseCodeType, direction=OUT
        WriteData
          4 x arg:
            Data: type=Dcm_Data28ByteType, direction=IN
            DataLength: type=uint16, direction=IN
            OpStatus: type=Dcm_OpStatusType, direction=IN
            ErrorCode: type=Dcm_NegativeResponseCodeType, direction=OUT
      error E_NOT_OK: error-code=1
      error DCM_E_PENDING: error-code=10
    DataServices_DcmDspData_SvkBackup60
      operation ReadData: possible-error=[DataServices_DcmDspData_SvkBackup60/E_NOT_OK, DataServices_DcmDspData_SvkBackup60/DCM_E_PENDING]
        arg OpStatus: type=Dcm_OpStatusType, direction=IN
        arg Data: type=Dcm_Data49ByteType, direction=OUT
      operation ConditionCheckRead: possible-error=[DataServices_DcmDspData_SvkBackup60/E_NOT_OK, DataServices_DcmDspData_SvkBackup60/DCM_E_PENDING]
        arg OpStatus: type=Dcm_OpStatusType, direction=IN
        arg ErrorCode: type=Dcm_NegativeResponseCodeType, direction=OUT
      error E_NOT_OK: error-code=1
      error DCM_E_PENDING: error-code=10
    DataServices_DcmDspData_PiaProfile1
      4 x operation, all with possible-error=[DataServices_DcmDspData_PiaProfile1/E_NOT_OK, DataServices_DcmDspData_PiaProfile1/DCM_E_PENDING]:
        ReadData
          arg OpStatus: type=Dcm_OpStatusType, direction=IN
          arg Data: type=Dcm_Data28ByteType, direction=OUT
        ReadDataLength
          arg OpStatus: type=Dcm_OpStatusType, direction=IN
          arg DataLength: type=uint16, direction=OUT
        ConditionCheckRead
          arg OpStatus: type=Dcm_OpStatusType, direction=IN
          arg ErrorCode: type=Dcm_NegativeResponseCodeType, direction=OUT
        WriteData
          4 x arg:
            Data: type=Dcm_Data28ByteType, direction=IN
            DataLength: type=uint16, direction=IN
            OpStatus: type=Dcm_OpStatusType, direction=IN
            ErrorCode: type=Dcm_NegativeResponseCodeType, direction=OUT
      error E_NOT_OK: error-code=1
      error DCM_E_PENDING: error-code=10
    DataServices_DcmDspData_PiaProfile2
      4 x operation, all with possible-error=[DataServices_DcmDspData_PiaProfile2/E_NOT_OK, DataServices_DcmDspData_PiaProfile2/DCM_E_PENDING]:
        ReadData
          arg OpStatus: type=Dcm_OpStatusType, direction=IN
          arg Data: type=Dcm_Data28ByteType, direction=OUT
        ReadDataLength
          arg OpStatus: type=Dcm_OpStatusType, direction=IN
          arg DataLength: type=uint16, direction=OUT
        ConditionCheckRead
          arg OpStatus: type=Dcm_OpStatusType, direction=IN
          arg ErrorCode: type=Dcm_NegativeResponseCodeType, direction=OUT
        WriteData
          4 x arg:
            Data: type=Dcm_Data28ByteType, direction=IN
            DataLength: type=uint16, direction=IN
            OpStatus: type=Dcm_OpStatusType, direction=IN
            ErrorCode: type=Dcm_NegativeResponseCodeType, direction=OUT
      error E_NOT_OK: error-code=1
      error DCM_E_PENDING: error-code=10
    DataServices_DcmDspData_SvkSysSupplier
      operation ReadData: possible-error=[DataServices_DcmDspData_SvkSysSupplier/E_NOT_OK, DataServices_DcmDspData_SvkSysSupplier/DCM_E_PENDING]
        arg OpStatus: type=Dcm_OpStatusType, direction=IN
        arg Data: type=Dcm_Data49ByteType, direction=OUT
      operation ConditionCheckRead: possible-error=[DataServices_DcmDspData_SvkSysSupplier/E_NOT_OK, DataServices_DcmDspData_SvkSysSupplier/DCM_E_PENDING]
        arg OpStatus: type=Dcm_OpStatusType, direction=IN
        arg ErrorCode: type=Dcm_NegativeResponseCodeType, direction=OUT
      error E_NOT_OK: error-code=1
      error DCM_E_PENDING: error-code=10
    DataServices_DcmDspData_PiaProfileA
      4 x operation, all with possible-error=[DataServices_DcmDspData_PiaProfileA/E_NOT_OK, DataServices_DcmDspData_PiaProfileA/DCM_E_PENDING]:
        ReadData
          arg OpStatus: type=Dcm_OpStatusType, direction=IN
          arg Data: type=Dcm_Data28ByteType, direction=OUT
        ReadDataLength
          arg OpStatus: type=Dcm_OpStatusType, direction=IN
          arg DataLength: type=uint16, direction=OUT
        ConditionCheckRead
          arg OpStatus: type=Dcm_OpStatusType, direction=IN
          arg ErrorCode: type=Dcm_NegativeResponseCodeType, direction=OUT
        WriteData
          4 x arg:
            Data: type=Dcm_Data28ByteType, direction=IN
            DataLength: type=uint16, direction=IN
            OpStatus: type=Dcm_OpStatusType, direction=IN
            ErrorCode: type=Dcm_NegativeResponseCodeType, direction=OUT
      error E_NOT_OK: error-code=1
      error DCM_E_PENDING: error-code=10
    DataServices_DcmDspData_SvkBackup59
      operation ReadData: possible-error=[DataServices_DcmDspData_SvkBackup59/E_NOT_OK, DataServices_DcmDspData_SvkBackup59/DCM_E_PENDING]
        arg OpStatus: type=Dcm_OpStatusType, direction=IN
        arg Data: type=Dcm_Data49ByteType, direction=OUT
      operation ConditionCheckRead: possible-error=[DataServices_DcmDspData_SvkBackup59/E_NOT_OK, DataServices_DcmDspData_SvkBackup59/DCM_E_PENDING]
        arg OpStatus: type=Dcm_OpStatusType, direction=IN
        arg ErrorCode: type=Dcm_NegativeResponseCodeType, direction=OUT
      error E_NOT_OK: error-code=1
      error DCM_E_PENDING: error-code=10
    DataServices_DcmDspData_SvkBackup58
      operation ReadData: possible-error=[DataServices_DcmDspData_SvkBackup58/E_NOT_OK, DataServices_DcmDspData_SvkBackup58/DCM_E_PENDING]
        arg OpStatus: type=Dcm_OpStatusType, direction=IN
        arg Data: type=Dcm_Data49ByteType, direction=OUT
      operation ConditionCheckRead: possible-error=[DataServices_DcmDspData_SvkBackup58/E_NOT_OK, DataServices_DcmDspData_SvkBackup58/DCM_E_PENDING]
        arg OpStatus: type=Dcm_OpStatusType, direction=IN
        arg ErrorCode: type=Dcm_NegativeResponseCodeType, direction=OUT
      error E_NOT_OK: error-code=1
      error DCM_E_PENDING: error-code=10
    DataServices_DcmDspData_SvkBackup57
      operation ReadData: possible-error=[DataServices_DcmDspData_SvkBackup57/E_NOT_OK, DataServices_DcmDspData_SvkBackup57/DCM_E_PENDING]
        arg OpStatus: type=Dcm_OpStatusType, direction=IN
        arg Data: type=Dcm_Data49ByteType, direction=OUT
      operation ConditionCheckRead: possible-error=[DataServices_DcmDspData_SvkBackup57/E_NOT_OK, DataServices_DcmDspData_SvkBackup57/DCM_E_PENDING]
        arg OpStatus: type=Dcm_OpStatusType, direction=IN
        arg ErrorCode: type=Dcm_NegativeResponseCodeType, direction=OUT
      error E_NOT_OK: error-code=1
      error DCM_E_PENDING: error-code=10
    DataServices_DcmDspData_SvkBackup56
      operation ReadData: possible-error=[DataServices_DcmDspData_SvkBackup56/E_NOT_OK, DataServices_DcmDspData_SvkBackup56/DCM_E_PENDING]
        arg OpStatus: type=Dcm_OpStatusType, direction=IN
        arg Data: type=Dcm_Data49ByteType, direction=OUT
      operation ConditionCheckRead: possible-error=[DataServices_DcmDspData_SvkBackup56/E_NOT_OK, DataServices_DcmDspData_SvkBackup56/DCM_E_PENDING]
        arg OpStatus: type=Dcm_OpStatusType, direction=IN
        arg ErrorCode: type=Dcm_NegativeResponseCodeType, direction=OUT
      error E_NOT_OK: error-code=1
      error DCM_E_PENDING: error-code=10
    DataServices_DcmDspData_SvkBackup55
      operation ReadData: possible-error=[DataServices_DcmDspData_SvkBackup55/E_NOT_OK, DataServices_DcmDspData_SvkBackup55/DCM_E_PENDING]
        arg OpStatus: type=Dcm_OpStatusType, direction=IN
        arg Data: type=Dcm_Data49ByteType, direction=OUT
      operation ConditionCheckRead: possible-error=[DataServices_DcmDspData_SvkBackup55/E_NOT_OK, DataServices_DcmDspData_SvkBackup55/DCM_E_PENDING]
        arg OpStatus: type=Dcm_OpStatusType, direction=IN
        arg ErrorCode: type=Dcm_NegativeResponseCodeType, direction=OUT
      error E_NOT_OK: error-code=1
      error DCM_E_PENDING: error-code=10
    DataServices_DcmDspData_SvkBackup54
      operation ReadData: possible-error=[DataServices_DcmDspData_SvkBackup54/E_NOT_OK, DataServices_DcmDspData_SvkBackup54/DCM_E_PENDING]
        arg OpStatus: type=Dcm_OpStatusType, direction=IN
        arg Data: type=Dcm_Data49ByteType, direction=OUT
      operation ConditionCheckRead: possible-error=[DataServices_DcmDspData_SvkBackup54/E_NOT_OK, DataServices_DcmDspData_SvkBackup54/DCM_E_PENDING]
        arg OpStatus: type=Dcm_OpStatusType, direction=IN
        arg ErrorCode: type=Dcm_NegativeResponseCodeType, direction=OUT
      error E_NOT_OK: error-code=1
      error DCM_E_PENDING: error-code=10
    DataServices_DcmDspData_SvkBackup53
      operation ReadData: possible-error=[DataServices_DcmDspData_SvkBackup53/E_NOT_OK, DataServices_DcmDspData_SvkBackup53/DCM_E_PENDING]
        arg OpStatus: type=Dcm_OpStatusType, direction=IN
        arg Data: type=Dcm_Data49ByteType, direction=OUT
      operation ConditionCheckRead: possible-error=[DataServices_DcmDspData_SvkBackup53/E_NOT_OK, DataServices_DcmDspData_SvkBackup53/DCM_E_PENDING]
        arg OpStatus: type=Dcm_OpStatusType, direction=IN
        arg ErrorCode: type=Dcm_NegativeResponseCodeType, direction=OUT
      error E_NOT_OK: error-code=1
      error DCM_E_PENDING: error-code=10
    DataServices_DcmDspData_SvkBackup52
      operation ReadData: possible-error=[DataServices_DcmDspData_SvkBackup52/E_NOT_OK, DataServices_DcmDspData_SvkBackup52/DCM_E_PENDING]
        arg OpStatus: type=Dcm_OpStatusType, direction=IN
        arg Data: type=Dcm_Data49ByteType, direction=OUT
      operation ConditionCheckRead: possible-error=[DataServices_DcmDspData_SvkBackup52/E_NOT_OK, DataServices_DcmDspData_SvkBackup52/DCM_E_PENDING]
        arg OpStatus: type=Dcm_OpStatusType, direction=IN
        arg ErrorCode: type=Dcm_NegativeResponseCodeType, direction=OUT
      error E_NOT_OK: error-code=1
      error DCM_E_PENDING: error-code=10
    DataServices_DcmDspData_SvkBackup51
      operation ReadData: possible-error=[DataServices_DcmDspData_SvkBackup51/E_NOT_OK, DataServices_DcmDspData_SvkBackup51/DCM_E_PENDING]
        arg OpStatus: type=Dcm_OpStatusType, direction=IN
        arg Data: type=Dcm_Data49ByteType, direction=OUT
      operation ConditionCheckRead: possible-error=[DataServices_DcmDspData_SvkBackup51/E_NOT_OK, DataServices_DcmDspData_SvkBackup51/DCM_E_PENDING]
        arg OpStatus: type=Dcm_OpStatusType, direction=IN
        arg ErrorCode: type=Dcm_NegativeResponseCodeType, direction=OUT
      error E_NOT_OK: error-code=1
      error DCM_E_PENDING: error-code=10
    DataServices_DcmDspData_SvkBackup50
      operation ReadData: possible-error=[DataServices_DcmDspData_SvkBackup50/E_NOT_OK, DataServices_DcmDspData_SvkBackup50/DCM_E_PENDING]
        arg OpStatus: type=Dcm_OpStatusType, direction=IN
        arg Data: type=Dcm_Data49ByteType, direction=OUT
      operation ConditionCheckRead: possible-error=[DataServices_DcmDspData_SvkBackup50/E_NOT_OK, DataServices_DcmDspData_SvkBackup50/DCM_E_PENDING]
        arg OpStatus: type=Dcm_OpStatusType, direction=IN
        arg ErrorCode: type=Dcm_NegativeResponseCodeType, direction=OUT
      error E_NOT_OK: error-code=1
      error DCM_E_PENDING: error-code=10
    DataServices_DcmDspData_ProgrammingCounter
      operation ReadData: possible-error=DataServices_DcmDspData_ProgrammingCounter/E_NOT_OK
        arg Data: type=Dcm_Data4ByteType, direction=OUT
      error E_NOT_OK: error-code=1
    DataServices_DcmDspData_Systemzeit
      operation ReadData: possible-error=DataServices_DcmDspData_Systemzeit/E_NOT_OK
        arg Data: type=Dcm_Data4ByteType, direction=OUT
      error E_NOT_OK: error-code=1
    DataServices_DcmDspData_SvkBackup49
      operation ReadData: possible-error=[DataServices_DcmDspData_SvkBackup49/E_NOT_OK, DataServices_DcmDspData_SvkBackup49/DCM_E_PENDING]
        arg OpStatus: type=Dcm_OpStatusType, direction=IN
        arg Data: type=Dcm_Data49ByteType, direction=OUT
      operation ConditionCheckRead: possible-error=[DataServices_DcmDspData_SvkBackup49/E_NOT_OK, DataServices_DcmDspData_SvkBackup49/DCM_E_PENDING]
        arg OpStatus: type=Dcm_OpStatusType, direction=IN
        arg ErrorCode: type=Dcm_NegativeResponseCodeType, direction=OUT
      error E_NOT_OK: error-code=1
      error DCM_E_PENDING: error-code=10
    DataServices_DcmDspData_SvkBackup48
      operation ReadData: possible-error=[DataServices_DcmDspData_SvkBackup48/E_NOT_OK, DataServices_DcmDspData_SvkBackup48/DCM_E_PENDING]
        arg OpStatus: type=Dcm_OpStatusType, direction=IN
        arg Data: type=Dcm_Data49ByteType, direction=OUT
      operation ConditionCheckRead: possible-error=[DataServices_DcmDspData_SvkBackup48/E_NOT_OK, DataServices_DcmDspData_SvkBackup48/DCM_E_PENDING]
        arg OpStatus: type=Dcm_OpStatusType, direction=IN
        arg ErrorCode: type=Dcm_NegativeResponseCodeType, direction=OUT
      error E_NOT_OK: error-code=1
      error DCM_E_PENDING: error-code=10
    DataServices_DcmDspData_SvkBackup47
      operation ReadData: possible-error=[DataServices_DcmDspData_SvkBackup47/E_NOT_OK, DataServices_DcmDspData_SvkBackup47/DCM_E_PENDING]
        arg OpStatus: type=Dcm_OpStatusType, direction=IN
        arg Data: type=Dcm_Data49ByteType, direction=OUT
      operation ConditionCheckRead: possible-error=[DataServices_DcmDspData_SvkBackup47/E_NOT_OK, DataServices_DcmDspData_SvkBackup47/DCM_E_PENDING]
        arg OpStatus: type=Dcm_OpStatusType, direction=IN
        arg ErrorCode: type=Dcm_NegativeResponseCodeType, direction=OUT
      error E_NOT_OK: error-code=1
      error DCM_E_PENDING: error-code=10
    DataServices_DcmDspData_SvkBackup46
      operation ReadData: possible-error=[DataServices_DcmDspData_SvkBackup46/E_NOT_OK, DataServices_DcmDspData_SvkBackup46/DCM_E_PENDING]
        arg OpStatus: type=Dcm_OpStatusType, direction=IN
        arg Data: type=Dcm_Data49ByteType, direction=OUT
      operation ConditionCheckRead: possible-error=[DataServices_DcmDspData_SvkBackup46/E_NOT_OK, DataServices_DcmDspData_SvkBackup46/DCM_E_PENDING]
        arg OpStatus: type=Dcm_OpStatusType, direction=IN
        arg ErrorCode: type=Dcm_NegativeResponseCodeType, direction=OUT
      error E_NOT_OK: error-code=1
      error DCM_E_PENDING: error-code=10
    DataServices_DcmDspData_SvkBackup45
      operation ReadData: possible-error=[DataServices_DcmDspData_SvkBackup45/E_NOT_OK, DataServices_DcmDspData_SvkBackup45/DCM_E_PENDING]
        arg OpStatus: type=Dcm_OpStatusType, direction=IN
        arg Data: type=Dcm_Data49ByteType, direction=OUT
      operation ConditionCheckRead: possible-error=[DataServices_DcmDspData_SvkBackup45/E_NOT_OK, DataServices_DcmDspData_SvkBackup45/DCM_E_PENDING]
        arg OpStatus: type=Dcm_OpStatusType, direction=IN
        arg ErrorCode: type=Dcm_NegativeResponseCodeType, direction=OUT
      error E_NOT_OK: error-code=1
      error DCM_E_PENDING: error-code=10
    DataServices_DcmDspData_SvkBackup44
      operation ReadData: possible-error=[DataServices_DcmDspData_SvkBackup44/E_NOT_OK, DataServices_DcmDspData_SvkBackup44/DCM_E_PENDING]
        arg OpStatus: type=Dcm_OpStatusType, direction=IN
        arg Data: type=Dcm_Data49ByteType, direction=OUT
      operation ConditionCheckRead: possible-error=[DataServices_DcmDspData_SvkBackup44/E_NOT_OK, DataServices_DcmDspData_SvkBackup44/DCM_E_PENDING]
        arg OpStatus: type=Dcm_OpStatusType, direction=IN
        arg ErrorCode: type=Dcm_NegativeResponseCodeType, direction=OUT
      error E_NOT_OK: error-code=1
      error DCM_E_PENDING: error-code=10
    DataServices_DcmDspData_SvkBackup43
      operation ReadData: possible-error=[DataServices_DcmDspData_SvkBackup43/E_NOT_OK, DataServices_DcmDspData_SvkBackup43/DCM_E_PENDING]
        arg OpStatus: type=Dcm_OpStatusType, direction=IN
        arg Data: type=Dcm_Data49ByteType, direction=OUT
      operation ConditionCheckRead: possible-error=[DataServices_DcmDspData_SvkBackup43/E_NOT_OK, DataServices_DcmDspData_SvkBackup43/DCM_E_PENDING]
        arg OpStatus: type=Dcm_OpStatusType, direction=IN
        arg ErrorCode: type=Dcm_NegativeResponseCodeType, direction=OUT
      error E_NOT_OK: error-code=1
      error DCM_E_PENDING: error-code=10
    DataServices_DcmDspData_SvkBackup42
      operation ReadData: possible-error=[DataServices_DcmDspData_SvkBackup42/E_NOT_OK, DataServices_DcmDspData_SvkBackup42/DCM_E_PENDING]
        arg OpStatus: type=Dcm_OpStatusType, direction=IN
        arg Data: type=Dcm_Data49ByteType, direction=OUT
      operation ConditionCheckRead: possible-error=[DataServices_DcmDspData_SvkBackup42/E_NOT_OK, DataServices_DcmDspData_SvkBackup42/DCM_E_PENDING]
        arg OpStatus: type=Dcm_OpStatusType, direction=IN
        arg ErrorCode: type=Dcm_NegativeResponseCodeType, direction=OUT
      error E_NOT_OK: error-code=1
      error DCM_E_PENDING: error-code=10
    DataServices_DcmDspData_SvkBackup41
      operation ReadData: possible-error=[DataServices_DcmDspData_SvkBackup41/E_NOT_OK, DataServices_DcmDspData_SvkBackup41/DCM_E_PENDING]
        arg OpStatus: type=Dcm_OpStatusType, direction=IN
        arg Data: type=Dcm_Data49ByteType, direction=OUT
      operation ConditionCheckRead: possible-error=[DataServices_DcmDspData_SvkBackup41/E_NOT_OK, DataServices_DcmDspData_SvkBackup41/DCM_E_PENDING]
        arg OpStatus: type=Dcm_OpStatusType, direction=IN
        arg ErrorCode: type=Dcm_NegativeResponseCodeType, direction=OUT
      error E_NOT_OK: error-code=1
      error DCM_E_PENDING: error-code=10
    DataServices_DcmDspData_SvkBackup40
      operation ReadData: possible-error=[DataServices_DcmDspData_SvkBackup40/E_NOT_OK, DataServices_DcmDspData_SvkBackup40/DCM_E_PENDING]
        arg OpStatus: type=Dcm_OpStatusType, direction=IN
        arg Data: type=Dcm_Data49ByteType, direction=OUT
      operation ConditionCheckRead: possible-error=[DataServices_DcmDspData_SvkBackup40/E_NOT_OK, DataServices_DcmDspData_SvkBackup40/DCM_E_PENDING]
        arg OpStatus: type=Dcm_OpStatusType, direction=IN
        arg ErrorCode: type=Dcm_NegativeResponseCodeType, direction=OUT
      error E_NOT_OK: error-code=1
      error DCM_E_PENDING: error-code=10
    DataServices_DIDRange_DcmDspDidRange_Coding
      operation ReadDidData: possible-error=[DataServices_DIDRange_DcmDspDidRange_Coding/E_NOT_OK, DataServices_DIDRange_DcmDspDidRange_Coding/DCM_E_PENDING]
        5 x arg:
          DID: type=uint16, direction=IN
          Data: type=Dcm_Data250ByteType, direction=OUT
          OpStatus: type=Dcm_OpStatusType, direction=IN
          DataLength: type=uint16, direction=OUT
          ErrorCode: type=Dcm_NegativeResponseCodeType, direction=OUT
      operation WriteDidData: possible-error=[DataServices_DIDRange_DcmDspDidRange_Coding/E_NOT_OK, DataServices_DIDRange_DcmDspDidRange_Coding/DCM_E_PENDING]
        5 x arg:
          DID: type=uint16, direction=IN
          Data: type=Dcm_Data250ByteType, direction=IN
          OpStatus: type=Dcm_OpStatusType, direction=IN
          DataLength: type=uint16, direction=IN
          ErrorCode: type=Dcm_NegativeResponseCodeType, direction=OUT
      operation IsDidAvailable: possible-error=[DataServices_DIDRange_DcmDspDidRange_Coding/E_NOT_OK, DataServices_DIDRange_DcmDspDidRange_Coding/DCM_E_PENDING]
        arg DID: type=uint16, direction=IN
        arg OpStatus: type=Dcm_OpStatusType, direction=IN
        arg supported: type=Dcm_DidSupportedType, direction=OUT
      error E_NOT_OK: error-code=1
      error DCM_E_PENDING: error-code=10
    DataServices_Data_DcmDspDid_SensorLesen_1
      operation ReadData: possible-error=[DataServices_Data_DcmDspDid_SensorLesen_1/E_NOT_OK, DataServices_Data_DcmDspDid_SensorLesen_1/DCM_E_PENDING]
        arg OpStatus: type=Dcm_OpStatusType, direction=IN
        arg Data: type=Dcm_Data8ByteType, direction=OUT
      operation ConditionCheckRead: possible-error=[DataServices_Data_DcmDspDid_SensorLesen_1/E_NOT_OK, DataServices_Data_DcmDspDid_SensorLesen_1/DCM_E_PENDING]
        arg OpStatus: type=Dcm_OpStatusType, direction=IN
        arg ErrorCode: type=Dcm_NegativeResponseCodeType, direction=OUT
      error E_NOT_OK: error-code=1
      error DCM_E_PENDING: error-code=10
    DataServices_Data_DcmDspDid_SensorLesen_2
      operation ReadData: possible-error=[DataServices_Data_DcmDspDid_SensorLesen_2/E_NOT_OK, DataServices_Data_DcmDspDid_SensorLesen_2/DCM_E_PENDING]
        arg OpStatus: type=Dcm_OpStatusType, direction=IN
        arg Data: type=Dcm_Data8ByteType, direction=OUT
      operation ConditionCheckRead: possible-error=[DataServices_Data_DcmDspDid_SensorLesen_2/E_NOT_OK, DataServices_Data_DcmDspDid_SensorLesen_2/DCM_E_PENDING]
        arg OpStatus: type=Dcm_OpStatusType, direction=IN
        arg ErrorCode: type=Dcm_NegativeResponseCodeType, direction=OUT
      error E_NOT_OK: error-code=1
      error DCM_E_PENDING: error-code=10
    DataServices_Data_DcmDspDid_SensorLesen_3
      operation ReadData: possible-error=[DataServices_Data_DcmDspDid_SensorLesen_3/E_NOT_OK, DataServices_Data_DcmDspDid_SensorLesen_3/DCM_E_PENDING]
        arg OpStatus: type=Dcm_OpStatusType, direction=IN
        arg Data: type=Dcm_Data8ByteType, direction=OUT
      operation ConditionCheckRead: possible-error=[DataServices_Data_DcmDspDid_SensorLesen_3/E_NOT_OK, DataServices_Data_DcmDspDid_SensorLesen_3/DCM_E_PENDING]
        arg OpStatus: type=Dcm_OpStatusType, direction=IN
        arg ErrorCode: type=Dcm_NegativeResponseCodeType, direction=OUT
      error E_NOT_OK: error-code=1
      error DCM_E_PENDING: error-code=10
