AUTOSAR XML (schema 4-3-0)
package /COM/VECTOR/CFG/WORKFLOW/SYSDESC/SYNC
  flat map FLATMAP
    flat instance descriptor BMW_Application_Connector_Dummy: upstream-reference=SystemComponentPrototype.OEM_Extension_BMW.BMW_Application_Connector_Dummy, ecu-extract-reference=COMPOSITIONTYPE.BMW_Application_Connector_Dummy
    flat instance descriptor BMW_Application_Main: upstream-reference=SystemComponentPrototype.OEM_Extension_BMW.BMW_Application_Main, ecu-extract-reference=COMPOSITIONTYPE.BMW_Application_Main
