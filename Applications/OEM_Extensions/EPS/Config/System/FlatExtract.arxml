AUTOSAR XML (schema 4-3-0)
package /COM/VECTOR/CFG/WORKFLOW/SYSDESC/SYNC
  system SYSTEM: category=ECU_EXTRACT
    system mapping MAPPINGS
    root-software-compositions:
      root sw composition prototype COMPOSITIONTYPE: flat-map=FLATMAP, software-composition=COMPOSITIONTYPE
  composition sw component type COMPOSITIONTYPE  # UB:Derived from original system description
    21 x component:
      BswM: type=BswM
      ComM: type=ComM
      Det: type=Det
      EcuM: type=EcuM
      NvM: type=NvM
      Os_OsCore_CORE0_swc: type=Os_OsCore_CORE0_swc
      Dcm: type=Dcm
      WdgM_OsApplication_ASIL: type=WdgM_OsApplication_ASIL
      Bs: type=Bs
      Darh: type=Darh
      Dlog: type=Dlog
      IntegrationSample: type=IntegrationSample
      Omc: type=Omc
      StdDiag: type=StdDiag
      SysTime: type=SysTime
      DemMaster_0: type=DemMaster_0
      DemSatellite_0: type=DemSatellite_0
      DemWrapper: type=DemWrapper
      BMW_Application_Connector_Dummy: type=BMW_Application_Connector_Dummy
      BMW_Application_Main: type=BMW_Application_Main
      Stm: type=Stm
    connect Bs.LifeCycle -> BswM.Notification_SWC_ModeNotification_Lifecycle_Bs
    connect Darh.LifeCycle -> BswM.Notification_SWCModeSwitch_Lifecycle_Darh
    connect Darh.RoeStatePort -> StdDiag.RoeStatePort
    connect Det.DetServicePort_Darh -> Darh.DetPort
    connect NvM.PS_NVM_BLOCK_DARH_DiagnoseMasterEnable -> Darh.DiagnoseMasterStatus
    connect Darh.DmClientTriggerDtcEntry -> Dcm.RoutineServices_DcmDspRoutine_DmClientTriggerDtcEntry
    connect Darh.DmIsDtcActiveResponse -> Dcm.DataServices_DcmDspData_DmIsDtcActiveResponse
    connect NvM.PS_NvM_BLOCK_DARH -> Darh.ErrorQueueBlock
    connect BswM.Provide_MSRP_Darh -> Darh.LifeCycleRequest
    connect Darh.NvMNotifyJobFinished -> NvM.NvM_RpNotifyJobEnd_NVM_BLOCK_DARH_DiagnoseMasterEnable
    connect BswM.Switch_SwitchPort_Darh_ReportErrorMode -> Darh.ReportErrorMode
    connect Dlog.LifeCycle -> BswM.Notification_SWCModeSwitch_Lifecycle_Dlog
    connect Dlog.DevelopmentInfoField -> Dcm.RoutineServices_DcmDspRoutine_RcRswedi
    connect Dlog.EcuSerialNumber -> Dcm.DataServices_DcmDspData_EcuSerialNumber
    connect Dlog.FlashTimingParameter -> Dcm.DataServices_DcmDspData_FlashTimingParameter
    connect Dlog.InitBlockProgData -> NvM.NvM_RpNotifyInit_NVM_BLOCK_BOOT_PROG_DATA
    connect BswM.Provide_MSRP_Dlog -> Dlog.LifeCycleRequest
    connect Dlog.ManufacturingDate -> Dcm.DataServices_DcmDspData_Herstelldatum
    connect NvM.PAdmin_NVM_BLOCK_BOOT_PROG_DATA -> Dlog.NvMAdmin_DlogProgData
    connect Dlog.NvMNotifyJobFinished_DlogProgData -> NvM.NvM_RpNotifyJobEnd_NVM_BLOCK_BOOT_PROG_DATA
    connect NvM.PS_NVM_BLOCK_BOOT_SVK_HISTORY -> Dlog.NvMService_DlogSvkHistory
    connect Dlog.SvkBackup{01..03} -> Dcm.DataServices_DcmDspData_SvkBackup{01..03}
    connect Dlog.SvkCurrent -> Dcm.DataServices_DcmDspData_SvkAktuell
    connect Dlog.SvkPlant -> Dcm.DataServices_DcmDspData_SvkWerk
    connect Dlog.SvkSysSupplier -> Dcm.DataServices_DcmDspData_SvkSysSupplier
    connect NvM.PS_NVM_BLOCK_DLOG_SvkEntry -> Dlog.NvMService_DlogSvkEntry
    connect NvM.PS_NVM_BLOCK_BOOT_PROG_DATA -> Dlog.NvMService_DlogProgData
    connect Dlog.NvMNotifyJobFinished_SvkEntry -> NvM.NvM_RpNotifyJobEnd_NVM_BLOCK_DLOG_SvkEntry
    connect IntegrationSample.IntegrationSampleSimpleTimerPort_0 -> BswM.Notification_SWC_Mode_Notification_SimpleTimerMode
    connect IntegrationSample.EcuRunState -> BswM.Notification_SWCModeSwitch_IS_EcuRunState
    connect BswM.Provide_MSRP_IntegrationSample_EcuRunMode -> IntegrationSample.EcuRunStateRequest
    connect IntegrationSample.IntegrationSample_PP_ServiceRequestManufacturerNotificationPort -> Dcm.ServiceRequestManufacturerNotification_IntegrationSample
    connect IntegrationSample.PP_ReadData_DemDataElementClass_KILOMETER -> DemMaster_0.CBReadData_DemDataElementClass_KmStand
    connect Omc.extendedOperatingModeSwitchPort -> StdDiag.ExtendedOperatingModeControlPort
    connect Omc.LifeCycle -> BswM.Notification_SWCModeSwitch_Lifecycle_Omc
    connect Omc.operatingModeSwitchPort -> StdDiag.OperatingModeControlPort
    connect StdDiag.AllowOpModeChangePort -> Omc.StdDiag
    connect StdDiag.LifeCycle -> BswM.Notification_SWCModeSwitch_Lifecycle_StdDiag
    connect SysTime.LifeCycle -> BswM.Notification_SWCModeSwitch_Lifecycle_Systime
    connect BswM.Provide_MSRP_Systime -> SysTime.LifeCycleRequest
    connect SysTime.SystemTime -> Dcm.DataServices_DcmDspData_Systemzeit
    connect Det.DetServicePort_SysTime -> SysTime.SysTimeReportError
    connect DemSatellite_0.Event_DmTestAppl -> Darh.DmTestAppl
    connect DemSatellite_0.Event_DmTestCom -> Darh.DmTestCom
    connect Darh.EventDataChangedPort -> DemMaster_0.GeneralCBDataEvt
    connect BswM.Switch_ESH_ModeSwitch -> BswM.Notification_ESH_ModeNotification
    connect BswM.Switch_SwitchPort_StdDiag_SessionChangeIndication -> StdDiag.SessionChangeIndicationPort
    connect BswM.Switch_SwitchPort_StdDiagComControlNormalNotificationPort -> StdDiag.ComControlNormalModeAccessPort
    connect StdDiag.ComControlModeRequestPort -> BswM.Request_SWCModeReq_StdDiag_CommunicationModeDeclarationGroup
    connect BswM.Provide_MSRP_Omc -> Omc.LifeCycleRequest
    connect BswM.Provide_MSRP_StdDiag -> StdDiag.LifeCycleRequest
    connect BswM.Provide_MRSP_Bs -> Bs.LifeCycleRequest
    connect Dcm.DcmCommunicationControl_ComMConf_ComMChannel_A_FlexRay_5b5a9ac2 -> BswM.Notification_SWCModeSwitch_DcmCommunicationControl_ComMConf_ComMChannel_BAC4_FlexRay_8e151c3c
    connect Dcm.DcmEcuReset -> BswM.Notification_BSWModeSwitch_DcmEcuReset
    connect Dcm.DcmDiagnosticSessionControl -> BswM.Notification_BSWModeSwitch_DcmDiagnosticSessionControl
    connect Omc.EnergySavingState -> Dcm.DataServices_DcmDspData_EnergySavingState
    connect StdDiag.CheckProgrammingPreconditions -> Dcm.RoutineServices_DcmDspRoutine_RcCppc
    connect StdDiag.ClearSecondaryErrorMemory -> Dcm.RoutineServices_DcmDspRoutine_IsLoeschen
    connect Dcm.DCMServices -> StdDiag.DCMServicesPort
    connect StdDiag.DiagCommLoopback -> Dcm.RoutineServices_DcmDspRoutine_DiagCommLoopback
    connect DemMaster_0.EnableCond_DemEnableCondition_StdDiag -> StdDiag.EnableConditionPort
    connect Det.DetServicePort_StdDiag -> StdDiag.ReportErrorPort
    connect StdDiag.ServiceRequestManufacturerNotificationPort -> Dcm.ServiceRequestManufacturerNotification_StdDiag
    connect StdDiag.SgbdIndex -> Dcm.DataServices_DcmDspData_SgbdIdx
    connect DemWrapper.DemWrapper_ApplicationDTCInfoPort -> Darh.ApplicationDTCInfoPort
    connect DemWrapper.DemWrapper_NetworkDTCInfoPort -> Darh.NetworkDTCInfoPort
    connect Dlog.EcuUid -> Bs.Dlog_EcuUid
    connect Dlog.HWModificationIndex -> Dcm.DataServices_DcmDspData_Readhwmodificationindex
    connect Dlog.Vin -> Dcm.DataServices_DcmDspData_Vin
    connect Omc.ClearEventAllowedPort -> DemMaster_0.CBClrEvt_VsmEventOpmode
    connect Omc.ControlEnergySavingState -> Dcm.RoutineServices_DcmDspRoutine_Energiesparmode
    connect Omc.ControlExtendedEnergySavingState -> Dcm.RoutineServices_DcmDspRoutine_ControlExtendedEnergySavingState
    connect Det.DetServicePort_Omc -> Omc.DETServicePort
    connect DemMaster_0.EnableCond_DemEnableCondition_Omc -> Omc.EnableCond_OMC
    connect Omc.ExtendedEnergySavingState -> Dcm.DataServices_DcmDspData_ExtendedEnergySavingState
    connect NvM.PS_OmcDependencyNVMData -> Omc.NvMServicePort
    connect DemSatellite_0.Event_VsmEventOpmode -> Omc.VsmEventOpmode
    connect Omc.NvMNotifyJobFinished -> NvM.NvM_RpNotifyJobEnd_OmcDependencyNVMData
    connect DemWrapper.DemWrapper_CddIf -> StdDiag.ClearDTCPort
    connect DemMaster_0.ClearDTC_DemClient_CDD -> DemWrapper.DemWrapper_ClearDTC
    connect DemWrapper.DemWrapper_Darh_GeneralDiagnosticInfo -> Darh.GeneralDiagnosticInfoPort
    connect DemSatellite_0.EvtInfo_DmTestAppl -> DemWrapper.DemWrapper_EvtInfo_DM_TEST_APPL
    connect DemSatellite_0.EvtInfo_DmTestCom -> DemWrapper.DemWrapper_EvtInfo_DM_TEST_COM
    connect DemMaster_0.GeneralEventInfo -> DemWrapper.DemWrapper_GeneralDiagnosticInfo
    connect StdDiag.ActiveSessionState -> Dcm.DataServices_DcmDspData_ReadActiveSessionState
    connect Dcm.DcmModeRapidPowerShutDown -> BMW_Application_Main.DcmModeRapidPowerShutDown
    connect BMW_Application_Connector_Dummy.CSDataServices_DemDataElementClass_FUwBn -> DemMaster_0.CBReadData_DemDataElementClass_FUwBn
    connect BMW_Application_Connector_Dummy.CSDataServices_DemDataElementClass_FUwTn -> DemMaster_0.CBReadData_DemDataElementClass_FUwTn
    connect BMW_Application_Connector_Dummy.DataServices_DcmDspData_MileKmEeprom -> Dcm.DataServices_DcmDspData_MileKmEeprom
    connect BMW_Application_Connector_Dummy.DataServices_DcmDspData_SensorenAnzahlLesen -> Dcm.DataServices_DcmDspData_SensorenAnzahlLesen
    connect BMW_Application_Connector_Dummy.DataServices_DcmDspData_SystemSupplierIdentifier -> Dcm.DataServices_DcmDspData_SystemSupplierIdentifier
    connect NvM.PS_TestStampDefaults -> BMW_Application_Main.NvMService_AC3_SRBS
    connect BMW_Application_Connector_Dummy.DataServices_DcmDspData_Sekundaererfehlerspeicher -> Dcm.DataServices_DcmDspData_Sekundaererfehlerspeicher
    connect BMW_Application_Connector_Dummy.DataServices_Data_DcmDspDid_SensorLesen_3 -> Dcm.DataServices_Data_DcmDspDid_SensorLesen_3
    connect BMW_Application_Connector_Dummy.DataServices_Data_DcmDspDid_SensorLesen_2 -> Dcm.DataServices_Data_DcmDspDid_SensorLesen_2
    connect BMW_Application_Connector_Dummy.DataServices_Data_DcmDspDid_SensorLesen_1 -> Dcm.DataServices_Data_DcmDspDid_SensorLesen_1
    connect Stm.CentralErrorLockModeSwitchPort -> BswM.Notification_SWCModeSwitch_currentCentralErrorLockMode
    connect IntegrationSample.PP_Stm_CEL_Signal -> Stm.CentralErrorLockRx
    connect Stm.VehicleStateModeSwitchPort -> StdDiag.VehicleStatePort
    connect IntegrationSample.PP_IS_ST_CON_VEH -> Stm.VehicleStateRx
  end to end protection set E2EPROTECTIONSET
  port interface mapping set PORTINTERFACEMAPPINGSET
