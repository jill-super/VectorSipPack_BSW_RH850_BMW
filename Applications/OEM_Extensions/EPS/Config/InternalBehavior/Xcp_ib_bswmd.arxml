AUTOSAR XML (schema 4-3-0)
package /MICROSAR/Xcp_ib_bswmd/BswModuleDescriptions
  bsw module description Xcp: provided-entrys=[Xcp_MainFunction, FrXcp_MainFunctionRx, FrXcp_MainFunctionTx]
    bsw internal behavior XcpBehavior
      8 x exclusive area:
        XCP_EXCLUSIVE_AREA_{0..2}
        CANXCP_EXCLUSIVE_AREA_0
        FRXCP_EXCLUSIVE_AREA_{0..2}
        TCPIPXCP_EXCLUSIVE_AREA_0
      bsw schedulable entity Xcp_MainFunction: implemented-entry=Xcp_MainFunction
      bsw schedulable entity FrXcp_MainFunctionRx: implemented-entry=FrXcp_MainFunctionRx
      bsw schedulable entity FrXcp_MainFunctionTx: implemented-entry=FrXcp_MainFunctionTx
      bsw timing event Xcp_MainFunctionTimingEvent0: starts-on-event=Xcp_MainFunction, period=0.005
      bsw timing event FrXcp_MainFunctionRxTimingEvent0: starts-on-event=FrXcp_MainFunctionRx, period=0.005
      bsw timing event FrXcp_MainFunctionTxTimingEvent0: starts-on-event=FrXcp_MainFunctionTx, period=0.005
  bsw module entry Xcp_MainFunction: call-type=SCHEDULED, execution-context=TASK
  bsw module entry FrXcp_MainFunctionRx: call-type=SCHEDULED, execution-context=TASK
  bsw module entry FrXcp_MainFunctionTx: call-type=SCHEDULED, execution-context=TASK
