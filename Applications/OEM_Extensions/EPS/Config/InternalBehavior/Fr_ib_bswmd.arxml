AUTOSAR XML (schema 4-3-0)
package /MICROSAR/Fr_V85xEray
  bsw implementation Fr_Impl: programming-language=C, sw-version=4.01.00, used-code-generator=DaVinci Configurator, vendor-id=30, ar-release-version=4.00.03
package /MICROSAR/Fr_V85xEray_ib_bsmwd/BswModuleDescriptions
  bsw module description Fr
    bsw internal behavior Fr_V85xErayBehavior
      exclusive area FR_EXCLUSIVE_AREA_0
      exclusive area FR_EXCLUSIVE_AREA_1
