AUTOSAR XML (schema 4-3-0)
package /MICROSAR/Csm_ib_bswmd/BswModuleDescriptions
  bsw module description Csm: provided-entrys=Csm_MainFunction
    bsw internal behavior CsmBehavior
      exclusive area CSM_EXCLUSIVE_AREA_0  # This critical section protects queuing resources that can be accessed from various contexts. Therefore the critical section enclosed with CSM_EXCLUSIVE_AREA_0 should never be interrupted by any Csm API which accesses queuing resources. For more details, see DocTechRef.
      bsw schedulable entity Csm_MainFunction: implemented-entry=Csm_MainFunction
      bsw timing event Csm_MainFunctionTimingEvent0: starts-on-event=Csm_MainFunction, period=10
  bsw module entry Csm_MainFunction: call-type=SCHEDULED, execution-context=TASK
