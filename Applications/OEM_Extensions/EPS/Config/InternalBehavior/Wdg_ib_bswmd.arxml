AUTOSAR XML (schema 4-3-0)
package /Renesas/Wdg_59_DriverA_ib_bswmd/BswModuleDescriptions
  bsw module description Wdg
    bsw internal behavior Wdg_59_DriverABehavior
      exclusive area MODE_SWITCH_PROTECTION
      exclusive area TRIGG_PROTECTION
