AUTOSAR XML (schema 4-3-0)
package /Renesas/Mcu_ib_bswmd/BswModuleDescriptions
  bsw module description Mcu
    bsw internal behavior McuBehavior
      exclusive area MCU_REG_DATA_PROTECTION
      exclusive area MCU_REGISTER_PROTECTION
