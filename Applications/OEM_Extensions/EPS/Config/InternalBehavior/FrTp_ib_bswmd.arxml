AUTOSAR XML (schema 4-3-0)
package /MICROSAR
  bsw implementation FrTp_Impl: programming-language=C, sw-version=2.04.03, used-code-generator=cMSR, vendor-id=30, ar-release-version=4.00.03
package /MICROSAR/FrTp_ib_bswmd/BswModuleDescriptions
  bsw module description FrTp: provided-entrys=FrTp_MainFunction
    bsw internal behavior FrTpBehavior
      exclusive area FRTP_EXCLUSIVE_AREA_{0..2}
      bsw schedulable entity FrTp_MainFunction: implemented-entry=FrTp_MainFunction
      bsw timing event FrTp_MainFunctionTimingEvent0: starts-on-event=FrTp_MainFunction, period=0.005
  bsw module entry FrTp_MainFunction: call-type=SCHEDULED, execution-context=TASK
