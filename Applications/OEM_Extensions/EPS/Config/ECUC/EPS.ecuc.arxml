AUTOSAR XML (schema 4-3-0)
package /ActiveEcuC
  ecuc value collection ActiveEcuC: ecu-extract=SYSTEM
    ecuc-values:
      Com
      Rte
      Os
      Xcp
      FrSM
      FrIf
      ComM
      EcuC
      Fr
      IpduM
      Det
      PduR
      EcuM
      Fee
      MemIf
      NvM
      Fls
      Mcu
      Port
      Wdg
      Dcm
      Dem
      FrTp
      Crc
      WdgIf
      WdgM
      Darh
      Dlog
      Omc
      StdDiag
      SysTime
      DlogShared
      Crypto
      CryptoClassic
      DarhClassic
      DlogClassic
      IntegrationSample
      StdDiagClassic
      SysTimeClassic
      BswM
      BsClassic
      StmClassic
