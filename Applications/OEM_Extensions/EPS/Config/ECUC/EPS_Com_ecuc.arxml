AUTOSAR XML (schema 4-3-0)
package /ActiveEcuC
  module config Com: implementation-config-variant=VARIANT-PRE-COMPILE, module-description=Com_Impl
    ComGeneration:
      ComOutOfBoundsWriteProtectionStrategy = NONE
      ComOutOfBoundsWriteSanitizer = false
      ComOutOfBoundsReadSanitizer = false
      ComReduceConstantData2Define = false
      ComBoolDataInArrayOfStructStrategy = BOOLEAN
      ComDeduplicateIndirectedData = true
      ComDataDeduplicationStrategy = WITH_CAST
      ComReduceBoolDataByNegationThreshold = 2
      ComReduceBoolDataByNumericalComparisonThreshold = 2
      ComReduceBoolDataByNumericalRelationThreshold = 2
      ComReduceBoolDataByNumericalOperandStrategy = WITH_ANY_VALUE
      ComReduceNumericalDataByOffsetThreshold = 2
      ComReduceNumericalDataByArraySubtractionThreshold = 2
      ComReduceDataByStreaming = false
      ComShortSymbols = false
      ComInterfacesForDeactivatedData = false
      ComReferringKeysInComments = false
    ComOptimization:
      ComTxCyclicProcessingISRLockThreshold = 1
      ComTxDeadlineMonitoringISRLockThreshold = 1
      ComTxProcessingISRLockThreshold = 1
      ComRxDeadlineMonitoringISRLockThreshold = 1
      ComRxDeferredProcessingISRLockThreshold = 1
      ComGatewayProcessingISRLockThreshold = 1
      ComGatewayDescriptionProcessingISRLockThreshold = 1
      ComIPduGroupISRLockThreshold = 1
    ComConfig: ComConfigurationId=0, ComRxDeferredNotificationCacheSize=0, ComRxImmediateNotificationCacheSize=0
      ST_STAB_DSC_23008def (ComIPdu):
        ComIPduDirection = RECEIVE
        ComIPduType = NORMAL
        ComIPduHandleId = 21
        ComIPduSignalProcessing = DEFERRED
        ComIPduCancellationSupport = false
        ComIPduGroupRef = EPS_IN_PduGroup3_7933cc8b
        ComIPduSignalRef = sn_3e35ac63fc494d0fb399c763aeb7057b_24_e92786ce091d4130a2deaffa00e99dac_12_a08a0405
        ComPduIdRef = pduTr_ST_STAB_DSC_A_FlexRay_pduPort_EPS_A_FlexRay_IN_7d601c47_052bff33
      signalGrp_ST_DIAG_OBD_3_DRDY_grpMap_2d32eef5 (ComSignalGroup): ComSignalGroupAccess=ACCESS_NEEDED_BY_OTHER, ComHandleId=8, ComSystemTemplateSignalGroupRef=signalGrp_ST_DIAG_OBD_3_DRDY_grpMap
        11 x ComGroupSignal, all with ComSignalEndianness=LITTLE_ENDIAN, ComSignalType=UINT8, ComTransferProperty=TRIGGERED_ON_CHANGE, ComSignalInitValue=0, ComSignalAccess=ACCESS_NEEDED_BY_OTHER:
          sn_95dff1578f214757b23c8394af12aa48_4_e4264132e02e49db9ec8e2776b5fcdc1_3_0f13a3f0: ComBitPosition=16, ComBitSize=6, ComSignalDataInvalidValue=63, ComHandleId=54, ComSystemTemplateSystemSignalRef=sn_95dff1578f214757b23c8394af12aa48_4_e4264132e02e49db9ec8e2776b5fcdc1_3
          sn_95dff1578f214757b23c8394af12aa48_4_bc5db64191594d34b6307cf590b732aa_3_0f13a3f0: ComBitPosition=40, ComBitSize=6, ComSignalDataInvalidValue=63, ComHandleId=52, ComSystemTemplateSystemSignalRef=sn_95dff1578f214757b23c8394af12aa48_4_bc5db64191594d34b6307cf590b732aa_3
          sn_95dff1578f214757b23c8394af12aa48_4_e7a993bdb77e422285430840510dadf4_3_0f13a3f0: ComBitPosition=34, ComBitSize=6, ComSignalDataInvalidValue=63, ComHandleId=53, ComSystemTemplateSystemSignalRef=sn_95dff1578f214757b23c8394af12aa48_4_e7a993bdb77e422285430840510dadf4_3
          sn_95dff1578f214757b23c8394af12aa48_4_82ff67f6b9334982a57ad12edde7bc16_2_0f13a3f0: ComBitPosition=4, ComBitSize=6, ComSignalDataInvalidValue=63, ComHandleId=47, ComSystemTemplateSystemSignalRef=sn_95dff1578f214757b23c8394af12aa48_4_82ff67f6b9334982a57ad12edde7bc16_2
          sn_95dff1578f214757b23c8394af12aa48_4_a019edbda7904702959e9dc445570356_3_0f13a3f0: ComBitPosition=52, ComBitSize=6, ComSignalDataInvalidValue=63, ComHandleId=50, ComSystemTemplateSystemSignalRef=sn_95dff1578f214757b23c8394af12aa48_4_a019edbda7904702959e9dc445570356_3
          sn_95dff1578f214757b23c8394af12aa48_4_27f4ba17468e41e3b3968930b1409f81_3_0f13a3f0: ComBitPosition=58, ComBitSize=6, ComSignalDataInvalidValue=63, ComHandleId=46, ComSystemTemplateSystemSignalRef=sn_95dff1578f214757b23c8394af12aa48_4_27f4ba17468e41e3b3968930b1409f81_3
          sn_95dff1578f214757b23c8394af12aa48_4_e84002878a3d4f3a8c86fbd58c15f81a_3_0f13a3f0: ComBitPosition=28, ComBitSize=6, ComSignalDataInvalidValue=63, ComHandleId=55, ComSystemTemplateSystemSignalRef=sn_95dff1578f214757b23c8394af12aa48_4_e84002878a3d4f3a8c86fbd58c15f81a_3
          sn_95dff1578f214757b23c8394af12aa48_4_b829418ae8544fc7a495975b5e034ae1_1_0f13a3f0: ComBitPosition=0, ComBitSize=4, ComSignalDataInvalidValue=15, ComHandleId=51, ComSystemTemplateSystemSignalRef=sn_95dff1578f214757b23c8394af12aa48_4_b829418ae8544fc7a495975b5e034ae1_1
          sn_95dff1578f214757b23c8394af12aa48_4_3d6bee37a7644cd595111347b1ab806d_3_0f13a3f0: ComBitPosition=22, ComBitSize=6, ComSignalDataInvalidValue=63, ComHandleId=45, ComSystemTemplateSystemSignalRef=sn_95dff1578f214757b23c8394af12aa48_4_3d6bee37a7644cd595111347b1ab806d_3
          sn_95dff1578f214757b23c8394af12aa48_4_426c8a72d1bb4a46ad11235b0f09bdc6_3_0f13a3f0: ComBitPosition=46, ComBitSize=6, ComSignalDataInvalidValue=63, ComHandleId=48, ComSystemTemplateSystemSignalRef=sn_95dff1578f214757b23c8394af12aa48_4_426c8a72d1bb4a46ad11235b0f09bdc6_3
          sn_95dff1578f214757b23c8394af12aa48_4_7607fe5e22044ec8b524b790117d1144_2_0f13a3f0: ComBitPosition=10, ComBitSize=6, ComSignalDataInvalidValue=63, ComHandleId=49, ComSystemTemplateSystemSignalRef=sn_95dff1578f214757b23c8394af12aa48_4_7607fe5e22044ec8b524b790117d1144_2
      sn_085b67cff4b142a59fb46d892b9938f0_15_fdd79fd1376744b592ab1dd909dcc64c_5_6c696df6 (ComSignal):
        ComBitPosition = 40
        ComBitSize = 2
        ComSignalDataInvalidValue = 3
        ComSignalEndianness = LITTLE_ENDIAN
        ComSignalType = UINT8
        ComSignalInitValue = 0
        ComSignalAccess = ACCESS_NEEDED_BY_OTHER
        ComHandleId = 54
        ComSystemTemplateSystemSignalRef = sn_085b67cff4b142a59fb46d892b9938f0_15_fdd79fd1376744b592ab1dd909dcc64c_5
      sn_6e55c14d93c64aaa86e33b57aac2ae43_9_a49f1a757dbb42f99b42ad072723479a_2_36f7a929 (ComSignal):
        ComBitPosition = 32
        ComBitSize = 2
        ComSignalDataInvalidValue = 3
        ComSignalEndianness = LITTLE_ENDIAN
        ComSignalType = UINT8
        ComSignalInitValue = 0
        ComSignalAccess = ACCESS_NEEDED_BY_OTHER
        ComHandleId = 29
        ComSystemTemplateSystemSignalRef = sn_6e55c14d93c64aaa86e33b57aac2ae43_9_a49f1a757dbb42f99b42ad072723479a_2
      EPS_OUT_PduGroup_7933cc8b (ComIPduGroup): ComIPduGroupHandleId=12
      FAHRGESTELLNUMMER_23008def (ComIPdu):
        ComIPduDirection = RECEIVE
        ComIPduType = NORMAL
        ComIPduHandleId = 11
        ComIPduSignalProcessing = DEFERRED
        ComIPduCancellationSupport = false
        ComIPduGroupRef = EPS_IN_PduGroup3_7933cc8b
        ComIPduSignalGroupRef = signalGrp_FAHRGESTELLNUMMER_grpMap_77f31243
        ComPduIdRef = pduTr_FAHRGESTELLNUMMER_A_FlexRay_pduPort_EPS_A_FlexRay_IN_7d601c47_052bff33
      sn_6e55c14d93c64aaa86e33b57aac2ae43_9_fb20730d9415410f9e3bc21bb71c92b8_2_36f7a929 (ComSignal):
        ComBitPosition = 8
        ComBitSize = 4
        ComSignalDataInvalidValue = 15
        ComSignalEndianness = LITTLE_ENDIAN
        ComSignalType = UINT8
        ComSignalInitValue = 0
        ComSignalAccess = ACCESS_NEEDED_BY_OTHER
        ComHandleId = 30
        ComSystemTemplateSystemSignalRef = sn_6e55c14d93c64aaa86e33b57aac2ae43_9_fb20730d9415410f9e3bc21bb71c92b8_2
      e2eGrp_AVL_RPM_WHL_grpMap_9ee47a3e (ComSignalGroup): ComSignalGroupAccess=ACCESS_NEEDED_BY_OTHER, ComHandleId=1, ComSystemTemplateSignalGroupRef=e2eGrp_AVL_RPM_WHL_grpMap
        11 x ComGroupSignal, all with ComSignalEndianness=LITTLE_ENDIAN, ComSignalAccess=ACCESS_NEEDED_BY_OTHER:
          sn_ca307c7178fd4cb8b1f0845b9598b7e4_18_a501b58ff3634c35a48eb475f1576ef4_2_0136c679: ComBitPosition=0, ComBitSize=8, ComSignalType=UINT8, ComSignalInitValue=0, ComHandleId=100, ComSystemTemplateSystemSignalRef=sn_ca307c7178fd4cb8b1f0845b9598b7e4_18_a501b58ff3634c35a48eb475f1576ef4_2
          sn_ca307c7178fd4cb8b1f0845b9598b7e4_18_cc92814877d54dd6ae1dd209c4865a32_8_0136c679: ComBitPosition=48, ComBitSize=16, ComSignalDataInvalidValue=65535, ComSignalType=UINT16, ComSignalInitValue=0, ComHandleId=101, ComSystemTemplateSystemSignalRef=sn_ca307c7178fd4cb8b1f0845b9598b7e4_18_cc92814877d54dd6ae1dd209c4865a32_8
          sn_ca307c7178fd4cb8b1f0845b9598b7e4_18_96e79e323c194994bc5c88fd2c606a13_8_0136c679: ComBitPosition=64, ComBitSize=16, ComSignalDataInvalidValue=65535, ComSignalType=UINT16, ComSignalInitValue=0, ComHandleId=96, ComSystemTemplateSystemSignalRef=sn_ca307c7178fd4cb8b1f0845b9598b7e4_18_96e79e323c194994bc5c88fd2c606a13_8
          AVL_RPM_WHL_dummy_12_15_0136c679: ComBitPosition=12, ComBitSize=4, ComSignalInitValue=15, ComSignalType=UINT8, ComHandleId=2, ComSystemTemplateSystemSignalRef=AVL_RPM_WHL_dummy_12_15
          sn_ca307c7178fd4cb8b1f0845b9598b7e4_18_0caaaf0e787848339bc25a94575449c2_13_0136c679: ComBitPosition=80, ComBitSize=4, ComSignalDataInvalidValue=15, ComSignalType=UINT8, ComSignalInitValue=0, ComHandleId=93, ComSystemTemplateSystemSignalRef=sn_ca307c7178fd4cb8b1f0845b9598b7e4_18_0caaaf0e787848339bc25a94575449c2_13
          sn_ca307c7178fd4cb8b1f0845b9598b7e4_18_77005174aa4742b0a646ec42e5086ea4_14_0136c679: ComBitPosition=88, ComBitSize=4, ComSignalDataInvalidValue=15, ComSignalType=UINT8, ComSignalInitValue=0, ComHandleId=99, ComSystemTemplateSystemSignalRef=sn_ca307c7178fd4cb8b1f0845b9598b7e4_18_77005174aa4742b0a646ec42e5086ea4_14
          sn_ca307c7178fd4cb8b1f0845b9598b7e4_18_768ce7ec1493408a84f5de8246b34d32_13_0136c679: ComBitPosition=84, ComBitSize=4, ComSignalDataInvalidValue=15, ComSignalType=UINT8, ComSignalInitValue=0, ComHandleId=98, ComSystemTemplateSystemSignalRef=sn_ca307c7178fd4cb8b1f0845b9598b7e4_18_768ce7ec1493408a84f5de8246b34d32_13
          sn_ca307c7178fd4cb8b1f0845b9598b7e4_18_689ab022c9664232a25b9bf47fac730d_1_0136c679: ComBitPosition=8, ComBitSize=4, ComSignalDataInvalidValue=15, ComSignalType=UINT8, ComSignalInitValue=0, ComHandleId=97, ComSystemTemplateSystemSignalRef=sn_ca307c7178fd4cb8b1f0845b9598b7e4_18_689ab022c9664232a25b9bf47fac730d_1
          sn_ca307c7178fd4cb8b1f0845b9598b7e4_18_7ba9ac40e06b4b4cb875d606bdea3bf4_14_0136c679: ComBitPosition=92, ComBitSize=4, ComSignalDataInvalidValue=15, ComSignalType=UINT8, ComSignalInitValue=0, ComHandleId=95, ComSystemTemplateSystemSignalRef=sn_ca307c7178fd4cb8b1f0845b9598b7e4_18_7ba9ac40e06b4b4cb875d606bdea3bf4_14
          sn_ca307c7178fd4cb8b1f0845b9598b7e4_18_f56acda22c2442ff85a725fcb0ae86c5_7_0136c679: ComBitPosition=32, ComBitSize=16, ComSignalDataInvalidValue=65535, ComSignalType=UINT16, ComSignalInitValue=0, ComHandleId=102, ComSystemTemplateSystemSignalRef=sn_ca307c7178fd4cb8b1f0845b9598b7e4_18_f56acda22c2442ff85a725fcb0ae86c5_7
          sn_ca307c7178fd4cb8b1f0845b9598b7e4_18_4a3b2166543f48339c6f727a404b1680_7_0136c679: ComBitPosition=16, ComBitSize=16, ComSignalDataInvalidValue=65535, ComSignalType=UINT16, ComSignalInitValue=0, ComHandleId=94, ComSystemTemplateSystemSignalRef=sn_ca307c7178fd4cb8b1f0845b9598b7e4_18_4a3b2166543f48339c6f727a404b1680_7
      ANFRAGE_ID2_434514f6_In (ComSignal):
        ComBitPosition = 0
        ComBitSize = 8
        ComSignalEndianness = LITTLE_ENDIAN
        ComSignalInitValue = 1
        ComSignalType = UINT8
        ComSignalAccess = ACCESS_NEEDED_BY_OTHER
        ComHandleId = 1
        ComSystemTemplateSystemSignalRef = ANFRAGE_ID2
      CTR_VIB_STW_DISP_EXMI_SP2015_23008def (ComIPdu):
        ComIPduDirection = RECEIVE
        ComIPduType = NORMAL
        ComIPduHandleId = 6
        ComIPduSignalProcessing = DEFERRED
        ComIPduCancellationSupport = false
        ComIPduGroupRef = EPS_IN_PduGroup6_7933cc8b
        ComIPduSignalRef = sn_8e1fc510f7a3427998068160382540c0_4_21fe3f3f6c7244818f57f1c3c8c46f0f_1_262fad9b
        ComIPduSignalRef = sn_8e1fc510f7a3427998068160382540c0_4_84e2267531a54593b0ba6603319c899d_1_262fad9b
        ComIPduSignalRef = sn_8e1fc510f7a3427998068160382540c0_4_c8ce6b50abf248f0b72cde93f56ad0ff_1_262fad9b
        ComPduIdRef = pduTr_CTR_VIB_STW_DISP_EXMI_SP2015_A_FlexRay_pduPort_EPS_A_FlexRay_IN_7d601c47_052bff33
      e2eGrp_AVL_PO_EPS_grpMap_0e78aaac (ComSignalGroup): ComSignalGroupAccess=ACCESS_NEEDED_BY_OTHER, ComHandleId=1, ComSystemTemplateSignalGroupRef=e2eGrp_AVL_PO_EPS_grpMap
        8 x ComGroupSignal, all with ComSignalEndianness=LITTLE_ENDIAN, ComSignalInitValue=0, ComSignalAccess=ACCESS_NEEDED_BY_OTHER, ComTransferProperty=PENDING:
          sn_e0f63d36315c4773ba837e73d6faaadd_15_bc95b5ba2eae48218eb9877ea08559a2_2_828cc38e: ComBitPosition=8, ComBitSize=4, ComSignalDataInvalidValue=15, ComSignalType=UINT8, ComHandleId=63, ComSystemTemplateSystemSignalRef=sn_e0f63d36315c4773ba837e73d6faaadd_15_bc95b5ba2eae48218eb9877ea08559a2_2
          sn_e0f63d36315c4773ba837e73d6faaadd_15_4fc18042a3ed4ed3935aa3b3038bf544_5_828cc38e: ComBitPosition=32, ComBitSize=16, ComSignalDataInvalidValue=65535, ComSignalType=UINT16, ComHandleId=58, ComSystemTemplateSystemSignalRef=sn_e0f63d36315c4773ba837e73d6faaadd_15_4fc18042a3ed4ed3935aa3b3038bf544_5
          sn_e0f63d36315c4773ba837e73d6faaadd_15_99fd6a6f88664f46a45dae1eac3e4bb9_5_828cc38e: ComBitPosition=48, ComBitSize=12, ComSignalDataInvalidValue=4095, ComSignalType=UINT16, ComHandleId=60, ComSystemTemplateSystemSignalRef=sn_e0f63d36315c4773ba837e73d6faaadd_15_99fd6a6f88664f46a45dae1eac3e4bb9_5
          sn_e0f63d36315c4773ba837e73d6faaadd_15_c5c4fc12c19449dca31982abd0f99bbb_2_828cc38e: ComBitPosition=0, ComBitSize=8, ComSignalType=UINT8, ComHandleId=64, ComSystemTemplateSystemSignalRef=sn_e0f63d36315c4773ba837e73d6faaadd_15_c5c4fc12c19449dca31982abd0f99bbb_2
          sn_e0f63d36315c4773ba837e73d6faaadd_15_2de5d882792e4739a95de3e1c7b8ccad_10_828cc38e: ComBitPosition=12, ComBitSize=4, ComSignalDataInvalidValue=15, ComSignalType=UINT8, ComHandleId=57, ComSystemTemplateSystemSignalRef=sn_e0f63d36315c4773ba837e73d6faaadd_15_2de5d882792e4739a95de3e1c7b8ccad_10
          sn_e0f63d36315c4773ba837e73d6faaadd_15_accb41f44683494d8bbe73645993b2b8_9_828cc38e: ComBitPosition=16, ComBitSize=16, ComSignalDataInvalidValue=65535, ComSignalType=UINT16, ComHandleId=62, ComSystemTemplateSystemSignalRef=sn_e0f63d36315c4773ba837e73d6faaadd_15_accb41f44683494d8bbe73645993b2b8_9
          sn_e0f63d36315c4773ba837e73d6faaadd_15_7184c8825a7a44dd9a0b76c751498b8c_6_828cc38e: ComBitPosition=60, ComBitSize=2, ComSignalDataInvalidValue=3, ComSignalType=UINT8, ComHandleId=61, ComSystemTemplateSystemSignalRef=sn_e0f63d36315c4773ba837e73d6faaadd_15_7184c8825a7a44dd9a0b76c751498b8c_6
          sn_e0f63d36315c4773ba837e73d6faaadd_15_7f90cd4f694b47ba8781390120dcbc0a_3_828cc38e: ComBitPosition=62, ComBitSize=2, ComSignalDataInvalidValue=3, ComSignalType=UINT8, ComHandleId=59, ComSystemTemplateSystemSignalRef=sn_e0f63d36315c4773ba837e73d6faaadd_15_7f90cd4f694b47ba8781390120dcbc0a_3
      e2eGrp_CON_VEH_grpMap_125c48d9 (ComSignalGroup): ComSignalGroupAccess=ACCESS_NEEDED_BY_OTHER, ComHandleId=2, ComSystemTemplateSignalGroupRef=e2eGrp_CON_VEH_grpMap
        7 x ComGroupSignal, all with ComSignalEndianness=LITTLE_ENDIAN, ComSignalAccess=ACCESS_NEEDED_BY_OTHER:
          sn_f39dc9b4f18c4462a3ca3222d270f882_11_27cab225247945149cedbf8a6572a041_6_aa0b865f: ComBitPosition=12, ComBitSize=4, ComSignalDataInvalidValue=15, ComSignalType=UINT8, ComSignalInitValue=0, ComHandleId=114, ComSystemTemplateSystemSignalRef=sn_f39dc9b4f18c4462a3ca3222d270f882_11_27cab225247945149cedbf8a6572a041_6
          sn_f39dc9b4f18c4462a3ca3222d270f882_11_eaad471b16e343ebb9a64a56b77d99cf_3_aa0b865f: ComBitPosition=52, ComBitSize=4, ComSignalDataInvalidValue=15, ComSignalType=UINT8, ComSignalInitValue=0, ComHandleId=116, ComSystemTemplateSystemSignalRef=sn_f39dc9b4f18c4462a3ca3222d270f882_11_eaad471b16e343ebb9a64a56b77d99cf_3
          CON_VEH_dummy_56_63_aa0b865f: ComBitPosition=56, ComBitSize=8, ComSignalInitValue=255, ComSignalType=UINT8, ComHandleId=3, ComSystemTemplateSystemSignalRef=CON_VEH_dummy_56_63
          sn_f39dc9b4f18c4462a3ca3222d270f882_11_fea9eeb6b9064310b5e2c102c7429d64_2_aa0b865f: ComBitPosition=0, ComBitSize=8, ComSignalType=UINT8, ComSignalInitValue=0, ComHandleId=117, ComSystemTemplateSystemSignalRef=sn_f39dc9b4f18c4462a3ca3222d270f882_11_fea9eeb6b9064310b5e2c102c7429d64_2
          sn_f39dc9b4f18c4462a3ca3222d270f882_11_31158b9d716b4ee985e36b830c254e3a_6_aa0b865f: ComBitPosition=48, ComBitSize=4, ComSignalDataInvalidValue=15, ComSignalType=UINT8, ComSignalInitValue=0, ComHandleId=115, ComSystemTemplateSystemSignalRef=sn_f39dc9b4f18c4462a3ca3222d270f882_11_31158b9d716b4ee985e36b830c254e3a_6
          sn_f39dc9b4f18c4462a3ca3222d270f882_11_5b1908a90ce1499db5d60fe77e5bdbfc_10_aa0b865f: ComBitPosition=16, ComBitSize=32, ComSignalDataInvalidValue=4294967295, ComSignalType=UINT32, ComSignalInitValue=0, ComHandleId=113, ComSystemTemplateSystemSignalRef=sn_f39dc9b4f18c4462a3ca3222d270f882_11_5b1908a90ce1499db5d60fe77e5bdbfc_10
          sn_f39dc9b4f18c4462a3ca3222d270f882_11_3e3eaebd055944cc9a1ff983552ec9bf_2_aa0b865f: ComBitPosition=8, ComBitSize=4, ComSignalDataInvalidValue=15, ComSignalType=UINT8, ComSignalInitValue=0, ComHandleId=112, ComSystemTemplateSystemSignalRef=sn_f39dc9b4f18c4462a3ca3222d270f882_11_3e3eaebd055944cc9a1ff983552ec9bf_2
      SECU_FAHRGESTELLNUMMER_23008def (ComIPdu):
        ComIPduDirection = RECEIVE
        ComIPduType = NORMAL
        ComIPduHandleId = 16
        ComIPduSignalProcessing = DEFERRED
        ComIPduCancellationSupport = false
        ComIPduGroupRef = EPS_IN_PduGroup3_7933cc8b
        ComIPduSignalGroupRef = signalGrp_SECU_FAHRGESTELLNUMMER_grpMap_facbc46e
        ComPduIdRef = pduTr_SECU_FAHRGESTELLNUMMER_A_FlexRay_pduPort_EPS_A_FlexRay_IN_7d601c47_052bff33
      DBG_EPS_MOD_EXT_120_BYTE_CHOV_DBG_MOD_EPS_8a0e8110 (ComSignal):
        ComBitPosition = 0
        ComBitSize = 8
        ComSignalEndianness = LITTLE_ENDIAN
        ComSignalInitValue = 2
        ComSignalType = UINT8
        ComTransferProperty = PENDING
        ComSignalAccess = ACCESS_NEEDED_BY_OTHER
        ComHandleId = 4
        ComSystemTemplateSystemSignalRef = DBG_EPS_MOD_EXT_120_BYTE_CHOV_DBG_MOD_EPS
      sn_2d91f731ef854e209f0a9d17b0596648_8_c06c9dcca09a433db7ff26cc5c43b9ad_5_f361cf54 (ComSignal):
        ComBitPosition = 8
        ComBitSize = 8
        ComSignalDataInvalidValue = 255
        ComSignalEndianness = LITTLE_ENDIAN
        ComSignalType = UINT8
        ComSignalInitValue = 0
        ComSignalAccess = ACCESS_NEEDED_BY_OTHER
        ComHandleId = 28
        ComTransferProperty = PENDING
        ComSystemTemplateSystemSignalRef = sn_2d91f731ef854e209f0a9d17b0596648_8_c06c9dcca09a433db7ff26cc5c43b9ad_5
      EPS_IN_PduGroup3_7933cc8b (ComIPduGroup): ComIPduGroupHandleId=1
      sn_04b89dc3c26d4ca08465c4eec950ef56_8_5c4106f5d9894a4e97dd9baa72070138_2_3bc7fd4a (ComSignal):
        ComBitPosition = 8
        ComBitSize = 4
        ComSignalDataInvalidValue = 15
        ComSignalEndianness = LITTLE_ENDIAN
        ComSignalType = UINT8
        ComSignalInitValue = 0
        ComSignalAccess = ACCESS_NEEDED_BY_OTHER
        ComHandleId = 35
        ComSystemTemplateSystemSignalRef = sn_04b89dc3c26d4ca08465c4eec950ef56_8_5c4106f5d9894a4e97dd9baa72070138_2
      ENSU_SFY_23008def (ComIPdu):
        ComIPduDirection = RECEIVE
        ComIPduType = NORMAL
        ComIPduHandleId = 9
        ComIPduSignalProcessing = DEFERRED
        ComIPduCancellationSupport = false
        ComIPduGroupRef = EPS_IN_PduGroup6_7933cc8b
        ComIPduSignalGroupRef = e2eGrp_ENSU_SFY_grpMap_516886f4
        ComPduIdRef = pduTr_ENSU_SFY_A_FlexRay_pduPort_EPS_A_FlexRay_IN_7d601c47_052bff33
      ANFRAGE_434514f6_Out (ComIPdu):
        ComIPduDirection = SEND
        ComIPduType = NORMAL
        ComIPduHandleId = 0
        ComIPduSignalProcessing = DEFERRED
        ComIPduCancellationSupport = false
        ComIPduGroupRef = EPS_OUT_PduGroup_7933cc8b
        ComIPduSignalRef = ANFRAGE_ID2_434514f6_Out
        ComIPduSignalRef = sn_809234ffb6e24e4eb85479b73d250d21_49_761b4cd9ec7e47aeb030258f54c21bfc_46_434514f6_Out
        ComPduIdRef = ANFRAGE_434514f6_Out
        ComTxIPdu: ComMinimumDelayTime=0.5, ComTxIPduUnusedAreasDefault=255, ComTxIPduClearUpdateBit=TriggerTransmit
          ComTxModeTrue
            ComTxMode: ComTxModeMode=DIRECT, ComTxModeNumberOfRepetitions=0
          ComTxModeFalse
            ComTxMode: ComTxModeMode=NONE
      EPS_IN_PduGroup9_7933cc8b (ComIPduGroup): ComIPduGroupHandleId=7
      RQ_STG_EFAN_ID2_f361cf54 (ComSignal):
        ComBitPosition = 0
        ComBitSize = 8
        ComSignalEndianness = LITTLE_ENDIAN
        ComSignalInitValue = 21
        ComSignalType = UINT8
        ComTransferProperty = PENDING
        ComSignalAccess = ACCESS_NEEDED_BY_OTHER
        ComHandleId = 9
        ComSystemTemplateSystemSignalRef = RQ_STG_EFAN_ID2
      RELATIVZEIT_23008def (ComIPdu):
        ComIPduDirection = RECEIVE
        ComIPduType = NORMAL
        ComIPduHandleId = 15
        ComIPduSignalProcessing = DEFERRED
        ComIPduCancellationSupport = false
        ComIPduGroupRef = EPS_IN_PduGroup4_7933cc8b
        ComIPduSignalRef = sn_acb3c9a426bf4887ba724efd428ad5a4_3_ad2096213c0c47a78c10b4a8c5667464_7_7e6a2fc7
        ComPduIdRef = pduTr_RELATIVZEIT_A_FlexRay_pduPort_EPS_A_FlexRay_IN_7d601c47_052bff33
      SECU_CHAL_23008def (ComIPdu):
        ComIPduDirection = SEND
        ComIPduType = NORMAL
        ComIPduHandleId = 10
        ComIPduSignalProcessing = DEFERRED
        ComIPduCancellationSupport = false
        ComIPduGroupRef = EPS_OUT_PduGroup3_7933cc8b
        ComIPduSignalGroupRef = signalGrp_SECU_CHAL_grpMap_2a1be51a
        ComIPduSignalRef = SECU_CHAL_ID2_2a1be51a
        ComPduIdRef = pduTr_SECU_CHAL_A_FlexRay_pduPort_EPS_A_FlexRay_OUT_7d601c47_052bff33
        ComTxIPdu: ComMinimumDelayTime=0.05, ComTxIPduUnusedAreasDefault=255, ComTxIPduClearUpdateBit=TriggerTransmit
          ComTxModeTrue
            ComTxMode: ComTxModeMode=DIRECT, ComTxModeNumberOfRepetitions=0
          ComTxModeFalse
            ComTxMode: ComTxModeMode=NONE
      4 x ComSignal, all with ComSignalEndianness=LITTLE_ENDIAN, ComSignalAccess=ACCESS_NEEDED_BY_OTHER:
        sn_3e35ac63fc494d0fb399c763aeb7057b_24_e92786ce091d4130a2deaffa00e99dac_12_a08a0405: ComBitPosition=16, ComBitSize=12, ComSignalDataInvalidValue=4095, ComSignalType=UINT16, ComSignalInitValue=0, ComHandleId=24, ComSystemTemplateSystemSignalRef=sn_3e35ac63fc494d0fb399c763aeb7057b_24_e92786ce091d4130a2deaffa00e99dac_12
        sn_2d91f731ef854e209f0a9d17b0596648_8_6c1ea235872142cfbe3d872d17caa2ae_3_f361cf54: ComBitPosition=24, ComBitSize=8, ComSignalDataInvalidValue=255, ComSignalType=UINT8, ComSignalInitValue=0, ComHandleId=26, ComTransferProperty=PENDING, ComSystemTemplateSystemSignalRef=sn_2d91f731ef854e209f0a9d17b0596648_8_6c1ea235872142cfbe3d872d17caa2ae_3
        ANFRAGE_ID2_434514f6_Out: ComBitPosition=0, ComBitSize=8, ComSignalInitValue=1, ComSignalType=UINT8, ComTransferProperty=PENDING, ComHandleId=0, ComSystemTemplateSystemSignalRef=ANFRAGE_ID2
        sn_03a68de7c576470bbe5c65893688a981_2_1d95be4f9b5642d8ad66a452046dc075_2_1182661c: ComBitPosition=8, ComBitSize=8, ComSignalType=UINT8, ComSignalInitValue=0, ComHandleId=29, ComTransferProperty=PENDING, ComSystemTemplateSystemSignalRef=sn_03a68de7c576470bbe5c65893688a981_2_1d95be4f9b5642d8ad66a452046dc075_2
      e2eGrp_AVL_STMOM_DV_ACT_grpMap_5b4255fb (ComSignalGroup): ComSignalGroupAccess=ACCESS_NEEDED_BY_OTHER, ComHandleId=2, ComSystemTemplateSignalGroupRef=e2eGrp_AVL_STMOM_DV_ACT_grpMap
        5 x ComGroupSignal, all with ComSignalEndianness=LITTLE_ENDIAN, ComSignalAccess=ACCESS_NEEDED_BY_OTHER, ComTransferProperty=PENDING:
          AVL_STMOM_DV_ACT_dummy_12_15_d3120462: ComBitPosition=12, ComBitSize=4, ComSignalInitValue=15, ComSignalType=UINT8, ComHandleId=2, ComSystemTemplateSystemSignalRef=AVL_STMOM_DV_ACT_dummy_12_15
          sn_1edf400c871b41dab29d318a6fc3ec64_13_aaebf3e364fa4b0da7de252527de9449_3_d3120462: ComBitPosition=8, ComBitSize=4, ComSignalDataInvalidValue=15, ComSignalType=UINT8, ComSignalInitValue=0, ComHandleId=23, ComSystemTemplateSystemSignalRef=sn_1edf400c871b41dab29d318a6fc3ec64_13_aaebf3e364fa4b0da7de252527de9449_3
          sn_1edf400c871b41dab29d318a6fc3ec64_13_5d9506af077e4dd09e190f5d484d7305_9_d3120462: ComBitPosition=28, ComBitSize=4, ComSignalDataInvalidValue=15, ComSignalType=UINT8, ComSignalInitValue=0, ComHandleId=21, ComSystemTemplateSystemSignalRef=sn_1edf400c871b41dab29d318a6fc3ec64_13_5d9506af077e4dd09e190f5d484d7305_9
          sn_1edf400c871b41dab29d318a6fc3ec64_13_7c6cdad248d54f7cbe6f830bb0fcf68d_3_d3120462: ComBitPosition=0, ComBitSize=8, ComSignalType=UINT8, ComSignalInitValue=0, ComHandleId=22, ComSystemTemplateSystemSignalRef=sn_1edf400c871b41dab29d318a6fc3ec64_13_7c6cdad248d54f7cbe6f830bb0fcf68d_3
          sn_1edf400c871b41dab29d318a6fc3ec64_13_f65da775f9284544b6d9e8ec17402794_5_d3120462: ComBitPosition=16, ComBitSize=12, ComSignalDataInvalidValue=4095, ComSignalType=UINT16, ComSignalInitValue=0, ComHandleId=24, ComSystemTemplateSystemSignalRef=sn_1edf400c871b41dab29d318a6fc3ec64_13_f65da775f9284544b6d9e8ec17402794_5
      sn_8e1fc510f7a3427998068160382540c0_4_c8ce6b50abf248f0b72cde93f56ad0ff_1_262fad9b (ComSignal):
        ComBitPosition = 56
        ComBitSize = 4
        ComSignalDataInvalidValue = 15
        ComSignalEndianness = LITTLE_ENDIAN
        ComSignalType = UINT8
        ComSignalInitValue = 0
        ComSignalAccess = ACCESS_NEEDED_BY_OTHER
        ComHandleId = 33
        ComSystemTemplateSystemSignalRef = sn_8e1fc510f7a3427998068160382540c0_4_c8ce6b50abf248f0b72cde93f56ad0ff_1
      sn_1d8c8b7c4f314df494349db3e54a099c_3_0751acece3ed45e28561953fa2cf0d8a_2_8a0e8110 (ComSignal):
        ComBitPosition = 8
        ComBitSize = 8
        ComSignalEndianness = LITTLE_ENDIAN
        ComSignalType = UINT8
        ComSignalInitValue = 0
        ComSignalAccess = ACCESS_NEEDED_BY_OTHER
        ComHandleId = 20
        ComTransferProperty = PENDING
        ComSystemTemplateSystemSignalRef = sn_1d8c8b7c4f314df494349db3e54a099c_3_0751acece3ed45e28561953fa2cf0d8a_2
      AVL_RPM_WHL_23008def (ComIPdu):
        ComIPduDirection = RECEIVE
        ComIPduType = NORMAL
        ComIPduHandleId = 2
        ComIPduSignalProcessing = DEFERRED
        ComIPduCancellationSupport = false
        ComIPduGroupRef = EPS_IN_PduGroup3_7933cc8b
        ComIPduSignalGroupRef = e2eGrp_AVL_RPM_WHL_grpMap_9ee47a3e
        ComPduIdRef = pduTr_AVL_RPM_WHL_A_FlexRay_pduPort_EPS_A_FlexRay_IN_7d601c47_052bff33
      EPS_IN_PduGroup4_7933cc8b (ComIPduGroup): ComIPduGroupHandleId=2
      EPS_IN_PduGroup10_7933cc8b (ComIPduGroup): ComIPduGroupHandleId=8
      DBG_EPS_MOD_EXT_120_BYTE_23008def (ComIPdu):
        ComIPduDirection = SEND
        ComIPduType = NORMAL
        ComIPduHandleId = 5
        ComIPduSignalProcessing = DEFERRED
        ComIPduCancellationSupport = false
        ComIPduGroupRef = EPS_OUT_PduGroup2_7933cc8b
        ComIPduSignalRef = DBG_EPS_MOD_EXT_120_BYTE_CHOV_DBG_MOD_EPS_8a0e8110
        ComIPduSignalRef = sn_1d8c8b7c4f314df494349db3e54a099c_3_0751acece3ed45e28561953fa2cf0d8a_2_8a0e8110
        ComPduIdRef = pduTr_DBG_EPS_MOD_EXT_120_BYTE_A_FlexRay_pduPort_EPS_A_FlexRay_OUT_7d601c47_052bff33
        ComTxIPdu: ComTxIPduUnusedAreasDefault=255, ComMinimumDelayTime=0, ComTxIPduClearUpdateBit=TriggerTransmit
          ComTxModeTrue
            ComTxMode: ComTxModeMode=PERIODIC, ComTxModeTimePeriod=0.005, ComTxModeTimeOffset=0
          ComTxModeFalse
            ComTxMode: ComTxModeMode=NONE
      ST_DIAG_OBD_3_DRDY_23008def (ComIPdu):
        ComIPduDirection = SEND
        ComIPduType = NORMAL
        ComIPduHandleId = 11
        ComIPduSignalProcessing = DEFERRED
        ComIPduCancellationSupport = false
        ComIPduGroupRef = EPS_OUT_PduGroup2_7933cc8b
        ComIPduSignalGroupRef = signalGrp_ST_DIAG_OBD_3_DRDY_grpMap_2d32eef5
        ComPduIdRef = pduTr_ST_DIAG_OBD_3_DRDY_A_FlexRay_pduPort_EPS_A_FlexRay_OUT_7d601c47_052bff33
        ComTxIPdu: ComMinimumDelayTime=0.16, ComTxIPduUnusedAreasDefault=255
          ComTxModeTrue
            ComTxMode: ComTxModeMode=DIRECT, ComTxModeNumberOfRepetitions=0
          ComTxModeFalse
            ComTxMode: ComTxModeMode=NONE
      SECU_RESP_ID2_a6936a2f (ComSignal):
        ComBitPosition = 0
        ComBitSize = 8
        ComSignalEndianness = LITTLE_ENDIAN
        ComSignalInitValue = 247
        ComSignalType = UINT8
        ComSignalAccess = ACCESS_NEEDED_BY_OTHER
        ComHandleId = 7
        ComSystemTemplateSystemSignalRef = SECU_RESP_ID2
      e2eGrp_TAR_QTA_STRMOM_DV_grpMap_47595eaf (ComSignalGroup): ComSignalGroupAccess=ACCESS_NEEDED_BY_OTHER, ComHandleId=7, ComSystemTemplateSignalGroupRef=e2eGrp_TAR_QTA_STRMOM_DV_grpMap
        10 x ComGroupSignal, all with ComSignalEndianness=LITTLE_ENDIAN, ComSignalAccess=ACCESS_NEEDED_BY_OTHER:
          sn_2b4b9cfb3a644a13aeec78e06779be78_9_4f1cb301ca9544d4a46d651e9536efd1_4_425260ef: ComBitPosition=28, ComBitSize=4, ComSignalDataInvalidValue=15, ComSignalType=UINT8, ComSignalInitValue=0, ComHandleId=17, ComSystemTemplateSystemSignalRef=sn_2b4b9cfb3a644a13aeec78e06779be78_9_4f1cb301ca9544d4a46d651e9536efd1_4
          sn_2b4b9cfb3a644a13aeec78e06779be78_9_01dc732302854f9daf379339aec3bf41_4_425260ef: ComBitPosition=48, ComBitSize=8, ComSignalDataInvalidValue=255, ComSignalType=UINT8, ComSignalInitValue=0, ComHandleId=18, ComSystemTemplateSystemSignalRef=sn_2b4b9cfb3a644a13aeec78e06779be78_9_01dc732302854f9daf379339aec3bf41_4
          sn_2b4b9cfb3a644a13aeec78e06779be78_9_b7dbfdc1e82d4733afb19fcf9e269188_4_425260ef: ComBitPosition=32, ComBitSize=8, ComSignalDataInvalidValue=255, ComSignalType=UINT8, ComSignalInitValue=0, ComHandleId=21, ComSystemTemplateSystemSignalRef=sn_2b4b9cfb3a644a13aeec78e06779be78_9_b7dbfdc1e82d4733afb19fcf9e269188_4
          sn_2b4b9cfb3a644a13aeec78e06779be78_9_197556b4d9a045cb9282d0bc6431da4b_2_425260ef: ComBitPosition=8, ComBitSize=4, ComSignalDataInvalidValue=15, ComSignalType=UINT8, ComSignalInitValue=0, ComHandleId=20, ComSystemTemplateSystemSignalRef=sn_2b4b9cfb3a644a13aeec78e06779be78_9_197556b4d9a045cb9282d0bc6431da4b_2
          sn_2b4b9cfb3a644a13aeec78e06779be78_9_0d32674ea9b948a48e2f9146dc8d0383_3_425260ef: ComBitPosition=56, ComBitSize=4, ComSignalDataInvalidValue=15, ComSignalType=UINT8, ComSignalInitValue=0, ComHandleId=15, ComSystemTemplateSystemSignalRef=sn_2b4b9cfb3a644a13aeec78e06779be78_9_0d32674ea9b948a48e2f9146dc8d0383_3
          sn_2b4b9cfb3a644a13aeec78e06779be78_9_2c4be44656a74ad1973ec6f292be1b63_2_425260ef: ComBitPosition=0, ComBitSize=8, ComSignalType=UINT8, ComSignalInitValue=0, ComHandleId=16, ComSystemTemplateSystemSignalRef=sn_2b4b9cfb3a644a13aeec78e06779be78_9_2c4be44656a74ad1973ec6f292be1b63_2
          sn_2b4b9cfb3a644a13aeec78e06779be78_9_70d4f068b0c04cd9a2e782d5ca0eb678_1_425260ef: ComBitPosition=60, ComBitSize=4, ComSignalDataInvalidValue=15, ComSignalType=UINT8, ComSignalInitValue=0, ComHandleId=19, ComSystemTemplateSystemSignalRef=sn_2b4b9cfb3a644a13aeec78e06779be78_9_70d4f068b0c04cd9a2e782d5ca0eb678_1
          sn_2b4b9cfb3a644a13aeec78e06779be78_9_f6eac96cf628429bb0c9b3d36d80d166_3_425260ef: ComBitPosition=16, ComBitSize=12, ComSignalDataInvalidValue=4095, ComSignalType=UINT16, ComSignalInitValue=0, ComHandleId=23, ComSystemTemplateSystemSignalRef=sn_2b4b9cfb3a644a13aeec78e06779be78_9_f6eac96cf628429bb0c9b3d36d80d166_3
          TAR_QTA_STRMOM_DV_dummy_12_15_425260ef: ComBitPosition=12, ComBitSize=4, ComSignalInitValue=15, ComSignalType=UINT8, ComHandleId=10, ComSystemTemplateSystemSignalRef=TAR_QTA_STRMOM_DV_dummy_12_15
          sn_2b4b9cfb3a644a13aeec78e06779be78_9_c094059b7c4b4be182a54415fff82701_5_425260ef: ComBitPosition=40, ComBitSize=8, ComSignalDataInvalidValue=255, ComSignalType=UINT8, ComSignalInitValue=0, ComHandleId=22, ComSystemTemplateSystemSignalRef=sn_2b4b9cfb3a644a13aeec78e06779be78_9_c094059b7c4b4be182a54415fff82701_5
      sn_6e55c14d93c64aaa86e33b57aac2ae43_9_19b3ebba571d40978c473fbc372b3866_1_36f7a929 (ComSignal):
        ComBitPosition = 34
        ComBitSize = 2
        ComSignalDataInvalidValue = 3
        ComSignalEndianness = LITTLE_ENDIAN
        ComSignalType = UINT8
        ComSignalInitValue = 0
        ComSignalAccess = ACCESS_NEEDED_BY_OTHER
        ComHandleId = 26
        ComSystemTemplateSystemSignalRef = sn_6e55c14d93c64aaa86e33b57aac2ae43_9_19b3ebba571d40978c473fbc372b3866_1
      EPS_IN_PduGroup8_7933cc8b (ComIPduGroup): ComIPduGroupHandleId=6
      3 x ComIPdu, all with ComIPduDirection=RECEIVE, ComIPduType=NORMAL, ComIPduSignalProcessing=DEFERRED, ComIPduCancellationSupport=false:
        V_VEH_23008def: ComIPduHandleId=27, ComIPduGroupRef=EPS_IN_PduGroup3_7933cc8b, ComIPduSignalGroupRef=e2eGrp_V_VEH_grpMap_6a5236f2, ComPduIdRef=pduTr_V_VEH_A_FlexRay_pduPort_EPS_A_FlexRay_IN_7d601c47_052bff33
        SU_CLE_DRDY_DXP_23008def: ComIPduHandleId=22, ComIPduGroupRef=EPS_IN_PduGroup3_7933cc8b, ComIPduSignalRef=sn_04b89dc3c26d4ca08465c4eec950ef56_8_1ef5db97b1344b9b93faeb7438eb9f92_3_3bc7fd4a, ComIPduSignalRef=sn_04b89dc3c26d4ca08465c4eec950ef56_8_5c4106f5d9894a4e97dd9baa72070138_2_3bc7fd4a, ComPduIdRef=pduTr_SU_CLE_DRDY_DXP_A_FlexRay_pduPort_EPS_A_FlexRay_IN_7d601c47_052bff33
        ST_ENERG_GEN_23008def: ComIPduHandleId=20, ComIPduGroupRef=EPS_IN_PduGroup_7933cc8b, ComIPduSignalRef=sn_085b67cff4b142a59fb46d892b9938f0_15_91a4644db3794ecd81aa7b3ba03f0ae0_3_6c696df6, ComIPduSignalRef=sn_085b67cff4b142a59fb46d892b9938f0_15_fdd79fd1376744b592ab1dd909dcc64c_5_6c696df6, ComPduIdRef=pduTr_ST_ENERG_GEN_A_FlexRay_pduPort_EPS_A_FlexRay_IN_7d601c47_052bff33
      sn_6e55c14d93c64aaa86e33b57aac2ae43_9_9c391600986c4bfcac5985aa50535648_4_36f7a929 (ComSignal):
        ComBitPosition = 16
        ComBitSize = 4
        ComSignalDataInvalidValue = 15
        ComSignalEndianness = LITTLE_ENDIAN
        ComSignalType = UINT8
        ComSignalInitValue = 0
        ComSignalAccess = ACCESS_NEEDED_BY_OTHER
        ComHandleId = 25
        ComSystemTemplateSystemSignalRef = sn_6e55c14d93c64aaa86e33b57aac2ae43_9_9c391600986c4bfcac5985aa50535648_4
      e2eGrp_DT_EST_grpMap_002dadf7 (ComSignalGroup): ComSignalGroupAccess=ACCESS_NEEDED_BY_OTHER, ComHandleId=4, ComSystemTemplateSignalGroupRef=e2eGrp_DT_EST_grpMap
        9 x ComGroupSignal, all with ComSignalEndianness=LITTLE_ENDIAN, ComSignalAccess=ACCESS_NEEDED_BY_OTHER, ComTransferProperty=PENDING:
          DT_EST_dummy_64_95_52335c52: ComBitPosition=64, ComBitSize=32, ComSignalInitValue=4294967295, ComSignalType=UINT32, ComHandleId=7, ComSystemTemplateSystemSignalRef=DT_EST_dummy_64_95
          sn_f1c2ea448b5742e6a930415b5321c120_9_9fa32cadfaed4d9d8f9ace3694433c0d_2_52335c52: ComBitPosition=0, ComBitSize=8, ComSignalType=UINT8, ComSignalInitValue=0, ComHandleId=71, ComSystemTemplateSystemSignalRef=sn_f1c2ea448b5742e6a930415b5321c120_9_9fa32cadfaed4d9d8f9ace3694433c0d_2
          DT_EST_dummy_16_47_52335c52: ComBitPosition=16, ComBitSize=32, ComSignalInitValue=4294967295, ComSignalType=UINT32, ComHandleId=6, ComSystemTemplateSystemSignalRef=DT_EST_dummy_16_47
          sn_f1c2ea448b5742e6a930415b5321c120_9_9d997c8fa7874a73b4c82edfa1c465ee_1_52335c52: ComBitPosition=60, ComBitSize=4, ComSignalDataInvalidValue=15, ComSignalType=UINT8, ComSignalInitValue=0, ComHandleId=70, ComSystemTemplateSystemSignalRef=sn_f1c2ea448b5742e6a930415b5321c120_9_9d997c8fa7874a73b4c82edfa1c465ee_1
          sn_f1c2ea448b5742e6a930415b5321c120_9_6d1119ef97ee4f5b8a1d4c39b8ee4a4b_2_52335c52: ComBitPosition=56, ComBitSize=4, ComSignalDataInvalidValue=15, ComSignalType=UINT8, ComSignalInitValue=0, ComHandleId=69, ComSystemTemplateSystemSignalRef=sn_f1c2ea448b5742e6a930415b5321c120_9_6d1119ef97ee4f5b8a1d4c39b8ee4a4b_2
          sn_f1c2ea448b5742e6a930415b5321c120_9_f726c286e26b4226a9ab68faaaa0268d_4_52335c52: ComBitPosition=48, ComBitSize=8, ComSignalDataInvalidValue=255, ComSignalType=UINT8, ComSignalInitValue=0, ComHandleId=73, ComSystemTemplateSystemSignalRef=sn_f1c2ea448b5742e6a930415b5321c120_9_f726c286e26b4226a9ab68faaaa0268d_4
          sn_f1c2ea448b5742e6a930415b5321c120_9_11ec244fdbd64e57b309defc17cb2624_2_52335c52: ComBitPosition=8, ComBitSize=4, ComSignalDataInvalidValue=15, ComSignalType=UINT8, ComSignalInitValue=0, ComHandleId=72, ComSystemTemplateSystemSignalRef=sn_f1c2ea448b5742e6a930415b5321c120_9_11ec244fdbd64e57b309defc17cb2624_2
          DT_EST_dummy_12_15_52335c52: ComBitPosition=12, ComBitSize=4, ComSignalInitValue=15, ComSignalType=UINT8, ComHandleId=5, ComSystemTemplateSystemSignalRef=DT_EST_dummy_12_15
          DT_EST_dummy_96_127_52335c52: ComBitPosition=96, ComBitSize=32, ComSignalInitValue=4294967295, ComSignalType=UINT32, ComHandleId=8, ComSystemTemplateSystemSignalRef=DT_EST_dummy_96_127
      TAR_STMOM_DV_ACT_23008def (ComIPdu):
        ComIPduDirection = RECEIVE
        ComIPduType = NORMAL
        ComIPduHandleId = 25
        ComIPduSignalProcessing = DEFERRED
        ComIPduCancellationSupport = false
        ComIPduGroupRef = EPS_IN_PduGroup3_7933cc8b
        ComIPduSignalGroupRef = e2eGrp_TAR_STMOM_DV_ACT_grpMap_b5764fca
        ComPduIdRef = pduTr_TAR_STMOM_DV_ACT_A_FlexRay_pduPort_EPS_A_FlexRay_IN_7d601c47_052bff33
      AVL_PO_EPS_23008def (ComIPdu):
        ComIPduDirection = SEND
        ComIPduType = NORMAL
        ComIPduHandleId = 2
        ComIPduSignalProcessing = DEFERRED
        ComIPduCancellationSupport = false
        ComIPduGroupRef = EPS_OUT_PduGroup2_7933cc8b
        ComIPduSignalGroupRef = e2eGrp_AVL_PO_EPS_grpMap_0e78aaac
        ComPduIdRef = pduTr_AVL_PO_EPS_A_FlexRay_pduPort_EPS_A_FlexRay_OUT_7d601c47_052bff33
        ComTxIPdu: ComTxIPduUnusedAreasDefault=255, ComMinimumDelayTime=0
          ComTxModeTrue
            ComTxMode: ComTxModeMode=PERIODIC, ComTxModeTimePeriod=0.01, ComTxModeTimeOffset=0
          ComTxModeFalse
            ComTxMode: ComTxModeMode=NONE
      ComTimeBase: ComRxTimeBase=0.01, ComTxTimeBase=0.005, ComGwTimeBase=0.01, ComRxDlMonTimeBase=21
      EPS_IN_PduGroup6_7933cc8b (ComIPduGroup): ComIPduGroupHandleId=4
      3 x ComSignal, all with ComSignalEndianness=LITTLE_ENDIAN, ComSignalType=UINT8, ComSignalInitValue=0, ComSignalAccess=ACCESS_NEEDED_BY_OTHER:
        sn_d8833aa6063240d791b5384f59f75d9a_13_35c5d363e5eb40db9e554c7d4cab4463_5_afa1da25: ComBitPosition=0, ComBitSize=6, ComSignalDataInvalidValue=63, ComHandleId=110, ComSystemTemplateSystemSignalRef=sn_d8833aa6063240d791b5384f59f75d9a_13_35c5d363e5eb40db9e554c7d4cab4463_5
        sn_47c848be64324d52af177d4eda36b369_12_d340d69f4388438e9ec7442ceae02261_3_8f561bce: ComBitPosition=56, ComBitSize=2, ComSignalDataInvalidValue=3, ComHandleId=51, ComSystemTemplateSystemSignalRef=sn_47c848be64324d52af177d4eda36b369_12_d340d69f4388438e9ec7442ceae02261_3
        sn_8e1fc510f7a3427998068160382540c0_4_21fe3f3f6c7244818f57f1c3c8c46f0f_1_262fad9b: ComBitPosition=36, ComBitSize=4, ComSignalDataInvalidValue=15, ComHandleId=31, ComSystemTemplateSystemSignalRef=sn_8e1fc510f7a3427998068160382540c0_4_21fe3f3f6c7244818f57f1c3c8c46f0f_1
      e2eGrp_ENSU_SFY_grpMap_516886f4 (ComSignalGroup): ComSignalGroupAccess=ACCESS_NEEDED_BY_OTHER, ComHandleId=4, ComSystemTemplateSignalGroupRef=e2eGrp_ENSU_SFY_grpMap
        7 x ComGroupSignal, all with ComSignalEndianness=LITTLE_ENDIAN, ComSignalAccess=ACCESS_NEEDED_BY_OTHER:
          ENSU_SFY_dummy_28_31_48f5d03e: ComBitPosition=28, ComBitSize=4, ComSignalInitValue=15, ComSignalType=UINT8, ComHandleId=5, ComSystemTemplateSystemSignalRef=ENSU_SFY_dummy_28_31
          sn_4145eaff72594a8e9989935517b189e9_2_c59bf536b4cc4ad8bd11209a76829f85_1_48f5d03e: ComBitPosition=0, ComBitSize=8, ComSignalType=UINT8, ComSignalInitValue=0, ComHandleId=66, ComSystemTemplateSystemSignalRef=sn_4145eaff72594a8e9989935517b189e9_2_c59bf536b4cc4ad8bd11209a76829f85_1
          sn_4145eaff72594a8e9989935517b189e9_2_4fe42e10027d41f4938110561ac34b34_1_48f5d03e: ComBitPosition=16, ComBitSize=8, ComSignalDataInvalidValue=255, ComSignalType=UINT8, ComSignalInitValue=0, ComHandleId=62, ComSystemTemplateSystemSignalRef=sn_4145eaff72594a8e9989935517b189e9_2_4fe42e10027d41f4938110561ac34b34_1
          sn_4145eaff72594a8e9989935517b189e9_2_6c68bd74160c499e80ce3b99e28d446f_2_48f5d03e: ComBitPosition=24, ComBitSize=4, ComSignalDataInvalidValue=15, ComSignalType=UINT8, ComSignalInitValue=0, ComHandleId=63, ComSystemTemplateSystemSignalRef=sn_4145eaff72594a8e9989935517b189e9_2_6c68bd74160c499e80ce3b99e28d446f_2
          ENSU_SFY_dummy_32_63_48f5d03e: ComBitPosition=32, ComBitSize=32, ComSignalInitValue=4294967295, ComSignalType=UINT32, ComHandleId=6, ComSystemTemplateSystemSignalRef=ENSU_SFY_dummy_32_63
          sn_4145eaff72594a8e9989935517b189e9_2_a72bbe97541440a48948afb1eb76d645_1_48f5d03e: ComBitPosition=8, ComBitSize=4, ComSignalDataInvalidValue=15, ComSignalType=UINT8, ComSignalInitValue=0, ComHandleId=65, ComSystemTemplateSystemSignalRef=sn_4145eaff72594a8e9989935517b189e9_2_a72bbe97541440a48948afb1eb76d645_1
          sn_4145eaff72594a8e9989935517b189e9_2_711dcfdb594d48dea88be956bcd8940b_1_48f5d03e: ComBitPosition=12, ComBitSize=4, ComSignalDataInvalidValue=15, ComSignalType=UINT8, ComSignalInitValue=0, ComHandleId=64, ComSystemTemplateSystemSignalRef=sn_4145eaff72594a8e9989935517b189e9_2_711dcfdb594d48dea88be956bcd8940b_1
      sn_55e086fa3cb3405c9e0849033f661450_11_389ce921618246489b7062f81bb683c4_4_e39ca898 (ComSignal):
        ComBitPosition = 36
        ComBitSize = 12
        ComSignalDataInvalidValue = 4095
        ComSignalEndianness = LITTLE_ENDIAN
        ComSignalType = UINT16
        ComSignalInitValue = 0
        ComSignalAccess = ACCESS_NEEDED_BY_OTHER
        ComHandleId = 52
        ComSystemTemplateSystemSignalRef = sn_55e086fa3cb3405c9e0849033f661450_11_389ce921618246489b7062f81bb683c4_4
      ANFRAGE_434514f6_In (ComIPdu):
        ComIPduDirection = RECEIVE
        ComIPduType = NORMAL
        ComIPduHandleId = 1
        ComIPduSignalProcessing = DEFERRED
        ComIPduCancellationSupport = false
        ComIPduGroupRef = EPS_IN_PduGroup2_7933cc8b
        ComIPduSignalRef = ANFRAGE_ID2_434514f6_In
        ComIPduSignalRef = sn_809234ffb6e24e4eb85479b73d250d21_49_761b4cd9ec7e47aeb030258f54c21bfc_46_434514f6_In
        ComPduIdRef = ANFRAGE_434514f6_In
      AVL_STMOM_DV_ACT_23008def (ComIPdu):
        ComIPduDirection = SEND
        ComIPduType = NORMAL
        ComIPduHandleId = 3
        ComIPduSignalProcessing = DEFERRED
        ComIPduCancellationSupport = false
        ComIPduGroupRef = EPS_OUT_PduGroup2_7933cc8b
        ComIPduSignalGroupRef = e2eGrp_AVL_STMOM_DV_ACT_grpMap_5b4255fb
        ComPduIdRef = pduTr_AVL_STMOM_DV_ACT_A_FlexRay_pduPort_EPS_A_FlexRay_OUT_7d601c47_052bff33
        ComTxIPdu: ComTxIPduUnusedAreasDefault=255, ComMinimumDelayTime=0
          ComTxModeTrue
            ComTxMode: ComTxModeMode=PERIODIC, ComTxModeTimePeriod=0.01, ComTxModeTimeOffset=0
          ComTxModeFalse
            ComTxMode: ComTxModeMode=NONE
      e2eGrp_DISP_CC_EPS_grpMap_d85bde33 (ComSignalGroup): ComSignalGroupAccess=ACCESS_NEEDED_BY_OTHER, ComHandleId=3, ComSystemTemplateSignalGroupRef=e2eGrp_DISP_CC_EPS_grpMap
        7 x ComGroupSignal, all with ComSignalEndianness=LITTLE_ENDIAN, ComTransferProperty=TRIGGERED_ON_CHANGE, ComSignalInitValue=0, ComSignalAccess=ACCESS_NEEDED_BY_OTHER:
          sn_39a2ac19c7164f0385b879ca14e85e7b_2_d9a5c75d3be94893aa6dba0ca6c42810_2_4c5ede1d: ComBitPosition=32, ComBitSize=2, ComSignalDataInvalidValue=3, ComSignalType=UINT8, ComHandleId=43, ComSystemTemplateSystemSignalRef=sn_39a2ac19c7164f0385b879ca14e85e7b_2_d9a5c75d3be94893aa6dba0ca6c42810_2
          sn_39a2ac19c7164f0385b879ca14e85e7b_2_dbd0108a94f54fd190c31739eefdc4ca_1_4c5ede1d: ComBitPosition=0, ComBitSize=8, ComSignalType=UINT16, ComHandleId=44, ComSystemTemplateSystemSignalRef=sn_39a2ac19c7164f0385b879ca14e85e7b_2_dbd0108a94f54fd190c31739eefdc4ca_1
          sn_39a2ac19c7164f0385b879ca14e85e7b_2_9051b95afb204671aff526a500db42b7_1_4c5ede1d: ComBitPosition=12, ComBitSize=4, ComSignalDataInvalidValue=15, ComSignalType=UINT8, ComHandleId=41, ComSystemTemplateSystemSignalRef=sn_39a2ac19c7164f0385b879ca14e85e7b_2_9051b95afb204671aff526a500db42b7_1
          sn_39a2ac19c7164f0385b879ca14e85e7b_2_03f1be64196c4e708bef357e7333ae22_1_4c5ede1d: ComBitPosition=8, ComBitSize=4, ComSignalDataInvalidValue=15, ComSignalType=UINT16, ComHandleId=40, ComSystemTemplateSystemSignalRef=sn_39a2ac19c7164f0385b879ca14e85e7b_2_03f1be64196c4e708bef357e7333ae22_1
          sn_39a2ac19c7164f0385b879ca14e85e7b_2_3366770fef6a4623aee662f9f9c4c3c2_2_4c5ede1d: ComBitPosition=16, ComBitSize=16, ComSignalDataInvalidValue=65535, ComSignalType=UINT16, ComHandleId=42, ComSystemTemplateSystemSignalRef=sn_39a2ac19c7164f0385b879ca14e85e7b_2_3366770fef6a4623aee662f9f9c4c3c2_2
          sn_39a2ac19c7164f0385b879ca14e85e7b_2_3a077345b6d34d0386d92666711189a4_2_4c5ede1d: ComBitPosition=34, ComBitSize=4, ComSignalDataInvalidValue=15, ComSignalType=UINT8, ComHandleId=38, ComSystemTemplateSystemSignalRef=sn_39a2ac19c7164f0385b879ca14e85e7b_2_3a077345b6d34d0386d92666711189a4_2
          sn_39a2ac19c7164f0385b879ca14e85e7b_2_7f3167446bf24e01ba2f382d6ae4ce13_2_4c5ede1d: ComBitPosition=38, ComBitSize=2, ComSignalDataInvalidValue=3, ComSignalType=UINT8, ComHandleId=39, ComSystemTemplateSystemSignalRef=sn_39a2ac19c7164f0385b879ca14e85e7b_2_7f3167446bf24e01ba2f382d6ae4ce13_2
      DBG_EPS_BS_MOD_58_BYTE_23008def (ComIPdu):
        ComIPduDirection = SEND
        ComIPduType = NORMAL
        ComIPduHandleId = 4
        ComIPduSignalProcessing = DEFERRED
        ComIPduCancellationSupport = false
        ComIPduGroupRef = EPS_OUT_PduGroup2_7933cc8b
        ComIPduSignalRef = DBG_EPS_BS_MOD_58_BYTE_CHOV_DBG_MOD_EPS_1182661c
        ComIPduSignalRef = sn_03a68de7c576470bbe5c65893688a981_2_1d95be4f9b5642d8ad66a452046dc075_2_1182661c
        ComPduIdRef = pduTr_DBG_EPS_BS_MOD_58_BYTE_A_FlexRay_pduPort_EPS_A_FlexRay_OUT_7d601c47_052bff33
        ComTxIPdu: ComTxIPduUnusedAreasDefault=255, ComMinimumDelayTime=0, ComTxIPduClearUpdateBit=TriggerTransmit
          ComTxModeTrue
            ComTxMode: ComTxModeMode=PERIODIC, ComTxModeTimePeriod=0.02, ComTxModeTimeOffset=0
          ComTxModeFalse
            ComTxMode: ComTxModeMode=NONE
      OFFS_QUAD_EPS_23008def (ComIPdu):
        ComIPduDirection = RECEIVE
        ComIPduType = NORMAL
        ComIPduHandleId = 14
        ComIPduSignalProcessing = DEFERRED
        ComIPduCancellationSupport = false
        ComIPduGroupRef = EPS_IN_PduGroup3_7933cc8b
        ComIPduSignalGroupRef = e2eGrp_OFFS_QUAD_EPS_grpMap_432fe468
        ComPduIdRef = pduTr_OFFS_QUAD_EPS_A_FlexRay_pduPort_EPS_A_FlexRay_IN_7d601c47_052bff33
      sn_677e18af96434b57a7947ca5849af5e4_4_db6644741d2e4213ad1bbd931a41dee0_3_a1887d97 (ComSignal):
        ComBitPosition = 0
        ComBitSize = 6
        ComSignalDataInvalidValue = 63
        ComSignalEndianness = LITTLE_ENDIAN
        ComSignalType = UINT8
        ComSignalInitValue = 0
        ComSignalAccess = ACCESS_NEEDED_BY_OTHER
        ComHandleId = 56
        ComSystemTemplateSystemSignalRef = sn_677e18af96434b57a7947ca5849af5e4_4_db6644741d2e4213ad1bbd931a41dee0_3
      signalGrp_SECU_CHAL_grpMap_2a1be51a (ComSignalGroup): ComSignalGroupAccess=ACCESS_NEEDED_BY_OTHER, ComHandleId=7, ComSystemTemplateSignalGroupRef=signalGrp_SECU_CHAL_grpMap
        3 x ComGroupSignal, all with ComSignalEndianness=LITTLE_ENDIAN, ComSignalInitValue=0, ComSignalAccess=ACCESS_NEEDED_BY_OTHER, ComTransferProperty=PENDING:
          sn_25b112f92e6a4ac19aba3c85121b531b_6_1bc03a0847a24be4b9edb43144f45870_1_333ec78a: ComBitPosition=24, ComBitSize=40, ComSignalDataInvalidValue=1099511627775, ComSignalType=UINT64, ComHandleId=35, ComSystemTemplateSystemSignalRef=sn_25b112f92e6a4ac19aba3c85121b531b_6_1bc03a0847a24be4b9edb43144f45870_1
          sn_25b112f92e6a4ac19aba3c85121b531b_6_7502fc35ca3a49b8aec4c3e56a6cec59_2_333ec78a: ComBitPosition=16, ComBitSize=8, ComSignalDataInvalidValue=255, ComSignalType=UINT8, ComHandleId=37, ComSystemTemplateSystemSignalRef=sn_25b112f92e6a4ac19aba3c85121b531b_6_7502fc35ca3a49b8aec4c3e56a6cec59_2
          sn_25b112f92e6a4ac19aba3c85121b531b_6_4e0d346165d34c65a7be51a612d26692_5_333ec78a: ComBitPosition=8, ComBitSize=8, ComSignalDataInvalidValue=255, ComSignalType=UINT8, ComHandleId=36, ComSystemTemplateSystemSignalRef=sn_25b112f92e6a4ac19aba3c85121b531b_6_4e0d346165d34c65a7be51a612d26692_5
      KILOMETERSTAND_23008def (ComIPdu):
        ComIPduDirection = RECEIVE
        ComIPduType = NORMAL
        ComIPduHandleId = 13
        ComIPduSignalProcessing = DEFERRED
        ComIPduCancellationSupport = false
        ComIPduGroupRef = EPS_IN_PduGroup4_7933cc8b
        ComIPduSignalRef = sn_209e4b614ee044c4bbf1020e8ad2a6e0_10_d2a8dd49e0f74a499b91350a40cf3a4b_5_605eb7ca
        ComPduIdRef = pduTr_KILOMETERSTAND_A_FlexRay_pduPort_EPS_A_FlexRay_IN_7d601c47_052bff33
      sn_2d91f731ef854e209f0a9d17b0596648_8_44efad82ff2147cdb10b6291c8cbea3f_3_f361cf54 (ComSignal):
        ComBitPosition = 16
        ComBitSize = 4
        ComSignalDataInvalidValue = 15
        ComSignalEndianness = LITTLE_ENDIAN
        ComSignalType = UINT8
        ComSignalInitValue = 0
        ComSignalAccess = ACCESS_NEEDED_BY_OTHER
        ComHandleId = 27
        ComTransferProperty = PENDING
        ComSystemTemplateSystemSignalRef = sn_2d91f731ef854e209f0a9d17b0596648_8_44efad82ff2147cdb10b6291c8cbea3f_3
      A_TEMP_23008def (ComIPdu):
        ComIPduDirection = RECEIVE
        ComIPduType = NORMAL
        ComIPduHandleId = 3
        ComIPduSignalProcessing = DEFERRED
        ComIPduCancellationSupport = false
        ComIPduGroupRef = EPS_IN_PduGroup4_7933cc8b
        ComIPduSignalRef = sn_d0ea1fc2c1ca4e2295bae82b1e156e9a_18_710f3e866b434077b7dd882156cb74d0_10_231d7192
        ComPduIdRef = pduTr_A_TEMP_A_FlexRay_pduPort_EPS_A_FlexRay_IN_7d601c47_052bff33
      ERRM_BN_U_23008def (ComIPdu):
        ComIPduDirection = RECEIVE
        ComIPduType = NORMAL
        ComIPduHandleId = 10
        ComIPduSignalProcessing = DEFERRED
        ComIPduCancellationSupport = false
        ComIPduGroupRef = EPS_IN_PduGroup9_7933cc8b
        ComIPduSignalRef = sn_677e18af96434b57a7947ca5849af5e4_4_db6644741d2e4213ad1bbd931a41dee0_3_a1887d97
        ComPduIdRef = pduTr_ERRM_BN_U_A_FlexRay_pduPort_EPS_A_FlexRay_IN_7d601c47_052bff33
      sn_6e55c14d93c64aaa86e33b57aac2ae43_9_42056696541e44238d7385d322aa3305_4_36f7a929 (ComSignal):
        ComBitPosition = 20
        ComBitSize = 4
        ComSignalDataInvalidValue = 15
        ComSignalEndianness = LITTLE_ENDIAN
        ComSignalType = UINT8
        ComSignalInitValue = 0
        ComSignalAccess = ACCESS_NEEDED_BY_OTHER
        ComHandleId = 28
        ComSystemTemplateSystemSignalRef = sn_6e55c14d93c64aaa86e33b57aac2ae43_9_42056696541e44238d7385d322aa3305_4
      RQ_STG_EFAN_23008def (ComIPdu):
        ComIPduDirection = SEND
        ComIPduType = NORMAL
        ComIPduHandleId = 9
        ComIPduSignalProcessing = DEFERRED
        ComIPduCancellationSupport = false
        ComIPduGroupRef = EPS_OUT_PduGroup2_7933cc8b
        ComIPduSignalRef = RQ_STG_EFAN_ID2_f361cf54
        ComIPduSignalRef = sn_2d91f731ef854e209f0a9d17b0596648_8_44efad82ff2147cdb10b6291c8cbea3f_3_f361cf54
        ComIPduSignalRef = sn_2d91f731ef854e209f0a9d17b0596648_8_5c6ec9e5beec46c09ef86c7818a9cbf6_3_f361cf54
        ComIPduSignalRef = sn_2d91f731ef854e209f0a9d17b0596648_8_6c1ea235872142cfbe3d872d17caa2ae_3_f361cf54
        ComIPduSignalRef = sn_2d91f731ef854e209f0a9d17b0596648_8_c06c9dcca09a433db7ff26cc5c43b9ad_5_f361cf54
        ComPduIdRef = pduTr_RQ_STG_EFAN_A_FlexRay_pduPort_EPS_A_FlexRay_OUT_7d601c47_052bff33
        ComTxIPdu: ComTxIPduUnusedAreasDefault=255, ComMinimumDelayTime=0, ComTxIPduClearUpdateBit=TriggerTransmit
          ComTxModeTrue
            ComTxMode: ComTxModeMode=PERIODIC, ComTxModeTimePeriod=1, ComTxModeTimeOffset=0
          ComTxModeFalse
            ComTxMode: ComTxModeMode=NONE
      e2eGrp_ST_EST_grpMap_1efe9fd4 (ComSignalGroup): ComSignalGroupAccess=ACCESS_NEEDED_BY_OTHER, ComHandleId=5, ComSystemTemplateSignalGroupRef=e2eGrp_ST_EST_grpMap
        6 x ComGroupSignal, all with ComSignalEndianness=LITTLE_ENDIAN, ComSignalType=UINT8, ComSignalAccess=ACCESS_NEEDED_BY_OTHER:
          ST_EST_dummy_16_23_2f274d97: ComBitPosition=16, ComBitSize=8, ComSignalInitValue=255, ComTransferProperty=PENDING, ComHandleId=11, ComSystemTemplateSystemSignalRef=ST_EST_dummy_16_23
          sn_0d521c7c53964f869478fa5c12f4ec50_14_754efa353cf340fcb5ebf6a252677ba9_1_2f274d97: ComBitPosition=8, ComBitSize=4, ComSignalDataInvalidValue=15, ComTransferProperty=TRIGGERED_ON_CHANGE, ComSignalInitValue=0, ComHandleId=18, ComSystemTemplateSystemSignalRef=sn_0d521c7c53964f869478fa5c12f4ec50_14_754efa353cf340fcb5ebf6a252677ba9_1
          sn_0d521c7c53964f869478fa5c12f4ec50_14_4b5d00d65aef4a05b869d24584abb8c4_1_2f274d97: ComBitPosition=0, ComBitSize=8, ComTransferProperty=TRIGGERED_ON_CHANGE, ComSignalInitValue=0, ComHandleId=15, ComSystemTemplateSystemSignalRef=sn_0d521c7c53964f869478fa5c12f4ec50_14_4b5d00d65aef4a05b869d24584abb8c4_1
          sn_0d521c7c53964f869478fa5c12f4ec50_14_8fcd25d281bf43f7836594d2433bdf22_11_2f274d97: ComBitPosition=32, ComBitSize=8, ComSignalDataInvalidValue=255, ComTransferProperty=TRIGGERED_ON_CHANGE, ComSignalInitValue=0, ComHandleId=16, ComSystemTemplateSystemSignalRef=sn_0d521c7c53964f869478fa5c12f4ec50_14_8fcd25d281bf43f7836594d2433bdf22_11
          sn_0d521c7c53964f869478fa5c12f4ec50_14_cab340b35df54638b5e0037eab93598a_8_2f274d97: ComBitPosition=24, ComBitSize=8, ComSignalDataInvalidValue=255, ComTransferProperty=TRIGGERED_ON_CHANGE, ComSignalInitValue=0, ComHandleId=19, ComSystemTemplateSystemSignalRef=sn_0d521c7c53964f869478fa5c12f4ec50_14_cab340b35df54638b5e0037eab93598a_8
          sn_0d521c7c53964f869478fa5c12f4ec50_14_296a2827f3ac4a3cb35d9abfed66395a_2_2f274d97: ComBitPosition=12, ComBitSize=4, ComSignalDataInvalidValue=15, ComTransferProperty=TRIGGERED_ON_CHANGE, ComSignalInitValue=0, ComHandleId=17, ComSystemTemplateSystemSignalRef=sn_0d521c7c53964f869478fa5c12f4ec50_14_296a2827f3ac4a3cb35d9abfed66395a_2
      signalGrp_SECU_RESP_grpMap_a6936a2f (ComSignalGroup): ComSignalGroupAccess=ACCESS_NEEDED_BY_OTHER, ComHandleId=13, ComSystemTemplateSignalGroupRef=signalGrp_SECU_RESP_grpMap
        3 x ComGroupSignal, all with ComSignalEndianness=LITTLE_ENDIAN, ComSignalInitValue=0, ComSignalAccess=ACCESS_NEEDED_BY_OTHER:
          sn_7524fb1868df47f692f20496abf88623_7_2ff2dc8921534b0db2b87c288a2967c1_2_fb35a62b: ComBitPosition=16, ComBitSize=24, ComSignalDataInvalidValue=16777215, ComSignalType=UINT32, ComHandleId=67, ComSystemTemplateSystemSignalRef=sn_7524fb1868df47f692f20496abf88623_7_2ff2dc8921534b0db2b87c288a2967c1_2
          sn_7524fb1868df47f692f20496abf88623_7_c199b38f0c704ce58dde1ab6957e021b_2_fb35a62b: ComBitPosition=40, ComBitSize=24, ComSignalDataInvalidValue=16777215, ComSignalType=UINT32, ComHandleId=69, ComSystemTemplateSystemSignalRef=sn_7524fb1868df47f692f20496abf88623_7_c199b38f0c704ce58dde1ab6957e021b_2
          sn_7524fb1868df47f692f20496abf88623_7_9a19746025ce47f3b7cd9c9e81e8631b_6_fb35a62b: ComBitPosition=8, ComBitSize=8, ComSignalDataInvalidValue=255, ComSignalType=UINT8, ComHandleId=68, ComSystemTemplateSystemSignalRef=sn_7524fb1868df47f692f20496abf88623_7_9a19746025ce47f3b7cd9c9e81e8631b_6
      VYAW_VEH_23008def (ComIPdu):
        ComIPduDirection = RECEIVE
        ComIPduType = NORMAL
        ComIPduHandleId = 26
        ComIPduSignalProcessing = DEFERRED
        ComIPduCancellationSupport = false
        ComIPduGroupRef = EPS_IN_PduGroup3_7933cc8b
        ComIPduSignalGroupRef = e2eGrp_VYAW_VEH_grpMap_72ad5356
        ComPduIdRef = pduTr_VYAW_VEH_A_FlexRay_pduPort_EPS_A_FlexRay_IN_7d601c47_052bff33
      sn_809234ffb6e24e4eb85479b73d250d21_49_761b4cd9ec7e47aeb030258f54c21bfc_46_434514f6_In (ComSignal):
        ComBitPosition = 8
        ComBitSize = 16
        ComSignalDataInvalidValue = 65535
        ComSignalEndianness = LITTLE_ENDIAN
        ComSignalType = UINT16
        ComSignalInitValue = 0
        ComSignalAccess = ACCESS_NEEDED_BY_OTHER
        ComHandleId = 85
        ComSystemTemplateSystemSignalRef = sn_809234ffb6e24e4eb85479b73d250d21_49_761b4cd9ec7e47aeb030258f54c21bfc_46
      e2eGrp_OFFS_QUAD_EPS_grpMap_432fe468 (ComSignalGroup): ComSignalGroupAccess=ACCESS_NEEDED_BY_OTHER, ComHandleId=5, ComSystemTemplateSignalGroupRef=e2eGrp_OFFS_QUAD_EPS_grpMap
        5 x ComGroupSignal, all with ComSignalEndianness=LITTLE_ENDIAN, ComSignalInitValue=0, ComSignalAccess=ACCESS_NEEDED_BY_OTHER:
          sn_2538d099b88d4657ae03c10c9544a047_14_2fc2cc0e152644629cc3240b5c954053_8_aae17425: ComBitPosition=12, ComBitSize=4, ComSignalDataInvalidValue=15, ComSignalType=UINT8, ComHandleId=57, ComSystemTemplateSystemSignalRef=sn_2538d099b88d4657ae03c10c9544a047_14_2fc2cc0e152644629cc3240b5c954053_8
          sn_2538d099b88d4657ae03c10c9544a047_14_3ff1e0a352104d0a9c0d95219caf3334_3_aae17425: ComBitPosition=24, ComBitSize=16, ComSignalDataInvalidValue=65535, ComSignalType=UINT16, ComHandleId=58, ComSystemTemplateSystemSignalRef=sn_2538d099b88d4657ae03c10c9544a047_14_3ff1e0a352104d0a9c0d95219caf3334_3
          sn_2538d099b88d4657ae03c10c9544a047_14_4f6b0f607df24896b0faa952446b326c_3_aae17425: ComBitPosition=0, ComBitSize=8, ComSignalType=UINT8, ComHandleId=59, ComSystemTemplateSystemSignalRef=sn_2538d099b88d4657ae03c10c9544a047_14_4f6b0f607df24896b0faa952446b326c_3
          sn_2538d099b88d4657ae03c10c9544a047_14_9f5b4c46afdb4c73b63aa906d0ef32e2_2_aae17425: ComBitPosition=8, ComBitSize=4, ComSignalDataInvalidValue=15, ComSignalType=UINT8, ComHandleId=60, ComSystemTemplateSystemSignalRef=sn_2538d099b88d4657ae03c10c9544a047_14_9f5b4c46afdb4c73b63aa906d0ef32e2_2
          sn_2538d099b88d4657ae03c10c9544a047_14_05a1cc95f1f243009d0e0e5041123079_3_aae17425: ComBitPosition=16, ComBitSize=8, ComSignalDataInvalidValue=255, ComSignalType=UINT8, ComHandleId=61, ComSystemTemplateSystemSignalRef=sn_2538d099b88d4657ae03c10c9544a047_14_05a1cc95f1f243009d0e0e5041123079_3
      TAR_QTA_STRMOM_DV_23008def (ComIPdu):
        ComIPduDirection = RECEIVE
        ComIPduType = NORMAL
        ComIPduHandleId = 24
        ComIPduSignalProcessing = DEFERRED
        ComIPduCancellationSupport = false
        ComIPduGroupRef = EPS_IN_PduGroup3_7933cc8b
        ComIPduSignalGroupRef = e2eGrp_TAR_QTA_STRMOM_DV_grpMap_47595eaf
        ComPduIdRef = pduTr_TAR_QTA_STRMOM_DV_A_FlexRay_pduPort_EPS_A_FlexRay_IN_7d601c47_052bff33
      SECU_RESP_23008def (ComIPdu):
        ComIPduDirection = RECEIVE
        ComIPduType = NORMAL
        ComIPduHandleId = 17
        ComIPduSignalProcessing = DEFERRED
        ComIPduCancellationSupport = false
        ComIPduGroupRef = EPS_IN_PduGroup4_7933cc8b
        ComIPduSignalGroupRef = signalGrp_SECU_RESP_grpMap_a6936a2f
        ComIPduSignalRef = SECU_RESP_ID2_a6936a2f
        ComPduIdRef = pduTr_SECU_RESP_A_FlexRay_pduPort_EPS_A_FlexRay_IN_7d601c47_052bff33
      sn_eb2aaf9fde954786857e30879fbebab8_4_32a695e8944f440980b86e5c6a1148d5_1_e1b92573 (ComSignal):
        ComBitPosition = 2
        ComBitSize = 2
        ComSignalDataInvalidValue = 3
        ComSignalEndianness = LITTLE_ENDIAN
        ComSignalType = UINT8
        ComSignalInitValue = 0
        ComSignalAccess = ACCESS_NEEDED_BY_OTHER
        ComHandleId = 111
        ComSystemTemplateSystemSignalRef = sn_eb2aaf9fde954786857e30879fbebab8_4_32a695e8944f440980b86e5c6a1148d5_1
      EPS_OUT_PduGroup3_7933cc8b (ComIPduGroup): ComIPduGroupHandleId=11
      e2eGrp_SU_EPS_grpMap_96d77004 (ComSignalGroup): ComSignalGroupAccess=ACCESS_NEEDED_BY_OTHER, ComHandleId=6, ComSystemTemplateSignalGroupRef=e2eGrp_SU_EPS_grpMap
        6 x ComGroupSignal, all with ComSignalEndianness=LITTLE_ENDIAN, ComSignalAccess=ACCESS_NEEDED_BY_OTHER, ComTransferProperty=PENDING:
          sn_ecced8165aea4835a2a17dc224344598_4_9a6a7a66988546f2a7d23dc165ed871a_3_e213077e: ComBitPosition=12, ComBitSize=2, ComSignalDataInvalidValue=3, ComSignalType=UINT8, ComSignalInitValue=0, ComHandleId=65, ComSystemTemplateSystemSignalRef=sn_ecced8165aea4835a2a17dc224344598_4_9a6a7a66988546f2a7d23dc165ed871a_3
          sn_ecced8165aea4835a2a17dc224344598_4_386a693e6a3e40caa81d96e20ae491f1_1_e213077e: ComBitPosition=52, ComBitSize=4, ComSignalDataInvalidValue=15, ComSignalType=UINT8, ComSignalInitValue=0, ComHandleId=67, ComSystemTemplateSystemSignalRef=sn_ecced8165aea4835a2a17dc224344598_4_386a693e6a3e40caa81d96e20ae491f1_1
          sn_ecced8165aea4835a2a17dc224344598_4_64d37827c64341ab93bbfe7c6e1f91a0_1_e213077e: ComBitPosition=56, ComBitSize=8, ComSignalType=UINT8, ComSignalInitValue=0, ComHandleId=66, ComSystemTemplateSystemSignalRef=sn_ecced8165aea4835a2a17dc224344598_4_64d37827c64341ab93bbfe7c6e1f91a0_1
          sn_ecced8165aea4835a2a17dc224344598_4_222481f9d4fd4d26baca286fbee3bf96_3_e213077e: ComBitPosition=0, ComBitSize=12, ComSignalDataInvalidValue=4095, ComSignalType=UINT16, ComSignalInitValue=0, ComHandleId=68, ComSystemTemplateSystemSignalRef=sn_ecced8165aea4835a2a17dc224344598_4_222481f9d4fd4d26baca286fbee3bf96_3
          SU_EPS_dummy_14_19_e213077e: ComBitPosition=14, ComBitSize=6, ComSignalInitValue=63, ComSignalType=UINT8, ComHandleId=12, ComSystemTemplateSystemSignalRef=SU_EPS_dummy_14_19
          SU_EPS_dummy_20_51_e213077e: ComBitPosition=20, ComBitSize=32, ComSignalInitValue=4294967295, ComSignalType=UINT32, ComHandleId=13, ComSystemTemplateSystemSignalRef=SU_EPS_dummy_20_51
      sn_8e1fc510f7a3427998068160382540c0_4_84e2267531a54593b0ba6603319c899d_1_262fad9b (ComSignal):
        ComBitPosition = 54
        ComBitSize = 2
        ComSignalDataInvalidValue = 3
        ComSignalEndianness = LITTLE_ENDIAN
        ComSignalType = UINT8
        ComSignalInitValue = 0
        ComSignalAccess = ACCESS_NEEDED_BY_OTHER
        ComHandleId = 32
        ComSystemTemplateSystemSignalRef = sn_8e1fc510f7a3427998068160382540c0_4_84e2267531a54593b0ba6603319c899d_1
      EPS_IN_PduGroup_7933cc8b (ComIPduGroup): ComIPduGroupHandleId=9
      STEA_OFFS_23008def (ComIPdu):
        ComIPduDirection = RECEIVE
        ComIPduType = NORMAL
        ComIPduHandleId = 18
        ComIPduSignalProcessing = DEFERRED
        ComIPduCancellationSupport = false
        ComIPduGroupRef = EPS_IN_PduGroup_7933cc8b
        ComIPduSignalRef = sn_55e086fa3cb3405c9e0849033f661450_11_389ce921618246489b7062f81bb683c4_4_e39ca898
        ComPduIdRef = pduTr_STEA_OFFS_A_FlexRay_pduPort_EPS_A_FlexRay_IN_7d601c47_052bff33
      e2eGrp_VYAW_VEH_grpMap_72ad5356 (ComSignalGroup): ComSignalGroupAccess=ACCESS_NEEDED_BY_OTHER, ComHandleId=9, ComSystemTemplateSignalGroupRef=e2eGrp_VYAW_VEH_grpMap
        6 x ComGroupSignal, all with ComSignalEndianness=LITTLE_ENDIAN, ComSignalAccess=ACCESS_NEEDED_BY_OTHER:
          VYAW_VEH_dummy_12_15_2b4fea7b: ComBitPosition=12, ComBitSize=4, ComSignalInitValue=15, ComSignalType=UINT8, ComHandleId=13, ComSystemTemplateSystemSignalRef=VYAW_VEH_dummy_12_15
          sn_27f7c756a0e24349b8e230b415458184_21_dcf5f5dfbfc44ee8a71982dfd4598bc5_6_2b4fea7b: ComBitPosition=16, ComBitSize=16, ComSignalDataInvalidValue=65535, ComSignalType=UINT16, ComSignalInitValue=0, ComHandleId=39, ComSystemTemplateSystemSignalRef=sn_27f7c756a0e24349b8e230b415458184_21_dcf5f5dfbfc44ee8a71982dfd4598bc5_6
          sn_27f7c756a0e24349b8e230b415458184_21_ad0347b6319e42198d41356e86be4f37_1_2b4fea7b: ComBitPosition=8, ComBitSize=4, ComSignalDataInvalidValue=15, ComSignalType=UINT8, ComSignalInitValue=0, ComHandleId=38, ComSystemTemplateSystemSignalRef=sn_27f7c756a0e24349b8e230b415458184_21_ad0347b6319e42198d41356e86be4f37_1
          sn_27f7c756a0e24349b8e230b415458184_21_29337f740ab54247baf7c3db99524333_14_2b4fea7b: ComBitPosition=44, ComBitSize=4, ComSignalDataInvalidValue=15, ComSignalType=UINT8, ComSignalInitValue=0, ComHandleId=36, ComSystemTemplateSystemSignalRef=sn_27f7c756a0e24349b8e230b415458184_21_29337f740ab54247baf7c3db99524333_14
          sn_27f7c756a0e24349b8e230b415458184_21_a941ebecb6a441e187826da1c487d2c2_3_2b4fea7b: ComBitPosition=32, ComBitSize=12, ComSignalDataInvalidValue=4095, ComSignalType=UINT16, ComSignalInitValue=0, ComHandleId=37, ComSystemTemplateSystemSignalRef=sn_27f7c756a0e24349b8e230b415458184_21_a941ebecb6a441e187826da1c487d2c2_3
          sn_27f7c756a0e24349b8e230b415458184_21_f9901bb3bb2044b6b25a6dfbc223991d_2_2b4fea7b: ComBitPosition=0, ComBitSize=8, ComSignalType=UINT8, ComSignalInitValue=0, ComHandleId=40, ComSystemTemplateSystemSignalRef=sn_27f7c756a0e24349b8e230b415458184_21_f9901bb3bb2044b6b25a6dfbc223991d_2
      e2eGrp_ACLNY_MASSCNTR_grpMap_809f87ed (ComSignalGroup): ComSignalGroupAccess=ACCESS_NEEDED_BY_OTHER, ComHandleId=0, ComSystemTemplateSignalGroupRef=e2eGrp_ACLNY_MASSCNTR_grpMap
        6 x ComGroupSignal, all with ComSignalEndianness=LITTLE_ENDIAN, ComSignalAccess=ACCESS_NEEDED_BY_OTHER:
          sn_060886cf9e88403f9df14c319aa0ae95_20_4b53f7b0fac04e8faf5f3bd3a6602934_8_676acd3b: ComBitPosition=16, ComBitSize=16, ComSignalDataInvalidValue=65535, ComSignalType=UINT16, ComSignalInitValue=0, ComHandleId=82, ComSystemTemplateSystemSignalRef=sn_060886cf9e88403f9df14c319aa0ae95_20_4b53f7b0fac04e8faf5f3bd3a6602934_8
          ACLNY_MASSCNTR_dummy_12_15_676acd3b: ComBitPosition=12, ComBitSize=4, ComSignalInitValue=15, ComSignalType=UINT8, ComHandleId=0, ComSystemTemplateSystemSignalRef=ACLNY_MASSCNTR_dummy_12_15
          sn_060886cf9e88403f9df14c319aa0ae95_20_1d92c110be454e9fa86cf52886346abe_6_676acd3b: ComBitPosition=32, ComBitSize=12, ComSignalDataInvalidValue=4095, ComSignalType=UINT16, ComSignalInitValue=0, ComHandleId=80, ComSystemTemplateSystemSignalRef=sn_060886cf9e88403f9df14c319aa0ae95_20_1d92c110be454e9fa86cf52886346abe_6
          sn_060886cf9e88403f9df14c319aa0ae95_20_d9ef5705d16b4542a9b87a1f657a1821_13_676acd3b: ComBitPosition=44, ComBitSize=4, ComSignalDataInvalidValue=15, ComSignalType=UINT8, ComSignalInitValue=0, ComHandleId=83, ComSystemTemplateSystemSignalRef=sn_060886cf9e88403f9df14c319aa0ae95_20_d9ef5705d16b4542a9b87a1f657a1821_13
          sn_060886cf9e88403f9df14c319aa0ae95_20_ec8233ebea8b4ff38f6cf06a75f47ec9_2_676acd3b: ComBitPosition=0, ComBitSize=8, ComSignalType=UINT8, ComSignalInitValue=0, ComHandleId=84, ComSystemTemplateSystemSignalRef=sn_060886cf9e88403f9df14c319aa0ae95_20_ec8233ebea8b4ff38f6cf06a75f47ec9_2
          sn_060886cf9e88403f9df14c319aa0ae95_20_3cec4cbf6b9349a88cfd5b60e201d60d_1_676acd3b: ComBitPosition=8, ComBitSize=4, ComSignalDataInvalidValue=15, ComSignalType=UINT8, ComSignalInitValue=0, ComHandleId=81, ComSystemTemplateSystemSignalRef=sn_060886cf9e88403f9df14c319aa0ae95_20_3cec4cbf6b9349a88cfd5b60e201d60d_1
      ENERG_DGR_DRDY_23008def (ComIPdu):
        ComIPduDirection = RECEIVE
        ComIPduType = NORMAL
        ComIPduHandleId = 8
        ComIPduSignalProcessing = DEFERRED
        ComIPduCancellationSupport = false
        ComIPduGroupRef = EPS_IN_PduGroup8_7933cc8b
        ComIPduSignalGroupRef = e2eGrp_ENERG_DGR_DRDY_grpMap_f9f50c8f
        ComPduIdRef = pduTr_ENERG_DGR_DRDY_A_FlexRay_pduPort_EPS_A_FlexRay_IN_7d601c47_052bff33
      3 x ComSignal, all with ComBitSize=8, ComSignalEndianness=LITTLE_ENDIAN, ComSignalType=UINT8, ComSignalAccess=ACCESS_NEEDED_BY_OTHER:
        SECU_CHAL_ID2_2a1be51a: ComBitPosition=0, ComSignalInitValue=248, ComTransferProperty=PENDING, ComHandleId=10, ComSystemTemplateSystemSignalRef=SECU_CHAL_ID2
        DBG_EPS_BS_MOD_58_BYTE_CHOV_DBG_MOD_EPS_1182661c: ComBitPosition=0, ComSignalInitValue=1, ComTransferProperty=PENDING, ComHandleId=3, ComSystemTemplateSystemSignalRef=DBG_EPS_BS_MOD_58_BYTE_CHOV_DBG_MOD_EPS
        sn_04b89dc3c26d4ca08465c4eec950ef56_8_1ef5db97b1344b9b93faeb7438eb9f92_3_3bc7fd4a: ComBitPosition=16, ComSignalDataInvalidValue=255, ComSignalInitValue=0, ComHandleId=34, ComSystemTemplateSystemSignalRef=sn_04b89dc3c26d4ca08465c4eec950ef56_8_1ef5db97b1344b9b93faeb7438eb9f92_3
      FZZSTD_23008def (ComIPdu):
        ComIPduDirection = RECEIVE
        ComIPduType = NORMAL
        ComIPduHandleId = 12
        ComIPduSignalProcessing = DEFERRED
        ComIPduCancellationSupport = false
        ComIPduGroupRef = EPS_IN_PduGroup4_7933cc8b
        ComIPduSignalRef = sn_47c848be64324d52af177d4eda36b369_12_27e33d21d6a8482f85f2064fac78c9e8_4_8f561bce
        ComIPduSignalRef = sn_47c848be64324d52af177d4eda36b369_12_d340d69f4388438e9ec7442ceae02261_3_8f561bce
        ComPduIdRef = pduTr_FZZSTD_A_FlexRay_pduPort_EPS_A_FlexRay_IN_7d601c47_052bff33
      CON_VEH_23008def (ComIPdu):
        ComIPduDirection = RECEIVE
        ComIPduType = NORMAL
        ComIPduHandleId = 4
        ComIPduSignalProcessing = DEFERRED
        ComIPduCancellationSupport = false
        ComIPduGroupRef = EPS_IN_PduGroup5_7933cc8b
        ComIPduSignalGroupRef = e2eGrp_CON_VEH_grpMap_125c48d9
        ComPduIdRef = pduTr_CON_VEH_A_FlexRay_pduPort_EPS_A_FlexRay_IN_7d601c47_052bff33
      sn_809234ffb6e24e4eb85479b73d250d21_49_761b4cd9ec7e47aeb030258f54c21bfc_46_434514f6_Out (ComSignal):
        ComBitPosition = 8
        ComBitSize = 16
        ComSignalDataInvalidValue = 65535
        ComSignalEndianness = LITTLE_ENDIAN
        ComSignalType = UINT16
        ComSignalInitValue = 0
        ComSignalAccess = ACCESS_NEEDED_BY_OTHER
        ComHandleId = 56
        ComTransferProperty = PENDING
        ComSystemTemplateSystemSignalRef = sn_809234ffb6e24e4eb85479b73d250d21_49_761b4cd9ec7e47aeb030258f54c21bfc_46
      3 x ComSignalGroup, all with ComSignalGroupAccess=ACCESS_NEEDED_BY_OTHER:
        e2eGrp_TAR_ESTP_VIRT_FTAX_grpMap_37ba0a72: ComHandleId=6, ComSystemTemplateSignalGroupRef=e2eGrp_TAR_ESTP_VIRT_FTAX_grpMap
          5 x ComGroupSignal, all with ComSignalEndianness=LITTLE_ENDIAN, ComSignalAccess=ACCESS_NEEDED_BY_OTHER:
            sn_12963b5f55914150b9f8aacada47bf44_5_807fb1a14891422faa61d2a17c3da182_2_fbd12829: ComBitPosition=0, ComBitSize=8, ComSignalType=UINT8, ComSignalInitValue=0, ComHandleId=79, ComSystemTemplateSystemSignalRef=sn_12963b5f55914150b9f8aacada47bf44_5_807fb1a14891422faa61d2a17c3da182_2
            TAR_ESTP_VIRT_FTAX_dummy_12_31_fbd12829: ComBitPosition=12, ComBitSize=20, ComSignalInitValue=1048575, ComSignalType=UINT32, ComHandleId=8, ComSystemTemplateSystemSignalRef=TAR_ESTP_VIRT_FTAX_dummy_12_31
            sn_12963b5f55914150b9f8aacada47bf44_5_85d7b190f15d4a06b4b7635543b8f0b4_1_fbd12829: ComBitPosition=32, ComBitSize=4, ComSignalDataInvalidValue=15, ComSignalType=UINT8, ComSignalInitValue=0, ComHandleId=77, ComSystemTemplateSystemSignalRef=sn_12963b5f55914150b9f8aacada47bf44_5_85d7b190f15d4a06b4b7635543b8f0b4_1
            TAR_ESTP_VIRT_FTAX_dummy_36_63_fbd12829: ComBitPosition=36, ComBitSize=28, ComSignalInitValue=268435455, ComSignalType=UINT32, ComHandleId=9, ComSystemTemplateSystemSignalRef=TAR_ESTP_VIRT_FTAX_dummy_36_63
            sn_12963b5f55914150b9f8aacada47bf44_5_301b3a8e3bed4861b26f50db718b7694_2_fbd12829: ComBitPosition=8, ComBitSize=4, ComSignalDataInvalidValue=15, ComSignalType=UINT8, ComSignalInitValue=0, ComHandleId=78, ComSystemTemplateSystemSignalRef=sn_12963b5f55914150b9f8aacada47bf44_5_301b3a8e3bed4861b26f50db718b7694_2
        e2eGrp_TAR_STMOM_DV_ACT_grpMap_b5764fca: ComHandleId=8, ComSystemTemplateSignalGroupRef=e2eGrp_TAR_STMOM_DV_ACT_grpMap
          8 x ComGroupSignal, all with ComSignalEndianness=LITTLE_ENDIAN, ComSignalAccess=ACCESS_NEEDED_BY_OTHER:
            sn_d81fd7307a29409f9d9a2c110d5f1a3d_9_3c6da90ea4cd420aa202db115effcb23_1_b1b7a1e4: ComBitPosition=0, ComBitSize=8, ComSignalType=UINT8, ComSignalInitValue=0, ComHandleId=105, ComSystemTemplateSystemSignalRef=sn_d81fd7307a29409f9d9a2c110d5f1a3d_9_3c6da90ea4cd420aa202db115effcb23_1
            sn_d81fd7307a29409f9d9a2c110d5f1a3d_9_f16d3d92b66746088f0af6e7df5b55bc_1_b1b7a1e4: ComBitPosition=52, ComBitSize=4, ComSignalDataInvalidValue=15, ComSignalType=UINT8, ComSignalInitValue=0, ComHandleId=109, ComSystemTemplateSystemSignalRef=sn_d81fd7307a29409f9d9a2c110d5f1a3d_9_f16d3d92b66746088f0af6e7df5b55bc_1
            sn_d81fd7307a29409f9d9a2c110d5f1a3d_9_2ba2c3f5c45f4aa083a493868834ad5f_3_b1b7a1e4: ComBitPosition=16, ComBitSize=12, ComSignalDataInvalidValue=4095, ComSignalType=UINT16, ComSignalInitValue=0, ComHandleId=104, ComSystemTemplateSystemSignalRef=sn_d81fd7307a29409f9d9a2c110d5f1a3d_9_2ba2c3f5c45f4aa083a493868834ad5f_3
            TAR_STMOM_DV_ACT_dummy_12_15_b1b7a1e4: ComBitPosition=12, ComBitSize=4, ComSignalInitValue=15, ComSignalType=UINT8, ComHandleId=11, ComSystemTemplateSystemSignalRef=TAR_STMOM_DV_ACT_dummy_12_15
            sn_d81fd7307a29409f9d9a2c110d5f1a3d_9_ab42396d28584920a6849c6bc0a7cc61_3_b1b7a1e4: ComBitPosition=56, ComBitSize=8, ComSignalDataInvalidValue=255, ComSignalType=UINT8, ComSignalInitValue=0, ComHandleId=108, ComSystemTemplateSystemSignalRef=sn_d81fd7307a29409f9d9a2c110d5f1a3d_9_ab42396d28584920a6849c6bc0a7cc61_3
            sn_d81fd7307a29409f9d9a2c110d5f1a3d_9_6cf29af14ea3476d8815dad896433c2d_1_b1b7a1e4: ComBitPosition=8, ComBitSize=4, ComSignalDataInvalidValue=15, ComSignalType=UINT8, ComSignalInitValue=0, ComHandleId=106, ComSystemTemplateSystemSignalRef=sn_d81fd7307a29409f9d9a2c110d5f1a3d_9_6cf29af14ea3476d8815dad896433c2d_1
            TAR_STMOM_DV_ACT_dummy_32_51_b1b7a1e4: ComBitPosition=32, ComBitSize=20, ComSignalInitValue=1048575, ComSignalType=UINT32, ComHandleId=12, ComSystemTemplateSystemSignalRef=TAR_STMOM_DV_ACT_dummy_32_51
            sn_d81fd7307a29409f9d9a2c110d5f1a3d_9_77c76ee3a9664c3c8c1378b7670411bc_4_b1b7a1e4: ComBitPosition=28, ComBitSize=4, ComSignalDataInvalidValue=15, ComSignalType=UINT8, ComSignalInitValue=0, ComHandleId=107, ComSystemTemplateSystemSignalRef=sn_d81fd7307a29409f9d9a2c110d5f1a3d_9_77c76ee3a9664c3c8c1378b7670411bc_4
        signalGrp_SECU_FAHRGESTELLNUMMER_grpMap_facbc46e: ComHandleId=12, ComSystemTemplateSignalGroupRef=signalGrp_SECU_FAHRGESTELLNUMMER_grpMap
          sn_ff5ad01b69a64f2fa3482d8ab369f18a_3_40470204da694c16804ac00662f4d060_1_8382b89a (ComGroupSignal):
            ComBitPosition = 0
            ComBitSize = 64
            ComSignalDataInvalidValue = 18446744073709551615
            ComSignalEndianness = LITTLE_ENDIAN
            ComSignalType = UINT64
            ComSignalInitValue = 0
            ComSignalAccess = ACCESS_NEEDED_BY_OTHER
            ComHandleId = 118
            ComSystemTemplateSystemSignalRef = sn_ff5ad01b69a64f2fa3482d8ab369f18a_3_40470204da694c16804ac00662f4d060_1
      EPS_OUT_PduGroup2_7933cc8b (ComIPduGroup): ComIPduGroupHandleId=10
      sn_d0ea1fc2c1ca4e2295bae82b1e156e9a_18_710f3e866b434077b7dd882156cb74d0_10_231d7192 (ComSignal):
        ComBitPosition = 0
        ComBitSize = 8
        ComSignalDataInvalidValue = 255
        ComSignalEndianness = LITTLE_ENDIAN
        ComSignalType = UINT8
        ComSignalInitValue = 0
        ComSignalAccess = ACCESS_NEEDED_BY_OTHER
        ComHandleId = 103
        ComSystemTemplateSystemSignalRef = sn_d0ea1fc2c1ca4e2295bae82b1e156e9a_18_710f3e866b434077b7dd882156cb74d0_10
      3 x ComIPdu, all with ComIPduType=NORMAL, ComIPduSignalProcessing=DEFERRED, ComIPduCancellationSupport=false:
        TAR_ESTP_VIRT_FTAX_23008def: ComIPduDirection=RECEIVE, ComIPduHandleId=23, ComIPduGroupRef=EPS_IN_PduGroup3_7933cc8b, ComIPduSignalGroupRef=e2eGrp_TAR_ESTP_VIRT_FTAX_grpMap_37ba0a72, ComPduIdRef=pduTr_TAR_ESTP_VIRT_FTAX_A_FlexRay_pduPort_EPS_A_FlexRay_IN_7d601c47_052bff33
        ENGTORQ_EPS_23008def: ComIPduDirection=SEND, ComIPduHandleId=8, ComIPduGroupRef=EPS_OUT_PduGroup2_7933cc8b, ComIPduSignalRef=sn_0c0ed9ed2c324b648cea19ccfdcf4017_2_e716efb46a29429ebef5b7d5737ff0c0_2_3b1b8e1f, ComPduIdRef=pduTr_ENGTORQ_EPS_A_FlexRay_pduPort_EPS_A_FlexRay_OUT_7d601c47_052bff33
          ComTxIPdu: ComTxIPduUnusedAreasDefault=255, ComMinimumDelayTime=0
            ComTxModeTrue
              ComTxMode: ComTxModeMode=PERIODIC, ComTxModeTimePeriod=0.01, ComTxModeTimeOffset=0
            ComTxModeFalse
              ComTxMode: ComTxModeMode=NONE
        ST_EST_23008def: ComIPduDirection=SEND, ComIPduHandleId=12, ComIPduGroupRef=EPS_OUT_PduGroup2_7933cc8b, ComIPduSignalGroupRef=e2eGrp_ST_EST_grpMap_1efe9fd4, ComPduIdRef=pduTr_ST_EST_A_FlexRay_pduPort_EPS_A_FlexRay_OUT_7d601c47_052bff33
          ComTxIPdu: ComMinimumDelayTime=0.05, ComTxIPduUnusedAreasDefault=255
            ComTxModeTrue
              ComTxMode: ComTxModeMode=MIXED, ComTxModeNumberOfRepetitions=0, ComTxModeTimePeriod=0.5, ComTxModeTimeOffset=0
            ComTxModeFalse
              ComTxMode: ComTxModeMode=NONE
      sn_0c0ed9ed2c324b648cea19ccfdcf4017_2_e716efb46a29429ebef5b7d5737ff0c0_2_3b1b8e1f (ComSignal):
        ComBitPosition = 16
        ComBitSize = 12
        ComSignalDataInvalidValue = 4095
        ComSignalEndianness = LITTLE_ENDIAN
        ComSignalType = UINT16
        ComSignalInitValue = 0
        ComSignalAccess = ACCESS_NEEDED_BY_OTHER
        ComHandleId = 14
        ComTransferProperty = PENDING
        ComSystemTemplateSystemSignalRef = sn_0c0ed9ed2c324b648cea19ccfdcf4017_2_e716efb46a29429ebef5b7d5737ff0c0_2
      e2eGrp_ENERG_DGR_DRDY_grpMap_f9f50c8f (ComSignalGroup): ComSignalGroupAccess=ACCESS_NEEDED_BY_OTHER, ComHandleId=3, ComSystemTemplateSignalGroupRef=e2eGrp_ENERG_DGR_DRDY_grpMap
        10 x ComGroupSignal, all with ComSignalEndianness=LITTLE_ENDIAN, ComSignalType=UINT8, ComSignalAccess=ACCESS_NEEDED_BY_OTHER:
          sn_39c3f0eb640a4f78a081a30d189b0df4_8_549b4cfdad08471bb65ffaa1f7e128c8_4_323657ec: ComBitPosition=16, ComBitSize=8, ComSignalDataInvalidValue=255, ComSignalInitValue=0, ComHandleId=45, ComSystemTemplateSystemSignalRef=sn_39c3f0eb640a4f78a081a30d189b0df4_8_549b4cfdad08471bb65ffaa1f7e128c8_4
          sn_39c3f0eb640a4f78a081a30d189b0df4_8_bdb3f81fb35a4393983b8eef64f811fa_4_323657ec: ComBitPosition=40, ComBitSize=8, ComSignalDataInvalidValue=255, ComSignalInitValue=0, ComHandleId=48, ComSystemTemplateSystemSignalRef=sn_39c3f0eb640a4f78a081a30d189b0df4_8_bdb3f81fb35a4393983b8eef64f811fa_4
          ENERG_DGR_DRDY_dummy_12_15_323657ec: ComBitPosition=12, ComBitSize=4, ComSignalInitValue=15, ComHandleId=4, ComSystemTemplateSystemSignalRef=ENERG_DGR_DRDY_dummy_12_15
          sn_39c3f0eb640a4f78a081a30d189b0df4_8_cb39eb125cc14ed0af249d5d67f8bd8b_2_323657ec: ComBitPosition=8, ComBitSize=4, ComSignalDataInvalidValue=15, ComSignalInitValue=0, ComHandleId=49, ComSystemTemplateSystemSignalRef=sn_39c3f0eb640a4f78a081a30d189b0df4_8_cb39eb125cc14ed0af249d5d67f8bd8b_2
          sn_39c3f0eb640a4f78a081a30d189b0df4_8_14e56c6abcd843b5a26d720ba0d8db8b_2_323657ec: ComBitPosition=48, ComBitSize=4, ComSignalDataInvalidValue=15, ComSignalInitValue=0, ComHandleId=42, ComSystemTemplateSystemSignalRef=sn_39c3f0eb640a4f78a081a30d189b0df4_8_14e56c6abcd843b5a26d720ba0d8db8b_2
          sn_39c3f0eb640a4f78a081a30d189b0df4_8_713c359a278f4f88a03967667e018042_5_323657ec: ComBitPosition=24, ComBitSize=8, ComSignalDataInvalidValue=255, ComSignalInitValue=0, ComHandleId=46, ComSystemTemplateSystemSignalRef=sn_39c3f0eb640a4f78a081a30d189b0df4_8_713c359a278f4f88a03967667e018042_5
          sn_39c3f0eb640a4f78a081a30d189b0df4_8_432289a519914516a899afcf71d1d116_5_323657ec: ComBitPosition=32, ComBitSize=8, ComSignalDataInvalidValue=255, ComSignalInitValue=0, ComHandleId=47, ComSystemTemplateSystemSignalRef=sn_39c3f0eb640a4f78a081a30d189b0df4_8_432289a519914516a899afcf71d1d116_5
          sn_39c3f0eb640a4f78a081a30d189b0df4_8_80b961ffa4074a35943c73f682505d16_1_323657ec: ComBitPosition=52, ComBitSize=4, ComSignalDataInvalidValue=15, ComSignalInitValue=0, ComHandleId=44, ComSystemTemplateSystemSignalRef=sn_39c3f0eb640a4f78a081a30d189b0df4_8_80b961ffa4074a35943c73f682505d16_1
          sn_39c3f0eb640a4f78a081a30d189b0df4_8_44fe0b2f15ac4ee1815b4114ef80ab03_3_323657ec: ComBitPosition=0, ComBitSize=8, ComSignalDataInvalidValue=255, ComSignalInitValue=0, ComHandleId=43, ComSystemTemplateSystemSignalRef=sn_39c3f0eb640a4f78a081a30d189b0df4_8_44fe0b2f15ac4ee1815b4114ef80ab03_3
          sn_39c3f0eb640a4f78a081a30d189b0df4_8_4b239780c76c4895af8a924c1735888d_1_323657ec: ComBitPosition=56, ComBitSize=8, ComSignalInitValue=0, ComHandleId=41, ComSystemTemplateSystemSignalRef=sn_39c3f0eb640a4f78a081a30d189b0df4_8_4b239780c76c4895af8a924c1735888d_1
      DT_EST_23008def (ComIPdu):
        ComIPduDirection = SEND
        ComIPduType = NORMAL
        ComIPduHandleId = 7
        ComIPduSignalProcessing = DEFERRED
        ComIPduCancellationSupport = false
        ComIPduGroupRef = EPS_OUT_PduGroup2_7933cc8b
        ComIPduSignalGroupRef = e2eGrp_DT_EST_grpMap_002dadf7
        ComPduIdRef = pduTr_DT_EST_A_FlexRay_pduPort_EPS_A_FlexRay_OUT_7d601c47_052bff33
        ComTxIPdu: ComTxIPduUnusedAreasDefault=255, ComMinimumDelayTime=0
          ComTxModeTrue
            ComTxMode: ComTxModeMode=PERIODIC, ComTxModeTimePeriod=0.01, ComTxModeTimeOffset=0
          ComTxModeFalse
            ComTxMode: ComTxModeMode=NONE
      EPS_IN_PduGroup5_7933cc8b (ComIPduGroup): ComIPduGroupHandleId=3
      3 x ComSignal, all with ComSignalEndianness=LITTLE_ENDIAN, ComSignalInitValue=0, ComSignalAccess=ACCESS_NEEDED_BY_OTHER:
        sn_acb3c9a426bf4887ba724efd428ad5a4_3_ad2096213c0c47a78c10b4a8c5667464_7_7e6a2fc7: ComBitPosition=0, ComBitSize=32, ComSignalDataInvalidValue=4294967295, ComSignalType=UINT32, ComHandleId=86, ComSystemTemplateSystemSignalRef=sn_acb3c9a426bf4887ba724efd428ad5a4_3_ad2096213c0c47a78c10b4a8c5667464_7
        sn_085b67cff4b142a59fb46d892b9938f0_15_91a4644db3794ecd81aa7b3ba03f0ae0_3_6c696df6: ComBitPosition=56, ComBitSize=4, ComSignalDataInvalidValue=15, ComSignalType=UINT8, ComHandleId=53, ComSystemTemplateSystemSignalRef=sn_085b67cff4b142a59fb46d892b9938f0_15_91a4644db3794ecd81aa7b3ba03f0ae0_3
        sn_2d91f731ef854e209f0a9d17b0596648_8_5c6ec9e5beec46c09ef86c7818a9cbf6_3_f361cf54: ComBitPosition=20, ComBitSize=4, ComSignalDataInvalidValue=15, ComSignalType=UINT8, ComHandleId=25, ComTransferProperty=PENDING, ComSystemTemplateSystemSignalRef=sn_2d91f731ef854e209f0a9d17b0596648_8_5c6ec9e5beec46c09ef86c7818a9cbf6_3
      signalGrp_FAHRGESTELLNUMMER_grpMap_77f31243 (ComSignalGroup): ComSignalGroupAccess=ACCESS_NEEDED_BY_OTHER, ComHandleId=11, ComSystemTemplateSignalGroupRef=signalGrp_FAHRGESTELLNUMMER_grpMap
        7 x ComGroupSignal, all with ComSignalDataInvalidValue=255, ComSignalEndianness=opaque, ComSignalLength=1, ComSignalType=UINT8_N, ComSignalInitValue=0, ComSignalAccess=ACCESS_NEEDED_BY_OTHER:
          sn_9007d271e9154737bbd9f3c54ab3098b_12_0e9104a324b24ea4ab0595d4878193dc_1_cbcf7330: ComBitPosition=40, ComHandleId=70, ComSystemTemplateSystemSignalRef=sn_9007d271e9154737bbd9f3c54ab3098b_12_0e9104a324b24ea4ab0595d4878193dc_1
          sn_9007d271e9154737bbd9f3c54ab3098b_12_b1a3e7f0af954749a8dd6e6cd1539759_1_cbcf7330: ComBitPosition=32, ComHandleId=74, ComSystemTemplateSystemSignalRef=sn_9007d271e9154737bbd9f3c54ab3098b_12_b1a3e7f0af954749a8dd6e6cd1539759_1
          sn_9007d271e9154737bbd9f3c54ab3098b_12_b7c79d0102c449d0aed961fad16e1b7c_1_cbcf7330: ComBitPosition=8, ComHandleId=75, ComSystemTemplateSystemSignalRef=sn_9007d271e9154737bbd9f3c54ab3098b_12_b7c79d0102c449d0aed961fad16e1b7c_1
          sn_9007d271e9154737bbd9f3c54ab3098b_12_a9cb3e40f2dc48a7b222fabc1b1c23d7_1_cbcf7330: ComBitPosition=0, ComHandleId=73, ComSystemTemplateSystemSignalRef=sn_9007d271e9154737bbd9f3c54ab3098b_12_a9cb3e40f2dc48a7b222fabc1b1c23d7_1
          sn_9007d271e9154737bbd9f3c54ab3098b_12_6456fd4fa0c84cd99253c9be9203970d_4_cbcf7330: ComBitPosition=48, ComHandleId=72, ComSystemTemplateSystemSignalRef=sn_9007d271e9154737bbd9f3c54ab3098b_12_6456fd4fa0c84cd99253c9be9203970d_4
          sn_9007d271e9154737bbd9f3c54ab3098b_12_7b4a826f73e44b58ab36a6e9a35d27ee_1_cbcf7330: ComBitPosition=16, ComHandleId=71, ComSystemTemplateSystemSignalRef=sn_9007d271e9154737bbd9f3c54ab3098b_12_7b4a826f73e44b58ab36a6e9a35d27ee_1
          sn_9007d271e9154737bbd9f3c54ab3098b_12_eb6a3d2fe3114adda5fddf46f965e4e9_1_cbcf7330: ComBitPosition=24, ComHandleId=76, ComSystemTemplateSystemSignalRef=sn_9007d271e9154737bbd9f3c54ab3098b_12_eb6a3d2fe3114adda5fddf46f965e4e9_1
      sn_47c848be64324d52af177d4eda36b369_12_27e33d21d6a8482f85f2064fac78c9e8_4_8f561bce (ComSignal):
        ComBitPosition = 16
        ComBitSize = 4
        ComSignalDataInvalidValue = 15
        ComSignalEndianness = LITTLE_ENDIAN
        ComSignalType = UINT8
        ComSignalInitValue = 0
        ComSignalAccess = ACCESS_NEEDED_BY_OTHER
        ComHandleId = 50
        ComSystemTemplateSystemSignalRef = sn_47c848be64324d52af177d4eda36b369_12_27e33d21d6a8482f85f2064fac78c9e8_4
      DISP_CC_EPS_23008def (ComIPdu):
        ComIPduDirection = SEND
        ComIPduType = NORMAL
        ComIPduHandleId = 6
        ComIPduSignalProcessing = DEFERRED
        ComIPduCancellationSupport = false
        ComIPduGroupRef = EPS_OUT_PduGroup2_7933cc8b
        ComIPduSignalGroupRef = e2eGrp_DISP_CC_EPS_grpMap_d85bde33
        ComPduIdRef = pduTr_DISP_CC_EPS_A_FlexRay_pduPort_EPS_A_FlexRay_OUT_7d601c47_052bff33
        ComTxIPdu: ComMinimumDelayTime=0.06, ComTxIPduUnusedAreasDefault=255
          ComTxModeTrue
            ComTxMode: ComTxModeMode=MIXED, ComTxModeNumberOfRepetitions=0, ComTxModeTimePeriod=0.32, ComTxModeTimeOffset=0
          ComTxModeFalse
            ComTxMode: ComTxModeMode=NONE
      SU_EPS_23008def (ComIPdu):
        ComIPduDirection = SEND
        ComIPduType = NORMAL
        ComIPduHandleId = 13
        ComIPduSignalProcessing = DEFERRED
        ComIPduCancellationSupport = false
        ComIPduGroupRef = EPS_OUT_PduGroup2_7933cc8b
        ComIPduSignalGroupRef = e2eGrp_SU_EPS_grpMap_96d77004
        ComPduIdRef = pduTr_SU_EPS_A_FlexRay_pduPort_EPS_A_FlexRay_OUT_7d601c47_052bff33
        ComTxIPdu: ComMinimumDelayTime=0.5, ComTxIPduUnusedAreasDefault=255
          ComTxModeTrue
            ComTxMode: ComTxModeMode=MIXED, ComTxModeNumberOfRepetitions=2, ComTxModeRepetitionPeriod=0.5, ComTxModeTimePeriod=5, ComTxModeTimeOffset=0
          ComTxModeFalse
            ComTxMode: ComTxModeMode=NONE
      sn_209e4b614ee044c4bbf1020e8ad2a6e0_10_d2a8dd49e0f74a499b91350a40cf3a4b_5_605eb7ca (ComSignal):
        ComBitPosition = 0
        ComBitSize = 24
        ComSignalDataInvalidValue = 16777215
        ComSignalEndianness = LITTLE_ENDIAN
        ComSignalType = UINT32
        ComSignalInitValue = 0
        ComSignalAccess = ACCESS_NEEDED_BY_OTHER
        ComHandleId = 55
        ComSystemTemplateSystemSignalRef = sn_209e4b614ee044c4bbf1020e8ad2a6e0_10_d2a8dd49e0f74a499b91350a40cf3a4b_5
      sn_6e55c14d93c64aaa86e33b57aac2ae43_9_663c7f2797d74e12bbabeb2d22f7ba12_3_36f7a929 (ComSignal):
        ComBitPosition = 24
        ComBitSize = 8
        ComSignalDataInvalidValue = 255
        ComSignalEndianness = LITTLE_ENDIAN
        ComSignalType = UINT8
        ComSignalInitValue = 0
        ComSignalAccess = ACCESS_NEEDED_BY_OTHER
        ComHandleId = 27
        ComSystemTemplateSystemSignalRef = sn_6e55c14d93c64aaa86e33b57aac2ae43_9_663c7f2797d74e12bbabeb2d22f7ba12_3
      e2eGrp_V_VEH_grpMap_6a5236f2 (ComSignalGroup): ComSignalGroupAccess=ACCESS_NEEDED_BY_OTHER, ComHandleId=10, ComSystemTemplateSignalGroupRef=e2eGrp_V_VEH_grpMap
        7 x ComGroupSignal, all with ComSignalEndianness=LITTLE_ENDIAN, ComSignalAccess=ACCESS_NEEDED_BY_OTHER:
          sn_af83ce37179a45aca7ac57646532416b_18_405a168a7cd7415d97d9faebd997c5ce_2_8650906f: ComBitPosition=12, ComBitSize=4, ComSignalDataInvalidValue=15, ComSignalType=UINT8, ComSignalInitValue=0, ComHandleId=91, ComSystemTemplateSystemSignalRef=sn_af83ce37179a45aca7ac57646532416b_18_405a168a7cd7415d97d9faebd997c5ce_2
          sn_af83ce37179a45aca7ac57646532416b_18_0e547cbdd62a48f49df4be80e94fa743_11_8650906f: ComBitPosition=36, ComBitSize=3, ComSignalDataInvalidValue=7, ComSignalType=UINT8, ComSignalInitValue=0, ComHandleId=88, ComSystemTemplateSystemSignalRef=sn_af83ce37179a45aca7ac57646532416b_18_0e547cbdd62a48f49df4be80e94fa743_11
          sn_af83ce37179a45aca7ac57646532416b_18_60da722cb98148d7ac583057f3e43e4e_1_8650906f: ComBitPosition=8, ComBitSize=4, ComSignalDataInvalidValue=15, ComSignalType=UINT8, ComSignalInitValue=0, ComHandleId=90, ComSystemTemplateSystemSignalRef=sn_af83ce37179a45aca7ac57646532416b_18_60da722cb98148d7ac583057f3e43e4e_1
          sn_af83ce37179a45aca7ac57646532416b_18_10a739af18c04017a5fa1d5deaaa5b11_2_8650906f: ComBitPosition=0, ComBitSize=8, ComSignalType=UINT8, ComSignalInitValue=0, ComHandleId=89, ComSystemTemplateSystemSignalRef=sn_af83ce37179a45aca7ac57646532416b_18_10a739af18c04017a5fa1d5deaaa5b11_2
          V_VEH_dummy_39_39_8650906f: ComBitPosition=39, ComBitSize=1, ComSignalInitValue=1, ComSignalType=UINT8, ComHandleId=14, ComSystemTemplateSystemSignalRef=V_VEH_dummy_39_39
          sn_af83ce37179a45aca7ac57646532416b_18_0adb5aa0864a48ecbd0facf7a8348e78_9_8650906f: ComBitPosition=32, ComBitSize=4, ComSignalDataInvalidValue=15, ComSignalType=UINT8, ComSignalInitValue=0, ComHandleId=87, ComSystemTemplateSystemSignalRef=sn_af83ce37179a45aca7ac57646532416b_18_0adb5aa0864a48ecbd0facf7a8348e78_9
          sn_af83ce37179a45aca7ac57646532416b_18_c6825405b1e44ee0b8f81e84185f7380_5_8650906f: ComBitPosition=16, ComBitSize=16, ComSignalDataInvalidValue=65535, ComSignalType=UINT16, ComSignalInitValue=0, ComHandleId=92, ComSystemTemplateSystemSignalRef=sn_af83ce37179a45aca7ac57646532416b_18_c6825405b1e44ee0b8f81e84185f7380_5
      DIAG_OBD_ENG_23008def (ComIPdu):
        ComIPduDirection = RECEIVE
        ComIPduType = NORMAL
        ComIPduHandleId = 7
        ComIPduSignalProcessing = DEFERRED
        ComIPduCancellationSupport = false
        ComIPduGroupRef = EPS_IN_PduGroup7_7933cc8b
        ComIPduSignalRef = sn_d8833aa6063240d791b5384f59f75d9a_13_35c5d363e5eb40db9e554c7d4cab4463_5_afa1da25
        ComPduIdRef = pduTr_DIAG_OBD_ENG_A_FlexRay_pduPort_EPS_A_FlexRay_IN_7d601c47_052bff33
      ACLNY_MASSCNTR_23008def (ComIPdu):
        ComIPduDirection = RECEIVE
        ComIPduType = NORMAL
        ComIPduHandleId = 0
        ComIPduSignalProcessing = DEFERRED
        ComIPduCancellationSupport = false
        ComIPduGroupRef = EPS_IN_PduGroup_7933cc8b
        ComIPduSignalGroupRef = e2eGrp_ACLNY_MASSCNTR_grpMap_809f87ed
        ComPduIdRef = pduTr_ACLNY_MASSCNTR_A_FlexRay_pduPort_EPS_A_FlexRay_IN_7d601c47_052bff33
      EPS_IN_PduGroup2_7933cc8b (ComIPduGroup): ComIPduGroupHandleId=0
      e2eGrp_AVL_FORC_GRD_grpMap_4612dae3 (ComSignalGroup): ComSignalGroupAccess=ACCESS_NEEDED_BY_OTHER, ComHandleId=0, ComSystemTemplateSignalGroupRef=e2eGrp_AVL_FORC_GRD_grpMap
        6 x ComGroupSignal, all with ComSignalEndianness=LITTLE_ENDIAN, ComSignalAccess=ACCESS_NEEDED_BY_OTHER, ComTransferProperty=PENDING:
          AVL_FORC_GRD_dummy_12_15_9b458801: ComBitPosition=12, ComBitSize=4, ComSignalInitValue=15, ComSignalType=UINT8, ComHandleId=1, ComSystemTemplateSystemSignalRef=AVL_FORC_GRD_dummy_12_15
          sn_09e4bde6148d45f99746b23c44ef9b67_14_b8a0fa3e4cf64a1ab5fc745baa78e585_2_9b458801: ComBitPosition=8, ComBitSize=4, ComSignalDataInvalidValue=15, ComSignalType=UINT16, ComSignalInitValue=0, ComHandleId=33, ComSystemTemplateSystemSignalRef=sn_09e4bde6148d45f99746b23c44ef9b67_14_b8a0fa3e4cf64a1ab5fc745baa78e585_2
          sn_09e4bde6148d45f99746b23c44ef9b67_14_197c766bc806474bab8b0adb6b45f8af_5_9b458801: ComBitPosition=32, ComBitSize=8, ComSignalDataInvalidValue=255, ComSignalType=UINT16, ComSignalInitValue=0, ComHandleId=32, ComSystemTemplateSystemSignalRef=sn_09e4bde6148d45f99746b23c44ef9b67_14_197c766bc806474bab8b0adb6b45f8af_5
          sn_09e4bde6148d45f99746b23c44ef9b67_14_2ff2d3a958b44ed3bf7b9b844a310c8a_5_9b458801: ComBitPosition=16, ComBitSize=12, ComSignalDataInvalidValue=4095, ComSignalType=UINT16, ComSignalInitValue=0, ComHandleId=30, ComSystemTemplateSystemSignalRef=sn_09e4bde6148d45f99746b23c44ef9b67_14_2ff2d3a958b44ed3bf7b9b844a310c8a_5
          sn_09e4bde6148d45f99746b23c44ef9b67_14_3c4236203a2749bcbb2aed6382953164_2_9b458801: ComBitPosition=0, ComBitSize=8, ComSignalType=UINT16, ComSignalInitValue=0, ComHandleId=31, ComSystemTemplateSystemSignalRef=sn_09e4bde6148d45f99746b23c44ef9b67_14_3c4236203a2749bcbb2aed6382953164_2
          sn_09e4bde6148d45f99746b23c44ef9b67_14_c18c5dd3b39e4668a8f82c337e371f6f_6_9b458801: ComBitPosition=28, ComBitSize=4, ComSignalDataInvalidValue=15, ComSignalType=UINT16, ComSignalInitValue=0, ComHandleId=34, ComSystemTemplateSystemSignalRef=sn_09e4bde6148d45f99746b23c44ef9b67_14_c18c5dd3b39e4668a8f82c337e371f6f_6
      CTR_DIAG_OBD_DRDY_23008def (ComIPdu):
        ComIPduDirection = RECEIVE
        ComIPduType = NORMAL
        ComIPduHandleId = 5
        ComIPduSignalProcessing = DEFERRED
        ComIPduCancellationSupport = false
        ComIPduGroupRef = EPS_IN_PduGroup6_7933cc8b
        ComIPduSignalRef = sn_eb2aaf9fde954786857e30879fbebab8_4_32a695e8944f440980b86e5c6a1148d5_1_e1b92573
        ComPduIdRef = pduTr_CTR_DIAG_OBD_DRDY_A_FlexRay_pduPort_EPS_A_FlexRay_IN_7d601c47_052bff33
      AVL_FORC_GRD_23008def (ComIPdu):
        ComIPduDirection = SEND
        ComIPduType = NORMAL
        ComIPduHandleId = 1
        ComIPduSignalProcessing = DEFERRED
        ComIPduCancellationSupport = false
        ComIPduGroupRef = EPS_OUT_PduGroup2_7933cc8b
        ComIPduSignalGroupRef = e2eGrp_AVL_FORC_GRD_grpMap_4612dae3
        ComPduIdRef = pduTr_AVL_FORC_GRD_A_FlexRay_pduPort_EPS_A_FlexRay_OUT_7d601c47_052bff33
        ComTxIPdu: ComTxIPduUnusedAreasDefault=255, ComMinimumDelayTime=0
          ComTxModeTrue
            ComTxMode: ComTxModeMode=PERIODIC, ComTxModeTimePeriod=0.01, ComTxModeTimeOffset=0
          ComTxModeFalse
            ComTxMode: ComTxModeMode=NONE
      EPS_IN_PduGroup7_7933cc8b (ComIPduGroup): ComIPduGroupHandleId=5
      ST_CENG_23008def (ComIPdu):
        ComIPduDirection = RECEIVE
        ComIPduType = NORMAL
        ComIPduHandleId = 19
        ComIPduSignalProcessing = DEFERRED
        ComIPduCancellationSupport = false
        ComIPduGroupRef = EPS_IN_PduGroup10_7933cc8b
        ComIPduSignalRef = sn_6e55c14d93c64aaa86e33b57aac2ae43_9_19b3ebba571d40978c473fbc372b3866_1_36f7a929
        ComIPduSignalRef = sn_6e55c14d93c64aaa86e33b57aac2ae43_9_42056696541e44238d7385d322aa3305_4_36f7a929
        ComIPduSignalRef = sn_6e55c14d93c64aaa86e33b57aac2ae43_9_663c7f2797d74e12bbabeb2d22f7ba12_3_36f7a929
        ComIPduSignalRef = sn_6e55c14d93c64aaa86e33b57aac2ae43_9_9c391600986c4bfcac5985aa50535648_4_36f7a929
        ComIPduSignalRef = sn_6e55c14d93c64aaa86e33b57aac2ae43_9_a49f1a757dbb42f99b42ad072723479a_2_36f7a929
        ComIPduSignalRef = sn_6e55c14d93c64aaa86e33b57aac2ae43_9_fb20730d9415410f9e3bc21bb71c92b8_2_36f7a929
        ComPduIdRef = pduTr_ST_CENG_A_FlexRay_pduPort_EPS_A_FlexRay_IN_7d601c47_052bff33
    ComGeneral:
      ComConfigurationUseDet = true
      ComEnableSignalGroupArrayApi = false
      ComRetryFailedTransmitRequests = true
      ComSupportedIPduGroups = 13
      ComVersionInfoApi = false
      ComAdvancedIPduCallouts = true
      ComOptimizedIPduGroupHandling = false
      ComMetaDataSupport = false
      ComReceiveSignalMacroAPI = false
      ComDeferredEventCacheSupport = false
      ComMainfunctionTimingDomainSupport = true
      ComDescriptionRoutingCodeGeneration = false
      ComSafeBswChecks = true
