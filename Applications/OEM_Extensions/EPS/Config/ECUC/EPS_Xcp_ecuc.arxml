AUTOSAR XML (schema 4-3-0)
package /ActiveEcuC
  module config Xcp: implementation-config-variant=VARIANT-PRE-COMPILE, module-description=Xcp_Impl
    XcpCmdConfig: XcpOpenCommandInterface=false
      XcpStandard:
        XcpBlockUpload = false
        XcpCommunicationModeInfo = false
        XcpGetIdGeneric = false
        XcpMemoryReadProtection = false
        XcpSeedKey = false
        XcpUserDefinedCommand = false
      XcpAsynchMessage: XcpEventCodes=false, XcpServiceRequestMessage=false
      XcpDaqAndStim:
        XcpDAQODTMessageHeader = false
        XcpFixedTimestamp = false
        XcpGetDAQEventInfo = true
        XcpMaxNumberOfOdtDaq = 1
        XcpMaxNumberOfOdtEntries = 2
        XcpMaxNumberOfOdtStim = 1
        XcpOverrunIndication = true
        XcpResolutionInfo = true
        XcpResumeMode = false
        XcpSynchronousDataStimulation = true
        XcpWriteDAQMultiple = false
      XcpCalibration: XcpBlockDownload=false, XcpMIN_STForBlockDownload=0, XcpModifyBits=false, XcpShortDownload=false
    XcpGeneral:
      XcpOnFlexRayEnabled = true
      XcpDevErrorDetect = true
      XcpMainFunctionPeriod = 0.005
      XcpMaxEventChannel = 255
      XcpPrescalerSupported = false
      XcpVersionInfoApi = false
      XcpBootloaderDownload = false
      XcpControl = false
      XcpMultiClientSupport = false
      XcpRuntimeMeasurementSupport = false
      XcpSafeBswChecks = true
      XcpSessionStatusAPI = false
      XcpTypeSafeCopy = false
      XcpDAQMemAccessByApplication = false
      XcpOnCanEnabled = false
      XcpOnCddEnabled = false
      XcpOnEthernetEnabled = false
      XcpA2L: XcpTimeoutT1=2000, XcpTimeoutT2=10000, XcpTimeoutT3=2000, XcpTimeoutT4=2000, XcpTimeoutT5=2000, XcpTimeoutT6=2000, XcpTimeoutT7=0
    XcpConfig
      11 x XcpPdu:
        xcpdynamic254_6_23008def
          xcpdynamic254_6_23008def (XcpTxPdu):
            XcpTxPduId = 0
            XcpOnFrPduIsRuntimeConfigurable = true
            XcpOnFrTxPduType = Variable
            XcpTxPduRef = pduTr_xcpdynamic254_6_A_FlexRay_pduPort_EPS_A_FlexRay_OUT_7d601c47_052bff33
        xcpdynamic254_3_23008def
          xcpdynamic254_3_23008def (XcpTxPdu):
            XcpTxPduId = 1
            XcpOnFrPduIsRuntimeConfigurable = true
            XcpOnFrTxPduType = Variable
            XcpTxPduRef = pduTr_xcpdynamic254_3_A_FlexRay_pduPort_EPS_A_FlexRay_OUT_7d601c47_052bff33
        xcpdynamic254_8_23008def
          xcpdynamic254_8_23008def (XcpTxPdu):
            XcpTxPduId = 2
            XcpOnFrPduIsRuntimeConfigurable = true
            XcpOnFrTxPduType = Variable
            XcpTxPduRef = pduTr_xcpdynamic254_8_A_FlexRay_pduPort_EPS_A_FlexRay_OUT_7d601c47_052bff33
        dummy16bstatic_23008def
          dummy16bstatic_23008def (XcpTxPdu):
            XcpTxPduId = 3
            XcpOnFrPduIsRuntimeConfigurable = true
            XcpOnFrTxPduType = Variable
            XcpTxPduRef = pduTr_dummy16bstatic_A_FlexRay_pduPort_EPS_A_FlexRay_OUT_7d601c47_052bff33
        xcpdynamic254_7_23008def
          xcpdynamic254_7_23008def (XcpTxPdu):
            XcpTxPduId = 4
            XcpOnFrPduIsRuntimeConfigurable = true
            XcpOnFrTxPduType = Variable
            XcpTxPduRef = pduTr_xcpdynamic254_7_A_FlexRay_pduPort_EPS_A_FlexRay_OUT_7d601c47_052bff33
        xcpdynamic254_1_23008def
          xcpdynamic254_1_23008def (XcpTxPdu):
            XcpTxPduId = 5
            XcpOnFrPduIsRuntimeConfigurable = true
            XcpOnFrTxPduType = Variable
            XcpTxPduRef = pduTr_xcpdynamic254_1_A_FlexRay_pduPort_EPS_A_FlexRay_OUT_7d601c47_052bff33
        xcpdynamic254_4_23008def
          xcpdynamic254_4_23008def (XcpTxPdu):
            XcpTxPduId = 6
            XcpOnFrPduIsRuntimeConfigurable = true
            XcpOnFrTxPduType = Variable
            XcpTxPduRef = pduTr_xcpdynamic254_4_A_FlexRay_pduPort_EPS_A_FlexRay_OUT_7d601c47_052bff33
        dummy32bslave_23008def
          dummy32bslave_23008def (XcpTxPdu):
            XcpTxPduId = 7
            XcpOnFrPduIsRuntimeConfigurable = true
            XcpOnFrTxPduType = Variable
            XcpTxPduRef = pduTr_dummy32bslave_A_FlexRay_pduPort_EPS_A_FlexRay_OUT_7d601c47_052bff33
        xcpdynamic254_2_23008def
          xcpdynamic254_2_23008def (XcpTxPdu):
            XcpTxPduId = 8
            XcpOnFrPduIsRuntimeConfigurable = true
            XcpOnFrTxPduType = Variable
            XcpTxPduRef = pduTr_xcpdynamic254_2_A_FlexRay_pduPort_EPS_A_FlexRay_OUT_7d601c47_052bff33
        xcpdynamic254_5_23008def
          xcpdynamic254_5_23008def (XcpTxPdu):
            XcpTxPduId = 9
            XcpOnFrPduIsRuntimeConfigurable = true
            XcpOnFrTxPduType = Variable
            XcpTxPduRef = pduTr_xcpdynamic254_5_A_FlexRay_pduPort_EPS_A_FlexRay_OUT_7d601c47_052bff33
        dummy32bmaster_23008def
          dummy32bmaster_23008def (XcpRxPdu):
            XcpRxPduId = 0
            XcpOnFrPduIsRuntimeConfigurable = true
            XcpOnFrRxPduType = Variable
            XcpRxPduRef = pduTr_dummy32bmaster_A_FlexRay_pduPort_EPS_A_FlexRay_IN_7d601c47_052bff33
      XcpTransportLayer
        XcpOnFr:
          XcpOnFrMaxCto = 12
          XcpOnFrMaxDto = 12
          XcpOnFrConfirmationTimeout = 8
          XcpOnFrReadCCConfig = false
          XcpOnFrReadCCConfigExtAddr = 253
          XcpOnFrNodeAddress = 0
          XcpOnFrFrameAlignment = Align8Bit
          XcpOnFrSequenceCounter = true
          XcpOnFrFrameConcatenation = false
          XcpOnFrMaxPDU = 14
          XcpOnFrTransmissionMode = Decoupled
          XcpOnFrOptimizedCopy = false
      XcpCoreDefinition: XcpSendQueueSize=256
      XcpEventChannel:
        XcpEventChannelMaxDaqList = 1
        XcpEventChannelNumber = 0
        XcpEventChannelTimeCycle = 10
        XcpEventChannelTimeUnit = TIMESTAMP_UNIT_1MS
        XcpEventChannelType = DAQ_STIM
        XcpEventChannelCoreRef = XcpCoreDefinition
