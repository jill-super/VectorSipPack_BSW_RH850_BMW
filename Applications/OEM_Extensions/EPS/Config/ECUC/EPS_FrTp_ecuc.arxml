AUTOSAR XML (schema 4-3-0)
package /ActiveEcuC
  module config FrTp: implementation-config-variant=VARIANT-PRE-COMPILE, module-description=FrTp_Impl
    FrTpGeneral:
      FrTpSafeBswChecks = true
      FrTpAckRt = false
      FrTpChanNum = 1
      FrTpChangeParamApi = false
      FrTpDevErrorDetect = true
      FrTpFullDuplexEnable = true
      FrTpMainFuncCycle = 0.005
      FrTpTransmitCancellation = false
      FrTpUnknownMsgLength = false
      FrTpVersionInfoApi = false
      FrTpRxIndEarlierThanTxConf = false
      FrTpInstanceId = 0
      FrTpMultiPurposeTp = false
      FrTpRxChanNum = 28
      FrTpTxChanNum = 14
      FrTpRuntimeMeasurementSupport = false
      FrTpReceiveCancellation = false
    FrTpMultipleConfig
      TL_BRC_FR_32_TxF8_0xDFTN_0x00F8_248_TN_0x0030_48 (FrTpConnection): FrTpLa=223, FrTpMultipleReceiverCon=true, FrTpRa=248, FrTpConCtrlRef=TPCC, FrTpRxPduPoolRef=RxPduPool_TL_BRC_FR_32_Tp
        TL_BRC_FR_32_TxF8_0xDF (FrTpRxSdu): FrTpRxSduId=8, FrTpRxSduRef=PT_TL_BRC_FR_32_TxF8_0xDF_PP_TL_BRC_FR_32_TxF8_0xDF_Rx_7d601c47_052bff33
      TPCC (FrTpConnectionControl):
        FrTpAckType = FRTP_ACK_WITH_RT
        FrTpMaxAr = 2
        FrTpMaxAs = 2
        FrTpMaxBufferSize = 4096
        FrTpMaxFCWait = 0
        FrTpMaxFrIf = 0
        FrTpMaxNbrOfNPduPerCycle = 1
        FrTpMaxRn = 2
        FrTpSCexp = 0
        FrTpTimeBr = 0.05
        FrTpTimeBuffer = 0.02
        FrTpTimeFrIf = 0.02
        FrTpTimeoutAr = 0.15
        FrTpTimeoutAs = 0.15
        FrTpTimeoutBs = 0.5
        FrTpTimeoutCr = 0.6
        FrTpTimeCs = 0.05
      RxPduPool_TL_BRC_FR_32_Tp (FrTpRxPduPool)
        FrTpRxPdu_TL_BRC_FR_32_Tp (FrTpRxPdu): FrTpRxPduId=1, FrTpRxPduRef=pduTr_TL_BRC_FR_32_A_FlexRay_pduPort_EPS_A_FlexRay_IN_7d601c47_052bff33
        RxPduPool_TL_GW_FR (FrTpRxPdu): FrTpRxPduId=2, FrTpRxPduRef=pduTr_TL_MST_GW_TRNSM_FR_254_A_FlexRay_pduPort_EPS_A_FlexRay_IN_7d601c47_052bff33
      TxPduPool_TL_ECU_TRNSM_FR_32_00BC0001_Tp (FrTpTxPduPool)
        TxPduPool_TL_ECU_TRNSM_FR_32_00BC0001_Tp (FrTpTxPdu): FrTpTxConfirmationPduId=0, FrTpTxPduRef=pduTr_TL_ECU_TRNSM_FR_32_A_FlexRay_pduPort_EPS_A_FlexRay_OUT_7d601c47_052bff33
      14 x FrTpConnection, all with FrTpConCtrlRef=TPCC:
        TL_BRC_FR_32_TxF2_0xDFTN_0x00F2_242_TN_0x0030_48: FrTpLa=223, FrTpMultipleReceiverCon=true, FrTpRa=242, FrTpRxPduPoolRef=RxPduPool_TL_BRC_FR_32_Tp
          TL_BRC_FR_32_TxF2_0xDF (FrTpRxSdu): FrTpRxSduId=2, FrTpRxSduRef=PT_TL_BRC_FR_32_TxF2_0xDF_PP_TL_BRC_FR_32_TxF2_0xDF_Rx_7d601c47_052bff33
        TL_BRC_FR_32_TxF3_0xDFTN_0x00F3_243_TN_0x0030_48: FrTpLa=223, FrTpMultipleReceiverCon=true, FrTpRa=243, FrTpRxPduPoolRef=RxPduPool_TL_BRC_FR_32_Tp
          TL_BRC_FR_32_TxF3_0xDF (FrTpRxSdu): FrTpRxSduId=3, FrTpRxSduRef=PT_TL_BRC_FR_32_TxF3_0xDF_PP_TL_BRC_FR_32_TxF3_0xDF_Rx_7d601c47_052bff33
        TL_BRC_FR_32_TxF4_0xDFTN_0x00F4_244_TN_0x0030_48: FrTpLa=223, FrTpMultipleReceiverCon=true, FrTpRa=244, FrTpRxPduPoolRef=RxPduPool_TL_BRC_FR_32_Tp
          TL_BRC_FR_32_TxF4_0xDF (FrTpRxSdu): FrTpRxSduId=4, FrTpRxSduRef=PT_TL_BRC_FR_32_TxF4_0xDF_PP_TL_BRC_FR_32_TxF4_0xDF_Rx_7d601c47_052bff33
        TL_BRC_FR_32_TxF5_0xDFTN_0x00F5_245_TN_0x0030_48: FrTpLa=223, FrTpMultipleReceiverCon=true, FrTpRa=245, FrTpRxPduPoolRef=RxPduPool_TL_BRC_FR_32_Tp
          TL_BRC_FR_32_TxF5_0xDF (FrTpRxSdu): FrTpRxSduId=5, FrTpRxSduRef=PT_TL_BRC_FR_32_TxF5_0xDF_PP_TL_BRC_FR_32_TxF5_0xDF_Rx_7d601c47_052bff33
        TL_BRC_FR_32_TxF6_0xDFTN_0x00F6_246_TN_0x0030_48: FrTpLa=223, FrTpMultipleReceiverCon=true, FrTpRa=246, FrTpRxPduPoolRef=RxPduPool_TL_BRC_FR_32_Tp
          TL_BRC_FR_32_TxF6_0xDF (FrTpRxSdu): FrTpRxSduId=6, FrTpRxSduRef=PT_TL_BRC_FR_32_TxF6_0xDF_PP_TL_BRC_FR_32_TxF6_0xDF_Rx_7d601c47_052bff33
        TL_BRC_FR_32_TxF7_0xDFTN_0x00F7_247_TN_0x0030_48: FrTpLa=223, FrTpMultipleReceiverCon=true, FrTpRa=247, FrTpRxPduPoolRef=RxPduPool_TL_BRC_FR_32_Tp
          TL_BRC_FR_32_TxF7_0xDF (FrTpRxSdu): FrTpRxSduId=7, FrTpRxSduRef=PT_TL_BRC_FR_32_TxF7_0xDF_PP_TL_BRC_FR_32_TxF7_0xDF_Rx_7d601c47_052bff33
        TL_BRC_FR_32_TxF1_0xDFTN_0x00F1_241_TN_0x0030_48: FrTpLa=223, FrTpMultipleReceiverCon=true, FrTpRa=241, FrTpRxPduPoolRef=RxPduPool_TL_BRC_FR_32_Tp
          TL_BRC_FR_32_TxF1_0xDF (FrTpRxSdu): FrTpRxSduId=1, FrTpRxSduRef=PT_TL_BRC_FR_32_TxF1_0xDF_PP_TL_BRC_FR_32_TxF1_0xDF_Rx_7d601c47_052bff33
        TL_BRC_FR_32_TxF9_0xDFTN_0x00F9_249_TN_0x0030_48: FrTpLa=223, FrTpMultipleReceiverCon=true, FrTpRa=249, FrTpRxPduPoolRef=RxPduPool_TL_BRC_FR_32_Tp
          TL_BRC_FR_32_TxF9_0xDF (FrTpRxSdu): FrTpRxSduId=9, FrTpRxSduRef=PT_TL_BRC_FR_32_TxF9_0xDF_PP_TL_BRC_FR_32_TxF9_0xDF_Rx_7d601c47_052bff33
        TL_BRC_FR_32_TxFA_0xDFTN_0x00FA_250_TN_0x0030_48: FrTpLa=223, FrTpMultipleReceiverCon=true, FrTpRa=250, FrTpRxPduPoolRef=RxPduPool_TL_BRC_FR_32_Tp
          TL_BRC_FR_32_TxFA_0xDF (FrTpRxSdu): FrTpRxSduId=10, FrTpRxSduRef=PT_TL_BRC_FR_32_TxFA_0xDF_PP_TL_BRC_FR_32_TxFA_0xDF_Rx_7d601c47_052bff33
        TL_BRC_FR_32_TxFB_0xDFTN_0x00FB_251_TN_0x0030_48: FrTpLa=223, FrTpMultipleReceiverCon=true, FrTpRa=251, FrTpRxPduPoolRef=RxPduPool_TL_BRC_FR_32_Tp
          TL_BRC_FR_32_TxFB_0xDF (FrTpRxSdu): FrTpRxSduId=11, FrTpRxSduRef=PT_TL_BRC_FR_32_TxFB_0xDF_PP_TL_BRC_FR_32_TxFB_0xDF_Rx_7d601c47_052bff33
        TL_BRC_FR_32_TxFC_0xDFTN_0x00FC_252_TN_0x0030_48: FrTpLa=223, FrTpMultipleReceiverCon=true, FrTpRa=252, FrTpRxPduPoolRef=RxPduPool_TL_BRC_FR_32_Tp
          TL_BRC_FR_32_TxFC_0xDF (FrTpRxSdu): FrTpRxSduId=12, FrTpRxSduRef=PT_TL_BRC_FR_32_TxFC_0xDF_PP_TL_BRC_FR_32_TxFC_0xDF_Rx_7d601c47_052bff33
        TL_BRC_FR_32_TxFD_0xDFTN_0x00FD_253_TN_0x0030_48: FrTpLa=223, FrTpMultipleReceiverCon=true, FrTpRa=253, FrTpRxPduPoolRef=RxPduPool_TL_BRC_FR_32_Tp
          TL_BRC_FR_32_TxFD_0xDF (FrTpRxSdu): FrTpRxSduId=13, FrTpRxSduRef=PT_TL_BRC_FR_32_TxFD_0xDF_PP_TL_BRC_FR_32_TxFD_0xDF_Rx_7d601c47_052bff33
        TL_BRC_FR_32_TxF0_0xDFTN_0x00F0_240_TN_0x0030_48: FrTpLa=223, FrTpMultipleReceiverCon=true, FrTpRa=240, FrTpRxPduPoolRef=RxPduPool_TL_BRC_FR_32_Tp
          TL_BRC_FR_32_TxF0_0xDF (FrTpRxSdu): FrTpRxSduId=0, FrTpRxSduRef=PT_TL_BRC_FR_32_TxF0_0xDF_PP_TL_BRC_FR_32_TxF0_0xDF_Rx_7d601c47_052bff33
        TL_MST_GW_TRNSM_FR_254_00980001_TxF0TN_0x00F0_240_TN_0x0030_48: FrTpLa=48, FrTpMultipleReceiverCon=false, FrTpRa=240, FrTpRxPduPoolRef=FrTpMultipleConfig/RxPduPool_TL_MST_GW_TRNSM_FR_254_00980001_Tp, FrTpTxPduPoolRef=FrTpMultipleConfig/TxPduPool_TL_ECU_TRNSM_FR_32_00BC0001_Tp
          TL_MST_GW_TRNSM_FR_254_00980001_TxF0 (FrTpRxSdu): FrTpRxSduId=14, FrTpRxSduRef=PT_TL_MST_GW_TRNSM_FR_254_00980001_TxF0_PP_TL_MST_GW_TRNSM_FR_254_00980001_TxF0_Rx_7d601c47_052bff33
          TL_ECU_TRNSM_FR_32_00BC0001_RxF0 (FrTpTxSdu): FrTpTxSduId=0, FrTpTxSduRef=PT_TL_ECU_TRNSM_FR_32_00BC0001_RxF0_PP_TL_ECU_TRNSM_FR_32_00BC0001_RxF0_Tx_7d601c47_052bff33
      RxPduPool_TL_MST_GW_TRNSM_FR_254_00980001_Tp (FrTpRxPduPool)
        RxPduPool_TL_MST_GW_TRNSM_FR_254_00980001_Tp (FrTpRxPdu): FrTpRxPduId=0, FrTpRxPduRef=pduTr_TL_MST_GW_TRNSM_FR_254_A_FlexRay_pduPort_EPS_A_FlexRay_IN_7d601c47_052bff33
      13 x FrTpConnection, all with FrTpLa=48, FrTpMultipleReceiverCon=false, FrTpConCtrlRef=TPCC, FrTpRxPduPoolRef=FrTpMultipleConfig/RxPduPool_TL_MST_GW_TRNSM_FR_254_00980001_Tp, FrTpTxPduPoolRef=FrTpMultipleConfig/TxPduPool_TL_ECU_TRNSM_FR_32_00BC0001_Tp:
        TL_MST_GW_TRNSM_FR_254_00980001_TxF1TN_0x00F1_241_TN_0x0030_48: FrTpRa=241
          TL_MST_GW_TRNSM_FR_254_00980001_TxF1 (FrTpRxSdu): FrTpRxSduId=15, FrTpRxSduRef=PT_TL_MST_GW_TRNSM_FR_254_00980001_TxF1_PP_TL_MST_GW_TRNSM_FR_254_00980001_TxF1_Rx_7d601c47_052bff33
          TL_ECU_TRNSM_FR_32_00BC0001_RxF1 (FrTpTxSdu): FrTpTxSduId=1, FrTpTxSduRef=PT_TL_ECU_TRNSM_FR_32_00BC0001_RxF1_PP_TL_ECU_TRNSM_FR_32_00BC0001_RxF1_Tx_7d601c47_052bff33
        TL_MST_GW_TRNSM_FR_254_00980001_TxF2TN_0x00F2_242_TN_0x0030_48: FrTpRa=242
          TL_MST_GW_TRNSM_FR_254_00980001_TxF2 (FrTpRxSdu): FrTpRxSduId=16, FrTpRxSduRef=PT_TL_MST_GW_TRNSM_FR_254_00980001_TxF2_PP_TL_MST_GW_TRNSM_FR_254_00980001_TxF2_Rx_7d601c47_052bff33
          TL_ECU_TRNSM_FR_32_00BC0001_RxF2 (FrTpTxSdu): FrTpTxSduId=2, FrTpTxSduRef=PT_TL_ECU_TRNSM_FR_32_00BC0001_RxF2_PP_TL_ECU_TRNSM_FR_32_00BC0001_RxF2_Tx_7d601c47_052bff33
        TL_MST_GW_TRNSM_FR_254_00980001_TxF3TN_0x00F3_243_TN_0x0030_48: FrTpRa=243
          TL_MST_GW_TRNSM_FR_254_00980001_TxF3 (FrTpRxSdu): FrTpRxSduId=17, FrTpRxSduRef=PT_TL_MST_GW_TRNSM_FR_254_00980001_TxF3_PP_TL_MST_GW_TRNSM_FR_254_00980001_TxF3_Rx_7d601c47_052bff33
          TL_ECU_TRNSM_FR_32_00BC0001_RxF3 (FrTpTxSdu): FrTpTxSduId=3, FrTpTxSduRef=PT_TL_ECU_TRNSM_FR_32_00BC0001_RxF3_PP_TL_ECU_TRNSM_FR_32_00BC0001_RxF3_Tx_7d601c47_052bff33
        TL_MST_GW_TRNSM_FR_254_00980001_TxF4TN_0x00F4_244_TN_0x0030_48: FrTpRa=244
          TL_MST_GW_TRNSM_FR_254_00980001_TxF4 (FrTpRxSdu): FrTpRxSduId=18, FrTpRxSduRef=PT_TL_MST_GW_TRNSM_FR_254_00980001_TxF4_PP_TL_MST_GW_TRNSM_FR_254_00980001_TxF4_Rx_7d601c47_052bff33
          TL_ECU_TRNSM_FR_32_00BC0001_RxF4 (FrTpTxSdu): FrTpTxSduId=4, FrTpTxSduRef=PT_TL_ECU_TRNSM_FR_32_00BC0001_RxF4_PP_TL_ECU_TRNSM_FR_32_00BC0001_RxF4_Tx_7d601c47_052bff33
        TL_MST_GW_TRNSM_FR_254_00980001_TxF5TN_0x00F5_245_TN_0x0030_48: FrTpRa=245
          TL_MST_GW_TRNSM_FR_254_00980001_TxF5 (FrTpRxSdu): FrTpRxSduId=19, FrTpRxSduRef=PT_TL_MST_GW_TRNSM_FR_254_00980001_TxF5_PP_TL_MST_GW_TRNSM_FR_254_00980001_TxF5_Rx_7d601c47_052bff33
          TL_ECU_TRNSM_FR_32_00BC0001_RxF5 (FrTpTxSdu): FrTpTxSduId=5, FrTpTxSduRef=PT_TL_ECU_TRNSM_FR_32_00BC0001_RxF5_PP_TL_ECU_TRNSM_FR_32_00BC0001_RxF5_Tx_7d601c47_052bff33
        TL_MST_GW_TRNSM_FR_254_00980001_TxF6TN_0x00F6_246_TN_0x0030_48: FrTpRa=246
          TL_MST_GW_TRNSM_FR_254_00980001_TxF6 (FrTpRxSdu): FrTpRxSduId=20, FrTpRxSduRef=PT_TL_MST_GW_TRNSM_FR_254_00980001_TxF6_PP_TL_MST_GW_TRNSM_FR_254_00980001_TxF6_Rx_7d601c47_052bff33
          TL_ECU_TRNSM_FR_32_00BC0001_RxF6 (FrTpTxSdu): FrTpTxSduId=6, FrTpTxSduRef=PT_TL_ECU_TRNSM_FR_32_00BC0001_RxF6_PP_TL_ECU_TRNSM_FR_32_00BC0001_RxF6_Tx_7d601c47_052bff33
        TL_MST_GW_TRNSM_FR_254_00980001_TxF7TN_0x00F7_247_TN_0x0030_48: FrTpRa=247
          TL_MST_GW_TRNSM_FR_254_00980001_TxF7 (FrTpRxSdu): FrTpRxSduId=21, FrTpRxSduRef=PT_TL_MST_GW_TRNSM_FR_254_00980001_TxF7_PP_TL_MST_GW_TRNSM_FR_254_00980001_TxF7_Rx_7d601c47_052bff33
          TL_ECU_TRNSM_FR_32_00BC0001_RxF7 (FrTpTxSdu): FrTpTxSduId=7, FrTpTxSduRef=PT_TL_ECU_TRNSM_FR_32_00BC0001_RxF7_PP_TL_ECU_TRNSM_FR_32_00BC0001_RxF7_Tx_7d601c47_052bff33
        TL_MST_GW_TRNSM_FR_254_00980001_TxF8TN_0x00F8_248_TN_0x0030_48: FrTpRa=248
          TL_MST_GW_TRNSM_FR_254_00980001_TxF8 (FrTpRxSdu): FrTpRxSduId=22, FrTpRxSduRef=PT_TL_MST_GW_TRNSM_FR_254_00980001_TxF8_PP_TL_MST_GW_TRNSM_FR_254_00980001_TxF8_Rx_7d601c47_052bff33
          TL_ECU_TRNSM_FR_32_00BC0001_RxF8 (FrTpTxSdu): FrTpTxSduId=8, FrTpTxSduRef=PT_TL_ECU_TRNSM_FR_32_00BC0001_RxF8_PP_TL_ECU_TRNSM_FR_32_00BC0001_RxF8_Tx_7d601c47_052bff33
        TL_MST_GW_TRNSM_FR_254_00980001_TxF9TN_0x00F9_249_TN_0x0030_48: FrTpRa=249
          TL_MST_GW_TRNSM_FR_254_00980001_TxF9 (FrTpRxSdu): FrTpRxSduId=23, FrTpRxSduRef=PT_TL_MST_GW_TRNSM_FR_254_00980001_TxF9_PP_TL_MST_GW_TRNSM_FR_254_00980001_TxF9_Rx_7d601c47_052bff33
          TL_ECU_TRNSM_FR_32_00BC0001_RxF9 (FrTpTxSdu): FrTpTxSduId=9, FrTpTxSduRef=PT_TL_ECU_TRNSM_FR_32_00BC0001_RxF9_PP_TL_ECU_TRNSM_FR_32_00BC0001_RxF9_Tx_7d601c47_052bff33
        TL_MST_GW_TRNSM_FR_254_00980001_TxFATN_0x00FA_250_TN_0x0030_48: FrTpRa=250
          TL_MST_GW_TRNSM_FR_254_00980001_TxFA (FrTpRxSdu): FrTpRxSduId=24, FrTpRxSduRef=PT_TL_MST_GW_TRNSM_FR_254_00980001_TxFA_PP_TL_MST_GW_TRNSM_FR_254_00980001_TxFA_Rx_7d601c47_052bff33
          TL_ECU_TRNSM_FR_32_00BC0001_RxFA (FrTpTxSdu): FrTpTxSduId=10, FrTpTxSduRef=PT_TL_ECU_TRNSM_FR_32_00BC0001_RxFA_PP_TL_ECU_TRNSM_FR_32_00BC0001_RxFA_Tx_7d601c47_052bff33
        TL_MST_GW_TRNSM_FR_254_00980001_TxFBTN_0x00FB_251_TN_0x0030_48: FrTpRa=251
          TL_MST_GW_TRNSM_FR_254_00980001_TxFB (FrTpRxSdu): FrTpRxSduId=25, FrTpRxSduRef=PT_TL_MST_GW_TRNSM_FR_254_00980001_TxFB_PP_TL_MST_GW_TRNSM_FR_254_00980001_TxFB_Rx_7d601c47_052bff33
          TL_ECU_TRNSM_FR_32_00BC0001_RxFB (FrTpTxSdu): FrTpTxSduId=11, FrTpTxSduRef=PT_TL_ECU_TRNSM_FR_32_00BC0001_RxFB_PP_TL_ECU_TRNSM_FR_32_00BC0001_RxFB_Tx_7d601c47_052bff33
        TL_MST_GW_TRNSM_FR_254_00980001_TxFCTN_0x00FC_252_TN_0x0030_48: FrTpRa=252
          TL_MST_GW_TRNSM_FR_254_00980001_TxFC (FrTpRxSdu): FrTpRxSduId=26, FrTpRxSduRef=PT_TL_MST_GW_TRNSM_FR_254_00980001_TxFC_PP_TL_MST_GW_TRNSM_FR_254_00980001_TxFC_Rx_7d601c47_052bff33
          TL_ECU_TRNSM_FR_32_00BC0001_RxFC (FrTpTxSdu): FrTpTxSduId=12, FrTpTxSduRef=PT_TL_ECU_TRNSM_FR_32_00BC0001_RxFC_PP_TL_ECU_TRNSM_FR_32_00BC0001_RxFC_Tx_7d601c47_052bff33
        TL_MST_GW_TRNSM_FR_254_00980001_TxFDTN_0x00FD_253_TN_0x0030_48: FrTpRa=253
          TL_MST_GW_TRNSM_FR_254_00980001_TxFD (FrTpRxSdu): FrTpRxSduId=27, FrTpRxSduRef=PT_TL_MST_GW_TRNSM_FR_254_00980001_TxFD_PP_TL_MST_GW_TRNSM_FR_254_00980001_TxFD_Rx_7d601c47_052bff33
          TL_ECU_TRNSM_FR_32_00BC0001_RxFD (FrTpTxSdu): FrTpTxSduId=13, FrTpTxSduRef=PT_TL_ECU_TRNSM_FR_32_00BC0001_RxFD_PP_TL_ECU_TRNSM_FR_32_00BC0001_RxFD_Tx_7d601c47_052bff33
