AUTOSAR XML (schema 4-3-0)
package /ActiveEcuC
  module config BsClassic: implementation-config-variant=VARIANT-PRE-COMPILE
    CommonPublishedInformation: SwMajorVersion=5, SwMinorVersion=3, SwPatchVersion=0
    Crypto
      CryptoLib: SecureTokenHashFunction=Crypto_SHA256, SecureTokenSigVerifyFunction=Crypto_EccVerifyHash
    General: DevErrorDetect=true
    Sfa: MaxTokenSize=256, TokenHashSize=32, TokenSignatureSize=32
      Features1 (Features): FeatureId=65537
    Lcs: LcsIds=1
    CertificateManagement: CertTempBufSize=128
      CSR:
        CSRTemplateData = 0x30, 0x82, 0x01, 0xB4, 0x30, 0x82, 0x01, 0x39, 0x02, 0x01, 0x00, 0x30, 0x81, 0x9B, 0x31, 0x13,0x30, 0x11, 0x06, 0x03, 0x55, 0x04, 0x08, 0x13, 0x0A, 0x50, 0x72, 0x6F, 0x64, 0x75, 0x63, 0x74, 0x69, 0x6F, 0x6E, 0x31, 0x17, 0x30, 0x15, 0x06, 0x03, 0x55, 0x04, 0x07, 0x0C, 0x0E, 0x42, 0x41, 0x43, 0x34, 0x5F, 0x45, 0x56, 0x41, 0x4C, 0x42, 0x4F, 0x41, 0x52, 0x44, 0x31, 0x12, 0x30, 0x10,0x06, 0x03, 0x55, 0x04, 0x0A, 0x13, 0x09, 0x42, 0x4D, 0x57, 0x20, 0x47, 0x72, 0x6F, 0x75, 0x70, 0x31, 0x17, 0x30, 0x15, 0x06, 0x03, 0x55, 0x04, 0x0B, 0x13, 0x0E, 0x56, 0x65, 0x68, 0x69, 0x63,0x6C, 0x65, 0x50, 0x4B, 0x49, 0x2D, 0x45, 0x43, 0x55, 0x31, 0x0B, 0x30, 0x09, 0x06, 0x03, 0x55, 0x04, 0x03, 0x13, 0x02, 0x49, 0x44, 0x31, 0x31, 0x30, 0x2F, 0x06, 0x03, 0x55, 0x04, 0x05, 0x13,0x28, 0x45, 0x43, 0x55, 0x2D, 0x55, 0x49, 0x44, 0x3A, 0x30, 0x30, 0x30, 0x31, 0x30, 0x32, 0x30,0x33, 0x30, 0x34, 0x30, 0x35, 0x30, 0x36, 0x30, 0x37, 0x30, 0x38, 0x30, 0x39, 0x30, 0x41, 0x30, 0x42, 0x30, 0x43, 0x30, 0x44, 0x30, 0x45, 0x45, 0x45, 0x30, 0x76, 0x30, 0x10, 0x06, 0x07, 0x2A, 0x86, 0x48, 0xCE, 0x3D, 0x02, 0x01, 0x06, 0x05, 0x2B, 0x81, 0x04, 0x00, 0x22, 0x03, 0x62, 0x00, 0x04, 0xA0, 0xEF, 0xA9, 0xD0, 0x6D, 0x72, 0xC3, 0xBC, 0x51, 0x57, 0xE6, 0x13, 0x49, 0x6C, 0xE1, 0x6C, 0xFE, 0xDD, 0x50, 0x23, 0x80, 0x1C, 0x88, 0xF4, 0x17, 0x03, 0xDA, 0xD4, 0x15, 0xEB, 0x4C, 0x38, 0xDC, 0x7C, 0x42, 0x25, 0x13, 0x30, 0xD3, 0xBB, 0xEE, 0x19, 0x1C, 0xD0, 0x73, 0xA7, 0x65, 0x66, 0x6C, 0xCA, 0x1E, 0x00, 0x69, 0x8E, 0x92, 0x72, 0xDA, 0xD2, 0xF7, 0xFB, 0x4F, 0x7D, 0x1A, 0xEE, 0x0E, 0xBF, 0x5F, 0x69, 0xDA, 0x60, 0x94, 0x40, 0xA7, 0xE3, 0xFF, 0x92, 0x5C, 0x11, 0xFD, 0x6B, 0x50, 0xA2, 0x21, 0x9A, 0xC3, 0xB2, 0xE8, 0x8F, 0xCF, 0xB9, 0x17, 0x7A, 0xFA, 0xAD, 0xE1, 0x9C, 0xA0, 0x1E, 0x30, 0x1C, 0x06, 0x09, 0x2A, 0x86, 0x48, 0x86, 0xF7, 0x0D, 0x01, 0x09, 0x0E, 0x31, 0x0F, 0x30, 0x0D, 0x30, 0x0B, 0x06, 0x03, 0x55, 0x1D, 0x0F, 0x04, 0x04, 0x03, 0x02, 0x07, 0x80, 0x30, 0x0A, 0x06, 0x08, 0x2A, 0x86, 0x48, 0xCE, 0x3D, 0x04, 0x03, 0x02, 0x03, 0x69, 0x00, 0x30, 0x66, 0x02, 0x31, 0x00, 0xB1, 0x93, 0xB4, 0x96, 0x59, 0x27, 0x2C, 0x26, 0xE4, 0x47, 0x7B, 0xA9, 0xDD, 0x75, 0xF8, 0xC5, 0xC3, 0x2A, 0x09, 0x1D, 0xB9, 0x6B, 0xE9, 0x0C, 0x67, 0xD4, 0xC5, 0x33, 0xD7, 0x0A, 0xFF, 0x56, 0x09, 0xD0, 0xA9, 0xD5, 0x50, 0xA1, 0xAD, 0xDE, 0x43, 0xC8, 0x5D, 0xBA, 0x15, 0x20, 0xB8, 0x30, 0x02, 0x31, 0x00, 0xBA, 0x26, 0x33, 0xD4, 0x62, 0x90, 0xD1, 0x58, 0x76, 0xF9, 0x9C, 0x8A, 0x3E, 0x12, 0x49, 0xFC, 0x90, 0x0E, 0x07, 0x06, 0x51, 0x91, 0xA0, 0xEF, 0x78, 0x5F, 0xBC, 0x5C, 0x2C, 0xD6, 0xDC, 0x0C, 0x5D, 0x69, 0xB9, 0xD5, 0x94, 0x9F, 0x84, 0x23, 0xEB, 0x0D, 0xEC, 0x79, 0xF9, 0xE1, 0x2F, 0xAA
