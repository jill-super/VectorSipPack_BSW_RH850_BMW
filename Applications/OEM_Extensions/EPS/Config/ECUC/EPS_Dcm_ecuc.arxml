AUTOSAR XML (schema 4-3-0)
package /ActiveEcuC
  module config Dcm: implementation-config-variant=VARIANT-PRE-COMPILE, module-description=Dcm_Impl
    DcmConfigSet
      DcmDsd
        DcmDsdServiceTable
          13 x DcmDsdService:
            DcmDsdService_READ_DTC_INFORMATION: DcmDsdSidTabServiceId=25, DcmDsdSidTabSubfuncAvail=true, DcmDsdSidTabSessionLevelRef=DcmDspSessionRow_DEFAULT_SESSION, DcmDsdSidTabSessionLevelRef=DcmDspSessionRow_EXTENDED_DIAGNOSTIC_SESSION
              4 x DcmDsdSubService:
                DcmDsdSubService_0xa: DcmDsdSubServiceId=10, DcmDsdSubServiceSessionLevelRef=DcmDspSessionRow_DEFAULT_SESSION, DcmDsdSubServiceSessionLevelRef=DcmDspSessionRow_EXTENDED_DIAGNOSTIC_SESSION
                DcmDsdSubService_0x4: DcmDsdSubServiceId=4, DcmDsdSubServiceSessionLevelRef=DcmDspSessionRow_DEFAULT_SESSION, DcmDsdSubServiceSessionLevelRef=DcmDspSessionRow_EXTENDED_DIAGNOSTIC_SESSION
                DcmDsdSubService_0x6: DcmDsdSubServiceId=6, DcmDsdSubServiceSessionLevelRef=DcmDspSessionRow_DEFAULT_SESSION, DcmDsdSubServiceSessionLevelRef=DcmDspSessionRow_EXTENDED_DIAGNOSTIC_SESSION
                RDTCBSM: DcmDsdSubServiceId=2
            DcmDsdService_REQUEST_UPLOAD: DcmDsdSidTabServiceId=53, DcmDsdSidTabSubfuncAvail=false, DcmDsdSidTabFnc=Dcm_DiagnosticService_0x35, DcmDsdSidTabSessionLevelRef=DcmDspSessionRow_EXTENDED_DIAGNOSTIC_SESSION
            DcmDsdService_SECURITY_ACCESS: DcmDsdSidTabServiceId=39, DcmDsdSidTabSubfuncAvail=true, DcmDsdSidTabSessionLevelRef=DcmDspSessionRow_EXTENDED_DIAGNOSTIC_SESSION
              8 x DcmDsdSubService:
                DcmDsdSubService_0x4: DcmDsdSubServiceId=4, DcmDsdSubServiceSessionLevelRef=DcmDspSessionRow_EXTENDED_DIAGNOSTIC_SESSION
                DcmDsdSubService_0x3: DcmDsdSubServiceId=3, DcmDsdSubServiceSessionLevelRef=DcmDspSessionRow_EXTENDED_DIAGNOSTIC_SESSION
                DcmDsdSubService_0x11: DcmDsdSubServiceId=17
                DcmDsdSubService_0x12: DcmDsdSubServiceId=18
                DcmDsdSubService_0x13: DcmDsdSubServiceId=19
                DcmDsdSubService_0x14: DcmDsdSubServiceId=20
                DcmDsdSubService_0x1: DcmDsdSubServiceId=1, DcmDsdSubServiceSessionLevelRef=DcmDspSessionRow_EXTENDED_DIAGNOSTIC_SESSION
                DcmDsdSubService_0x2: DcmDsdSubServiceId=2, DcmDsdSubServiceSessionLevelRef=DcmDspSessionRow_EXTENDED_DIAGNOSTIC_SESSION
            DcmDsdService_WRITE_DATA_BY_IDENTIFIER: DcmDsdSidTabServiceId=46, DcmDsdSidTabSubfuncAvail=false, DcmDsdSidTabSessionLevelRef=DcmDspSessionRow_CODING_SESSION, DcmDsdSidTabSessionLevelRef=DcmDspSessionRow_DEFAULT_SESSION, DcmDsdSidTabSessionLevelRef=DcmDspSessionRow_EXTENDED_DIAGNOSTIC_SESSION
            DcmDsdService_READ_DATA_BY_IDENTIFIER: DcmDsdSidTabServiceId=34, DcmDsdSidTabSubfuncAvail=false, DcmDsdSidTabSessionLevelRef=DcmDspSessionRow_CODING_SESSION, DcmDsdSidTabSessionLevelRef=DcmDspSessionRow_DEFAULT_SESSION, DcmDsdSidTabSessionLevelRef=DcmDspSessionRow_EXTENDED_DIAGNOSTIC_SESSION, DcmDsdSidTabSessionLevelRef=DcmDspSessionRow_HDD_DOWNLOAD_SESSION
            DcmDsdService_ROUTINE_CONTROL: DcmDsdSidTabServiceId=49, DcmDsdSidTabSubfuncAvail=true, DcmDsdSidTabSessionLevelRef=DcmDspSessionRow_CODING_SESSION, DcmDsdSidTabSessionLevelRef=DcmDspSessionRow_DEFAULT_SESSION, DcmDsdSidTabSessionLevelRef=DcmDspSessionRow_EXTENDED_DIAGNOSTIC_SESSION, DcmDsdSidTabSessionLevelRef=DcmDspSessionRow_HDD_DOWNLOAD_SESSION, DcmDsdSidTabSessionLevelRef=DcmDspSessionRow_SWT_SESSION
            DcmDsdService_CLEAR_DIAGNOSTIC_INFORMATION: DcmDsdSidTabServiceId=20, DcmDsdSidTabSubfuncAvail=false, DcmDsdSidTabSessionLevelRef=DcmDspSessionRow_DEFAULT_SESSION, DcmDsdSidTabSessionLevelRef=DcmDspSessionRow_EXTENDED_DIAGNOSTIC_SESSION
            DcmDsdService_DIAG_SESSION_CONTROL: DcmDsdSidTabServiceId=16, DcmDsdSidTabSubfuncAvail=true
              6 x DcmDsdSubService:
                Default: DcmDsdSubServiceId=1, DcmDsdSubServiceSessionLevelRef=DcmDspSessionRow_CODING_SESSION, DcmDsdSubServiceSessionLevelRef=DcmDspSessionRow_DEFAULT_SESSION, DcmDsdSubServiceSessionLevelRef=DcmDspSessionRow_EXTENDED_DIAGNOSTIC_SESSION
                Extended: DcmDsdSubServiceId=3, DcmDsdSubServiceSessionLevelRef=DcmDspSessionRow_DEFAULT_SESSION, DcmDsdSubServiceSessionLevelRef=DcmDspSessionRow_EXTENDED_DIAGNOSTIC_SESSION
                Programming: DcmDsdSubServiceId=2, DcmDsdSubServiceSessionLevelRef=DcmDspSessionRow_EXTENDED_DIAGNOSTIC_SESSION, DcmDsdSubServiceSessionLevelRef=DcmDspSessionRow_PROGRAMMING_SESSION
                Coding: DcmDsdSubServiceId=65, DcmDsdSubServiceSessionLevelRef=DcmDspSessionRow_CODING_SESSION, DcmDsdSubServiceSessionLevelRef=DcmDspSessionRow_EXTENDED_DIAGNOSTIC_SESSION
                Swt: DcmDsdSubServiceId=66
                HddDownload: DcmDsdSubServiceId=67
            TesterPresent: DcmDsdSidTabServiceId=62, DcmDsdSidTabSubfuncAvail=true, DcmDsdSidTabSessionLevelRef=DcmDspSessionRow_DEFAULT_SESSION, DcmDsdSidTabSessionLevelRef=DcmDspSessionRow_EXTENDED_DIAGNOSTIC_SESSION
              TesterPresent (DcmDsdSubService):
                DcmDsdSubServiceId = 0
                DcmDsdSubServiceSessionLevelRef = DcmDspSessionRow_DEFAULT_SESSION
                DcmDsdSubServiceSessionLevelRef = DcmDspSessionRow_EXTENDED_DIAGNOSTIC_SESSION
            DcmDsdService_COMMUNICATION_CONTROL: DcmDsdSidTabServiceId=40, DcmDsdSidTabSubfuncAvail=true, DcmDsdSidTabSessionLevelRef=DcmDspSessionRow_EXTENDED_DIAGNOSTIC_SESSION
              4 x DcmDsdSubService, all with DcmDsdSubServiceSessionLevelRef=DcmDspSessionRow_EXTENDED_DIAGNOSTIC_SESSION:
                DisableRxDisableTx: DcmDsdSubServiceId=3
                DisableRxEnableTx: DcmDsdSubServiceId=2
                EnableRxDisableTx: DcmDsdSubServiceId=1
                EnableRxEnableTx: DcmDsdSubServiceId=0
            DcmDsdService_CONTROL_DTC_SETTING: DcmDsdSidTabServiceId=133, DcmDsdSidTabSubfuncAvail=true, DcmDsdSidTabSessionLevelRef=DcmDspSessionRow_EXTENDED_DIAGNOSTIC_SESSION
              Enable (DcmDsdSubService): DcmDsdSubServiceId=1, DcmDsdSubServiceSessionLevelRef=DcmDspSessionRow_EXTENDED_DIAGNOSTIC_SESSION
              Disable (DcmDsdSubService): DcmDsdSubServiceId=2, DcmDsdSubServiceSessionLevelRef=DcmDspSessionRow_EXTENDED_DIAGNOSTIC_SESSION
            DcmDsdService_ECU_RESET: DcmDsdSidTabServiceId=17, DcmDsdSidTabSubfuncAvail=true, DcmDsdSidTabSessionLevelRef=DcmDspSessionRow_DEFAULT_SESSION, DcmDsdSidTabSessionLevelRef=DcmDspSessionRow_EXTENDED_DIAGNOSTIC_SESSION
              HardReset (DcmDsdSubService):
                DcmDsdSubServiceId = 1
                DcmDsdSubServiceSessionLevelRef = DcmDspSessionRow_DEFAULT_SESSION
                DcmDsdSubServiceSessionLevelRef = DcmDspSessionRow_EXTENDED_DIAGNOSTIC_SESSION
              EnableRapidShutdown (DcmDsdSubService):
                DcmDsdSubServiceId = 4
                DcmDsdSubServiceSessionLevelRef = DcmDspSessionRow_DEFAULT_SESSION
                DcmDsdSubServiceSessionLevelRef = DcmDspSessionRow_EXTENDED_DIAGNOSTIC_SESSION
            DcmDsdService_ROE: DcmDsdSidTabServiceId=134, DcmDsdSidTabSubfuncAvail=true, DcmDsdSidTabSessionLevelRef=DcmDspSessionRow_DEFAULT_SESSION, DcmDsdSidTabSessionLevelRef=DcmDspSessionRow_EXTENDED_DIAGNOSTIC_SESSION
              3 x DcmDsdSubService, all with DcmDsdSubServiceSessionLevelRef=DcmDspSessionRow_DEFAULT_SESSION, DcmDsdSubServiceSessionLevelRef=DcmDspSessionRow_EXTENDED_DIAGNOSTIC_SESSION:
                StStart: DcmDsdSubServiceId=69
                ReportActEv: DcmDsdSubServiceId=4
                StStop: DcmDsdSubServiceId=64
      DcmDsl  # Darh
        IntegrationSample (DcmDslServiceRequestManufacturerNotification)
        DcmDslBuffer: DcmDslBufferSize=8195
        DcmDslDiagResp: DcmDslDiagRespMaxNumRespPend=2, DcmDslDiagRespOnSecondDeclinedRequest=true, DcmDslDiagRespMaxNumOfDeclinedRequests=3
        DcmDslProtocol
          DcmDslProtocolRow_DCM_UDS_ON_FLEXRAY (DcmDslProtocolRow):
            DcmDslProtocolID = DCM_UDS_ON_FLEXRAY
            DcmDslProtocolTransType = TYPE1
            DcmSendRespPendOnTransToBoot = true
            DcmDslProtocolPriority = 0
            DcmTimStrP2ServerAdjust = 0.03
            DcmTimStrP2StarServerAdjust = 0.03
            DcmDslProtocolMaximumResponseSize = 4095
            DcmDslProtocolEndiannessConvEnabled = false
            DcmDslProtocolIsParallelExecutab = false
            DcmDslProtocolPreemptTimeout = 0
            DcmDslProtocolRxBufferID = DcmDslBuffer
            DcmDslProtocolSIDTable = DcmDsdServiceTable
            DcmDslProtocolTxBufferID = DcmDslBuffer
            DcmDemClientRef = DemClient_DCM
            14 x DcmDslConnection:
              DcmDslConnection_0xF4
                DcmDslMainConnection: DcmDslProtocolRxTesterSourceAddr=244
                  DcmDslProtocolRx_0xF4_ph (DcmDslProtocolRx):
                    DcmDslProtocolRxAddrType = DCM_PHYSICAL_TYPE
                    DcmDslProtocolRxPduId = 9
                    DcmDslProtocolRxChannelId = 0
                    DcmDslProtocolRxPduRef = PT_TL_MST_GW_TRNSM_FR_254_00980001_TxF4_PP_TL_MST_GW_TRNSM_FR_254_00980001_TxF4_Rx_7d601c47_052bff33
                    DcmDslProtocolRxComMChannelRef = A_FlexRay_5b5a9ac2
                  DcmDslProtocolRx_0xF4_fu (DcmDslProtocolRx):
                    DcmDslProtocolRxAddrType = DCM_FUNCTIONAL_TYPE
                    DcmDslProtocolRxPduId = 8
                    DcmDslProtocolRxChannelId = 0
                    DcmDslProtocolRxPduRef = PT_TL_BRC_FR_32_TxF4_0xDF_PP_TL_BRC_FR_32_TxF4_0xDF_Rx_7d601c47_052bff33
                    DcmDslProtocolRxComMChannelRef = A_FlexRay_5b5a9ac2
                  DcmDslProtocolTx_0xF4 (DcmDslProtocolTx):
                    DcmDslTxConfirmationPduId = 4
                    DcmDslProtocolTxPduRef = PT_TL_ECU_TRNSM_FR_32_00BC0001_RxF4_PP_TL_ECU_TRNSM_FR_32_00BC0001_RxF4_Tx_7d601c47_052bff33
              DcmDslConnection_0xF3
                DcmDslMainConnection: DcmDslProtocolRxTesterSourceAddr=243
                  DcmDslProtocolRx_0xF3_ph (DcmDslProtocolRx):
                    DcmDslProtocolRxAddrType = DCM_PHYSICAL_TYPE
                    DcmDslProtocolRxPduId = 7
                    DcmDslProtocolRxChannelId = 0
                    DcmDslProtocolRxPduRef = PT_TL_MST_GW_TRNSM_FR_254_00980001_TxF3_PP_TL_MST_GW_TRNSM_FR_254_00980001_TxF3_Rx_7d601c47_052bff33
                    DcmDslProtocolRxComMChannelRef = A_FlexRay_5b5a9ac2
                  DcmDslProtocolRx_0xF3_fu (DcmDslProtocolRx):
                    DcmDslProtocolRxAddrType = DCM_FUNCTIONAL_TYPE
                    DcmDslProtocolRxPduId = 6
                    DcmDslProtocolRxChannelId = 0
                    DcmDslProtocolRxPduRef = PT_TL_BRC_FR_32_TxF3_0xDF_PP_TL_BRC_FR_32_TxF3_0xDF_Rx_7d601c47_052bff33
                    DcmDslProtocolRxComMChannelRef = A_FlexRay_5b5a9ac2
                  DcmDslProtocolTx_0xF3 (DcmDslProtocolTx):
                    DcmDslTxConfirmationPduId = 3
                    DcmDslProtocolTxPduRef = PT_TL_ECU_TRNSM_FR_32_00BC0001_RxF3_PP_TL_ECU_TRNSM_FR_32_00BC0001_RxF3_Tx_7d601c47_052bff33
              DcmDslConnection_0xF2
                DcmDslMainConnection: DcmDslProtocolRxTesterSourceAddr=242
                  DcmDslProtocolRx_0xF2_ph (DcmDslProtocolRx):
                    DcmDslProtocolRxAddrType = DCM_PHYSICAL_TYPE
                    DcmDslProtocolRxPduId = 5
                    DcmDslProtocolRxChannelId = 0
                    DcmDslProtocolRxPduRef = PT_TL_MST_GW_TRNSM_FR_254_00980001_TxF2_PP_TL_MST_GW_TRNSM_FR_254_00980001_TxF2_Rx_7d601c47_052bff33
                    DcmDslProtocolRxComMChannelRef = A_FlexRay_5b5a9ac2
                  DcmDslProtocolRx_0xF2_fu (DcmDslProtocolRx):
                    DcmDslProtocolRxAddrType = DCM_FUNCTIONAL_TYPE
                    DcmDslProtocolRxPduId = 4
                    DcmDslProtocolRxChannelId = 0
                    DcmDslProtocolRxPduRef = PT_TL_BRC_FR_32_TxF2_0xDF_PP_TL_BRC_FR_32_TxF2_0xDF_Rx_7d601c47_052bff33
                    DcmDslProtocolRxComMChannelRef = A_FlexRay_5b5a9ac2
                  DcmDslProtocolTx_0xF2 (DcmDslProtocolTx):
                    DcmDslTxConfirmationPduId = 2
                    DcmDslProtocolTxPduRef = PT_TL_ECU_TRNSM_FR_32_00BC0001_RxF2_PP_TL_ECU_TRNSM_FR_32_00BC0001_RxF2_Tx_7d601c47_052bff33
              DcmDslConnection_0xF1
                DcmDslMainConnection: DcmDslProtocolRxTesterSourceAddr=241
                  DcmDslProtocolTx_0xF1 (DcmDslProtocolTx):
                    DcmDslTxConfirmationPduId = 1
                    DcmDslProtocolTxPduRef = PT_TL_ECU_TRNSM_FR_32_00BC0001_RxF1_PP_TL_ECU_TRNSM_FR_32_00BC0001_RxF1_Tx_7d601c47_052bff33
                  DcmDslProtocolRx_0xF1_ph (DcmDslProtocolRx):
                    DcmDslProtocolRxAddrType = DCM_PHYSICAL_TYPE
                    DcmDslProtocolRxPduId = 3
                    DcmDslProtocolRxChannelId = 0
                    DcmDslProtocolRxPduRef = PT_TL_MST_GW_TRNSM_FR_254_00980001_TxF1_PP_TL_MST_GW_TRNSM_FR_254_00980001_TxF1_Rx_7d601c47_052bff33
                    DcmDslProtocolRxComMChannelRef = A_FlexRay_5b5a9ac2
                  DcmDslProtocolRx_0xF1_fu (DcmDslProtocolRx):
                    DcmDslProtocolRxAddrType = DCM_FUNCTIONAL_TYPE
                    DcmDslProtocolRxPduId = 2
                    DcmDslProtocolRxChannelId = 0
                    DcmDslProtocolRxPduRef = PT_TL_BRC_FR_32_TxF1_0xDF_PP_TL_BRC_FR_32_TxF1_0xDF_Rx_7d601c47_052bff33
                    DcmDslProtocolRxComMChannelRef = A_FlexRay_5b5a9ac2
              DcmDslConnection_0xF8
                DcmDslMainConnection: DcmDslProtocolRxTesterSourceAddr=248
                  DcmDslProtocolRx_0xF8_ph (DcmDslProtocolRx):
                    DcmDslProtocolRxAddrType = DCM_PHYSICAL_TYPE
                    DcmDslProtocolRxPduId = 17
                    DcmDslProtocolRxChannelId = 0
                    DcmDslProtocolRxPduRef = PT_TL_MST_GW_TRNSM_FR_254_00980001_TxF8_PP_TL_MST_GW_TRNSM_FR_254_00980001_TxF8_Rx_7d601c47_052bff33
                    DcmDslProtocolRxComMChannelRef = A_FlexRay_5b5a9ac2
                  DcmDslProtocolTx_0xF8 (DcmDslProtocolTx):
                    DcmDslTxConfirmationPduId = 8
                    DcmDslProtocolTxPduRef = PT_TL_ECU_TRNSM_FR_32_00BC0001_RxF8_PP_TL_ECU_TRNSM_FR_32_00BC0001_RxF8_Tx_7d601c47_052bff33
                  DcmDslProtocolRx_0xF8_fu (DcmDslProtocolRx):
                    DcmDslProtocolRxAddrType = DCM_FUNCTIONAL_TYPE
                    DcmDslProtocolRxPduId = 16
                    DcmDslProtocolRxChannelId = 0
                    DcmDslProtocolRxPduRef = PT_TL_BRC_FR_32_TxF8_0xDF_PP_TL_BRC_FR_32_TxF8_0xDF_Rx_7d601c47_052bff33
                    DcmDslProtocolRxComMChannelRef = A_FlexRay_5b5a9ac2
              DcmDslConnection_0xF7
                DcmDslMainConnection: DcmDslProtocolRxTesterSourceAddr=247
                  DcmDslProtocolRx_0xF7_ph (DcmDslProtocolRx):
                    DcmDslProtocolRxAddrType = DCM_PHYSICAL_TYPE
                    DcmDslProtocolRxPduId = 15
                    DcmDslProtocolRxChannelId = 0
                    DcmDslProtocolRxPduRef = PT_TL_MST_GW_TRNSM_FR_254_00980001_TxF7_PP_TL_MST_GW_TRNSM_FR_254_00980001_TxF7_Rx_7d601c47_052bff33
                    DcmDslProtocolRxComMChannelRef = A_FlexRay_5b5a9ac2
                  DcmDslProtocolTx_0xF7 (DcmDslProtocolTx):
                    DcmDslTxConfirmationPduId = 7
                    DcmDslProtocolTxPduRef = PT_TL_ECU_TRNSM_FR_32_00BC0001_RxF7_PP_TL_ECU_TRNSM_FR_32_00BC0001_RxF7_Tx_7d601c47_052bff33
                  DcmDslProtocolRx_0xF7_fu (DcmDslProtocolRx):
                    DcmDslProtocolRxAddrType = DCM_FUNCTIONAL_TYPE
                    DcmDslProtocolRxPduId = 14
                    DcmDslProtocolRxChannelId = 0
                    DcmDslProtocolRxPduRef = PT_TL_BRC_FR_32_TxF7_0xDF_PP_TL_BRC_FR_32_TxF7_0xDF_Rx_7d601c47_052bff33
                    DcmDslProtocolRxComMChannelRef = A_FlexRay_5b5a9ac2
              DcmDslConnection_0xF6
                DcmDslMainConnection: DcmDslProtocolRxTesterSourceAddr=246
                  DcmDslProtocolRx_0xF6_ph (DcmDslProtocolRx):
                    DcmDslProtocolRxAddrType = DCM_PHYSICAL_TYPE
                    DcmDslProtocolRxPduId = 13
                    DcmDslProtocolRxChannelId = 0
                    DcmDslProtocolRxPduRef = PT_TL_MST_GW_TRNSM_FR_254_00980001_TxF6_PP_TL_MST_GW_TRNSM_FR_254_00980001_TxF6_Rx_7d601c47_052bff33
                    DcmDslProtocolRxComMChannelRef = A_FlexRay_5b5a9ac2
                  DcmDslProtocolTx_0xF6 (DcmDslProtocolTx):
                    DcmDslTxConfirmationPduId = 6
                    DcmDslProtocolTxPduRef = PT_TL_ECU_TRNSM_FR_32_00BC0001_RxF6_PP_TL_ECU_TRNSM_FR_32_00BC0001_RxF6_Tx_7d601c47_052bff33
                  DcmDslProtocolRx_0xF6_fu (DcmDslProtocolRx):
                    DcmDslProtocolRxAddrType = DCM_FUNCTIONAL_TYPE
                    DcmDslProtocolRxPduId = 12
                    DcmDslProtocolRxChannelId = 0
                    DcmDslProtocolRxPduRef = PT_TL_BRC_FR_32_TxF6_0xDF_PP_TL_BRC_FR_32_TxF6_0xDF_Rx_7d601c47_052bff33
                    DcmDslProtocolRxComMChannelRef = A_FlexRay_5b5a9ac2
              DcmDslConnection_0xF5
                DcmDslMainConnection: DcmDslProtocolRxTesterSourceAddr=245
                  DcmDslProtocolRx_0xF5_ph (DcmDslProtocolRx):
                    DcmDslProtocolRxAddrType = DCM_PHYSICAL_TYPE
                    DcmDslProtocolRxPduId = 11
                    DcmDslProtocolRxChannelId = 0
                    DcmDslProtocolRxPduRef = PT_TL_MST_GW_TRNSM_FR_254_00980001_TxF5_PP_TL_MST_GW_TRNSM_FR_254_00980001_TxF5_Rx_7d601c47_052bff33
                    DcmDslProtocolRxComMChannelRef = A_FlexRay_5b5a9ac2
                  DcmDslProtocolRx_0xF5_fu (DcmDslProtocolRx):
                    DcmDslProtocolRxAddrType = DCM_FUNCTIONAL_TYPE
                    DcmDslProtocolRxPduId = 10
                    DcmDslProtocolRxChannelId = 0
                    DcmDslProtocolRxPduRef = PT_TL_BRC_FR_32_TxF5_0xDF_PP_TL_BRC_FR_32_TxF5_0xDF_Rx_7d601c47_052bff33
                    DcmDslProtocolRxComMChannelRef = A_FlexRay_5b5a9ac2
                  DcmDslProtocolTx_0xF5 (DcmDslProtocolTx):
                    DcmDslTxConfirmationPduId = 5
                    DcmDslProtocolTxPduRef = PT_TL_ECU_TRNSM_FR_32_00BC0001_RxF5_PP_TL_ECU_TRNSM_FR_32_00BC0001_RxF5_Tx_7d601c47_052bff33
              DcmDslConnection_0xF0
                DcmDslMainConnection: DcmDslProtocolRxTesterSourceAddr=240
                  DcmDslProtocolTx_0xF0 (DcmDslProtocolTx):
                    DcmDslTxConfirmationPduId = 0
                    DcmDslProtocolTxPduRef = PT_TL_ECU_TRNSM_FR_32_00BC0001_RxF0_PP_TL_ECU_TRNSM_FR_32_00BC0001_RxF0_Tx_7d601c47_052bff33
                  DcmDslProtocolRx_0xF0_fu (DcmDslProtocolRx):
                    DcmDslProtocolRxAddrType = DCM_FUNCTIONAL_TYPE
                    DcmDslProtocolRxPduId = 0
                    DcmDslProtocolRxChannelId = 0
                    DcmDslProtocolRxPduRef = PT_TL_BRC_FR_32_TxF0_0xDF_PP_TL_BRC_FR_32_TxF0_0xDF_Rx_7d601c47_052bff33
                    DcmDslProtocolRxComMChannelRef = A_FlexRay_5b5a9ac2
                  DcmDslProtocolRx_0xF0_ph (DcmDslProtocolRx):
                    DcmDslProtocolRxAddrType = DCM_PHYSICAL_TYPE
                    DcmDslProtocolRxPduId = 1
                    DcmDslProtocolRxChannelId = 0
                    DcmDslProtocolRxPduRef = PT_TL_MST_GW_TRNSM_FR_254_00980001_TxF0_PP_TL_MST_GW_TRNSM_FR_254_00980001_TxF0_Rx_7d601c47_052bff33
                    DcmDslProtocolRxComMChannelRef = A_FlexRay_5b5a9ac2
              DcmDslConnection_0xFD
                DcmDslMainConnection: DcmDslProtocolRxTesterSourceAddr=253
                  DcmDslProtocolRx_0xFD_fu (DcmDslProtocolRx):
                    DcmDslProtocolRxAddrType = DCM_FUNCTIONAL_TYPE
                    DcmDslProtocolRxPduId = 26
                    DcmDslProtocolRxChannelId = 0
                    DcmDslProtocolRxPduRef = PT_TL_BRC_FR_32_TxFD_0xDF_PP_TL_BRC_FR_32_TxFD_0xDF_Rx_7d601c47_052bff33
                    DcmDslProtocolRxComMChannelRef = A_FlexRay_5b5a9ac2
                  DcmDslProtocolRx_0xFD_ph (DcmDslProtocolRx):
                    DcmDslProtocolRxAddrType = DCM_PHYSICAL_TYPE
                    DcmDslProtocolRxPduId = 27
                    DcmDslProtocolRxChannelId = 0
                    DcmDslProtocolRxPduRef = PT_TL_MST_GW_TRNSM_FR_254_00980001_TxFD_PP_TL_MST_GW_TRNSM_FR_254_00980001_TxFD_Rx_7d601c47_052bff33
                    DcmDslProtocolRxComMChannelRef = A_FlexRay_5b5a9ac2
                  DcmDslProtocolTx_0xFD (DcmDslProtocolTx):
                    DcmDslTxConfirmationPduId = 13
                    DcmDslProtocolTxPduRef = PT_TL_ECU_TRNSM_FR_32_00BC0001_RxFD_PP_TL_ECU_TRNSM_FR_32_00BC0001_RxFD_Tx_7d601c47_052bff33
              DcmDslConnection_0xFC
                DcmDslMainConnection: DcmDslProtocolRxTesterSourceAddr=252
                  DcmDslProtocolRx_0xFC_fu (DcmDslProtocolRx):
                    DcmDslProtocolRxAddrType = DCM_FUNCTIONAL_TYPE
                    DcmDslProtocolRxPduId = 24
                    DcmDslProtocolRxChannelId = 0
                    DcmDslProtocolRxPduRef = PT_TL_BRC_FR_32_TxFC_0xDF_PP_TL_BRC_FR_32_TxFC_0xDF_Rx_7d601c47_052bff33
                    DcmDslProtocolRxComMChannelRef = A_FlexRay_5b5a9ac2
                  DcmDslProtocolRx_0xFC_ph (DcmDslProtocolRx):
                    DcmDslProtocolRxAddrType = DCM_PHYSICAL_TYPE
                    DcmDslProtocolRxPduId = 25
                    DcmDslProtocolRxChannelId = 0
                    DcmDslProtocolRxPduRef = PT_TL_MST_GW_TRNSM_FR_254_00980001_TxFC_PP_TL_MST_GW_TRNSM_FR_254_00980001_TxFC_Rx_7d601c47_052bff33
                    DcmDslProtocolRxComMChannelRef = A_FlexRay_5b5a9ac2
                  DcmDslProtocolTx_0xFC (DcmDslProtocolTx):
                    DcmDslTxConfirmationPduId = 12
                    DcmDslProtocolTxPduRef = PT_TL_ECU_TRNSM_FR_32_00BC0001_RxFC_PP_TL_ECU_TRNSM_FR_32_00BC0001_RxFC_Tx_7d601c47_052bff33
              DcmDslConnection_0xFB
                DcmDslMainConnection: DcmDslProtocolRxTesterSourceAddr=251
                  DcmDslProtocolRx_0xFB_fu (DcmDslProtocolRx):
                    DcmDslProtocolRxAddrType = DCM_FUNCTIONAL_TYPE
                    DcmDslProtocolRxPduId = 22
                    DcmDslProtocolRxChannelId = 0
                    DcmDslProtocolRxPduRef = PT_TL_BRC_FR_32_TxFB_0xDF_PP_TL_BRC_FR_32_TxFB_0xDF_Rx_7d601c47_052bff33
                    DcmDslProtocolRxComMChannelRef = A_FlexRay_5b5a9ac2
                  DcmDslProtocolRx_0xFB_ph (DcmDslProtocolRx):
                    DcmDslProtocolRxAddrType = DCM_PHYSICAL_TYPE
                    DcmDslProtocolRxPduId = 23
                    DcmDslProtocolRxChannelId = 0
                    DcmDslProtocolRxPduRef = PT_TL_MST_GW_TRNSM_FR_254_00980001_TxFB_PP_TL_MST_GW_TRNSM_FR_254_00980001_TxFB_Rx_7d601c47_052bff33
                    DcmDslProtocolRxComMChannelRef = A_FlexRay_5b5a9ac2
                  DcmDslProtocolTx_0xFB (DcmDslProtocolTx):
                    DcmDslTxConfirmationPduId = 11
                    DcmDslProtocolTxPduRef = PT_TL_ECU_TRNSM_FR_32_00BC0001_RxFB_PP_TL_ECU_TRNSM_FR_32_00BC0001_RxFB_Tx_7d601c47_052bff33
              DcmDslConnection_0xFA
                DcmDslMainConnection: DcmDslProtocolRxTesterSourceAddr=250
                  DcmDslProtocolRx_0xFA_ph (DcmDslProtocolRx):
                    DcmDslProtocolRxAddrType = DCM_PHYSICAL_TYPE
                    DcmDslProtocolRxPduId = 21
                    DcmDslProtocolRxChannelId = 0
                    DcmDslProtocolRxPduRef = PT_TL_MST_GW_TRNSM_FR_254_00980001_TxFA_PP_TL_MST_GW_TRNSM_FR_254_00980001_TxFA_Rx_7d601c47_052bff33
                    DcmDslProtocolRxComMChannelRef = A_FlexRay_5b5a9ac2
                  DcmDslProtocolTx_0xFA (DcmDslProtocolTx):
                    DcmDslTxConfirmationPduId = 10
                    DcmDslProtocolTxPduRef = PT_TL_ECU_TRNSM_FR_32_00BC0001_RxFA_PP_TL_ECU_TRNSM_FR_32_00BC0001_RxFA_Tx_7d601c47_052bff33
                  DcmDslProtocolRx_0xFA_fu (DcmDslProtocolRx):
                    DcmDslProtocolRxAddrType = DCM_FUNCTIONAL_TYPE
                    DcmDslProtocolRxPduId = 20
                    DcmDslProtocolRxChannelId = 0
                    DcmDslProtocolRxPduRef = PT_TL_BRC_FR_32_TxFA_0xDF_PP_TL_BRC_FR_32_TxFA_0xDF_Rx_7d601c47_052bff33
                    DcmDslProtocolRxComMChannelRef = A_FlexRay_5b5a9ac2
              DcmDslConnection_0xF9
                DcmDslMainConnection: DcmDslProtocolRxTesterSourceAddr=249
                  DcmDslProtocolRx_0xF9_fu (DcmDslProtocolRx):
                    DcmDslProtocolRxAddrType = DCM_FUNCTIONAL_TYPE
                    DcmDslProtocolRxPduId = 18
                    DcmDslProtocolRxChannelId = 0
                    DcmDslProtocolRxPduRef = PT_TL_BRC_FR_32_TxF9_0xDF_PP_TL_BRC_FR_32_TxF9_0xDF_Rx_7d601c47_052bff33
                    DcmDslProtocolRxComMChannelRef = A_FlexRay_5b5a9ac2
                  DcmDslProtocolRx_0xF9_ph (DcmDslProtocolRx):
                    DcmDslProtocolRxAddrType = DCM_PHYSICAL_TYPE
                    DcmDslProtocolRxPduId = 19
                    DcmDslProtocolRxChannelId = 0
                    DcmDslProtocolRxPduRef = PT_TL_MST_GW_TRNSM_FR_254_00980001_TxF9_PP_TL_MST_GW_TRNSM_FR_254_00980001_TxF9_Rx_7d601c47_052bff33
                    DcmDslProtocolRxComMChannelRef = A_FlexRay_5b5a9ac2
                  DcmDslProtocolTx_0xF9 (DcmDslProtocolTx):
                    DcmDslTxConfirmationPduId = 9
                    DcmDslProtocolTxPduRef = PT_TL_ECU_TRNSM_FR_32_00BC0001_RxF9_PP_TL_ECU_TRNSM_FR_32_00BC0001_RxF9_Tx_7d601c47_052bff33
        StdDiag (DcmDslServiceRequestManufacturerNotification)
      DcmDsp: DcmDspMaxDidToRead=1, DcmDspReadDIDReportsNODIByte=false, DcmDspPowerDownTime=255
        DcmDspSession
          6 x DcmDspSessionRow:
            DcmDspSessionRow_DEFAULT_SESSION: DcmDspSessionForBoot=DCM_NO_BOOT, DcmDspSessionLevel=1, DcmDspSessionP2ServerMax=0.05, DcmDspSessionP2StarServerMax=5
            DcmDspSessionRow_SWT_SESSION: DcmDspSessionForBoot=DCM_NO_BOOT, DcmDspSessionLevel=66, DcmDspSessionP2ServerMax=0.05, DcmDspSessionP2StarServerMax=5
            DcmDspSessionRow_CODING_SESSION: DcmDspSessionForBoot=DCM_NO_BOOT, DcmDspSessionLevel=65, DcmDspSessionP2StarServerMax=5, DcmDspSessionP2ServerMax=0.05
            DcmDspSessionRow_PROGRAMMING_SESSION: DcmDspSessionForBoot=DCM_OEM_BOOT, DcmDspSessionLevel=2, DcmDspSessionP2ServerMax=0.095, DcmDspSessionP2StarServerMax=10
            DcmDspSessionRow_EXTENDED_DIAGNOSTIC_SESSION: DcmDspSessionForBoot=DCM_NO_BOOT, DcmDspSessionLevel=3, DcmDspSessionP2StarServerMax=5, DcmDspSessionP2ServerMax=0.05
            DcmDspSessionRow_HDD_DOWNLOAD_SESSION: DcmDspSessionForBoot=DCM_NO_BOOT, DcmDspSessionLevel=67, DcmDspSessionP2StarServerMax=5, DcmDspSessionP2ServerMax=0.05
        DcmDspDid_SvkBackup39 (DcmDspDid): DcmDspDidIdentifier=61738, DcmDspDidUsed=true, DcmDspDidUsePort=USE_DATA_ELEMENT_SPECIFIC_INTERFACES, DcmDspDidInfoRef=DcmDspDidInfo_SvkBackup39
          DcmDspDidSignal_SvkBackup39 (DcmDspDidSignal): DcmDspDidDataPos=0, DcmDspDidDataRef=DcmDspData_SvkBackup39
        DcmDspDidInfo_Cps (DcmDspDidInfo): DcmDspDidDynamicallyDefined=false
          DcmDspDidAccess
            DcmDspDidWrite: DcmDspDidWriteSecurityLevelRef=DcmDspSecurityRow_Coding, DcmDspDidWriteSessionRef=DcmDspSessionRow_CODING_SESSION
            DcmDspDidRead:
              DcmDspDidReadSessionRef = DcmDspSessionRow_DEFAULT_SESSION
              DcmDspDidReadSessionRef = DcmDspSessionRow_EXTENDED_DIAGNOSTIC_SESSION
              DcmDspDidReadSessionRef = DcmDspSessionRow_CODING_SESSION
        DcmDspDid_SvkBackup38 (DcmDspDid): DcmDspDidIdentifier=61737, DcmDspDidUsed=true, DcmDspDidUsePort=USE_DATA_ELEMENT_SPECIFIC_INTERFACES, DcmDspDidInfoRef=DcmDspDidInfo_SvkBackup38
          DcmDspDidSignal_SvkBackup38 (DcmDspDidSignal): DcmDspDidDataPos=0, DcmDspDidDataRef=DcmDspData_SvkBackup38
        DcmDspDid_SvkBackup37 (DcmDspDid): DcmDspDidIdentifier=61736, DcmDspDidUsed=true, DcmDspDidUsePort=USE_DATA_ELEMENT_SPECIFIC_INTERFACES, DcmDspDidInfoRef=DcmDspDidInfo_SvkBackup37
          DcmDspDidSignal_SvkBackup37 (DcmDspDidSignal): DcmDspDidDataPos=0, DcmDspDidDataRef=DcmDspData_SvkBackup37
        DcmDspRoutine_RcCppc_1Qt2kP (DcmDspRoutineInfo)
          DcmDspRoutineAuthorization: DcmDspRoutineSessionRef=DcmDspSessionRow_EXTENDED_DIAGNOSTIC_SESSION
          DcmDspStartRoutineOut_START_RcCppc (DcmDspStartRoutineOut)
            DcmDspStartRoutineOutSignal_dataOut (DcmDspStartRoutineOutSignal): DcmDspRoutineSignalPos=0, DcmDspRoutineSignalType=VARIABLE_LENGTH, DcmDspRoutineSignalLength=2048
        DcmDspDid_SvkBackup36 (DcmDspDid): DcmDspDidIdentifier=61735, DcmDspDidUsed=true, DcmDspDidUsePort=USE_DATA_ELEMENT_SPECIFIC_INTERFACES, DcmDspDidInfoRef=DcmDspDidInfo_SvkBackup36
          DcmDspDidSignal_SvkBackup36 (DcmDspDidSignal): DcmDspDidDataPos=0, DcmDspDidDataRef=DcmDspData_SvkBackup36
        DcmDspDid_SvkBackup35 (DcmDspDid): DcmDspDidIdentifier=61734, DcmDspDidUsed=true, DcmDspDidUsePort=USE_DATA_ELEMENT_SPECIFIC_INTERFACES, DcmDspDidInfoRef=DcmDspDidInfo_SvkBackup35
          DcmDspDidSignal_SvkBackup35 (DcmDspDidSignal): DcmDspDidDataPos=0, DcmDspDidDataRef=DcmDspData_SvkBackup35
        DcmDspRoutine_RcRswedi_3rXcSz (DcmDspRoutineInfo)
          DcmDspStartRoutineIn_START_RcRswedi (DcmDspStartRoutineIn)
            DcmDspStartRoutineInSignal_DataIn (DcmDspStartRoutineInSignal): DcmDspRoutineSignalLength=64, DcmDspRoutineSignalPos=0, DcmDspRoutineSignalType=VARIABLE_LENGTH
          DcmDspRoutineAuthorization: DcmDspRoutineSessionRef=DcmDspSessionRow_DEFAULT_SESSION, DcmDspRoutineSessionRef=DcmDspSessionRow_EXTENDED_DIAGNOSTIC_SESSION
          DcmDspStartRoutineOut_START_RcRswedi (DcmDspStartRoutineOut)
            DcmDspStartRoutineOutSignal_DataOut (DcmDspStartRoutineOutSignal): DcmDspRoutineSignalPos=0, DcmDspRoutineSignalType=VARIABLE_LENGTH, DcmDspRoutineSignalLength=128
        DcmDspDid_SvkBackup34 (DcmDspDid): DcmDspDidIdentifier=61733, DcmDspDidUsed=true, DcmDspDidUsePort=USE_DATA_ELEMENT_SPECIFIC_INTERFACES, DcmDspDidInfoRef=DcmDspDidInfo_SvkBackup34
          DcmDspDidSignal_SvkBackup34 (DcmDspDidSignal): DcmDspDidDataPos=0, DcmDspDidDataRef=DcmDspData_SvkBackup34
        DcmDspDid_SvkBackup33 (DcmDspDid): DcmDspDidIdentifier=61732, DcmDspDidUsed=true, DcmDspDidUsePort=USE_DATA_ELEMENT_SPECIFIC_INTERFACES, DcmDspDidInfoRef=DcmDspDidInfo_SvkBackup33
          DcmDspDidSignal_SvkBackup33 (DcmDspDidSignal): DcmDspDidDataPos=0, DcmDspDidDataRef=DcmDspData_SvkBackup33
        DcmDspData_MileKmEeprom (DcmDspData): DcmDspDataSize=24, DcmDspDataType=UINT8, DcmDspDataUsePort=USE_DATA_ASYNCH_CLIENT_SERVER, DcmDspDataInfoRef=DcmDspDataInfo_Dummy
        DcmDspDid_SvkBackup32 (DcmDspDid): DcmDspDidIdentifier=61731, DcmDspDidUsed=true, DcmDspDidUsePort=USE_DATA_ELEMENT_SPECIFIC_INTERFACES, DcmDspDidInfoRef=DcmDspDidInfo_SvkBackup32
          DcmDspDidSignal_SvkBackup32 (DcmDspDidSignal): DcmDspDidDataPos=0, DcmDspDidDataRef=DcmDspData_SvkBackup32
        DcmDspData_EnergySavingState (DcmDspData):
          DcmDspDataConditionCheckReadFncUsed = true
          DcmDspDataSize = 8
          DcmDspDataType = UINT8
          DcmDspDataUsePort = USE_DATA_SYNCH_CLIENT_SERVER
          DcmDspDataInfoRef = DcmDspDataInfo_Dummy
        3 x DcmDspDid, all with DcmDspDidUsed=true, DcmDspDidUsePort=USE_DATA_ELEMENT_SPECIFIC_INTERFACES:
          DcmDspDid_SvkBackup31: DcmDspDidIdentifier=61730, DcmDspDidInfoRef=DcmDspDidInfo_SvkBackup31
            DcmDspDidSignal_SvkBackup31 (DcmDspDidSignal): DcmDspDidDataPos=0, DcmDspDidDataRef=DcmDspData_SvkBackup31
          DcmDspDid_SvkBackup30: DcmDspDidIdentifier=61729, DcmDspDidInfoRef=DcmDspDidInfo_SvkBackup30
            DcmDspDidSignal_SvkBackup30 (DcmDspDidSignal): DcmDspDidDataPos=0, DcmDspDidDataRef=DcmDspData_SvkBackup30
          DcmDspDid_EthGetNumberOfPorts: DcmDspDidIdentifier=6144, DcmDspDidInfoRef=DcmDspDidInfo_EthGetNumberOfPorts
            DcmDspDidSignal_EthGetNumberOfPorts (DcmDspDidSignal): DcmDspDidDataPos=0, DcmDspDidDataRef=DcmDspData_EthGetNumberOfPorts
        DcmDspData_IndivDataTable (DcmDspData):
          DcmDspDataConditionCheckReadFncUsed = false
          DcmDspDataType = UINT8
          DcmDspDataUsePort = USE_DATA_SYNCH_CLIENT_SERVER
          DcmDspDataSize = 80
          DcmDspDataInfoRef = DcmDspDataInfo_Dummy
        DcmDspRoutine_FsN30X (DcmDspRoutine):
          DcmDspRoutineIdentifier = 524
          DcmDspRoutineUsePort = true
          DcmDspRoutineUsed = true
          DcmDspRequestResultsRoutineSupported = true
          DcmDspStopRoutineSupported = false
          DcmDspRoutineFixedLength = false
          DcmDspRoutineInfoRef = DcmDspRoutine_FsN30X_YxJhc
        DcmDspData_SvkWerk (DcmDspData):
          DcmDspDataConditionCheckReadFncUsed = true
          DcmDspDataType = UINT8
          DcmDspDataUsePort = USE_DATA_ASYNCH_CLIENT_SERVER
          DcmDspDataSize = 392
          DcmDspDataInfoRef = DcmDspDataInfo_Dummy
        DcmDspDidInfo_EnergySavingState (DcmDspDidInfo): DcmDspDidDynamicallyDefined=false
          DcmDspDidAccess
            DcmDspDidRead: DcmDspDidReadSessionRef=DcmDspSessionRow_DEFAULT_SESSION, DcmDspDidReadSessionRef=DcmDspSessionRow_EXTENDED_DIAGNOSTIC_SESSION
        DcmDspDidRange_Coding (DcmDspDidRange):
          DcmDspDidRangeHasGaps = true
          DcmDspDidRangeIdentifierLowerLimit = 12288
          DcmDspDidRangeIdentifierUpperLimit = 14334
          DcmDspDidRangeMaxDataLength = 250
          DcmDspDidRangeUsePort = true
          DcmDspDidRangeInfoRef = DcmDspDidInfo_Cps
        DcmDspData_Readhwmodificationindex (DcmDspData):
          DcmDspDataSize = 16
          DcmDspDataType = UINT8
          DcmDspDataUsePort = USE_DATA_SYNCH_CLIENT_SERVER
          DcmDspDataConditionCheckReadFncUsed = false
          DcmDspDataInfoRef = DcmDspDataInfo_Dummy
        4 x DcmDspDid, all with DcmDspDidUsed=true, DcmDspDidUsePort=USE_DATA_ELEMENT_SPECIFIC_INTERFACES:
          DcmDspDid_SvkBackup28: DcmDspDidIdentifier=61727, DcmDspDidInfoRef=DcmDspDidInfo_SvkBackup28
            DcmDspDidSignal_SvkBackup28 (DcmDspDidSignal): DcmDspDidDataPos=0, DcmDspDidDataRef=DcmDspData_SvkBackup28
          DcmDspDid_SvkBackup27: DcmDspDidIdentifier=61726, DcmDspDidInfoRef=DcmDspDidInfo_SvkBackup27
            DcmDspDidSignal_SvkBackup27 (DcmDspDidSignal): DcmDspDidDataPos=0, DcmDspDidDataRef=DcmDspData_SvkBackup27
          DcmDspDid_SvkBackup26: DcmDspDidIdentifier=61725, DcmDspDidInfoRef=DcmDspDidInfo_SvkBackup26
            DcmDspDidSignal_SvkBackup26 (DcmDspDidSignal): DcmDspDidDataPos=0, DcmDspDidDataRef=DcmDspData_SvkBackup26
          DcmDspDid_SvkBackup25: DcmDspDidIdentifier=61724, DcmDspDidInfoRef=DcmDspDidInfo_SvkBackup25
            DcmDspDidSignal_SvkBackup25 (DcmDspDidSignal): DcmDspDidDataPos=0, DcmDspDidDataRef=DcmDspData_SvkBackup25
        DcmDspRoutine_RcCpp (DcmDspRoutine):
          DcmDspRoutineIdentifier = 518
          DcmDspRoutineUsePort = true
          DcmDspRoutineUsed = true
          DcmDspRequestResultsRoutineSupported = false
          DcmDspStopRoutineSupported = false
          DcmDspRoutineFixedLength = false
          DcmDspRoutineInfoRef = DcmDspRoutine_RcCpp_q1vmL
        5 x DcmDspDid, all with DcmDspDidUsed=true, DcmDspDidUsePort=USE_DATA_ELEMENT_SPECIFIC_INTERFACES:
          DcmDspDid_SvkBackup24: DcmDspDidIdentifier=61723, DcmDspDidInfoRef=DcmDspDidInfo_SvkBackup24
            DcmDspDidSignal_SvkBackup24 (DcmDspDidSignal): DcmDspDidDataPos=0, DcmDspDidDataRef=DcmDspData_SvkBackup24
          DcmDspDid_SvkBackup23: DcmDspDidIdentifier=61722, DcmDspDidInfoRef=DcmDspDidInfo_SvkBackup23
            DcmDspDidSignal_SvkBackup23 (DcmDspDidSignal): DcmDspDidDataPos=0, DcmDspDidDataRef=DcmDspData_SvkBackup23
          DcmDspDid_SvkBackup22: DcmDspDidIdentifier=61721, DcmDspDidInfoRef=DcmDspDidInfo_SvkBackup22
            DcmDspDidSignal_SvkBackup22 (DcmDspDidSignal): DcmDspDidDataPos=0, DcmDspDidDataRef=DcmDspData_SvkBackup22
          DcmDspDid_SvkBackup21: DcmDspDidIdentifier=61720, DcmDspDidInfoRef=DcmDspDidInfo_SvkBackup21
            DcmDspDidSignal_SvkBackup21 (DcmDspDidSignal): DcmDspDidDataPos=0, DcmDspDidDataRef=DcmDspData_SvkBackup21
          DcmDspDid_SvkBackup20: DcmDspDidIdentifier=61719, DcmDspDidInfoRef=DcmDspDidInfo_SvkBackup20
            DcmDspDidSignal_SvkBackup20 (DcmDspDidSignal): DcmDspDidDataPos=0, DcmDspDidDataRef=DcmDspData_SvkBackup20
        DcmDspRoutine_FsMsmN220X (DcmDspRoutine):
          DcmDspRoutineIdentifier = 529
          DcmDspRoutineUsePort = true
          DcmDspRoutineUsed = true
          DcmDspRequestResultsRoutineSupported = false
          DcmDspStopRoutineSupported = false
          DcmDspRoutineFixedLength = false
          DcmDspRoutineInfoRef = DcmDspRoutine_FsMsmN220X_18JjzX
        DcmDspSecurity
          4 x DcmDspSecurityRow, all with DcmDspSecurityAttemptCounterEnabled=false, DcmDspSecurityDelayTime=0, DcmDspSecurityDelayTimeOnBoot=0, DcmDspSecurityUsePort=USE_ASYNCH_CLIENT_SERVER:
            DcmDspSecurityRow_Programming_HDD: DcmDspSecurityADRSize=4, DcmDspSecurityLevel=9, DcmDspSecuritySeedSize=8, DcmDspSecurityKeySize=4, DcmDspSecurityNumAttDelay=0
            DcmDspSecurityRow_Swt: DcmDspSecurityADRSize=4, DcmDspSecurityLevel=10, DcmDspSecuritySeedSize=8, DcmDspSecurityKeySize=132, DcmDspSecurityNumAttDelay=3
            DcmDspSecurityRow_Coding: DcmDspSecurityADRSize=4, DcmDspSecurityLevel=1, DcmDspSecuritySeedSize=8, DcmDspSecurityKeySize=132, DcmDspSecurityNumAttDelay=3
            DcmDspSecurityRow_level2: DcmDspSecurityKeySize=4, DcmDspSecurityLevel=2, DcmDspSecurityNumAttDelay=0, DcmDspSecuritySeedSize=4
        DcmDspRoutineInfo_d9xzR (DcmDspRoutineInfo)
          DcmDspStartRoutineIn_START_EthIpConfiguration (DcmDspStartRoutineIn)
            DcmDspStartRoutineInSignal_InternalExternalAddress (DcmDspStartRoutineInSignal): DcmDspRoutineSignalEndianness=opaque, DcmDspRoutineSignalLength=8, DcmDspRoutineSignalPos=0, DcmDspRoutineSignalType=UINT8
            DcmDspStartRoutineInSignal_TriggerGratuitousArp (DcmDspStartRoutineInSignal): DcmDspRoutineSignalEndianness=opaque, DcmDspRoutineSignalLength=8, DcmDspRoutineSignalPos=8, DcmDspRoutineSignalType=UINT8
          DcmDspRoutineAuthorization: DcmDspRoutineSessionRef=DcmDspSessionRow_DEFAULT_SESSION, DcmDspRoutineSessionRef=DcmDspSessionRow_EXTENDED_DIAGNOSTIC_SESSION
          DcmDspStartRoutineOut_START_EthIpConfiguration (DcmDspStartRoutineOut)
            DcmDspStartRoutineOutSignal_StatEthIpConfiguration (DcmDspStartRoutineOutSignal): DcmDspRoutineSignalPos=8, DcmDspRoutineSignalLength=8, DcmDspRoutineSignalType=UINT8
            DcmDspStartRoutineOutSignal_EcuType (DcmDspStartRoutineOutSignal): DcmDspRoutineSignalEndianness=opaque, DcmDspRoutineSignalLength=8, DcmDspRoutineSignalPos=0, DcmDspRoutineSignalType=UINT8
        10 x DcmDspDid, all with DcmDspDidUsed=true, DcmDspDidUsePort=USE_DATA_ELEMENT_SPECIFIC_INTERFACES:
          DcmDspDid_SvkBackup29: DcmDspDidIdentifier=61728, DcmDspDidInfoRef=DcmDspDidInfo_SvkBackup29
            DcmDspDidSignal_SvkBackup29 (DcmDspDidSignal): DcmDspDidDataPos=0, DcmDspDidDataRef=DcmDspData_SvkBackup29
          DcmDspDid_ListManipulationSecurityArtifact: DcmDspDidIdentifier=9616, DcmDspDidInfoRef=DcmDspDidInfo_ListManipulationSecurityArtifact
            DcmDspDidSignal_ListManipulationSecurityArtifact (DcmDspDidSignal): DcmDspDidDataPos=0, DcmDspDidDataRef=DcmDspData_ListManipulationSecurityArtifact
          DcmDspDid_SvkBackup17: DcmDspDidIdentifier=61716, DcmDspDidInfoRef=DcmDspDidInfo_SvkBackup17
            DcmDspDidSignal_SvkBackup17 (DcmDspDidSignal): DcmDspDidDataPos=0, DcmDspDidDataRef=DcmDspData_SvkBackup17
          DcmDspDid_SvkBackup16: DcmDspDidIdentifier=61715, DcmDspDidInfoRef=DcmDspDidInfo_SvkBackup16
            DcmDspDidSignal_SvkBackup16 (DcmDspDidSignal): DcmDspDidDataPos=0, DcmDspDidDataRef=DcmDspData_SvkBackup16
          DcmDspDid_SvkBackup15: DcmDspDidIdentifier=61714, DcmDspDidInfoRef=DcmDspDidInfo_SvkBackup15
            DcmDspDidSignal_SvkBackup15 (DcmDspDidSignal): DcmDspDidDataPos=0, DcmDspDidDataRef=DcmDspData_SvkBackup15
          DcmDspDid_SvkBackup14: DcmDspDidIdentifier=61713, DcmDspDidInfoRef=DcmDspDidInfo_SvkBackup14
            DcmDspDidSignal_SvkBackup14 (DcmDspDidSignal): DcmDspDidDataPos=0, DcmDspDidDataRef=DcmDspData_SvkBackup14
          DcmDspDid_SvkBackup13: DcmDspDidIdentifier=61712, DcmDspDidInfoRef=DcmDspDidInfo_SvkBackup13
            DcmDspDidSignal_SvkBackup13 (DcmDspDidSignal): DcmDspDidDataPos=0, DcmDspDidDataRef=DcmDspData_SvkBackup13
          DcmDspDid_SvkBackup12: DcmDspDidIdentifier=61711, DcmDspDidInfoRef=DcmDspDidInfo_SvkBackup12
            DcmDspDidSignal_SvkBackup12 (DcmDspDidSignal): DcmDspDidDataPos=0, DcmDspDidDataRef=DcmDspData_SvkBackup12
          DcmDspDid_SvkBackup11: DcmDspDidIdentifier=61710, DcmDspDidInfoRef=DcmDspDidInfo_SvkBackup11
            DcmDspDidSignal_SvkBackup11 (DcmDspDidSignal): DcmDspDidDataPos=0, DcmDspDidDataRef=DcmDspData_SvkBackup11
          DcmDspDid_SvkBackup10: DcmDspDidIdentifier=61709, DcmDspDidInfoRef=DcmDspDidInfo_SvkBackup10
            DcmDspDidSignal_SvkBackup10 (DcmDspDidSignal): DcmDspDidDataPos=0, DcmDspDidDataRef=DcmDspData_SvkBackup10
        DcmDspRoutineInfo_3sP0FB (DcmDspRoutineInfo)
          DcmDspStartRoutineIn_START_ControlExtendedEnergySavingState (DcmDspStartRoutineIn)
            DcmDspStartRoutineInSignal_ExtendedOperatingMode (DcmDspStartRoutineInSignal): DcmDspRoutineSignalLength=8, DcmDspRoutineSignalPos=0, DcmDspRoutineSignalType=UINT8
          DcmDspRoutineAuthorization: DcmDspRoutineSessionRef=DcmDspSessionRow_DEFAULT_SESSION, DcmDspRoutineSessionRef=DcmDspSessionRow_EXTENDED_DIAGNOSTIC_SESSION
        3 x DcmDspDidInfo, all with DcmDspDidDynamicallyDefined=false:
          DcmDspDidInfo_EcuSerialNumber
            DcmDspDidAccess
              DcmDspDidRead: DcmDspDidReadSessionRef=DcmDspSessionRow_EXTENDED_DIAGNOSTIC_SESSION, DcmDspDidReadSessionRef=DcmDspSessionRow_DEFAULT_SESSION
          DcmDspDidInfo_ListManipulationSw
            DcmDspDidAccess
              DcmDspDidRead: DcmDspDidReadSessionRef=DcmDspSessionRow_DEFAULT_SESSION, DcmDspDidReadSessionRef=DcmDspSessionRow_EXTENDED_DIAGNOSTIC_SESSION
          DcmDspDidInfo_IndivDataTable
            DcmDspDidAccess
              DcmDspDidRead: DcmDspDidReadSessionRef=DcmDspSessionRow_EXTENDED_DIAGNOSTIC_SESSION
        DcmDspRoutine_DmClientTriggerDtcEntry (DcmDspRoutine):
          DcmDspRoutineIdentifier = 772
          DcmDspRoutineUsePort = true
          DcmDspRoutineUsed = true
          DcmDspRequestResultsRoutineSupported = false
          DcmDspStopRoutineSupported = false
          DcmDspRoutineFixedLength = true
          DcmDspRoutineInfoRef = DcmDspRoutineInfo_15K4rM
        DcmDspDidInfo_DmDtcAktiveMeldung (DcmDspDidInfo): DcmDspDidDynamicallyDefined=false
          DcmDspDidAccess
            DcmDspDidRead: DcmDspDidReadSessionRef=DcmDspSessionRow_DEFAULT_SESSION, DcmDspDidReadSessionRef=DcmDspSessionRow_EXTENDED_DIAGNOSTIC_SESSION
        DcmDspData_ListManipulationSw (DcmDspData): DcmDspDataType=UINT8, DcmDspDataSize=65535, DcmDspDataUsePort=USE_DATA_ASYNCH_CLIENT_SERVER, DcmDspDataInfoRef=DcmDspDataInfo_Dummy
        3 x DcmDspRoutineInfo:
          DcmDspRoutineInfo_14zl3n
            DcmDspStartRoutineIn_START_DiagCommLoopback (DcmDspStartRoutineIn)
              DcmDspStartRoutineInSignal_dataIn (DcmDspStartRoutineInSignal): DcmDspRoutineSignalPos=0, DcmDspRoutineSignalType=VARIABLE_LENGTH, DcmDspRoutineSignalLength=128
            DcmDspStartRoutineOut_START_DiagCommLoopback (DcmDspStartRoutineOut)
              DcmDspStartRoutineOutSignal_dataOut (DcmDspStartRoutineOutSignal): DcmDspRoutineSignalPos=0, DcmDspRoutineSignalType=VARIABLE_LENGTH, DcmDspRoutineSignalLength=128
            DcmDspRoutineAuthorization: DcmDspRoutineSessionRef=DcmDspSessionRow_DEFAULT_SESSION, DcmDspRoutineSessionRef=DcmDspSessionRow_EXTENDED_DIAGNOSTIC_SESSION
          DcmDspRoutine_FsN5005_1TzqYQ
            DcmDspRoutineAuthorization: DcmDspRoutineSessionRef=DcmDspSessionRow_EXTENDED_DIAGNOSTIC_SESSION
            RESULT_FsN5005_OUT (DcmDspRoutineRequestResOut)
              4 x DcmDspRoutineRequestResOutSignal, all with DcmDspRoutineSignalLength=8, DcmDspRoutineSignalType=UINT8:
                DcmDspRequestRoutineResultsOutSignal_Res2: DcmDspRoutineSignalEndianness=opaque, DcmDspRoutineSignalPos=8
                DcmDspRequestRoutineResultsOutSignal_Len: DcmDspRoutineSignalEndianness=opaque, DcmDspRoutineSignalPos=16
                DcmDspRequestRoutineResultsOutSignal_Res1: DcmDspRoutineSignalEndianness=opaque, DcmDspRoutineSignalPos=0
                DcmDspRequestRoutineResultsOutSignal_SgMitFehlern: DcmDspRoutineSignalPos=24
            DcmDspStartRoutineIn_START_FsN5005 (DcmDspStartRoutineIn)
              DcmDspStartRoutineInSignal_Len (DcmDspStartRoutineInSignal): DcmDspRoutineSignalEndianness=opaque, DcmDspRoutineSignalLength=8, DcmDspRoutineSignalPos=0, DcmDspRoutineSignalType=UINT8
              DcmDspStartRoutineInSignal_Adr (DcmDspStartRoutineInSignal): DcmDspRoutineSignalPos=8, DcmDspRoutineSignalLength=8, DcmDspRoutineSignalType=UINT8
            DcmDspStartRoutineOut_START_FsN5005 (DcmDspStartRoutineOut)
              DcmDspStartRoutineOutSignal_Res1 (DcmDspStartRoutineOutSignal): DcmDspRoutineSignalEndianness=opaque, DcmDspRoutineSignalLength=8, DcmDspRoutineSignalPos=0, DcmDspRoutineSignalType=UINT8
              DcmDspStartRoutineOutSignal_Res2 (DcmDspStartRoutineOutSignal): DcmDspRoutineSignalEndianness=opaque, DcmDspRoutineSignalLength=8, DcmDspRoutineSignalPos=8, DcmDspRoutineSignalType=UINT8
          DcmDspRoutine_FsN5012_1TzqZm
            DcmDspRoutineAuthorization: DcmDspRoutineSessionRef=DcmDspSessionRow_DEFAULT_SESSION, DcmDspRoutineSessionRef=DcmDspSessionRow_EXTENDED_DIAGNOSTIC_SESSION
            DcmDspStartRoutineOut_START_FsN5012 (DcmDspStartRoutineOut)
              DcmDspStartRoutineOutSignal_Result1 (DcmDspStartRoutineOutSignal): DcmDspRoutineSignalLength=8, DcmDspRoutineSignalPos=0, DcmDspRoutineSignalType=UINT8
              DcmDspStartRoutineOutSignal_Result2 (DcmDspStartRoutineOutSignal): DcmDspRoutineSignalLength=8, DcmDspRoutineSignalPos=8, DcmDspRoutineSignalType=UINT8
            RESULT_FsN5012_OUT (DcmDspRoutineRequestResOut)
              3 x DcmDspRoutineRequestResOutSignal:
                DcmDspRequestRoutineResultsOutSignal_RandomNumberFscsm: DcmDspRoutineSignalLength=128, DcmDspRoutineSignalPos=16, DcmDspRoutineSignalType=VARIABLE_LENGTH
                DcmDspRequestRoutineResultsOutSignal_Result2: DcmDspRoutineSignalLength=8, DcmDspRoutineSignalPos=8, DcmDspRoutineSignalType=UINT8
                DcmDspRequestRoutineResultsOutSignal_Result1: DcmDspRoutineSignalLength=8, DcmDspRoutineSignalPos=0, DcmDspRoutineSignalType=UINT8
        DcmDspDidInfo_ProgrammingCounterMaxValue (DcmDspDidInfo): DcmDspDidDynamicallyDefined=false
          DcmDspDidAccess
            DcmDspDidRead: DcmDspDidReadSessionRef=DcmDspSessionRow_EXTENDED_DIAGNOSTIC_SESSION, DcmDspDidReadSessionRef=DcmDspSessionRow_DEFAULT_SESSION
        DcmDspDid_SvkBackup19 (DcmDspDid): DcmDspDidIdentifier=61718, DcmDspDidUsed=true, DcmDspDidUsePort=USE_DATA_ELEMENT_SPECIFIC_INTERFACES, DcmDspDidInfoRef=DcmDspDidInfo_SvkBackup19
          DcmDspDidSignal_SvkBackup19 (DcmDspDidSignal): DcmDspDidDataPos=0, DcmDspDidDataRef=DcmDspData_SvkBackup19
        DcmDspRoutine_SetDefaultBus (DcmDspRoutine):
          DcmDspRoutineIdentifier = 4112
          DcmDspRoutineUsePort = true
          DcmDspRoutineUsed = true
          DcmDspRequestResultsRoutineSupported = false
          DcmDspStopRoutineSupported = false
          DcmDspRoutineFixedLength = false
          DcmDspRoutineInfoRef = DcmDspRoutineInfo_1gWdmq
        5 x DcmDspDid, all with DcmDspDidUsed=true, DcmDspDidUsePort=USE_DATA_ELEMENT_SPECIFIC_INTERFACES:
          DcmDspDid_SvkBackup18: DcmDspDidIdentifier=61717, DcmDspDidInfoRef=DcmDspDidInfo_SvkBackup18
            DcmDspDidSignal_SvkBackup18 (DcmDspDidSignal): DcmDspDidDataPos=0, DcmDspDidDataRef=DcmDspData_SvkBackup18
          DcmDspDid_SvkBackup06: DcmDspDidIdentifier=61705, DcmDspDidInfoRef=DcmDspDidInfo_SvkBackup06
            DcmDspDidSignal_SvkBackup06 (DcmDspDidSignal): DcmDspDidDataPos=0, DcmDspDidDataRef=DcmDspData_SvkBackup06
          DcmDspDid_SvkBackup05: DcmDspDidIdentifier=61704, DcmDspDidInfoRef=DcmDspDidInfo_SvkBackup05
            DcmDspDidSignal_SvkBackup05 (DcmDspDidSignal): DcmDspDidDataPos=0, DcmDspDidDataRef=DcmDspData_SvkBackup05
          DcmDspDid_SvkBackup04: DcmDspDidIdentifier=61703, DcmDspDidInfoRef=DcmDspDidInfo_SvkBackup04
            DcmDspDidSignal_SvkBackup04 (DcmDspDidSignal): DcmDspDidDataPos=0, DcmDspDidDataRef=DcmDspData_SvkBackup04
          DcmDspDid_SvkBackup03: DcmDspDidIdentifier=61702, DcmDspDidInfoRef=DcmDspDidInfo_SvkBackup03
            DcmDspDidSignal_SvkBackup03 (DcmDspDidSignal): DcmDspDidDataPos=0, DcmDspDidDataRef=DcmDspData_SvkBackup03
        DcmDspRoutine_FsMsmN220X_18JjzX (DcmDspRoutineInfo)
          DcmDspStartRoutineIn_START_FsMsmN220X (DcmDspStartRoutineIn)
            DcmDspStartRoutineInSignal_Par3Req (DcmDspStartRoutineInSignal): DcmDspRoutineSignalEndianness=opaque, DcmDspRoutineSignalLength=8, DcmDspRoutineSignalPos=0, DcmDspRoutineSignalType=UINT8
            DcmDspStartRoutineInSignal_Par4Req (DcmDspStartRoutineInSignal): DcmDspRoutineSignalEndianness=opaque, DcmDspRoutineSignalLength=8, DcmDspRoutineSignalPos=8, DcmDspRoutineSignalType=UINT8
          DcmDspRoutineAuthorization: DcmDspRoutineSessionRef=DcmDspSessionRow_EXTENDED_DIAGNOSTIC_SESSION
          DcmDspStartRoutineOut_START_FsMsmN220X (DcmDspStartRoutineOut)
            DcmDspStartRoutineOutSignal_Par3Resp (DcmDspStartRoutineOutSignal): DcmDspRoutineSignalEndianness=opaque, DcmDspRoutineSignalLength=8, DcmDspRoutineSignalPos=0, DcmDspRoutineSignalType=UINT8
            DcmDspStartRoutineOutSignal_Par4Resp (DcmDspStartRoutineOutSignal): DcmDspRoutineSignalEndianness=opaque, DcmDspRoutineSignalLength=8, DcmDspRoutineSignalPos=8, DcmDspRoutineSignalType=UINT8
        DcmDspDid_SvkBackup02 (DcmDspDid): DcmDspDidIdentifier=61701, DcmDspDidUsed=true, DcmDspDidUsePort=USE_DATA_ELEMENT_SPECIFIC_INTERFACES, DcmDspDidInfoRef=DcmDspDidInfo_SvkBackup02
          DcmDspDidSignal_SvkBackup02 (DcmDspDidSignal): DcmDspDidDataPos=0, DcmDspDidDataRef=DcmDspData_SvkBackup02
        DcmDspDid_SvkBackup01 (DcmDspDid): DcmDspDidIdentifier=61700, DcmDspDidUsed=true, DcmDspDidUsePort=USE_DATA_ELEMENT_SPECIFIC_INTERFACES, DcmDspDidInfoRef=DcmDspDidInfo_SvkBackup01
          DcmDspDidSignal_SvkBackup01 (DcmDspDidSignal): DcmDspDidDataPos=0, DcmDspDidDataRef=DcmDspData_SvkBackup01
        DcmDspRoutine_EraseIdrData (DcmDspRoutine):
          DcmDspRoutineIdentifier = 4122
          DcmDspRoutineUsePort = true
          DcmDspRoutineUsed = true
          DcmDspRequestResultsRoutineSupported = false
          DcmDspStopRoutineSupported = false
          DcmDspRoutineFixedLength = true
          DcmDspRoutineInfoRef = DcmDspRoutineInfo_4ctJmy
        DcmDspRoutine_RcHdddRi4002 (DcmDspRoutine):
          DcmDspRequestResultsRoutineSupported = false
          DcmDspStopRoutineSupported = false
          DcmDspRoutineIdentifier = 516
          DcmDspRoutineUsePort = true
          DcmDspRoutineUsed = true
          DcmDspRoutineFixedLength = false
          DcmDspRoutineInfoRef = DcmDspRoutineInfo_x6nJQ
        DcmDspDid_StatusSystime (DcmDspDid): DcmDspDidIdentifier=5925, DcmDspDidUsed=true, DcmDspDidUsePort=USE_DATA_ELEMENT_SPECIFIC_INTERFACES, DcmDspDidInfoRef=DcmDspDidInfo_StatusSystime
          DcmDspDidSignal_StatusSystime (DcmDspDidSignal): DcmDspDidDataPos=0, DcmDspDidDataRef=DcmDspData_StatusSystime
        DcmDspRoutine_EthExtendedArlTable (DcmDspRoutine):
          DcmDspRoutineIdentifier = 4174
          DcmDspRoutineUsePort = true
          DcmDspRoutineUsed = true
          DcmDspRequestResultsRoutineSupported = false
          DcmDspStopRoutineSupported = false
          DcmDspRoutineFixedLength = false
          DcmDspRoutineInfoRef = DcmDspRoutineInfo_10R48r
        3 x DcmDspDid, all with DcmDspDidUsed=true, DcmDspDidUsePort=USE_DATA_ELEMENT_SPECIFIC_INTERFACES:
          DcmDspDid_SvkBackup09: DcmDspDidIdentifier=61708, DcmDspDidInfoRef=DcmDspDidInfo_SvkBackup09
            DcmDspDidSignal_SvkBackup09 (DcmDspDidSignal): DcmDspDidDataPos=0, DcmDspDidDataRef=DcmDspData_SvkBackup09
          DcmDspDid_SvkBackup08: DcmDspDidIdentifier=61707, DcmDspDidInfoRef=DcmDspDidInfo_SvkBackup08
            DcmDspDidSignal_SvkBackup08 (DcmDspDidSignal): DcmDspDidDataPos=0, DcmDspDidDataRef=DcmDspData_SvkBackup08
          DcmDspDid_SvkBackup07: DcmDspDidIdentifier=61706, DcmDspDidInfoRef=DcmDspDidInfo_SvkBackup07
            DcmDspDidSignal_SvkBackup07 (DcmDspDidSignal): DcmDspDidDataPos=0, DcmDspDidDataRef=DcmDspData_SvkBackup07
        5 x DcmDspDidInfo, all with DcmDspDidDynamicallyDefined=false:
          DcmDspDidInfo_SvkBackup05
            DcmDspDidAccess
              DcmDspDidRead: DcmDspDidReadSessionRef=DcmDspSessionRow_EXTENDED_DIAGNOSTIC_SESSION, DcmDspDidReadSessionRef=DcmDspSessionRow_DEFAULT_SESSION
          DcmDspDidInfo_SvkBackup06
            DcmDspDidAccess
              DcmDspDidRead: DcmDspDidReadSessionRef=DcmDspSessionRow_DEFAULT_SESSION, DcmDspDidReadSessionRef=DcmDspSessionRow_EXTENDED_DIAGNOSTIC_SESSION
          DcmDspDidInfo_SvkBackup03
            DcmDspDidAccess
              DcmDspDidRead: DcmDspDidReadSessionRef=DcmDspSessionRow_DEFAULT_SESSION, DcmDspDidReadSessionRef=DcmDspSessionRow_EXTENDED_DIAGNOSTIC_SESSION
          DcmDspDidInfo_SvkBackup04
            DcmDspDidAccess
              DcmDspDidRead: DcmDspDidReadSessionRef=DcmDspSessionRow_EXTENDED_DIAGNOSTIC_SESSION, DcmDspDidReadSessionRef=DcmDspSessionRow_DEFAULT_SESSION
          DcmDspDidInfo_SvkBackup09
            DcmDspDidAccess
              DcmDspDidRead: DcmDspDidReadSessionRef=DcmDspSessionRow_DEFAULT_SESSION, DcmDspDidReadSessionRef=DcmDspSessionRow_EXTENDED_DIAGNOSTIC_SESSION
        DcmDspData_FlashTimingParameter (DcmDspData):
          DcmDspDataConditionCheckReadFncUsed = false
          DcmDspDataSize = 96
          DcmDspDataType = UINT8
          DcmDspDataUsePort = USE_DATA_SYNCH_CLIENT_SERVER
          DcmDspDataInfoRef = DcmDspDataInfo_Dummy
        DcmDspDidInfo_SvkBackup07 (DcmDspDidInfo): DcmDspDidDynamicallyDefined=false
          DcmDspDidAccess
            DcmDspDidRead: DcmDspDidReadSessionRef=DcmDspSessionRow_DEFAULT_SESSION, DcmDspDidReadSessionRef=DcmDspSessionRow_EXTENDED_DIAGNOSTIC_SESSION
        DcmDspRoutineInfo_SyJZQ (DcmDspRoutineInfo)
          RESULT_FehlerspeicherEndeWerksablauf_OUT (DcmDspRoutineRequestResOut)
            DcmDspRequestRoutineResultsOutSignal_StatFsEndeWabl (DcmDspRoutineRequestResOutSignal): DcmDspRoutineSignalEndianness=opaque, DcmDspRoutineSignalLength=8, DcmDspRoutineSignalPos=0, DcmDspRoutineSignalType=UINT8
          DcmDspRoutineAuthorization: DcmDspRoutineSessionRef=DcmDspSessionRow_DEFAULT_SESSION, DcmDspRoutineSessionRef=DcmDspSessionRow_EXTENDED_DIAGNOSTIC_SESSION
        DcmDspDidInfo_SvkBackup08 (DcmDspDidInfo): DcmDspDidDynamicallyDefined=false
          DcmDspDidAccess
            DcmDspDidRead: DcmDspDidReadSessionRef=DcmDspSessionRow_DEFAULT_SESSION, DcmDspDidReadSessionRef=DcmDspSessionRow_EXTENDED_DIAGNOSTIC_SESSION
        DcmDspDidInfo_SvkBackup01 (DcmDspDidInfo): DcmDspDidDynamicallyDefined=false
          DcmDspDidAccess
            DcmDspDidRead: DcmDspDidReadSessionRef=DcmDspSessionRow_EXTENDED_DIAGNOSTIC_SESSION, DcmDspDidReadSessionRef=DcmDspSessionRow_DEFAULT_SESSION
        DcmDspDataInfo_bY4y4 (DcmDspDataInfo): DcmDspDataFixedLength=false
        DcmDspDidInfo_SvkBackup02 (DcmDspDidInfo): DcmDspDidDynamicallyDefined=false
          DcmDspDidAccess
            DcmDspDidRead: DcmDspDidReadSessionRef=DcmDspSessionRow_EXTENDED_DIAGNOSTIC_SESSION, DcmDspDidReadSessionRef=DcmDspSessionRow_DEFAULT_SESSION
        DcmDspRoutineInfo_x6nJQ (DcmDspRoutineInfo)
          DcmDspRoutineAuthorization
        DcmDspDid_HddDownloadTimeToCompletion (DcmDspDid):
          DcmDspDidIdentifier = 9489
          DcmDspDidUsed = true
          DcmDspDidUsePort = USE_DATA_ELEMENT_SPECIFIC_INTERFACES
          DcmDspDidInfoRef = DcmDspDidInfo_HddDownloadTimeToCompletion
          DcmDspDidSignal_HddDownloadTimeToCompletion (DcmDspDidSignal): DcmDspDidDataPos=0, DcmDspDidDataRef=DcmDspData_HddDownloadTimeToCompletion
        DcmDspRoutineInfo_4LZ7vb (DcmDspRoutineInfo)
          DcmDspRoutineAuthorization: DcmDspRoutineSessionRef=DcmDspSessionRow_DEFAULT_SESSION, DcmDspRoutineSessionRef=DcmDspSessionRow_EXTENDED_DIAGNOSTIC_SESSION
          DcmDspStartRoutineIn_START_EthReadPhyRegister (DcmDspStartRoutineIn)
            DcmDspStartRoutineInSignal_Data (DcmDspStartRoutineInSignal): DcmDspRoutineSignalPos=8, DcmDspRoutineSignalLength=8, DcmDspRoutineSignalType=UINT8
            DcmDspStartRoutineInSignal_RegReadRange (DcmDspStartRoutineInSignal): DcmDspRoutineSignalEndianness=opaque, DcmDspRoutineSignalLength=8, DcmDspRoutineSignalPos=0, DcmDspRoutineSignalType=UINT8
          DcmDspStartRoutineOut_START_EthReadPhyRegister (DcmDspStartRoutineOut)
            DcmDspStartRoutineOutSignal_StatRegReadData (DcmDspStartRoutineOutSignal): DcmDspRoutineSignalPos=8, DcmDspRoutineSignalLength=128, DcmDspRoutineSignalType=UINT8
            DcmDspStartRoutineOutSignal_StatRegReadOk (DcmDspStartRoutineOutSignal): DcmDspRoutineSignalEndianness=opaque, DcmDspRoutineSignalLength=8, DcmDspRoutineSignalPos=0, DcmDspRoutineSignalType=UINT8
        DcmDspRoutine_FsN31034_2gPlQH (DcmDspRoutineInfo)
          DcmDspRoutineAuthorization: DcmDspRoutineSessionRef=DcmDspSessionRow_EXTENDED_DIAGNOSTIC_SESSION
          DcmDspStartRoutineIn_START_FsN31034 (DcmDspStartRoutineIn)
            4 x DcmDspStartRoutineInSignal:
              DcmDspStartRoutineInSignal_Len: DcmDspRoutineSignalEndianness=BIG_ENDIAN, DcmDspRoutineSignalLength=16, DcmDspRoutineSignalPos=16, DcmDspRoutineSignalType=UINT16
              DcmDspStartRoutineInSignal_Par4Req: DcmDspRoutineSignalEndianness=opaque, DcmDspRoutineSignalLength=8, DcmDspRoutineSignalPos=0, DcmDspRoutineSignalType=UINT8
              DcmDspStartRoutineInSignal_Data: DcmDspRoutineSignalPos=32, DcmDspRoutineSignalLength=8, DcmDspRoutineSignalType=UINT8
              DcmDspStartRoutineInSignal_Par5: DcmDspRoutineSignalEndianness=opaque, DcmDspRoutineSignalLength=8, DcmDspRoutineSignalPos=8, DcmDspRoutineSignalType=UINT8
          DcmDspStartRoutineOut_START_FsN31034 (DcmDspStartRoutineOut)
            DcmDspStartRoutineOutSignal_Par4Resp (DcmDspStartRoutineOutSignal): DcmDspRoutineSignalEndianness=opaque, DcmDspRoutineSignalLength=8, DcmDspRoutineSignalPos=0, DcmDspRoutineSignalType=UINT8
        DcmDspData_SvkBackup48 (DcmDspData): DcmDspDataType=UINT8, DcmDspDataSize=392, DcmDspDataUsePort=USE_DATA_ASYNCH_CLIENT_SERVER, DcmDspDataInfoRef=DcmDspDataInfo_Dummy
        DcmDspRoutine_Swt (DcmDspRoutine):
          DcmDspRoutineIdentifier = 3871
          DcmDspRoutineUsePort = true
          DcmDspRoutineUsed = true
          DcmDspRequestResultsRoutineSupported = false
          DcmDspStopRoutineSupported = false
          DcmDspRoutineFixedLength = false
          DcmDspRoutineInfoRef = DcmDspRoutine_Swt_3DPx9T
        10 x DcmDspData, all with DcmDspDataType=UINT8, DcmDspDataUsePort=USE_DATA_ASYNCH_CLIENT_SERVER, DcmDspDataInfoRef=DcmDspDataInfo_Dummy:
          DcmDspData_SvkBackup47: DcmDspDataSize=392
          DcmDspData_SvkBackup49: DcmDspDataSize=392
          DcmDspData_SvkBackup44: DcmDspDataSize=392
          DcmDspData_SvkBackup43: DcmDspDataSize=392
          DcmDspData_SvkBackup46: DcmDspDataSize=392
          DcmDspData_SvkBackup45: DcmDspDataSize=392
          DcmDspData_SystemSupplierIdentifier: DcmDspDataSize=24
          DcmDspData_SvkBackup40: DcmDspDataSize=392
          DcmDspData_SvkBackup42: DcmDspDataSize=392
          DcmDspData_SvkBackup41: DcmDspDataSize=392
        DcmDspDid_StatusDmFssMaster (DcmDspDid):
          DcmDspDidIdentifier = 5904
          DcmDspDidUsed = true
          DcmDspDidUsePort = USE_DATA_ELEMENT_SPECIFIC_INTERFACES
          DcmDspDidInfoRef = DcmDspDidInfo_StatusDmFssMaster
          DcmDspDidSignal_StatusDmFssMaster (DcmDspDidSignal): DcmDspDidDataPos=0, DcmDspDidDataRef=DcmDspData_StatusDmFssMaster
        DcmDspData_SvkBackup60 (DcmDspData): DcmDspDataType=UINT8, DcmDspDataSize=392, DcmDspDataUsePort=USE_DATA_ASYNCH_CLIENT_SERVER, DcmDspDataInfoRef=DcmDspDataInfo_Dummy
        DcmDspRoutineInfo_1SGY3D (DcmDspRoutineInfo)
          DcmDspStartRoutineOut_START_EthArlTable (DcmDspStartRoutineOut)
            DcmDspStartRoutineOutSignal_StatArlVlanIdEntries (DcmDspStartRoutineOutSignal): DcmDspRoutineSignalPos=8, DcmDspRoutineSignalLength=8, DcmDspRoutineSignalType=UINT8
            DcmDspStartRoutineOutSignal_StatNumArlVlanIdEntriesWert (DcmDspStartRoutineOutSignal): DcmDspRoutineSignalEndianness=opaque, DcmDspRoutineSignalLength=8, DcmDspRoutineSignalPos=0, DcmDspRoutineSignalType=UINT8
          DcmDspStartRoutineIn_START_EthArlTable (DcmDspStartRoutineIn)
            DcmDspStartRoutineInSignal_PortIndex (DcmDspStartRoutineInSignal): DcmDspRoutineSignalEndianness=opaque, DcmDspRoutineSignalLength=8, DcmDspRoutineSignalPos=0, DcmDspRoutineSignalType=UINT8
          DcmDspRoutineAuthorization: DcmDspRoutineSessionRef=DcmDspSessionRow_DEFAULT_SESSION, DcmDspRoutineSessionRef=DcmDspSessionRow_EXTENDED_DIAGNOSTIC_SESSION
        4 x DcmDspData, all with DcmDspDataType=UINT8, DcmDspDataSize=392, DcmDspDataUsePort=USE_DATA_ASYNCH_CLIENT_SERVER, DcmDspDataInfoRef=DcmDspDataInfo_Dummy:
          DcmDspData_SvkBackup59
          DcmDspData_SvkBackup58
          DcmDspData_SvkBackup55
          DcmDspData_SvkBackup54
        DcmDspRoutine_IsLoeschen (DcmDspRoutine):
          DcmDspRoutineIdentifier = 3846
          DcmDspRoutineUsePort = true
          DcmDspRoutineUsed = true
          DcmDspRequestResultsRoutineSupported = false
          DcmDspStopRoutineSupported = false
          DcmDspRoutineFixedLength = true
          DcmDspRoutineInfoRef = DcmDspRoutine_IsLoeschen_26SwJG
        3 x DcmDspData, all with DcmDspDataType=UINT8, DcmDspDataUsePort=USE_DATA_ASYNCH_CLIENT_SERVER, DcmDspDataInfoRef=DcmDspDataInfo_Dummy:
          DcmDspData_SvkBackup57: DcmDspDataSize=392
          DcmDspData_SvkBackup56: DcmDspDataSize=392
          DcmDspData_ZgwZertifikat: DcmDspDataSize=65535
        DcmDspRoutineInfo_3MGry8 (DcmDspRoutineInfo)
          DcmDspRoutineAuthorization: DcmDspRoutineSessionRef=DcmDspSessionRow_DEFAULT_SESSION, DcmDspRoutineSessionRef=DcmDspSessionRow_EXTENDED_DIAGNOSTIC_SESSION
          RESULT_RamDatenSchreiben_OUT (DcmDspRoutineRequestResOut)
            DcmDspRequestRoutineResultsOutSignal_StatRamDatenSchreiben (DcmDspRoutineRequestResOutSignal): DcmDspRoutineSignalEndianness=opaque, DcmDspRoutineSignalLength=8, DcmDspRoutineSignalPos=0, DcmDspRoutineSignalType=UINT8
        DcmDspData_SvkBackup51 (DcmDspData): DcmDspDataType=UINT8, DcmDspDataSize=392, DcmDspDataUsePort=USE_DATA_ASYNCH_CLIENT_SERVER, DcmDspDataInfoRef=DcmDspDataInfo_Dummy
        DcmDspDidInfo_SwfkDeleteSupported (DcmDspDidInfo): DcmDspDidDynamicallyDefined=false
          DcmDspDidAccess
            DcmDspDidRead: DcmDspDidReadSessionRef=DcmDspSessionRow_DEFAULT_SESSION, DcmDspDidReadSessionRef=DcmDspSessionRow_EXTENDED_DIAGNOSTIC_SESSION
        3 x DcmDspData, all with DcmDspDataType=UINT8, DcmDspDataSize=392, DcmDspDataUsePort=USE_DATA_ASYNCH_CLIENT_SERVER, DcmDspDataInfoRef=DcmDspDataInfo_Dummy:
          DcmDspData_SvkBackup50
          DcmDspData_SvkBackup53
          DcmDspData_SvkBackup52
        DcmDspDidInfo_SvkBackup27 (DcmDspDidInfo): DcmDspDidDynamicallyDefined=false
          DcmDspDidAccess
            DcmDspDidRead: DcmDspDidReadSessionRef=DcmDspSessionRow_DEFAULT_SESSION, DcmDspDidReadSessionRef=DcmDspSessionRow_EXTENDED_DIAGNOSTIC_SESSION
        DcmDspDidInfo_SvkBackup28 (DcmDspDidInfo): DcmDspDidDynamicallyDefined=false
          DcmDspDidAccess
            DcmDspDidRead: DcmDspDidReadSessionRef=DcmDspSessionRow_EXTENDED_DIAGNOSTIC_SESSION, DcmDspDidReadSessionRef=DcmDspSessionRow_DEFAULT_SESSION
        DcmDspRoutine_EthGetPortTxRxStats (DcmDspRoutine):
          DcmDspRoutineIdentifier = 4169
          DcmDspRoutineUsePort = true
          DcmDspRoutineUsed = true
          DcmDspRequestResultsRoutineSupported = false
          DcmDspStopRoutineSupported = false
          DcmDspRoutineFixedLength = false
          DcmDspRoutineInfoRef = DcmDspRoutineInfo_1n4WLx
        4 x DcmDspDidInfo, all with DcmDspDidDynamicallyDefined=false:
          DcmDspDidInfo_SvkBackup25
            DcmDspDidAccess
              DcmDspDidRead: DcmDspDidReadSessionRef=DcmDspSessionRow_EXTENDED_DIAGNOSTIC_SESSION, DcmDspDidReadSessionRef=DcmDspSessionRow_DEFAULT_SESSION
          DcmDspDidInfo_SvkBackup26
            DcmDspDidAccess
              DcmDspDidRead: DcmDspDidReadSessionRef=DcmDspSessionRow_DEFAULT_SESSION, DcmDspDidReadSessionRef=DcmDspSessionRow_EXTENDED_DIAGNOSTIC_SESSION
          DcmDspDidInfo_SvkBackup29
            DcmDspDidAccess
              DcmDspDidRead: DcmDspDidReadSessionRef=DcmDspSessionRow_EXTENDED_DIAGNOSTIC_SESSION, DcmDspDidReadSessionRef=DcmDspSessionRow_DEFAULT_SESSION
          DcmDspDidInfo_SvkBackup20
            DcmDspDidAccess
              DcmDspDidRead: DcmDspDidReadSessionRef=DcmDspSessionRow_EXTENDED_DIAGNOSTIC_SESSION, DcmDspDidReadSessionRef=DcmDspSessionRow_DEFAULT_SESSION
        DcmDspRoutineInfo_2sK1ff (DcmDspRoutineInfo)
          DcmDspStartRoutineIn_START_IndividualDatenRettung (DcmDspStartRoutineIn)
            DcmDspStartRoutineInSignal: DcmDspRoutineSignalLength=8, DcmDspRoutineSignalPos=0, DcmDspRoutineSignalType=UINT8
          DcmDspRoutineAuthorization: DcmDspRoutineSessionRef=DcmDspSessionRow_EXTENDED_DIAGNOSTIC_SESSION
          DcmDspStartRoutineOut_START_IndividualDatenRettung (DcmDspStartRoutineOut)
            DcmDspStartRoutineOutSignal: DcmDspRoutineSignalLength=8, DcmDspRoutineSignalPos=0, DcmDspRoutineSignalType=UINT8
        3 x DcmDspDidInfo, all with DcmDspDidDynamicallyDefined=false:
          DcmDspDidInfo_EthSignalQuality
            DcmDspDidAccess
              DcmDspDidRead: DcmDspDidReadSessionRef=DcmDspSessionRow_DEFAULT_SESSION, DcmDspDidReadSessionRef=DcmDspSessionRow_EXTENDED_DIAGNOSTIC_SESSION
          DcmDspDidInfo_SvkBackup23
            DcmDspDidAccess
              DcmDspDidRead: DcmDspDidReadSessionRef=DcmDspSessionRow_EXTENDED_DIAGNOSTIC_SESSION, DcmDspDidReadSessionRef=DcmDspSessionRow_DEFAULT_SESSION
          DcmDspDidInfo_SvkBackup24
            DcmDspDidAccess
              DcmDspDidRead: DcmDspDidReadSessionRef=DcmDspSessionRow_DEFAULT_SESSION, DcmDspDidReadSessionRef=DcmDspSessionRow_EXTENDED_DIAGNOSTIC_SESSION
        DcmDspRoutine_EthGetDhcpStatus (DcmDspRoutine):
          DcmDspRoutineIdentifier = 4175
          DcmDspRoutineUsePort = true
          DcmDspRoutineUsed = true
          DcmDspRequestResultsRoutineSupported = false
          DcmDspStopRoutineSupported = false
          DcmDspRoutineFixedLength = false
          DcmDspRoutineInfoRef = DcmDspRoutineInfo_5dM0r2
        DcmDspData_ExtendedEnergySavingState (DcmDspData):
          DcmDspDataConditionCheckReadFncUsed = true
          DcmDspDataSize = 8
          DcmDspDataType = UINT8
          DcmDspDataUsePort = USE_DATA_SYNCH_CLIENT_SERVER
          DcmDspDataInfoRef = DcmDspDataInfo_Dummy
        DcmDspDidInfo_SvkBackup21 (DcmDspDidInfo): DcmDspDidDynamicallyDefined=false
          DcmDspDidAccess
            DcmDspDidRead: DcmDspDidReadSessionRef=DcmDspSessionRow_EXTENDED_DIAGNOSTIC_SESSION, DcmDspDidReadSessionRef=DcmDspSessionRow_DEFAULT_SESSION
        DcmDspDidInfo_SvkBackup22 (DcmDspDidInfo): DcmDspDidDynamicallyDefined=false
          DcmDspDidAccess
            DcmDspDidRead: DcmDspDidReadSessionRef=DcmDspSessionRow_EXTENDED_DIAGNOSTIC_SESSION, DcmDspDidReadSessionRef=DcmDspSessionRow_DEFAULT_SESSION
        DcmDspRoutineInfo_4ctJmy (DcmDspRoutineInfo)
          DcmDspRoutineAuthorization: DcmDspRoutineSessionRef=DcmDspSessionRow_EXTENDED_DIAGNOSTIC_SESSION
          DcmDspStartRoutineOut_START_EraseIdrData (DcmDspStartRoutineOut)
            DcmDspStartRoutineOutSignal_routineResult (DcmDspStartRoutineOutSignal): DcmDspRoutineSignalLength=8, DcmDspRoutineSignalPos=0, DcmDspRoutineSignalType=UINT8
        DcmDspData_DmDtcAktiveMeldung (DcmDspData):
          DcmDspDataConditionCheckReadFncUsed = true
          DcmDspDataSize = 168
          DcmDspDataType = UINT8
          DcmDspDataUsePort = USE_DATA_SYNCH_CLIENT_SERVER
          DcmDspDataInfoRef = DcmDspDataInfo_bY4y4
        DcmDspRoutineInfo_1gWdmq (DcmDspRoutineInfo)
          DcmDspStartRoutineIn_START_SetDefaultBus (DcmDspStartRoutineIn)
            DcmDspStartRoutineInSignal_ZustandDefaultBus (DcmDspStartRoutineInSignal): DcmDspRoutineSignalLength=8, DcmDspRoutineSignalPos=0, DcmDspRoutineSignalType=UINT8
          DcmDspRoutineAuthorization: DcmDspRoutineSessionRef=DcmDspSessionRow_DEFAULT_SESSION, DcmDspRoutineSessionRef=DcmDspSessionRow_EXTENDED_DIAGNOSTIC_SESSION
        DcmDspDidInfo_FlashTimingParameter (DcmDspDidInfo): DcmDspDidDynamicallyDefined=false
          DcmDspDidAccess
            DcmDspDidRead: DcmDspDidReadSessionRef=DcmDspSessionRow_DEFAULT_SESSION, DcmDspDidReadSessionRef=DcmDspSessionRow_EXTENDED_DIAGNOSTIC_SESSION
        DcmDspDidInfo_Sekundaererfehlerspeicher (DcmDspDidInfo): DcmDspDidDynamicallyDefined=false
          DcmDspDidAccess
            DcmDspDidRead: DcmDspDidReadSessionRef=DcmDspSessionRow_DEFAULT_SESSION, DcmDspDidReadSessionRef=DcmDspSessionRow_EXTENDED_DIAGNOSTIC_SESSION
        DcmDspData_SvkBackup61 (DcmDspData): DcmDspDataType=UINT8, DcmDspDataSize=392, DcmDspDataUsePort=USE_DATA_ASYNCH_CLIENT_SERVER, DcmDspDataInfoRef=DcmDspDataInfo_Dummy
        13 x DcmDspDidInfo, all with DcmDspDidDynamicallyDefined=false:
          DcmDspDidInfo_SvkBackup16
            DcmDspDidAccess
              DcmDspDidRead: DcmDspDidReadSessionRef=DcmDspSessionRow_EXTENDED_DIAGNOSTIC_SESSION, DcmDspDidReadSessionRef=DcmDspSessionRow_DEFAULT_SESSION
          DcmDspDidInfo_SvkBackup17
            DcmDspDidAccess
              DcmDspDidRead: DcmDspDidReadSessionRef=DcmDspSessionRow_DEFAULT_SESSION, DcmDspDidReadSessionRef=DcmDspSessionRow_EXTENDED_DIAGNOSTIC_SESSION
          DcmDspDidInfo_SvkBackup14
            DcmDspDidAccess
              DcmDspDidRead: DcmDspDidReadSessionRef=DcmDspSessionRow_EXTENDED_DIAGNOSTIC_SESSION, DcmDspDidReadSessionRef=DcmDspSessionRow_DEFAULT_SESSION
          DcmDspDidInfo_SvkBackup15
            DcmDspDidAccess
              DcmDspDidRead: DcmDspDidReadSessionRef=DcmDspSessionRow_EXTENDED_DIAGNOSTIC_SESSION, DcmDspDidReadSessionRef=DcmDspSessionRow_DEFAULT_SESSION
          DcmDspDidInfo_PiaProfileA
            DcmDspDidAccess
              DcmDspDidWrite: DcmDspDidWriteSessionRef=DcmDspSessionRow_EXTENDED_DIAGNOSTIC_SESSION
              DcmDspDidRead: DcmDspDidReadSessionRef=DcmDspSessionRow_EXTENDED_DIAGNOSTIC_SESSION
          DcmDspDidInfo_SvkBackup18
            DcmDspDidAccess
              DcmDspDidRead: DcmDspDidReadSessionRef=DcmDspSessionRow_EXTENDED_DIAGNOSTIC_SESSION, DcmDspDidReadSessionRef=DcmDspSessionRow_DEFAULT_SESSION
          DcmDspDidInfo_SvkBackup19
            DcmDspDidAccess
              DcmDspDidRead: DcmDspDidReadSessionRef=DcmDspSessionRow_EXTENDED_DIAGNOSTIC_SESSION, DcmDspDidReadSessionRef=DcmDspSessionRow_DEFAULT_SESSION
          DcmDspDidInfo_SvkBackup12
            DcmDspDidAccess
              DcmDspDidRead: DcmDspDidReadSessionRef=DcmDspSessionRow_DEFAULT_SESSION, DcmDspDidReadSessionRef=DcmDspSessionRow_EXTENDED_DIAGNOSTIC_SESSION
          DcmDspDidInfo_SvkBackup13
            DcmDspDidAccess
              DcmDspDidRead: DcmDspDidReadSessionRef=DcmDspSessionRow_DEFAULT_SESSION, DcmDspDidReadSessionRef=DcmDspSessionRow_EXTENDED_DIAGNOSTIC_SESSION
          DcmDspDidInfo_SvkBackup10
            DcmDspDidAccess
              DcmDspDidRead: DcmDspDidReadSessionRef=DcmDspSessionRow_DEFAULT_SESSION, DcmDspDidReadSessionRef=DcmDspSessionRow_EXTENDED_DIAGNOSTIC_SESSION
          DcmDspDidInfo_SvkBackup11
            DcmDspDidAccess
              DcmDspDidRead: DcmDspDidReadSessionRef=DcmDspSessionRow_EXTENDED_DIAGNOSTIC_SESSION, DcmDspDidReadSessionRef=DcmDspSessionRow_DEFAULT_SESSION
          DcmDspDidInfo_PiaProfile2
            DcmDspDidAccess
              DcmDspDidWrite: DcmDspDidWriteSessionRef=DcmDspSessionRow_EXTENDED_DIAGNOSTIC_SESSION
              DcmDspDidRead: DcmDspDidReadSessionRef=DcmDspSessionRow_EXTENDED_DIAGNOSTIC_SESSION
          DcmDspDidInfo_ExtendedEnergySavingState
            DcmDspDidAccess
              DcmDspDidRead: DcmDspDidReadSessionRef=DcmDspSessionRow_DEFAULT_SESSION, DcmDspDidReadSessionRef=DcmDspSessionRow_EXTENDED_DIAGNOSTIC_SESSION
        DcmDspRoutine_EthEnableTestMode (DcmDspRoutine):
          DcmDspRoutineIdentifier = 4172
          DcmDspRoutineUsePort = true
          DcmDspRoutineUsed = true
          DcmDspRequestResultsRoutineSupported = false
          DcmDspStopRoutineSupported = false
          DcmDspRoutineFixedLength = false
          DcmDspRoutineInfoRef = DcmDspRoutineInfo_2w2P9V
        DcmDspDidInfo_PiaProfile1 (DcmDspDidInfo): DcmDspDidDynamicallyDefined=false
          DcmDspDidAccess
            DcmDspDidWrite: DcmDspDidWriteSessionRef=DcmDspSessionRow_EXTENDED_DIAGNOSTIC_SESSION
            DcmDspDidRead: DcmDspDidReadSessionRef=DcmDspSessionRow_EXTENDED_DIAGNOSTIC_SESSION
        DcmDspDidInfo_PiaProfile0 (DcmDspDidInfo): DcmDspDidDynamicallyDefined=false
          DcmDspDidAccess
            DcmDspDidWrite: DcmDspDidWriteSessionRef=DcmDspSessionRow_EXTENDED_DIAGNOSTIC_SESSION
            DcmDspDidRead: DcmDspDidReadSessionRef=DcmDspSessionRow_EXTENDED_DIAGNOSTIC_SESSION
        DcmDspDid_HddDownloadStatus (DcmDspDid):
          DcmDspDidIdentifier = 9488
          DcmDspDidUsed = true
          DcmDspDidUsePort = USE_DATA_ELEMENT_SPECIFIC_INTERFACES
          DcmDspDidInfoRef = DcmDspDidInfo_HddDownloadStatus
          DcmDspDidSignal_HddDownloadStatus (DcmDspDidSignal): DcmDspDidDataPos=0, DcmDspDidDataRef=DcmDspData_HddDownloadStatus
        DcmDspRoutine_InitLinSlave (DcmDspRoutine):
          DcmDspRoutineIdentifier = 4128
          DcmDspRoutineUsePort = true
          DcmDspRoutineUsed = true
          DcmDspRequestResultsRoutineSupported = false
          DcmDspStopRoutineSupported = false
          DcmDspRoutineFixedLength = false
          DcmDspRoutineInfoRef = DcmDspRoutineInfo_4C5wFQ
        DcmDspDidInfo_ListManipulationSecureBoot (DcmDspDidInfo): DcmDspDidDynamicallyDefined=false
          DcmDspDidAccess
            DcmDspDidRead: DcmDspDidReadSessionRef=DcmDspSessionRow_EXTENDED_DIAGNOSTIC_SESSION, DcmDspDidReadSessionRef=DcmDspSessionRow_DEFAULT_SESSION
        DcmDspRoutine_RcCppc (DcmDspRoutine):
          DcmDspRoutineIdentifier = 515
          DcmDspRoutineUsePort = true
          DcmDspRoutineUsed = true
          DcmDspRequestResultsRoutineSupported = false
          DcmDspStopRoutineSupported = false
          DcmDspRoutineFixedLength = false
          DcmDspRoutineInfoRef = DcmDspRoutine_RcCppc_1Qt2kP
        3 x DcmDspRoutineInfo:
          DcmDspRoutineInfo_1X4xzf
            DcmDspRoutineAuthorization: DcmDspRoutineSessionRef=DcmDspSessionRow_DEFAULT_SESSION, DcmDspRoutineSessionRef=DcmDspSessionRow_EXTENDED_DIAGNOSTIC_SESSION
          DcmDspRoutineInfo_10gc40
            DcmDspStartRoutineIn_START_FsMsmN101AbfrageFzgsec (DcmDspStartRoutineIn)
              DcmDspStartRoutineInSignal_FunktionsId (DcmDspStartRoutineInSignal): DcmDspRoutineSignalEndianness=opaque, DcmDspRoutineSignalLength=8, DcmDspRoutineSignalPos=0, DcmDspRoutineSignalType=UINT8
            DcmDspRoutineAuthorization: DcmDspRoutineSessionRef=DcmDspSessionRow_EXTENDED_DIAGNOSTIC_SESSION
            DcmDspStartRoutineOut_START_FsMsmN101AbfrageFzgsec (DcmDspStartRoutineOut)
              3 x DcmDspStartRoutineOutSignal, all with DcmDspRoutineSignalEndianness=opaque, DcmDspRoutineSignalLength=8, DcmDspRoutineSignalType=UINT8:
                DcmDspStartRoutineOutSignal_State: DcmDspRoutineSignalPos=16
                DcmDspStartRoutineOutSignal_Res1: DcmDspRoutineSignalPos=0
                DcmDspStartRoutineOutSignal_Res2: DcmDspRoutineSignalPos=8
          DcmDspRoutine_FsMsmN102_1XQM0
            DcmDspRoutineAuthorization: DcmDspRoutineSessionRef=DcmDspSessionRow_EXTENDED_DIAGNOSTIC_SESSION
            DcmDspStartRoutineIn_START_FsMsmN102 (DcmDspStartRoutineIn)
              DcmDspStartRoutineInSignal_FunktionsId (DcmDspStartRoutineInSignal): DcmDspRoutineSignalEndianness=opaque, DcmDspRoutineSignalLength=8, DcmDspRoutineSignalPos=0, DcmDspRoutineSignalType=UINT8
            DcmDspStartRoutineOut_START_FsMsmN102 (DcmDspStartRoutineOut)
              3 x DcmDspStartRoutineOutSignal, all with DcmDspRoutineSignalEndianness=opaque, DcmDspRoutineSignalLength=8, DcmDspRoutineSignalType=UINT8:
                DcmDspStartRoutineOutSignal_State: DcmDspRoutineSignalPos=16
                DcmDspStartRoutineOutSignal_Res1: DcmDspRoutineSignalPos=0
                DcmDspStartRoutineOutSignal_Res2: DcmDspRoutineSignalPos=8
        5 x DcmDspData, all with DcmDspDataType=UINT8, DcmDspDataUsePort=USE_DATA_ASYNCH_CLIENT_SERVER, DcmDspDataInfoRef=DcmDspDataInfo_Dummy:
          DcmDspData_SvkBackup08: DcmDspDataSize=392
          DcmDspData_SvkBackup07: DcmDspDataSize=392
          DcmDspData_HddDownloadTimeToCompletion: DcmDspDataSize=32
          DcmDspData_SvkBackup09: DcmDspDataSize=392
          DcmDspData_SvkBackup04: DcmDspDataSize=392
        DcmDspDid_SvkAktuell (DcmDspDid): DcmDspDidIdentifier=61697, DcmDspDidUsed=true, DcmDspDidUsePort=USE_DATA_ELEMENT_SPECIFIC_INTERFACES, DcmDspDidInfoRef=DcmDspDidInfo_SvkAktuell
          DcmDspDidSignal_SvkAktuell (DcmDspDidSignal): DcmDspDidDataPos=0, DcmDspDidDataRef=DcmDspData_SvkAktuell
        DcmDspRoutine_FsN252_YxHYZ (DcmDspRoutineInfo)
          DcmDspRoutineAuthorization: DcmDspRoutineSessionRef=DcmDspSessionRow_DEFAULT_SESSION, DcmDspRoutineSessionRef=DcmDspSessionRow_EXTENDED_DIAGNOSTIC_SESSION
          DcmDspStartRoutineOut_START_FsN252 (DcmDspStartRoutineOut)
            DcmDspStartRoutineOutSignal_Result1 (DcmDspStartRoutineOutSignal): DcmDspRoutineSignalLength=8, DcmDspRoutineSignalPos=0, DcmDspRoutineSignalType=UINT8
            DcmDspStartRoutineOutSignal_Result2 (DcmDspStartRoutineOutSignal): DcmDspRoutineSignalLength=8, DcmDspRoutineSignalPos=8, DcmDspRoutineSignalType=UINT8
          DcmDspStartRoutineIn_START_FsN252 (DcmDspStartRoutineIn)
            DcmDspStartRoutineInSignal_DataToCompare (DcmDspStartRoutineInSignal): DcmDspRoutineSignalLength=128, DcmDspRoutineSignalPos=0, DcmDspRoutineSignalType=VARIABLE_LENGTH
        3 x DcmDspData, all with DcmDspDataType=UINT8, DcmDspDataUsePort=USE_DATA_ASYNCH_CLIENT_SERVER, DcmDspDataSize=392, DcmDspDataInfoRef=DcmDspDataInfo_Dummy:
          DcmDspData_SvkBackup03: DcmDspDataConditionCheckReadFncUsed=true
          DcmDspData_SvkBackup06
          DcmDspData_SvkBackup05
        DcmDspRoutine_EthResetPortTxRxStats (DcmDspRoutine):
          DcmDspRoutineIdentifier = 4171
          DcmDspRoutineUsePort = true
          DcmDspRoutineUsed = true
          DcmDspRequestResultsRoutineSupported = false
          DcmDspStopRoutineSupported = false
          DcmDspRoutineFixedLength = false
          DcmDspRoutineInfoRef = DcmDspRoutineInfo_PCxzr
        DcmDspData_SvkBackup02 (DcmDspData):
          DcmDspDataConditionCheckReadFncUsed = true
          DcmDspDataType = UINT8
          DcmDspDataUsePort = USE_DATA_ASYNCH_CLIENT_SERVER
          DcmDspDataSize = 392
          DcmDspDataInfoRef = DcmDspDataInfo_Dummy
        DcmDspRoutine_DiagCommLoopback (DcmDspRoutine):
          DcmDspRoutineIdentifier = 771
          DcmDspRoutineUsePort = true
          DcmDspRoutineUsed = true
          DcmDspRequestResultsRoutineSupported = false
          DcmDspStopRoutineSupported = false
          DcmDspRoutineFixedLength = false
          DcmDspRoutineInfoRef = DcmDspRoutineInfo_14zl3n
        DcmDspData_SvkBackup01 (DcmDspData):
          DcmDspDataConditionCheckReadFncUsed = true
          DcmDspDataType = UINT8
          DcmDspDataUsePort = USE_DATA_ASYNCH_CLIENT_SERVER
          DcmDspDataSize = 392
          DcmDspDataInfoRef = DcmDspDataInfo_Dummy
        DcmDspData_Sekundaererfehlerspeicher (DcmDspData): DcmDspDataType=UINT8, DcmDspDataSize=65535, DcmDspDataUsePort=USE_DATA_ASYNCH_CLIENT_SERVER, DcmDspDataInfoRef=DcmDspDataInfo_Dummy
        DcmDspDid_Readhwmodificationindex (DcmDspDid):
          DcmDspDidIdentifier = 61778
          DcmDspDidUsed = true
          DcmDspDidUsePort = USE_DATA_ELEMENT_SPECIFIC_INTERFACES
          DcmDspDidInfoRef = DcmDspDidInfo_Readhwmodificationindex
          DcmDspDidSignal_Readhwmodificationindex (DcmDspDidSignal): DcmDspDidDataPos=0, DcmDspDidDataRef=DcmDspData_Readhwmodificationindex
        DcmDspRoutine_EthPhyIdentifier (DcmDspRoutine):
          DcmDspRoutineIdentifier = 4167
          DcmDspRoutineUsePort = true
          DcmDspRoutineUsed = true
          DcmDspRequestResultsRoutineSupported = false
          DcmDspStopRoutineSupported = false
          DcmDspRoutineFixedLength = false
          DcmDspRoutineInfoRef = DcmDspRoutineInfo_4JGv5v
        DcmDspRoutine_SteuernDmFssMaster (DcmDspRoutine):
          DcmDspRoutineIdentifier = 773
          DcmDspRoutineUsePort = true
          DcmDspRoutineUsed = true
          DcmDspRequestResultsRoutineSupported = false
          DcmDspStopRoutineSupported = true
          DcmDspRoutineFixedLength = false
          DcmDspRoutineInfoRef = DcmDspRoutineInfo_3yymQj
        DcmDspDidInfo_HddDownloadStatus (DcmDspDidInfo): DcmDspDidDynamicallyDefined=false
          DcmDspDidAccess
            DcmDspDidRead: DcmDspDidReadSessionRef=DcmDspSessionRow_HDD_DOWNLOAD_SESSION
        DcmDspDidInfo_Readhwmodificationindex (DcmDspDidInfo): DcmDspDidDynamicallyDefined=false
          DcmDspDidAccess
            DcmDspDidRead: DcmDspDidReadSessionRef=DcmDspSessionRow_EXTENDED_DIAGNOSTIC_SESSION, DcmDspDidReadSessionRef=DcmDspSessionRow_DEFAULT_SESSION
        6 x DcmDspData, all with DcmDspDataType=UINT8, DcmDspDataUsePort=USE_DATA_ASYNCH_CLIENT_SERVER, DcmDspDataInfoRef=DcmDspDataInfo_Dummy:
          DcmDspData_SvkBackup19: DcmDspDataSize=392
          DcmDspData_ListManipulationSecurityArtifact: DcmDspDataSize=65535
          DcmDspData_SvkBackup18: DcmDspDataSize=392
          DcmDspData_SvkBackup15: DcmDspDataSize=392
          DcmDspData_SvkBackup14: DcmDspDataSize=392
          DcmDspData_SvkBackup17: DcmDspDataSize=392
        DcmDspRoutineInfo_4sZdNY (DcmDspRoutineInfo)
          DcmDspStartRoutineOut_START_AblageSystemkontext (DcmDspStartRoutineOut)
            DcmDspStartRoutineOutSignal_StatDmLockState (DcmDspStartRoutineOutSignal): DcmDspRoutineSignalEndianness=opaque, DcmDspRoutineSignalLength=8, DcmDspRoutineSignalPos=8, DcmDspRoutineSignalType=UINT8
            DcmDspStartRoutineOutSignal_StatFunction (DcmDspStartRoutineOutSignal): DcmDspRoutineSignalEndianness=opaque, DcmDspRoutineSignalLength=8, DcmDspRoutineSignalPos=0, DcmDspRoutineSignalType=UINT8
          DcmDspRoutineAuthorization: DcmDspRoutineSessionRef=DcmDspSessionRow_DEFAULT_SESSION, DcmDspRoutineSessionRef=DcmDspSessionRow_EXTENDED_DIAGNOSTIC_SESSION
          DcmDspStartRoutineIn_START_AblageSystemkontext (DcmDspStartRoutineIn)
            DcmDspStartRoutineInSignal_Function (DcmDspStartRoutineInSignal): DcmDspRoutineSignalEndianness=opaque, DcmDspRoutineSignalLength=8, DcmDspRoutineSignalPos=0, DcmDspRoutineSignalType=UINT8
        5 x DcmDspData, all with DcmDspDataType=UINT8, DcmDspDataSize=392, DcmDspDataUsePort=USE_DATA_ASYNCH_CLIENT_SERVER, DcmDspDataInfoRef=DcmDspDataInfo_Dummy:
          DcmDspData_SvkBackup16
          DcmDspData_SvkBackup11
          DcmDspData_SvkBackup10
          DcmDspData_SvkBackup13
          DcmDspData_SvkBackup12
        3 x DcmDspDidInfo, all with DcmDspDidDynamicallyDefined=false:
          DcmDspDidInfo_HddDownloadTimeToCompletion
            DcmDspDidAccess
              DcmDspDidRead: DcmDspDidReadSessionRef=DcmDspSessionRow_HDD_DOWNLOAD_SESSION
          DcmDspDidInfo_Herstelldatum
            DcmDspDidAccess
              DcmDspDidRead: DcmDspDidReadSessionRef=DcmDspSessionRow_DEFAULT_SESSION, DcmDspDidReadSessionRef=DcmDspSessionRow_EXTENDED_DIAGNOSTIC_SESSION
          DcmDspDidInfo_SensorenAnzahlLesen
            DcmDspDidAccess
              DcmDspDidRead: DcmDspDidReadSessionRef=DcmDspSessionRow_EXTENDED_DIAGNOSTIC_SESSION, DcmDspDidReadSessionRef=DcmDspSessionRow_DEFAULT_SESSION
        DcmDspRoutineInfo_yqjYv (DcmDspRoutineInfo)
          DcmDspStartRoutineIn_START_EthPhySwitchEngineReset (DcmDspStartRoutineIn)
            DcmDspStartRoutineInSignal_PortIndex (DcmDspStartRoutineInSignal): DcmDspRoutineSignalEndianness=opaque, DcmDspRoutineSignalLength=8, DcmDspRoutineSignalPos=0, DcmDspRoutineSignalType=UINT8
            DcmDspStartRoutineInSignal_StopPhyForT (DcmDspStartRoutineInSignal): DcmDspRoutineSignalEndianness=opaque, DcmDspRoutineSignalLength=8, DcmDspRoutineSignalPos=8, DcmDspRoutineSignalType=UINT8
          DcmDspStartRoutineOut_START_EthPhySwitchEngineReset (DcmDspStartRoutineOut)
            DcmDspStartRoutineOutSignal_StatPhyReset (DcmDspStartRoutineOutSignal): DcmDspRoutineSignalEndianness=opaque, DcmDspRoutineSignalLength=8, DcmDspRoutineSignalPos=0, DcmDspRoutineSignalType=UINT8
          DcmDspRoutineAuthorization: DcmDspRoutineSessionRef=DcmDspSessionRow_EXTENDED_DIAGNOSTIC_SESSION
        DcmDspRoutine_Swt_3DPx9T (DcmDspRoutineInfo)
          DcmDspStartRoutineIn_START_Swt (DcmDspStartRoutineIn)
            DcmDspStartRoutineInSignal_RCOption (DcmDspStartRoutineInSignal): DcmDspRoutineSignalLength=8, DcmDspRoutineSignalPos=0, DcmDspRoutineSignalType=UINT8
            DcmDspStartRoutineInSignal_DataIn (DcmDspStartRoutineInSignal): DcmDspRoutineSignalPos=8, DcmDspRoutineSignalType=VARIABLE_LENGTH, DcmDspRoutineSignalLength=128
          DcmDspRoutineAuthorization:
            DcmDspRoutineSessionRef = DcmDspSessionRow_DEFAULT_SESSION
            DcmDspRoutineSessionRef = DcmDspSessionRow_EXTENDED_DIAGNOSTIC_SESSION
            DcmDspRoutineSessionRef = DcmDspSessionRow_SWT_SESSION
          DcmDspStartRoutineOut_START_Swt (DcmDspStartRoutineOut)
            3 x DcmDspStartRoutineOutSignal:
              DcmDspStartRoutineOutSignal_ReturnCode: DcmDspRoutineSignalLength=8, DcmDspRoutineSignalPos=8, DcmDspRoutineSignalType=UINT8
              DcmDspStartRoutineOutSignal_DataOut: DcmDspRoutineSignalPos=16, DcmDspRoutineSignalType=VARIABLE_LENGTH, DcmDspRoutineSignalLength=128
              DcmDspStartRoutineOutSignal_RCOptionOut: DcmDspRoutineSignalLength=8, DcmDspRoutineSignalPos=0, DcmDspRoutineSignalType=UINT8
        DcmDspData_SvkBackup29 (DcmDspData): DcmDspDataType=UINT8, DcmDspDataSize=392, DcmDspDataUsePort=USE_DATA_ASYNCH_CLIENT_SERVER, DcmDspDataInfoRef=DcmDspDataInfo_Dummy
        DcmDspData_SvkBackup26 (DcmDspData): DcmDspDataType=UINT8, DcmDspDataSize=392, DcmDspDataUsePort=USE_DATA_ASYNCH_CLIENT_SERVER, DcmDspDataInfoRef=DcmDspDataInfo_Dummy
        DcmDspDidInfo_StatusSystime (DcmDspDidInfo): DcmDspDidDynamicallyDefined=false
          DcmDspDidAccess
            DcmDspDidRead: DcmDspDidReadSessionRef=DcmDspSessionRow_DEFAULT_SESSION, DcmDspDidReadSessionRef=DcmDspSessionRow_EXTENDED_DIAGNOSTIC_SESSION
        8 x DcmDspData, all with DcmDspDataType=UINT8, DcmDspDataSize=392, DcmDspDataUsePort=USE_DATA_ASYNCH_CLIENT_SERVER, DcmDspDataInfoRef=DcmDspDataInfo_Dummy:
          DcmDspData_SvkBackup25
          DcmDspData_SvkBackup28
          DcmDspData_SvkBackup27
          DcmDspData_SvkBackup22
          DcmDspData_SvkBackup21
          DcmDspData_SvkBackup24
          DcmDspData_SvkBackup23
          DcmDspData_SvkBackup20
        DcmDspDid_Pruefstempel (DcmDspDid): DcmDspDidIdentifier=4096, DcmDspDidUsed=true, DcmDspDidUsePort=USE_DATA_ELEMENT_SPECIFIC_INTERFACES, DcmDspDidInfoRef=DcmDspDidInfo_Pruefstempel
          DcmDspDidSignal_Pruefstempel (DcmDspDidSignal): DcmDspDidDataPos=0, DcmDspDidDataRef=DcmDspData_Pruefstempel
        DcmDspRoutineInfo_4JGv5v (DcmDspRoutineInfo)
          DcmDspRoutineAuthorization: DcmDspRoutineSessionRef=DcmDspSessionRow_DEFAULT_SESSION, DcmDspRoutineSessionRef=DcmDspSessionRow_EXTENDED_DIAGNOSTIC_SESSION
          DcmDspStartRoutineOut_START_EthPhyIdentifier (DcmDspStartRoutineOut)
            DcmDspStartRoutineOutSignal_StatOuiData (DcmDspStartRoutineOutSignal): DcmDspRoutineSignalEndianness=opaque, DcmDspRoutineSignalLength=48, DcmDspRoutineSignalPos=0, DcmDspRoutineSignalType=VARIABLE_LENGTH
          DcmDspStartRoutineIn_START_EthPhyIdentifier (DcmDspStartRoutineIn)
            DcmDspStartRoutineInSignal_PortIndex (DcmDspStartRoutineInSignal): DcmDspRoutineSignalEndianness=opaque, DcmDspRoutineSignalLength=8, DcmDspRoutineSignalPos=0, DcmDspRoutineSignalType=UINT8
        8 x DcmDspData, all with DcmDspDataType=UINT8, DcmDspDataSize=392, DcmDspDataUsePort=USE_DATA_ASYNCH_CLIENT_SERVER, DcmDspDataInfoRef=DcmDspDataInfo_Dummy:
          DcmDspData_SvkBackup37
          DcmDspData_SvkBackup36
          DcmDspData_SvkBackup39
          DcmDspData_SvkBackup38
          DcmDspData_SvkBackup33
          DcmDspData_SvkBackup32
          DcmDspData_SvkBackup35
          DcmDspData_SvkBackup34
        DcmDspDid_SensorenAnzahlLesen (DcmDspDid):
          DcmDspDidIdentifier = 5632
          DcmDspDidUsed = true
          DcmDspDidUsePort = USE_DATA_ELEMENT_SPECIFIC_INTERFACES
          DcmDspDidInfoRef = DcmDspDidInfo_SensorenAnzahlLesen
          DcmDspDidSignal_SensorenAnzahlLesen (DcmDspDidSignal): DcmDspDidDataPos=0, DcmDspDidDataRef=DcmDspData_SensorenAnzahlLesen
        DcmDspData_SvkBackup31 (DcmDspData): DcmDspDataType=UINT8, DcmDspDataSize=392, DcmDspDataUsePort=USE_DATA_ASYNCH_CLIENT_SERVER, DcmDspDataInfoRef=DcmDspDataInfo_Dummy
        DcmDspRoutine_EthPhySwitchEngineReset (DcmDspRoutine):
          DcmDspRoutineIdentifier = 4164
          DcmDspRoutineUsePort = true
          DcmDspRoutineUsed = true
          DcmDspRequestResultsRoutineSupported = false
          DcmDspStopRoutineSupported = false
          DcmDspRoutineFixedLength = false
          DcmDspRoutineInfoRef = DcmDspRoutineInfo_yqjYv
        DcmDspData_SvkBackup30 (DcmDspData): DcmDspDataType=UINT8, DcmDspDataSize=392, DcmDspDataUsePort=USE_DATA_ASYNCH_CLIENT_SERVER, DcmDspDataInfoRef=DcmDspDataInfo_Dummy
        DcmDspRoutine_RcRswedi (DcmDspRoutine):
          DcmDspRoutineIdentifier = 517
          DcmDspRoutineUsePort = true
          DcmDspRoutineUsed = true
          DcmDspRequestResultsRoutineSupported = false
          DcmDspStopRoutineSupported = false
          DcmDspRoutineFixedLength = false
          DcmDspRoutineInfoRef = DcmDspRoutine_RcRswedi_3rXcSz
        DcmDspDidInfo_ReadActiveSessionState (DcmDspDidInfo): DcmDspDidDynamicallyDefined=false
          DcmDspDidAccess
            DcmDspDidRead: DcmDspDidReadSessionRef=DcmDspSessionRow_EXTENDED_DIAGNOSTIC_SESSION, DcmDspDidReadSessionRef=DcmDspSessionRow_DEFAULT_SESSION
        DcmDspData_SensorenAnzahlLesen (DcmDspData): DcmDspDataSize=8, DcmDspDataType=UINT8, DcmDspDataUsePort=USE_DATA_ASYNCH_CLIENT_SERVER, DcmDspDataInfoRef=DcmDspDataInfo_SensorenAnzahlLesen
        DcmDspRoutine_FsN70X_YxKJ7 (DcmDspRoutineInfo)
          DcmDspRoutineAuthorization: DcmDspRoutineSessionRef=DcmDspSessionRow_DEFAULT_SESSION, DcmDspRoutineSessionRef=DcmDspSessionRow_EXTENDED_DIAGNOSTIC_SESSION
          RESULT_FsN70X_OUT (DcmDspRoutineRequestResOut)
            DcmDspRequestRoutineResultsOutSignal_Result (DcmDspRoutineRequestResOutSignal): DcmDspRoutineSignalEndianness=opaque, DcmDspRoutineSignalLength=8, DcmDspRoutineSignalPos=8, DcmDspRoutineSignalType=UINT8
            DcmDspRequestRoutineResultsOutSignal_Par4Resp (DcmDspRoutineRequestResOutSignal): DcmDspRoutineSignalEndianness=opaque, DcmDspRoutineSignalLength=8, DcmDspRoutineSignalPos=0, DcmDspRoutineSignalType=UINT8
          DcmDspStartRoutineOut_START_FsN70X (DcmDspStartRoutineOut)
            DcmDspStartRoutineOutSignal_Par4Resp (DcmDspStartRoutineOutSignal): DcmDspRoutineSignalEndianness=opaque, DcmDspRoutineSignalLength=8, DcmDspRoutineSignalPos=0, DcmDspRoutineSignalType=UINT8
          DcmDspStartRoutineIn_START_FsN70X (DcmDspStartRoutineIn)
            DcmDspStartRoutineInSignal_Par4Req (DcmDspStartRoutineInSignal): DcmDspRoutineSignalEndianness=opaque, DcmDspRoutineSignalLength=8, DcmDspRoutineSignalPos=0, DcmDspRoutineSignalType=UINT8
            DcmDspStartRoutineInSignal_Adr (DcmDspStartRoutineInSignal): DcmDspRoutineSignalEndianness=opaque, DcmDspRoutineSignalLength=8, DcmDspRoutineSignalPos=8, DcmDspRoutineSignalType=UINT8
        DcmDspRoutine_FsN7112 (DcmDspRoutine):
          DcmDspRoutineIdentifier = 534
          DcmDspRoutineUsePort = true
          DcmDspRoutineUsed = true
          DcmDspRequestResultsRoutineSupported = true
          DcmDspStopRoutineSupported = false
          DcmDspRoutineFixedLength = false
          DcmDspRoutineInfoRef = DcmDspRoutine_FsN7112_1TzSmF
        DcmDspRoutine_GetActualConfig (DcmDspRoutine):
          DcmDspRoutineIdentifier = 4113
          DcmDspRoutineUsePort = true
          DcmDspRoutineUsed = true
          DcmDspRequestResultsRoutineSupported = false
          DcmDspStopRoutineSupported = false
          DcmDspRoutineFixedLength = false
          DcmDspRoutineInfoRef = DcmDspRoutineInfo_pCCkH
        DcmDspData_EcuSerialNumber (DcmDspData):
          DcmDspDataConditionCheckReadFncUsed = false
          DcmDspDataSize = 80
          DcmDspDataType = UINT8
          DcmDspDataUsePort = USE_DATA_SYNCH_CLIENT_SERVER
          DcmDspDataInfoRef = DcmDspDataInfo_Dummy
        DcmDspDidInfo_EthGetNumberOfPorts (DcmDspDidInfo): DcmDspDidDynamicallyDefined=false
          DcmDspDidAccess
            DcmDspDidRead: DcmDspDidReadSessionRef=DcmDspSessionRow_DEFAULT_SESSION, DcmDspDidReadSessionRef=DcmDspSessionRow_EXTENDED_DIAGNOSTIC_SESSION
        DcmDspRoutine_FsN251_YxHYY (DcmDspRoutineInfo)
          DcmDspStartRoutineIn_START_FsN251 (DcmDspStartRoutineIn)
            DcmDspStartRoutineInSignal_Len (DcmDspStartRoutineInSignal): DcmDspRoutineSignalEndianness=opaque, DcmDspRoutineSignalLength=8, DcmDspRoutineSignalPos=0, DcmDspRoutineSignalType=UINT8
            DcmDspStartRoutineInSignal_Adr (DcmDspStartRoutineInSignal): DcmDspRoutineSignalPos=8, DcmDspRoutineSignalLength=8, DcmDspRoutineSignalType=UINT8
          DcmDspRoutineAuthorization: DcmDspRoutineSessionRef=DcmDspSessionRow_DEFAULT_SESSION, DcmDspRoutineSessionRef=DcmDspSessionRow_EXTENDED_DIAGNOSTIC_SESSION
          DcmDspStartRoutineOut_START_FsN251 (DcmDspStartRoutineOut)
            DcmDspStartRoutineOutSignal_Res1 (DcmDspStartRoutineOutSignal): DcmDspRoutineSignalEndianness=opaque, DcmDspRoutineSignalLength=8, DcmDspRoutineSignalPos=0, DcmDspRoutineSignalType=UINT8
            DcmDspStartRoutineOutSignal_Res2 (DcmDspStartRoutineOutSignal): DcmDspRoutineSignalEndianness=opaque, DcmDspRoutineSignalLength=8, DcmDspRoutineSignalPos=8, DcmDspRoutineSignalType=UINT8
        DcmDspData_SwfkDeleteSupported (DcmDspData):
          DcmDspDataConditionCheckReadFncUsed = false
          DcmDspDataSize = 8
          DcmDspDataType = UINT8
          DcmDspDataUsePort = USE_DATA_SYNCH_CLIENT_SERVER
          DcmDspDataInfoRef = DcmDspDataInfo_Dummy
        DcmDspDid_IndivDataTable (DcmDspDid): DcmDspDidIdentifier=5940, DcmDspDidUsed=true, DcmDspDidUsePort=USE_DATA_ELEMENT_SPECIFIC_INTERFACES, DcmDspDidInfoRef=DcmDspDidInfo_IndivDataTable
          DcmDspDidSignal_IndivDataTable (DcmDspDidSignal): DcmDspDidDataPos=0, DcmDspDidDataRef=DcmDspData_IndivDataTable
        DcmDspDid_DmDtcAktiveMeldung (DcmDspDid):
          DcmDspDidIdentifier = 5892
          DcmDspDidUsed = true
          DcmDspDidUsePort = USE_DATA_ELEMENT_SPECIFIC_INTERFACES
          DcmDspDidInfoRef = DcmDspDidInfo_DmDtcAktiveMeldung
          DcmDspDidSignal_DmDtcAktiveMeldung (DcmDspDidSignal): DcmDspDidDataPos=0, DcmDspDidDataRef=DcmDspData_DmDtcAktiveMeldung
        DcmDspRoutineInfo_4HTyTy (DcmDspRoutineInfo)
          DcmDspRoutineAuthorization: DcmDspRoutineSessionRef=DcmDspSessionRow_DEFAULT_SESSION, DcmDspRoutineSessionRef=DcmDspSessionRow_EXTENDED_DIAGNOSTIC_SESSION
        DcmDspRoutine_FsN251 (DcmDspRoutine):
          DcmDspRoutineIdentifier = 564
          DcmDspRoutineUsePort = true
          DcmDspRoutineUsed = true
          DcmDspRequestResultsRoutineSupported = false
          DcmDspStopRoutineSupported = false
          DcmDspRoutineFixedLength = false
          DcmDspRoutineInfoRef = DcmDspRoutine_FsN251_YxHYY
        DcmDspRoutine_FsN252 (DcmDspRoutine):
          DcmDspRoutineIdentifier = 565
          DcmDspRoutineUsePort = true
          DcmDspRoutineUsed = true
          DcmDspRequestResultsRoutineSupported = false
          DcmDspStopRoutineSupported = false
          DcmDspRoutineFixedLength = false
          DcmDspRoutineInfoRef = DcmDspRoutine_FsN252_YxHYZ
        DcmDspDid_SwfkDeleteSupported (DcmDspDid):
          DcmDspDidIdentifier = 9479
          DcmDspDidUsed = true
          DcmDspDidUsePort = USE_DATA_ELEMENT_SPECIFIC_INTERFACES
          DcmDspDidInfoRef = DcmDspDidInfo_SwfkDeleteSupported
          DcmDspDidSignal_SwfkDeleteSupported (DcmDspDidSignal): DcmDspDidDataPos=0, DcmDspDidDataRef=DcmDspData_SwfkDeleteSupported
        DcmDspDid_FlashTimingParameter (DcmDspDid):
          DcmDspDidIdentifier = 9476
          DcmDspDidUsed = true
          DcmDspDidUsePort = USE_DATA_ELEMENT_SPECIFIC_INTERFACES
          DcmDspDidInfoRef = DcmDspDidInfo_FlashTimingParameter
          DcmDspDidSignal_FlashTimingParameter (DcmDspDidSignal): DcmDspDidDataPos=0, DcmDspDidDataRef=DcmDspData_FlashTimingParameter
        DcmDspData_StatusSystime (DcmDspData): DcmDspDataSize=32, DcmDspDataType=UINT8, DcmDspDataUsePort=USE_DATA_ASYNCH_CLIENT_SERVER, DcmDspDataInfoRef=DcmDspDataInfo_Dummy
        DcmDspRoutine_AblageSystemkontext (DcmDspRoutine):
          DcmDspRoutineIdentifier = 16384
          DcmDspRoutineUsePort = true
          DcmDspRoutineUsed = true
          DcmDspRequestResultsRoutineSupported = false
          DcmDspStopRoutineSupported = false
          DcmDspRoutineFixedLength = false
          DcmDspRoutineInfoRef = DcmDspRoutineInfo_4sZdNY
        DcmDspRoutineInfo_1YcVW4 (DcmDspRoutineInfo)
          DcmDspStartRoutineOut_START_EthGetSwitchVlanConfiguration (DcmDspStartRoutineOut)
            DcmDspStartRoutineOutSignal_StatNumVlanConfigurationEntriesWert (DcmDspStartRoutineOutSignal): DcmDspRoutineSignalEndianness=opaque, DcmDspRoutineSignalLength=8, DcmDspRoutineSignalPos=0, DcmDspRoutineSignalType=UINT8
            DcmDspStartRoutineOutSignal_StatVlanConfigEntries (DcmDspStartRoutineOutSignal): DcmDspRoutineSignalPos=8, DcmDspRoutineSignalLength=8, DcmDspRoutineSignalType=UINT8
          DcmDspStartRoutineIn_START_EthGetSwitchVlanConfiguration (DcmDspStartRoutineIn)
            DcmDspStartRoutineInSignal_SwitchIndex (DcmDspStartRoutineInSignal): DcmDspRoutineSignalEndianness=opaque, DcmDspRoutineSignalLength=8, DcmDspRoutineSignalPos=0, DcmDspRoutineSignalType=UINT8
          DcmDspRoutineAuthorization:
            DcmDspRoutineSessionRef = DcmDspSessionRow_CODING_SESSION
            DcmDspRoutineSessionRef = DcmDspSessionRow_DEFAULT_SESSION
            DcmDspRoutineSessionRef = DcmDspSessionRow_EXTENDED_DIAGNOSTIC_SESSION
        DcmDspRoutineInfo_1n4WLx (DcmDspRoutineInfo)
          DcmDspStartRoutineOut_START_EthGetPortTxRxStats (DcmDspStartRoutineOut)
            6 x DcmDspStartRoutineOutSignal, all with DcmDspRoutineSignalEndianness=BIG_ENDIAN, DcmDspRoutineSignalLength=32, DcmDspRoutineSignalType=UINT32:
              DcmDspStartRoutineOutSignal_StatNumberOfDroppedRxPacketsWert: DcmDspRoutineSignalPos=160
              DcmDspStartRoutineOutSignal_StatBytesSentWert: DcmDspRoutineSignalPos=32
              DcmDspStartRoutineOutSignal_StatNumberOfReceivedPacketsWert: DcmDspRoutineSignalPos=96
              DcmDspStartRoutineOutSignal_StatNumberOfTransmittedPacketsWert: DcmDspRoutineSignalPos=0
              DcmDspStartRoutineOutSignal_StatStatBytesReceivedWert: DcmDspRoutineSignalPos=128
              DcmDspStartRoutineOutSignal_StatNumberOfDroppedTxPacketsWert: DcmDspRoutineSignalPos=64
          DcmDspRoutineAuthorization: DcmDspRoutineSessionRef=DcmDspSessionRow_DEFAULT_SESSION, DcmDspRoutineSessionRef=DcmDspSessionRow_EXTENDED_DIAGNOSTIC_SESSION
          DcmDspStartRoutineIn_START_EthGetPortTxRxStats (DcmDspStartRoutineIn)
            DcmDspStartRoutineInSignal_PortIndex (DcmDspStartRoutineInSignal): DcmDspRoutineSignalEndianness=opaque, DcmDspRoutineSignalLength=8, DcmDspRoutineSignalPos=0, DcmDspRoutineSignalType=UINT8
        DcmDspDidInfo_EthPhyLinkState (DcmDspDidInfo): DcmDspDidDynamicallyDefined=false
          DcmDspDidAccess
            DcmDspDidRead: DcmDspDidReadSessionRef=DcmDspSessionRow_DEFAULT_SESSION, DcmDspDidReadSessionRef=DcmDspSessionRow_EXTENDED_DIAGNOSTIC_SESSION
        DcmDspDidInfo_Pruefstempel (DcmDspDidInfo): DcmDspDidDynamicallyDefined=false
          DcmDspDidAccess
            DcmDspDidWrite: DcmDspDidWriteSessionRef=DcmDspSessionRow_EXTENDED_DIAGNOSTIC_SESSION, DcmDspDidWriteSessionRef=DcmDspSessionRow_DEFAULT_SESSION
            DcmDspDidRead: DcmDspDidReadSessionRef=DcmDspSessionRow_EXTENDED_DIAGNOSTIC_SESSION, DcmDspDidReadSessionRef=DcmDspSessionRow_DEFAULT_SESSION
        DcmDspRoutine_ActivateZgwCodingmode (DcmDspRoutine):
          DcmDspRoutineIdentifier = 4109
          DcmDspRoutineUsePort = true
          DcmDspRoutineUsed = true
          DcmDspRequestResultsRoutineSupported = false
          DcmDspStopRoutineSupported = false
          DcmDspRoutineFixedLength = false
          DcmDspRoutineInfoRef = DcmDspRoutineInfo_2X67zg
        DcmDspData_ReadRoeState (DcmDspData):
          DcmDspDataConditionCheckReadFncUsed = true
          DcmDspDataSize = 8
          DcmDspDataType = UINT8
          DcmDspDataUsePort = USE_DATA_SYNCH_CLIENT_SERVER
          DcmDspDataInfoRef = DcmDspDataInfo_Dummy
        DcmDspData_ListManipulationGeneral (DcmDspData): DcmDspDataType=UINT8, DcmDspDataSize=65535, DcmDspDataUsePort=USE_DATA_ASYNCH_CLIENT_SERVER, DcmDspDataInfoRef=DcmDspDataInfo_Dummy
        DcmDspDidInfo_ZgwZertifikat (DcmDspDidInfo): DcmDspDidDynamicallyDefined=false
          DcmDspDidAccess
            DcmDspDidRead: DcmDspDidReadSessionRef=DcmDspSessionRow_EXTENDED_DIAGNOSTIC_SESSION, DcmDspDidReadSessionRef=DcmDspSessionRow_DEFAULT_SESSION
        DcmDspRoutine_ExternalHsfz (DcmDspRoutine):
          DcmDspRoutineIdentifier = 4131
          DcmDspRoutineUsePort = true
          DcmDspRoutineUsed = true
          DcmDspRequestResultsRoutineSupported = false
          DcmDspStopRoutineSupported = false
          DcmDspRoutineFixedLength = false
          DcmDspRoutineInfoRef = DcmDspRoutineInfo_3ctCrQ
        DcmDspData_Vin (DcmDspData):
          DcmDspDataConditionCheckReadFncUsed = true
          DcmDspDataSize = 136
          DcmDspDataType = UINT8
          DcmDspDataUsePort = USE_DATA_ASYNCH_CLIENT_SERVER
          DcmDspDataInfoRef = DcmDspDataInfo_Dummy
        DcmDspDataInfo_GCft1 (DcmDspDataInfo): DcmDspDataFixedLength=false
        DcmDspDid_ListManipulationApplicationData (DcmDspDid):
          DcmDspDidIdentifier = 9618
          DcmDspDidUsed = true
          DcmDspDidUsePort = USE_DATA_ELEMENT_SPECIFIC_INTERFACES
          DcmDspDidInfoRef = DcmDspDidInfo_ListManipulationApplicationData
          DcmDspDidSignal_ListManipulationApplicationData (DcmDspDidSignal): DcmDspDidDataPos=0, DcmDspDidDataRef=DcmDspData_ListManipulationApplicationData
        DcmDspDid_Vin (DcmDspDid): DcmDspDidIdentifier=61840, DcmDspDidUsed=true, DcmDspDidUsePort=USE_DATA_ELEMENT_SPECIFIC_INTERFACES, DcmDspDidInfoRef=DcmDspDidInfo_Vin
          DcmDspDidSignal_Vin (DcmDspDidSignal): DcmDspDidDataPos=0, DcmDspDidDataRef=DcmDspData_Vin
        DcmDspDidInfo_ProgrammingCounter (DcmDspDidInfo): DcmDspDidDynamicallyDefined=false
          DcmDspDidAccess
            DcmDspDidRead: DcmDspDidReadSessionRef=DcmDspSessionRow_EXTENDED_DIAGNOSTIC_SESSION, DcmDspDidReadSessionRef=DcmDspSessionRow_DEFAULT_SESSION
        DcmDspRoutineInfo_29lnT1 (DcmDspRoutineInfo)
          DcmDspStartRoutineIn_START_EthArpTable (DcmDspStartRoutineIn)
            DcmDspStartRoutineInSignal_IpVersion (DcmDspStartRoutineInSignal): DcmDspRoutineSignalEndianness=opaque, DcmDspRoutineSignalLength=8, DcmDspRoutineSignalPos=0, DcmDspRoutineSignalType=UINT8
            DcmDspStartRoutineInSignal_ArpTableForIpAddress (DcmDspStartRoutineInSignal): DcmDspRoutineSignalPos=8, DcmDspRoutineSignalLength=8, DcmDspRoutineSignalType=UINT8
          DcmDspRoutineAuthorization: DcmDspRoutineSessionRef=DcmDspSessionRow_DEFAULT_SESSION, DcmDspRoutineSessionRef=DcmDspSessionRow_EXTENDED_DIAGNOSTIC_SESSION
          DcmDspStartRoutineOut_START_EthArpTable (DcmDspStartRoutineOut)
            DcmDspStartRoutineOutSignal_StatNumArpEntriesWert (DcmDspStartRoutineOutSignal): DcmDspRoutineSignalEndianness=opaque, DcmDspRoutineSignalLength=8, DcmDspRoutineSignalPos=0, DcmDspRoutineSignalType=UINT8
            DcmDspStartRoutineOutSignal_StatArpIpMacEntries (DcmDspStartRoutineOutSignal): DcmDspRoutineSignalPos=8, DcmDspRoutineSignalLength=8, DcmDspRoutineSignalType=UINT8
        DcmDspDid_EnergySavingState (DcmDspDid):
          DcmDspDidIdentifier = 4106
          DcmDspDidUsed = true
          DcmDspDidUsePort = USE_DATA_ELEMENT_SPECIFIC_INTERFACES
          DcmDspDidInfoRef = DcmDspDidInfo_EnergySavingState
          DcmDspDidSignal_EnergySavingState (DcmDspDidSignal): DcmDspDidDataPos=0, DcmDspDidDataRef=DcmDspData_EnergySavingState
        DcmDspRoutine_FsN5012 (DcmDspRoutine):
          DcmDspRoutineIdentifier = 568
          DcmDspRoutineUsePort = true
          DcmDspRoutineUsed = true
          DcmDspRequestResultsRoutineSupported = true
          DcmDspStopRoutineSupported = false
          DcmDspRoutineFixedLength = false
          DcmDspRoutineInfoRef = DcmDspRoutine_FsN5012_1TzqZm
        DcmDspRoutine_FsN7112_1TzSmF (DcmDspRoutineInfo)
          DcmDspStartRoutineIn_START_FsN7112 (DcmDspStartRoutineIn)
            DcmDspStartRoutineInSignal_Challenge (DcmDspStartRoutineInSignal): DcmDspRoutineSignalLength=128, DcmDspRoutineSignalPos=0, DcmDspRoutineSignalType=VARIABLE_LENGTH
          DcmDspRoutineAuthorization: DcmDspRoutineSessionRef=DcmDspSessionRow_DEFAULT_SESSION, DcmDspRoutineSessionRef=DcmDspSessionRow_EXTENDED_DIAGNOSTIC_SESSION
          RESULT_FsN7112_OUT (DcmDspRoutineRequestResOut)
            3 x DcmDspRoutineRequestResOutSignal:
              DcmDspRequestRoutineResultsOutSignal_ResultResponse: DcmDspRoutineSignalLength=128, DcmDspRoutineSignalPos=16, DcmDspRoutineSignalType=VARIABLE_LENGTH
              DcmDspRequestRoutineResultsOutSignal_Result2: DcmDspRoutineSignalLength=8, DcmDspRoutineSignalPos=8, DcmDspRoutineSignalType=UINT8
              DcmDspRequestRoutineResultsOutSignal_Result1: DcmDspRoutineSignalLength=8, DcmDspRoutineSignalPos=0, DcmDspRoutineSignalType=UINT8
          DcmDspStartRoutineOut_START_FsN7112 (DcmDspStartRoutineOut)
            DcmDspStartRoutineOutSignal_Result1 (DcmDspStartRoutineOutSignal): DcmDspRoutineSignalLength=8, DcmDspRoutineSignalPos=0, DcmDspRoutineSignalType=UINT8
            DcmDspStartRoutineOutSignal_Result2 (DcmDspStartRoutineOutSignal): DcmDspRoutineSignalLength=8, DcmDspRoutineSignalPos=8, DcmDspRoutineSignalType=UINT8
        DcmDspDid_ReadActiveSessionState (DcmDspDid):
          DcmDspDidIdentifier = 61696
          DcmDspDidUsed = true
          DcmDspDidUsePort = USE_DATA_ELEMENT_SPECIFIC_INTERFACES
          DcmDspDidInfoRef = DcmDspDidInfo_ReadActiveSessionState
          DcmDspDidSignal_ReadActiveSessionState (DcmDspDidSignal): DcmDspDidDataPos=0, DcmDspDidDataRef=DcmDspData_ReadActiveSessionState
        DcmDspRoutine_EthArpTable (DcmDspRoutine):
          DcmDspRoutineIdentifier = 4163
          DcmDspRoutineUsePort = true
          DcmDspRoutineUsed = true
          DcmDspRequestResultsRoutineSupported = false
          DcmDspStopRoutineSupported = false
          DcmDspRoutineFixedLength = false
          DcmDspRoutineInfoRef = DcmDspRoutineInfo_29lnT1
        DcmDspRoutine_FsN5005 (DcmDspRoutine):
          DcmDspRoutineIdentifier = 531
          DcmDspRoutineUsePort = true
          DcmDspRoutineUsed = true
          DcmDspRequestResultsRoutineSupported = true
          DcmDspStopRoutineSupported = false
          DcmDspRoutineFixedLength = false
          DcmDspRoutineInfoRef = DcmDspRoutine_FsN5005_1TzqYQ
        DcmDspData_EthGetNumberOfPorts (DcmDspData): DcmDspDataSize=8, DcmDspDataType=UINT8, DcmDspDataUsePort=USE_DATA_ASYNCH_CLIENT_SERVER, DcmDspDataInfoRef=DcmDspDataInfo_Dummy
        DcmDspRoutine_FsMsmN111_1XQMz (DcmDspRoutineInfo)
          DcmDspRoutineAuthorization: DcmDspRoutineSessionRef=DcmDspSessionRow_DEFAULT_SESSION, DcmDspRoutineSessionRef=DcmDspSessionRow_EXTENDED_DIAGNOSTIC_SESSION
          DcmDspStartRoutineIn_START_FsMsmN111 (DcmDspStartRoutineIn)
            DcmDspStartRoutineInSignal_FscsmId (DcmDspStartRoutineInSignal): DcmDspRoutineSignalEndianness=opaque, DcmDspRoutineSignalLength=8, DcmDspRoutineSignalPos=8, DcmDspRoutineSignalType=UINT8
            DcmDspStartRoutineInSignal_ParameterId (DcmDspStartRoutineInSignal): DcmDspRoutineSignalEndianness=opaque, DcmDspRoutineSignalLength=8, DcmDspRoutineSignalPos=0, DcmDspRoutineSignalType=UINT8
          DcmDspStartRoutineOut_START_FsMsmN111 (DcmDspStartRoutineOut)
            4 x DcmDspStartRoutineOutSignal, all with DcmDspRoutineSignalLength=8, DcmDspRoutineSignalType=UINT8:
              DcmDspStartRoutineOutSignal_Data: DcmDspRoutineSignalPos=24
              DcmDspStartRoutineOutSignal_Res1: DcmDspRoutineSignalEndianness=opaque, DcmDspRoutineSignalPos=0
              DcmDspStartRoutineOutSignal_Res2: DcmDspRoutineSignalEndianness=opaque, DcmDspRoutineSignalPos=8
              DcmDspStartRoutineOutSignal_Len: DcmDspRoutineSignalEndianness=opaque, DcmDspRoutineSignalPos=16
        DcmDspRoutine_FehlerspeicherEndeWerksablauf (DcmDspRoutine):
          DcmDspRoutineIdentifier = 4193
          DcmDspRoutineUsePort = true
          DcmDspRoutineUsed = true
          DcmDspRequestResultsRoutineSupported = true
          DcmDspStopRoutineSupported = false
          DcmDspRoutineFixedLength = false
          DcmDspRoutineInfoRef = DcmDspRoutineInfo_SyJZQ
        DcmDspRoutine_StartSystime (DcmDspRoutine):
          DcmDspRoutineIdentifier = 4101
          DcmDspRoutineUsePort = true
          DcmDspRoutineUsed = true
          DcmDspRequestResultsRoutineSupported = false
          DcmDspStopRoutineSupported = false
          DcmDspRoutineFixedLength = false
          DcmDspRoutineInfoRef = DcmDspRoutineInfo_1X4xzf
        DcmDspDid_EthPhyLinkState (DcmDspDid):
          DcmDspDidIdentifier = 6146
          DcmDspDidUsed = true
          DcmDspDidUsePort = USE_DATA_ELEMENT_SPECIFIC_INTERFACES
          DcmDspDidInfoRef = DcmDspDidInfo_EthPhyLinkState
          DcmDspDidSignal_EthPhyLinkState (DcmDspDidSignal): DcmDspDidDataPos=0, DcmDspDidDataRef=DcmDspData_EthPhyLinkState
        DcmDspRoutine_CheckHttpConnection (DcmDspRoutine):
          DcmDspRoutineIdentifier = 4130
          DcmDspRoutineUsePort = true
          DcmDspRoutineUsed = true
          DcmDspRequestResultsRoutineSupported = false
          DcmDspStopRoutineSupported = false
          DcmDspRoutineFixedLength = false
          DcmDspRoutineInfoRef = DcmDspRoutineInfo_3Gfcyc
        DcmDspData_ReadActiveSession (DcmDspData):
          DcmDspDataConditionCheckReadFncUsed = true
          DcmDspDataSize = 8
          DcmDspDataType = UINT8
          DcmDspDataUsePort = USE_DATA_SYNCH_CLIENT_SERVER
          DcmDspDataInfoRef = DcmDspDataInfo_Dummy
        DcmDspRoutineInfo_1HDxyB (DcmDspRoutineInfo)
          DcmDspStartRoutineOut_START_EthGetEthernetSwitches (DcmDspStartRoutineOut)
            DcmDspStartRoutineOutSignal_StatEthSwitchEntries (DcmDspStartRoutineOutSignal): DcmDspRoutineSignalPos=8, DcmDspRoutineSignalLength=8, DcmDspRoutineSignalType=UINT8
            DcmDspStartRoutineOutSignal_StatNumEthSwitchEntriesWert (DcmDspStartRoutineOutSignal): DcmDspRoutineSignalEndianness=opaque, DcmDspRoutineSignalLength=8, DcmDspRoutineSignalPos=0, DcmDspRoutineSignalType=UINT8
          DcmDspRoutineAuthorization:
            DcmDspRoutineSessionRef = DcmDspSessionRow_CODING_SESSION
            DcmDspRoutineSessionRef = DcmDspSessionRow_DEFAULT_SESSION
            DcmDspRoutineSessionRef = DcmDspSessionRow_EXTENDED_DIAGNOSTIC_SESSION
        DcmDspRoutine_EthGetEthernetSwitches (DcmDspRoutine):
          DcmDspRoutineIdentifier = 4176
          DcmDspRoutineUsePort = true
          DcmDspRoutineUsed = true
          DcmDspRequestResultsRoutineSupported = false
          DcmDspStopRoutineSupported = false
          DcmDspRoutineFixedLength = false
          DcmDspRoutineInfoRef = DcmDspRoutineInfo_1HDxyB
        DcmDspData_SvkSysSupplier (DcmDspData):
          DcmDspDataConditionCheckReadFncUsed = true
          DcmDspDataType = UINT8
          DcmDspDataUsePort = USE_DATA_ASYNCH_CLIENT_SERVER
          DcmDspDataSize = 392
          DcmDspDataInfoRef = DcmDspDataInfo_Dummy
        DcmDspData_ActiveDiagnosticSession (DcmDspData):
          DcmDspDataConditionCheckReadFncUsed = true
          DcmDspDataSize = 8
          DcmDspDataType = UINT8
          DcmDspDataUsePort = USE_DATA_SYNCH_FNC
          DcmDspDataConditionCheckReadFnc = Dcm_DidMgr_F186_ReadData
          DcmDspDataReadFnc = Dcm_DidMgr_F186_ReadData
          DcmDspDataInfoRef = DcmDspDataInfo_Dummy
        DcmDspRoutine_FsN5034 (DcmDspRoutine):
          DcmDspRoutineIdentifier = 569
          DcmDspRoutineUsePort = true
          DcmDspRoutineUsed = true
          DcmDspRequestResultsRoutineSupported = true
          DcmDspStopRoutineSupported = false
          DcmDspRoutineFixedLength = false
          DcmDspRoutineInfoRef = DcmDspRoutine_FsN5034_1Tzr0B
        4 x DcmDspData, all with DcmDspDataConditionCheckReadFncUsed=true, DcmDspDataType=UINT8, DcmDspDataUsePort=USE_DATA_ASYNCH_CLIENT_SERVER, DcmDspDataSize=224:
          DcmDspData_PiaProfileA: DcmDspDataInfoRef=DcmDspData_PiaProfileA_1ZT4D9
          DcmDspData_PiaProfile0: DcmDspDataInfoRef=DcmDspData_PiaProfile0_1ZT4CR
          DcmDspData_PiaProfile1: DcmDspDataInfoRef=DcmDspData_PiaProfile1_1ZT4CS
          DcmDspData_PiaProfile2: DcmDspDataInfoRef=DcmDspData_PiaProfile2_1ZT4CT
        DcmDspDid_EthSignalQuality (DcmDspDid):
          DcmDspDidIdentifier = 6145
          DcmDspDidUsed = true
          DcmDspDidUsePort = USE_DATA_ELEMENT_SPECIFIC_INTERFACES
          DcmDspDidInfoRef = DcmDspDidInfo_EthSignalQuality
          DcmDspDidSignal_EthSignalQuality (DcmDspDidSignal): DcmDspDidDataPos=0, DcmDspDidDataRef=DcmDspData_EthSignalQuality
        DcmDspRoutineInfo_43dZYd (DcmDspRoutineInfo)
          DcmDspRoutineAuthorization: DcmDspRoutineSessionRef=DcmDspSessionRow_DEFAULT_SESSION, DcmDspRoutineSessionRef=DcmDspSessionRow_EXTENDED_DIAGNOSTIC_SESSION
          DcmDspStartRoutineIn_START_FsMsmN300XTeleservice (DcmDspStartRoutineIn)
            5 x DcmDspStartRoutineInSignal, all with DcmDspRoutineSignalEndianness=opaque, DcmDspRoutineSignalLength=8, DcmDspRoutineSignalType=UINT8:
              DcmDspStartRoutineInSignal_Id: DcmDspRoutineSignalPos=8
              DcmDspStartRoutineInSignal_Par4Req: DcmDspRoutineSignalPos=0
              DcmDspStartRoutineInSignal_Par8Req: DcmDspRoutineSignalPos=32
              DcmDspStartRoutineInSignal_Par7Req: DcmDspRoutineSignalPos=24
              DcmDspStartRoutineInSignal_Par6Req: DcmDspRoutineSignalPos=16
          DcmDspStartRoutineOut_START_FsMsmN300XTeleservice (DcmDspStartRoutineOut)
            DcmDspStartRoutineOutSignal_Par4Resp (DcmDspStartRoutineOutSignal): DcmDspRoutineSignalEndianness=opaque, DcmDspRoutineSignalLength=8, DcmDspRoutineSignalPos=0, DcmDspRoutineSignalType=UINT8
          RESULT_FsMsmN300XTeleservice_OUT (DcmDspRoutineRequestResOut)
            5 x DcmDspRoutineRequestResOutSignal:
              DcmDspRequestRoutineResultsOutSignal_IdResp: DcmDspRoutineSignalEndianness=opaque, DcmDspRoutineSignalLength=8, DcmDspRoutineSignalPos=8, DcmDspRoutineSignalType=UINT8
              DcmDspRequestRoutineResultsOutSignal_Len: DcmDspRoutineSignalEndianness=BIG_ENDIAN, DcmDspRoutineSignalLength=16, DcmDspRoutineSignalPos=24, DcmDspRoutineSignalType=UINT16
              DcmDspRequestRoutineResultsOutSignal_Zufallszahl: DcmDspRoutineSignalEndianness=opaque, DcmDspRoutineSignalLength=160, DcmDspRoutineSignalPos=40, DcmDspRoutineSignalType=VARIABLE_LENGTH
              DcmDspRequestRoutineResultsOutSignal_Par6Resp: DcmDspRoutineSignalEndianness=opaque, DcmDspRoutineSignalLength=8, DcmDspRoutineSignalPos=16, DcmDspRoutineSignalType=UINT8
              DcmDspRequestRoutineResultsOutSignal_Par4Resp: DcmDspRoutineSignalEndianness=opaque, DcmDspRoutineSignalLength=8, DcmDspRoutineSignalPos=0, DcmDspRoutineSignalType=UINT8
        DcmDspRoutine_FsMsmN300XTeleservice (DcmDspRoutine):
          DcmDspRoutineIdentifier = 528
          DcmDspRoutineUsePort = true
          DcmDspRoutineUsed = true
          DcmDspRequestResultsRoutineSupported = true
          DcmDspStopRoutineSupported = false
          DcmDspRoutineFixedLength = false
          DcmDspRoutineInfoRef = DcmDspRoutineInfo_43dZYd
        DcmDspDid_ListManipulationSw (DcmDspDid):
          DcmDspDidIdentifier = 9617
          DcmDspDidUsed = true
          DcmDspDidUsePort = USE_DATA_ELEMENT_SPECIFIC_INTERFACES
          DcmDspDidInfoRef = DcmDspDidInfo_ListManipulationSw
          DcmDspDidSignal_ListManipulationSw (DcmDspDidSignal): DcmDspDidDataPos=0, DcmDspDidDataRef=DcmDspData_ListManipulationSw
        DcmDspData_EthSignalQuality (DcmDspData): DcmDspDataType=UINT8, DcmDspDataSize=65535, DcmDspDataUsePort=USE_DATA_ASYNCH_CLIENT_SERVER, DcmDspDataInfoRef=DcmDspDataInfo_Dummy
        DcmDspRoutineInfo_4C5wFQ (DcmDspRoutineInfo)
          DcmDspStartRoutineOut_START_InitLinSlave (DcmDspStartRoutineOut)
            DcmDspStartRoutineOutSignal_Status (DcmDspStartRoutineOutSignal): DcmDspRoutineSignalEndianness=opaque, DcmDspRoutineSignalLength=8, DcmDspRoutineSignalPos=0, DcmDspRoutineSignalType=UINT8
          DcmDspRoutineAuthorization: DcmDspRoutineSessionRef=DcmDspSessionRow_DEFAULT_SESSION, DcmDspRoutineSessionRef=DcmDspSessionRow_EXTENDED_DIAGNOSTIC_SESSION
        DcmDspDidInfo_Vin (DcmDspDidInfo): DcmDspDidDynamicallyDefined=false
          DcmDspDidAccess
            DcmDspDidRead: DcmDspDidReadSessionRef=DcmDspSessionRow_EXTENDED_DIAGNOSTIC_SESSION, DcmDspDidReadSessionRef=DcmDspSessionRow_DEFAULT_SESSION
        DcmDspDid_Herstelldatum (DcmDspDid): DcmDspDidIdentifier=61835, DcmDspDidUsed=true, DcmDspDidUsePort=USE_DATA_ELEMENT_SPECIFIC_INTERFACES, DcmDspDidInfoRef=DcmDspDidInfo_Herstelldatum
          DcmDspDidSignal_Herstelldatum (DcmDspDidSignal): DcmDspDidDataPos=0, DcmDspDidDataRef=DcmDspData_Herstelldatum
        DcmDspRoutine_RequestPreferredProtocol (DcmDspRoutine):
          DcmDspRoutineIdentifier = 4129
          DcmDspRoutineUsePort = true
          DcmDspRoutineUsed = true
          DcmDspRequestResultsRoutineSupported = false
          DcmDspStopRoutineSupported = false
          DcmDspRoutineFixedLength = false
          DcmDspRoutineInfoRef = DcmDspRoutineInfo_1VGBKh
        DcmDspDid_Sekundaererfehlerspeicher (DcmDspDid):
          DcmDspDidIdentifier = 8192
          DcmDspDidUsed = true
          DcmDspDidUsePort = USE_DATA_ELEMENT_SPECIFIC_INTERFACES
          DcmDspDidInfoRef = DcmDspDidInfo_Sekundaererfehlerspeicher
          DcmDspDidSignal_Sekundaererfehlerspeicher (DcmDspDidSignal): DcmDspDidDataPos=0, DcmDspDidDataRef=DcmDspData_Sekundaererfehlerspeicher
        DcmDspRoutine_ControlExtendedEnergySavingState (DcmDspRoutine):
          DcmDspRoutineIdentifier = 4099
          DcmDspRoutineUsePort = true
          DcmDspRoutineUsed = true
          DcmDspRequestResultsRoutineSupported = false
          DcmDspStopRoutineSupported = false
          DcmDspRoutineFixedLength = true
          DcmDspRoutineInfoRef = DcmDspRoutineInfo_3sP0FB
        DcmDspData_ReadActiveSessionState (DcmDspData):
          DcmDspDataConditionCheckReadFncUsed = true
          DcmDspDataSize = 32
          DcmDspDataType = UINT8
          DcmDspDataUsePort = USE_DATA_SYNCH_CLIENT_SERVER
          DcmDspDataInfoRef = DcmDspDataInfo_Dummy
        DcmDspDid_SystemSupplierIdentifier (DcmDspDid):
          DcmDspDidIdentifier = 61834
          DcmDspDidUsed = true
          DcmDspDidUsePort = USE_DATA_ELEMENT_SPECIFIC_INTERFACES
          DcmDspDidInfoRef = DcmDspDidInfo_SystemSupplierIdentifier
          DcmDspDidSignal_SystemSupplierIdentifier (DcmDspDidSignal): DcmDspDidDataPos=0, DcmDspDidDataRef=DcmDspData_SystemSupplierIdentifier
        DcmDspData_StatusDmFssMaster (DcmDspData): DcmDspDataSize=16, DcmDspDataType=UINT8, DcmDspDataUsePort=USE_DATA_ASYNCH_CLIENT_SERVER, DcmDspDataInfoRef=DcmDspDataInfo_Dummy
        DcmDspDidInfo_SvkSysSupplier (DcmDspDidInfo): DcmDspDidDynamicallyDefined=false
          DcmDspDidAccess
            DcmDspDidRead: DcmDspDidReadSessionRef=DcmDspSessionRow_EXTENDED_DIAGNOSTIC_SESSION, DcmDspDidReadSessionRef=DcmDspSessionRow_DEFAULT_SESSION
        3 x DcmDspRoutineInfo:
          DcmDspRoutineInfo_4KQsRC
            DcmDspStartRoutineOut_START_EthWritePhyRegister (DcmDspStartRoutineOut)
              DcmDspStartRoutineOutSignal_StatRegWriteOk (DcmDspStartRoutineOutSignal): DcmDspRoutineSignalEndianness=opaque, DcmDspRoutineSignalLength=8, DcmDspRoutineSignalPos=0, DcmDspRoutineSignalType=UINT8
            DcmDspRoutineAuthorization: DcmDspRoutineSessionRef=DcmDspSessionRow_EXTENDED_DIAGNOSTIC_SESSION
            DcmDspStartRoutineIn_START_EthWritePhyRegister (DcmDspStartRoutineIn)
              DcmDspStartRoutineInSignal_RegWriteProtect (DcmDspStartRoutineInSignal): DcmDspRoutineSignalEndianness=opaque, DcmDspRoutineSignalLength=8, DcmDspRoutineSignalPos=0, DcmDspRoutineSignalType=UINT8
              DcmDspStartRoutineInSignal_Data (DcmDspStartRoutineInSignal): DcmDspRoutineSignalPos=8, DcmDspRoutineSignalLength=8, DcmDspRoutineSignalType=UINT8
          DcmDspRoutine_FsN30X_YxJhc
            DcmDspStartRoutineIn_START_FsN30X (DcmDspStartRoutineIn)
              5 x DcmDspStartRoutineInSignal:
                DcmDspStartRoutineInSignal_Len: DcmDspRoutineSignalEndianness=BIG_ENDIAN, DcmDspRoutineSignalLength=16, DcmDspRoutineSignalPos=24, DcmDspRoutineSignalType=UINT16
                DcmDspStartRoutineInSignal_Id: DcmDspRoutineSignalEndianness=opaque, DcmDspRoutineSignalLength=8, DcmDspRoutineSignalPos=8, DcmDspRoutineSignalType=UINT8
                DcmDspStartRoutineInSignal_Par4Req: DcmDspRoutineSignalEndianness=opaque, DcmDspRoutineSignalLength=8, DcmDspRoutineSignalPos=0, DcmDspRoutineSignalType=UINT8
                DcmDspStartRoutineInSignal_Enc: DcmDspRoutineSignalPos=40, DcmDspRoutineSignalLength=8, DcmDspRoutineSignalType=UINT8
                DcmDspStartRoutineInSignal_Par6Req: DcmDspRoutineSignalEndianness=opaque, DcmDspRoutineSignalLength=8, DcmDspRoutineSignalPos=16, DcmDspRoutineSignalType=UINT8
            RESULT_FsN30X_OUT (DcmDspRoutineRequestResOut)
              DcmDspRequestRoutineResultsOutSignal_R1R2R3 (DcmDspRoutineRequestResOutSignal): DcmDspRoutineSignalEndianness=opaque, DcmDspRoutineSignalLength=32, DcmDspRoutineSignalPos=8, DcmDspRoutineSignalType=VARIABLE_LENGTH
              DcmDspRequestRoutineResultsOutSignal_Par4Resp (DcmDspRoutineRequestResOutSignal): DcmDspRoutineSignalEndianness=opaque, DcmDspRoutineSignalLength=8, DcmDspRoutineSignalPos=0, DcmDspRoutineSignalType=UINT8
            DcmDspRoutineAuthorization: DcmDspRoutineSessionRef=DcmDspSessionRow_DEFAULT_SESSION, DcmDspRoutineSessionRef=DcmDspSessionRow_EXTENDED_DIAGNOSTIC_SESSION
            DcmDspStartRoutineOut_START_FsN30X (DcmDspStartRoutineOut)
              DcmDspStartRoutineOutSignal_Par4Resp (DcmDspStartRoutineOutSignal): DcmDspRoutineSignalEndianness=opaque, DcmDspRoutineSignalLength=8, DcmDspRoutineSignalPos=0, DcmDspRoutineSignalType=UINT8
          DcmDspRoutineInfo_3yymQj
            DcmDspStartRoutineOut_START_SteuernDmFssMaster (DcmDspStartRoutineOut)
              DcmDspStartRoutineOutSignal_StatSignal (DcmDspStartRoutineOutSignal): DcmDspRoutineSignalEndianness=opaque, DcmDspRoutineSignalLength=8, DcmDspRoutineSignalPos=0, DcmDspRoutineSignalType=UINT8
            DcmDspRoutineAuthorization: DcmDspRoutineSessionRef=DcmDspSessionRow_DEFAULT_SESSION, DcmDspRoutineSessionRef=DcmDspSessionRow_EXTENDED_DIAGNOSTIC_SESSION
            DcmDspStartRoutineIn_START_SteuernDmFssMaster (DcmDspStartRoutineIn)
              DcmDspStartRoutineInSignal_ArgSignal (DcmDspStartRoutineInSignal): DcmDspRoutineSignalEndianness=opaque, DcmDspRoutineSignalLength=8, DcmDspRoutineSignalPos=0, DcmDspRoutineSignalType=UINT8
        DcmDspData_SvkAktuell_57zZ9W (DcmDspDataInfo): DcmDspDataFixedLength=false
        DcmDspRoutine_IndividualDatenRettung (DcmDspRoutine):
          DcmDspRoutineIdentifier = 4098
          DcmDspRoutineUsePort = true
          DcmDspRoutineUsed = true
          DcmDspRequestResultsRoutineSupported = false
          DcmDspStopRoutineSupported = false
          DcmDspRoutineFixedLength = false
          DcmDspRoutineInfoRef = DcmDspRoutineInfo_2sK1ff
        DcmDspRoutineInfo_10R48r (DcmDspRoutineInfo)
          DcmDspRoutineAuthorization: DcmDspRoutineSessionRef=DcmDspSessionRow_DEFAULT_SESSION, DcmDspRoutineSessionRef=DcmDspSessionRow_EXTENDED_DIAGNOSTIC_SESSION
          DcmDspStartRoutineOut_START_EthExtendedArlTable (DcmDspStartRoutineOut)
            DcmDspStartRoutineOutSignal_StatExtendedArlVlanIdEntries (DcmDspStartRoutineOutSignal): DcmDspRoutineSignalPos=8, DcmDspRoutineSignalLength=8, DcmDspRoutineSignalType=UINT8
            DcmDspStartRoutineOutSignal_StatNumArlVlanIdEntriesWert (DcmDspStartRoutineOutSignal): DcmDspRoutineSignalEndianness=opaque, DcmDspRoutineSignalLength=8, DcmDspRoutineSignalPos=0, DcmDspRoutineSignalType=UINT8
        DcmDspRoutineInfo_5dM0r2 (DcmDspRoutineInfo)
          DcmDspRoutineAuthorization:
            DcmDspRoutineSessionRef = DcmDspSessionRow_CODING_SESSION
            DcmDspRoutineSessionRef = DcmDspSessionRow_DEFAULT_SESSION
            DcmDspRoutineSessionRef = DcmDspSessionRow_EXTENDED_DIAGNOSTIC_SESSION
          DcmDspStartRoutineOut_START_EthGetDhcpStatus (DcmDspStartRoutineOut)
            DcmDspStartRoutineOutSignal_StatDhcpClientState (DcmDspStartRoutineOutSignal): DcmDspRoutineSignalEndianness=opaque, DcmDspRoutineSignalLength=8, DcmDspRoutineSignalPos=0, DcmDspRoutineSignalType=UINT8
          DcmDspStartRoutineIn_START_EthGetDhcpStatus (DcmDspStartRoutineIn)
            DcmDspStartRoutineInSignal_NwInterfaceIndex (DcmDspStartRoutineInSignal): DcmDspRoutineSignalEndianness=opaque, DcmDspRoutineSignalLength=8, DcmDspRoutineSignalPos=0, DcmDspRoutineSignalType=UINT8
        DcmDspDidInfo_SvkWerk (DcmDspDidInfo): DcmDspDidDynamicallyDefined=false
          DcmDspDidAccess
            DcmDspDidRead: DcmDspDidReadSessionRef=DcmDspSessionRow_DEFAULT_SESSION, DcmDspDidReadSessionRef=DcmDspSessionRow_EXTENDED_DIAGNOSTIC_SESSION
        DcmDspDid_MileKmEeprom (DcmDspDid): DcmDspDidIdentifier=9536, DcmDspDidUsed=true, DcmDspDidUsePort=USE_DATA_ELEMENT_SPECIFIC_INTERFACES, DcmDspDidInfoRef=DcmDspDidInfo_MileKmEeprom
          DcmDspDidSignal_MileKmEeprom (DcmDspDidSignal): DcmDspDidDataPos=0, DcmDspDidDataRef=DcmDspData_MileKmEeprom
        DcmDspData_PiaProfile0_1ZT4CR (DcmDspDataInfo): DcmDspDataFixedLength=false
        DcmDspRoutineInfo_3Gfcyc (DcmDspRoutineInfo)
          DcmDspRoutineAuthorization: DcmDspRoutineSessionRef=DcmDspSessionRow_DEFAULT_SESSION, DcmDspRoutineSessionRef=DcmDspSessionRow_EXTENDED_DIAGNOSTIC_SESSION
          DcmDspStartRoutineIn_START_CheckHttpConnection (DcmDspStartRoutineIn)
            DcmDspStartRoutineInSignal_ServerUrl (DcmDspStartRoutineInSignal): DcmDspRoutineSignalPos=32, DcmDspRoutineSignalLength=8, DcmDspRoutineSignalType=UINT8
            DcmDspStartRoutineInSignal_TimeOutTime (DcmDspStartRoutineInSignal): DcmDspRoutineSignalEndianness=BIG_ENDIAN, DcmDspRoutineSignalLength=32, DcmDspRoutineSignalPos=0, DcmDspRoutineSignalType=UINT32
          DcmDspStartRoutineOut_START_CheckHttpConnection (DcmDspStartRoutineOut)
            DcmDspStartRoutineOutSignal_HttpResponseCode (DcmDspStartRoutineOutSignal): DcmDspRoutineSignalEndianness=BIG_ENDIAN, DcmDspRoutineSignalLength=16, DcmDspRoutineSignalPos=8, DcmDspRoutineSignalType=UINT16
            DcmDspStartRoutineOutSignal_HttpConnectionStatus (DcmDspStartRoutineOutSignal): DcmDspRoutineSignalEndianness=opaque, DcmDspRoutineSignalLength=8, DcmDspRoutineSignalPos=0, DcmDspRoutineSignalType=UINT8
        DcmDspDidInfo_SvkAktuell (DcmDspDidInfo): DcmDspDidDynamicallyDefined=false
          DcmDspDidAccess
            DcmDspDidRead: DcmDspDidReadSessionRef=DcmDspSessionRow_EXTENDED_DIAGNOSTIC_SESSION, DcmDspDidReadSessionRef=DcmDspSessionRow_DEFAULT_SESSION
        DcmDspData_Systemzeit (DcmDspData):
          DcmDspDataConditionCheckReadFncUsed = false
          DcmDspDataSize = 32
          DcmDspDataType = UINT8
          DcmDspDataUsePort = USE_DATA_SYNCH_CLIENT_SERVER
          DcmDspDataInfoRef = DcmDspDataInfo_Dummy
        DcmDspRoutineInfo_2w2P9V (DcmDspRoutineInfo)
          DcmDspStartRoutineOut_START_EthEnableTestMode (DcmDspStartRoutineOut)
            DcmDspStartRoutineOutSignal_StatPhyTestMode (DcmDspStartRoutineOutSignal): DcmDspRoutineSignalEndianness=opaque, DcmDspRoutineSignalLength=8, DcmDspRoutineSignalPos=0, DcmDspRoutineSignalType=UINT8
          DcmDspRoutineAuthorization: DcmDspRoutineSessionRef=DcmDspSessionRow_EXTENDED_DIAGNOSTIC_SESSION
          DcmDspStartRoutineIn_START_EthEnableTestMode (DcmDspStartRoutineIn)
            3 x DcmDspStartRoutineInSignal, all with DcmDspRoutineSignalEndianness=opaque, DcmDspRoutineSignalLength=8, DcmDspRoutineSignalType=UINT8:
              DcmDspStartRoutineInSignal_TestDuration: DcmDspRoutineSignalPos=8
              DcmDspStartRoutineInSignal_PortIndex: DcmDspRoutineSignalPos=0
              DcmDspStartRoutineInSignal_TestModeId: DcmDspRoutineSignalPos=16
        DcmDspRoutine_FsMsmN111 (DcmDspRoutine):
          DcmDspRoutineIdentifier = 533
          DcmDspRoutineUsePort = true
          DcmDspRoutineUsed = true
          DcmDspRequestResultsRoutineSupported = false
          DcmDspStopRoutineSupported = false
          DcmDspRoutineFixedLength = false
          DcmDspRoutineInfoRef = DcmDspRoutine_FsMsmN111_1XQMz
        DcmDspDidInfo_ListManipulationGeneral (DcmDspDidInfo): DcmDspDidDynamicallyDefined=false
          DcmDspDidAccess
            DcmDspDidRead: DcmDspDidReadSessionRef=DcmDspSessionRow_DEFAULT_SESSION, DcmDspDidReadSessionRef=DcmDspSessionRow_EXTENDED_DIAGNOSTIC_SESSION
        DcmDspData_Herstelldatum (DcmDspData):
          DcmDspDataConditionCheckReadFncUsed = false
          DcmDspDataSize = 24
          DcmDspDataType = UINT8
          DcmDspDataUsePort = USE_DATA_SYNCH_CLIENT_SERVER
          DcmDspDataInfoRef = DcmDspDataInfo_Dummy
        DcmDspDid_ListManipulationGeneral (DcmDspDid):
          DcmDspDidIdentifier = 9620
          DcmDspDidUsed = true
          DcmDspDidUsePort = USE_DATA_ELEMENT_SPECIFIC_INTERFACES
          DcmDspDidInfoRef = DcmDspDidInfo_ListManipulationGeneral
          DcmDspDidSignal_ListManipulationGeneral (DcmDspDidSignal): DcmDspDidDataPos=0, DcmDspDidDataRef=DcmDspData_ListManipulationGeneral
        DcmDspData_HddDownloadStatus (DcmDspData): DcmDspDataType=UINT8, DcmDspDataSize=65535, DcmDspDataUsePort=USE_DATA_ASYNCH_CLIENT_SERVER, DcmDspDataInfoRef=DcmDspDataInfo_Dummy
        DcmDspRoutine_InitLinBus_4NDgMR (DcmDspRoutineInfo)
          DcmDspRoutineAuthorization:
            DcmDspRoutineSessionRef = DcmDspSessionRow_CODING_SESSION
            DcmDspRoutineSessionRef = DcmDspSessionRow_DEFAULT_SESSION
            DcmDspRoutineSessionRef = DcmDspSessionRow_EXTENDED_DIAGNOSTIC_SESSION
        DcmDspDid_SvkWerk (DcmDspDid): DcmDspDidIdentifier=61699, DcmDspDidUsed=true, DcmDspDidUsePort=USE_DATA_ELEMENT_SPECIFIC_INTERFACES, DcmDspDidInfoRef=DcmDspDidInfo_SvkWerk
          DcmDspDidSignal_SvkWerk (DcmDspDidSignal): DcmDspDidDataPos=0, DcmDspDidDataRef=DcmDspData_SvkWerk
        DcmDspRoutine_RamDatenSchreiben (DcmDspRoutine):
          DcmDspRoutineIdentifier = 16390
          DcmDspRoutineUsePort = true
          DcmDspRoutineUsed = true
          DcmDspRequestResultsRoutineSupported = true
          DcmDspStopRoutineSupported = false
          DcmDspRoutineFixedLength = false
          DcmDspRoutineInfoRef = DcmDspRoutineInfo_3MGry8
        DcmDspRoutine_FsMsmN102 (DcmDspRoutine):
          DcmDspRoutineIdentifier = 560
          DcmDspRoutineUsePort = true
          DcmDspRoutineUsed = true
          DcmDspRequestResultsRoutineSupported = false
          DcmDspStopRoutineSupported = false
          DcmDspRoutineFixedLength = false
          DcmDspRoutineInfoRef = DcmDspRoutine_FsMsmN102_1XQM0
        DcmDspData_Pruefstempel (DcmDspData):
          DcmDspDataSize = 24
          DcmDspDataType = UINT8
          DcmDspDataUsePort = USE_BLOCK_ID
          DcmDspDataInfoRef = DcmDspDataInfo_Dummy
          DcmDspDataBlockIdRef = TestStampDefaults
        DcmDspDid_ProgrammingCounterMaxValue (DcmDspDid):
          DcmDspDidIdentifier = 9475
          DcmDspDidUsed = true
          DcmDspDidUsePort = USE_DATA_ELEMENT_SPECIFIC_INTERFACES
          DcmDspDidInfoRef = DcmDspDidInfo_ProgrammingCounterMaxValue
          DcmDspDidSignal_ProgrammingCounterMaxValue (DcmDspDidSignal): DcmDspDidDataPos=0, DcmDspDidDataRef=DcmDspData_ProgrammingCounterMaxValue
        DcmDspRoutine_InitLinBus (DcmDspRoutine):
          DcmDspRoutineIdentifier = 16387
          DcmDspRoutineUsePort = true
          DcmDspRoutineUsed = true
          DcmDspRequestResultsRoutineSupported = false
          DcmDspStopRoutineSupported = false
          DcmDspRoutineFixedLength = false
          DcmDspRoutineInfoRef = DcmDspRoutine_InitLinBus_4NDgMR
        DcmDspRoutineInfo_PCxzr (DcmDspRoutineInfo)
          DcmDspRoutineAuthorization: DcmDspRoutineSessionRef=DcmDspSessionRow_DEFAULT_SESSION, DcmDspRoutineSessionRef=DcmDspSessionRow_EXTENDED_DIAGNOSTIC_SESSION
        DcmDspDid_EcuSerialNumber (DcmDspDid):
          DcmDspDidIdentifier = 61836
          DcmDspDidUsed = true
          DcmDspDidUsePort = USE_DATA_ELEMENT_SPECIFIC_INTERFACES
          DcmDspDidInfoRef = DcmDspDidInfo_EcuSerialNumber
          DcmDspDidSignal_EcuSerialNumber (DcmDspDidSignal): DcmDspDidDataPos=0, DcmDspDidDataRef=DcmDspData_EcuSerialNumber
        DcmDspDidInfo_DmIsDtcActiveResponse (DcmDspDidInfo): DcmDspDidDynamicallyDefined=false
          DcmDspDidAccess
            DcmDspDidRead: DcmDspDidReadSessionRef=DcmDspSessionRow_DEFAULT_SESSION, DcmDspDidReadSessionRef=DcmDspSessionRow_EXTENDED_DIAGNOSTIC_SESSION
        DcmDspRoutine_FsMsmN101AbfrageFzgsec (DcmDspRoutine):
          DcmDspRoutineIdentifier = 532
          DcmDspRoutineUsePort = true
          DcmDspRoutineUsed = true
          DcmDspRequestResultsRoutineSupported = false
          DcmDspStopRoutineSupported = false
          DcmDspRoutineFixedLength = false
          DcmDspRoutineInfoRef = DcmDspRoutineInfo_10gc40
        DcmDspDidInfo_IpConfiguration (DcmDspDidInfo): DcmDspDidDynamicallyDefined=false
          DcmDspDidAccess
            DcmDspDidRead: DcmDspDidReadSessionRef=DcmDspSessionRow_DEFAULT_SESSION, DcmDspDidReadSessionRef=DcmDspSessionRow_EXTENDED_DIAGNOSTIC_SESSION
        DcmDspDid_SgbdIdx (DcmDspDid): DcmDspDidIdentifier=61776, DcmDspDidUsed=true, DcmDspDidUsePort=USE_DATA_ELEMENT_SPECIFIC_INTERFACES, DcmDspDidInfoRef=DcmDspDidInfo_SgbdIdx
          DcmDspDidSignal_SgbdIdx (DcmDspDidSignal): DcmDspDidDataPos=0, DcmDspDidDataRef=DcmDspData_SgbdIdx
        DcmDspDidInfo_SvkBackup49 (DcmDspDidInfo): DcmDspDidDynamicallyDefined=false
          DcmDspDidAccess
            DcmDspDidRead: DcmDspDidReadSessionRef=DcmDspSessionRow_DEFAULT_SESSION, DcmDspDidReadSessionRef=DcmDspSessionRow_EXTENDED_DIAGNOSTIC_SESSION
        DcmDspDid_ZgwZertifikat (DcmDspDid): DcmDspDidIdentifier=5919, DcmDspDidUsed=true, DcmDspDidUsePort=USE_DATA_ELEMENT_SPECIFIC_INTERFACES, DcmDspDidInfoRef=DcmDspDidInfo_ZgwZertifikat
          DcmDspDidSignal_ZgwZertifikat (DcmDspDidSignal): DcmDspDidDataPos=0, DcmDspDidDataRef=DcmDspData_ZgwZertifikat
        4 x DcmDspDidInfo, all with DcmDspDidDynamicallyDefined=false:
          DcmDspDidInfo_SvkBackup47
            DcmDspDidAccess
              DcmDspDidRead: DcmDspDidReadSessionRef=DcmDspSessionRow_EXTENDED_DIAGNOSTIC_SESSION, DcmDspDidReadSessionRef=DcmDspSessionRow_DEFAULT_SESSION
          DcmDspDidInfo_SvkBackup48
            DcmDspDidAccess
              DcmDspDidRead: DcmDspDidReadSessionRef=DcmDspSessionRow_DEFAULT_SESSION, DcmDspDidReadSessionRef=DcmDspSessionRow_EXTENDED_DIAGNOSTIC_SESSION
          DcmDspDidInfo_SvkBackup41
            DcmDspDidAccess
              DcmDspDidRead: DcmDspDidReadSessionRef=DcmDspSessionRow_DEFAULT_SESSION, DcmDspDidReadSessionRef=DcmDspSessionRow_EXTENDED_DIAGNOSTIC_SESSION
          DcmDspDidInfo_SvkBackup42
            DcmDspDidAccess
              DcmDspDidRead: DcmDspDidReadSessionRef=DcmDspSessionRow_EXTENDED_DIAGNOSTIC_SESSION, DcmDspDidReadSessionRef=DcmDspSessionRow_DEFAULT_SESSION
        DcmDspData_ReadOpMode (DcmDspData):
          DcmDspDataConditionCheckReadFncUsed = true
          DcmDspDataSize = 8
          DcmDspDataType = UINT8
          DcmDspDataUsePort = USE_DATA_SYNCH_CLIENT_SERVER
          DcmDspDataInfoRef = DcmDspDataInfo_Dummy
        5 x DcmDspDidInfo, all with DcmDspDidDynamicallyDefined=false:
          DcmDspDidInfo_SvkBackup40
            DcmDspDidAccess
              DcmDspDidRead: DcmDspDidReadSessionRef=DcmDspSessionRow_EXTENDED_DIAGNOSTIC_SESSION, DcmDspDidReadSessionRef=DcmDspSessionRow_DEFAULT_SESSION
          DcmDspDidInfo_SvkBackup45
            DcmDspDidAccess
              DcmDspDidRead: DcmDspDidReadSessionRef=DcmDspSessionRow_EXTENDED_DIAGNOSTIC_SESSION, DcmDspDidReadSessionRef=DcmDspSessionRow_DEFAULT_SESSION
          DcmDspDidInfo_SvkBackup46
            DcmDspDidAccess
              DcmDspDidRead: DcmDspDidReadSessionRef=DcmDspSessionRow_EXTENDED_DIAGNOSTIC_SESSION, DcmDspDidReadSessionRef=DcmDspSessionRow_DEFAULT_SESSION
          DcmDspDidInfo_SvkBackup43
            DcmDspDidAccess
              DcmDspDidRead: DcmDspDidReadSessionRef=DcmDspSessionRow_EXTENDED_DIAGNOSTIC_SESSION, DcmDspDidReadSessionRef=DcmDspSessionRow_DEFAULT_SESSION
          DcmDspDidInfo_SvkBackup44
            DcmDspDidAccess
              DcmDspDidRead: DcmDspDidReadSessionRef=DcmDspSessionRow_DEFAULT_SESSION, DcmDspDidReadSessionRef=DcmDspSessionRow_EXTENDED_DIAGNOSTIC_SESSION
        3 x DcmDspRoutine, all with DcmDspRoutineUsePort=true, DcmDspRoutineUsed=true, DcmDspStopRoutineSupported=false, DcmDspRoutineFixedLength=false:
          DcmDspRoutine_EthIpConfiguration: DcmDspRoutineIdentifier=4165, DcmDspRequestResultsRoutineSupported=false, DcmDspRoutineInfoRef=DcmDspRoutineInfo_d9xzR
          DcmDspRoutine_FsN31034: DcmDspRoutineIdentifier=530, DcmDspRequestResultsRoutineSupported=false, DcmDspRoutineInfoRef=DcmDspRoutine_FsN31034_2gPlQH
          DcmDspRoutine_FsN70X: DcmDspRoutineIdentifier=527, DcmDspRequestResultsRoutineSupported=true, DcmDspRoutineInfoRef=DcmDspRoutine_FsN70X_YxKJ7
        DcmDspRoutineInfo_3ctCrQ (DcmDspRoutineInfo)
          DcmDspStartRoutineIn_START_ExternalHsfz (DcmDspStartRoutineIn)
            DcmDspStartRoutineInSignal_Activation (DcmDspStartRoutineInSignal): DcmDspRoutineSignalLength=8, DcmDspRoutineSignalPos=0, DcmDspRoutineSignalType=UINT8
          DcmDspRoutineAuthorization: DcmDspRoutineSessionRef=DcmDspSessionRow_DEFAULT_SESSION, DcmDspRoutineSessionRef=DcmDspSessionRow_EXTENDED_DIAGNOSTIC_SESSION
        6 x DcmDspDidInfo, all with DcmDspDidDynamicallyDefined=false:
          DcmDspDidInfo_SvkBackup38
            DcmDspDidAccess
              DcmDspDidRead: DcmDspDidReadSessionRef=DcmDspSessionRow_DEFAULT_SESSION, DcmDspDidReadSessionRef=DcmDspSessionRow_EXTENDED_DIAGNOSTIC_SESSION
          DcmDspDidInfo_SvkBackup39
            DcmDspDidAccess
              DcmDspDidRead: DcmDspDidReadSessionRef=DcmDspSessionRow_DEFAULT_SESSION, DcmDspDidReadSessionRef=DcmDspSessionRow_EXTENDED_DIAGNOSTIC_SESSION
          DcmDspDidInfo_SvkBackup36
            DcmDspDidAccess
              DcmDspDidRead: DcmDspDidReadSessionRef=DcmDspSessionRow_EXTENDED_DIAGNOSTIC_SESSION, DcmDspDidReadSessionRef=DcmDspSessionRow_DEFAULT_SESSION
          DcmDspDidInfo_SvkBackup37
            DcmDspDidAccess
              DcmDspDidRead: DcmDspDidReadSessionRef=DcmDspSessionRow_DEFAULT_SESSION, DcmDspDidReadSessionRef=DcmDspSessionRow_EXTENDED_DIAGNOSTIC_SESSION
          DcmDspDidInfo_SvkBackup30
            DcmDspDidAccess
              DcmDspDidRead: DcmDspDidReadSessionRef=DcmDspSessionRow_DEFAULT_SESSION, DcmDspDidReadSessionRef=DcmDspSessionRow_EXTENDED_DIAGNOSTIC_SESSION
          DcmDspDidInfo_SvkBackup31
            DcmDspDidAccess
              DcmDspDidRead: DcmDspDidReadSessionRef=DcmDspSessionRow_DEFAULT_SESSION, DcmDspDidReadSessionRef=DcmDspSessionRow_EXTENDED_DIAGNOSTIC_SESSION
        DcmDspRoutineInfo_15K4rM (DcmDspRoutineInfo)
          DcmDspStartRoutineIn_START_DmClientTriggerDtcEntry (DcmDspStartRoutineIn)
            DcmDspStartRoutineInSignal_DTCType (DcmDspStartRoutineInSignal): DcmDspRoutineSignalLength=8, DcmDspRoutineSignalPos=0, DcmDspRoutineSignalType=UINT8
          DcmDspRoutineAuthorization: DcmDspRoutineSessionRef=DcmDspSessionRow_DEFAULT_SESSION, DcmDspRoutineSessionRef=DcmDspSessionRow_EXTENDED_DIAGNOSTIC_SESSION
          DcmDspStartRoutineOut_START_DmClientTriggerDtcEntry (DcmDspStartRoutineOut)
            4 x DcmDspStartRoutineOutSignal, all with DcmDspRoutineSignalLength=8, DcmDspRoutineSignalType=UINT8:
              DcmDspStartRoutineOutSignal_DTCByte2: DcmDspRoutineSignalPos=16
              DcmDspStartRoutineOutSignal_DTCByte3: DcmDspRoutineSignalPos=24
              DcmDspStartRoutineOutSignal_DTCTypeOut: DcmDspRoutineSignalPos=0
              DcmDspStartRoutineOutSignal_DTCByte1: DcmDspRoutineSignalPos=8
        DcmDspDidInfo_SvkBackup34 (DcmDspDidInfo): DcmDspDidDynamicallyDefined=false
          DcmDspDidAccess
            DcmDspDidRead: DcmDspDidReadSessionRef=DcmDspSessionRow_EXTENDED_DIAGNOSTIC_SESSION, DcmDspDidReadSessionRef=DcmDspSessionRow_DEFAULT_SESSION
        DcmDspRoutine_Energiesparmode (DcmDspRoutine):
          DcmDspRoutineIdentifier = 3852
          DcmDspRoutineUsePort = true
          DcmDspRoutineUsed = true
          DcmDspRequestResultsRoutineSupported = false
          DcmDspStopRoutineSupported = false
          DcmDspRoutineFixedLength = true
          DcmDspRoutineInfoRef = DcmDspRoutineInfo_1T6bNw
        DcmDspDidInfo_SvkBackup35 (DcmDspDidInfo): DcmDspDidDynamicallyDefined=false
          DcmDspDidAccess
            DcmDspDidRead: DcmDspDidReadSessionRef=DcmDspSessionRow_DEFAULT_SESSION, DcmDspDidReadSessionRef=DcmDspSessionRow_EXTENDED_DIAGNOSTIC_SESSION
        DcmDspDidInfo_SvkBackup32 (DcmDspDidInfo): DcmDspDidDynamicallyDefined=false
          DcmDspDidAccess
            DcmDspDidRead: DcmDspDidReadSessionRef=DcmDspSessionRow_DEFAULT_SESSION, DcmDspDidReadSessionRef=DcmDspSessionRow_EXTENDED_DIAGNOSTIC_SESSION
        DcmDspRoutine_EthReadPhyRegister (DcmDspRoutine):
          DcmDspRoutineIdentifier = 4161
          DcmDspRoutineUsePort = true
          DcmDspRoutineUsed = true
          DcmDspRequestResultsRoutineSupported = false
          DcmDspStopRoutineSupported = false
          DcmDspRoutineFixedLength = false
          DcmDspRoutineInfoRef = DcmDspRoutineInfo_4LZ7vb
        DcmDspDidInfo_SvkBackup33 (DcmDspDidInfo): DcmDspDidDynamicallyDefined=false
          DcmDspDidAccess
            DcmDspDidRead: DcmDspDidReadSessionRef=DcmDspSessionRow_DEFAULT_SESSION, DcmDspDidReadSessionRef=DcmDspSessionRow_EXTENDED_DIAGNOSTIC_SESSION
        DcmDspRoutine_RcPad (DcmDspRoutine):
          DcmDspRoutineIdentifier = 28672
          DcmDspRoutineUsePort = true
          DcmDspRoutineUsed = true
          DcmDspRequestResultsRoutineSupported = false
          DcmDspStopRoutineSupported = false
          DcmDspRoutineFixedLength = false
          DcmDspRoutineInfoRef = DcmDspRoutine_RcPad_q1zPQ
        DcmDspRoutine_EthGetSwitchVlanConfiguration (DcmDspRoutine):
          DcmDspRoutineIdentifier = 4177
          DcmDspRoutineUsePort = true
          DcmDspRoutineUsed = true
          DcmDspRequestResultsRoutineSupported = false
          DcmDspStopRoutineSupported = false
          DcmDspRoutineFixedLength = false
          DcmDspRoutineInfoRef = DcmDspRoutineInfo_1YcVW4
        DcmDspData_ProgrammingCounter (DcmDspData):
          DcmDspDataConditionCheckReadFncUsed = false
          DcmDspDataSize = 32
          DcmDspDataType = UINT8
          DcmDspDataUsePort = USE_DATA_SYNCH_CLIENT_SERVER
          DcmDspDataInfoRef = DcmDspDataInfo_Dummy
        DcmDspDid_ListManipulationSecureBoot (DcmDspDid):
          DcmDspDidIdentifier = 9619
          DcmDspDidUsed = true
          DcmDspDidUsePort = USE_DATA_ELEMENT_SPECIFIC_INTERFACES
          DcmDspDidInfoRef = DcmDspDidInfo_ListManipulationSecureBoot
          DcmDspDidSignal_ListManipulationSecureBoot (DcmDspDidSignal): DcmDspDidDataPos=0, DcmDspDidDataRef=DcmDspData_ListManipulationSecureBoot
        DcmDspRoutineInfo_1T6bNw (DcmDspRoutineInfo)
          DcmDspRoutineAuthorization: DcmDspRoutineSessionRef=DcmDspSessionRow_DEFAULT_SESSION, DcmDspRoutineSessionRef=DcmDspSessionRow_EXTENDED_DIAGNOSTIC_SESSION
          DcmDspStartRoutineIn_START_Energiesparmode (DcmDspStartRoutineIn)
            DcmDspStartRoutineInSignal_OperatingMode (DcmDspStartRoutineInSignal): DcmDspRoutineSignalLength=8, DcmDspRoutineSignalPos=0, DcmDspRoutineSignalType=UINT8
        DcmDspDidInfo_SvkBackup61 (DcmDspDidInfo): DcmDspDidDynamicallyDefined=false
          DcmDspDidAccess
            DcmDspDidRead: DcmDspDidReadSessionRef=DcmDspSessionRow_DEFAULT_SESSION, DcmDspDidReadSessionRef=DcmDspSessionRow_EXTENDED_DIAGNOSTIC_SESSION
        DcmDspDid_DmIsDtcActiveResponse (DcmDspDid):
          DcmDspDidIdentifier = 5923
          DcmDspDidUsed = true
          DcmDspDidUsePort = USE_DATA_ELEMENT_SPECIFIC_INTERFACES
          DcmDspDidInfoRef = DcmDspDidInfo_DmIsDtcActiveResponse
          DcmDspDidSignal_DmIsDtcActiveResponse (DcmDspDidSignal): DcmDspDidDataPos=0, DcmDspDidDataRef=DcmDspData_DmIsDtcActiveResponse
        DcmDspRoutine_ActivateZgwFlashmode (DcmDspRoutine):
          DcmDspRoutineIdentifier = 4110
          DcmDspRoutineUsePort = true
          DcmDspRoutineUsed = true
          DcmDspRequestResultsRoutineSupported = false
          DcmDspStopRoutineSupported = false
          DcmDspRoutineFixedLength = false
          DcmDspRoutineInfoRef = DcmDspRoutineInfo_4fCQ3y
        DcmDspDidInfo_MileKmEeprom (DcmDspDidInfo): DcmDspDidDynamicallyDefined=false
          DcmDspDidAccess
            DcmDspDidRead: DcmDspDidReadSessionRef=DcmDspSessionRow_EXTENDED_DIAGNOSTIC_SESSION, DcmDspDidReadSessionRef=DcmDspSessionRow_DEFAULT_SESSION
        DcmDspDidInfo_ActiveDiagnosticSession (DcmDspDidInfo): DcmDspDidDynamicallyDefined=false
          DcmDspDidAccess
            DcmDspDidRead: DcmDspDidReadSessionRef=DcmDspSessionRow_EXTENDED_DIAGNOSTIC_SESSION, DcmDspDidReadSessionRef=DcmDspSessionRow_DEFAULT_SESSION
        DcmDspRoutineInfo_1VGBKh (DcmDspRoutineInfo)
          DcmDspRoutineAuthorization: DcmDspRoutineSessionRef=DcmDspSessionRow_DEFAULT_SESSION, DcmDspRoutineSessionRef=DcmDspSessionRow_EXTENDED_DIAGNOSTIC_SESSION
          DcmDspStartRoutineIn_START_RequestPreferredProtocol (DcmDspStartRoutineIn)
            DcmDspStartRoutineInSignal_SgbmId (DcmDspStartRoutineInSignal): DcmDspRoutineSignalEndianness=opaque, DcmDspRoutineSignalLength=64, DcmDspRoutineSignalPos=0, DcmDspRoutineSignalType=VARIABLE_LENGTH
          DcmDspStartRoutineOut_START_RequestPreferredProtocol (DcmDspStartRoutineOut)
            DcmDspStartRoutineOutSignal_AnzahlItems (DcmDspStartRoutineOutSignal): DcmDspRoutineSignalEndianness=opaque, DcmDspRoutineSignalLength=8, DcmDspRoutineSignalPos=0, DcmDspRoutineSignalType=UINT8
            DcmDspStartRoutineOutSignal_FpRpp31011021Eopfld (DcmDspStartRoutineOutSignal): DcmDspRoutineSignalPos=8, DcmDspRoutineSignalLength=128, DcmDspRoutineSignalType=UINT8
        DcmDspDidInfo_SvkBackup58 (DcmDspDidInfo): DcmDspDidDynamicallyDefined=false
          DcmDspDidAccess
            DcmDspDidRead: DcmDspDidReadSessionRef=DcmDspSessionRow_EXTENDED_DIAGNOSTIC_SESSION, DcmDspDidReadSessionRef=DcmDspSessionRow_DEFAULT_SESSION
        DcmDspDidInfo_SvkBackup59 (DcmDspDidInfo): DcmDspDidDynamicallyDefined=false
          DcmDspDidAccess
            DcmDspDidRead: DcmDspDidReadSessionRef=DcmDspSessionRow_DEFAULT_SESSION, DcmDspDidReadSessionRef=DcmDspSessionRow_EXTENDED_DIAGNOSTIC_SESSION
        DcmDspData_PiaProfile1_1ZT4CS (DcmDspDataInfo): DcmDspDataFixedLength=false
        7 x DcmDspDidInfo, all with DcmDspDidDynamicallyDefined=false:
          DcmDspDidInfo_SvkBackup52
            DcmDspDidAccess
              DcmDspDidRead: DcmDspDidReadSessionRef=DcmDspSessionRow_EXTENDED_DIAGNOSTIC_SESSION, DcmDspDidReadSessionRef=DcmDspSessionRow_DEFAULT_SESSION
          DcmDspDidInfo_SvkBackup53
            DcmDspDidAccess
              DcmDspDidRead: DcmDspDidReadSessionRef=DcmDspSessionRow_EXTENDED_DIAGNOSTIC_SESSION, DcmDspDidReadSessionRef=DcmDspSessionRow_DEFAULT_SESSION
          DcmDspDidInfo_SvkBackup50
            DcmDspDidAccess
              DcmDspDidRead: DcmDspDidReadSessionRef=DcmDspSessionRow_DEFAULT_SESSION, DcmDspDidReadSessionRef=DcmDspSessionRow_EXTENDED_DIAGNOSTIC_SESSION
          DcmDspDidInfo_SvkBackup51
            DcmDspDidAccess
              DcmDspDidRead: DcmDspDidReadSessionRef=DcmDspSessionRow_DEFAULT_SESSION, DcmDspDidReadSessionRef=DcmDspSessionRow_EXTENDED_DIAGNOSTIC_SESSION
          DcmDspDidInfo_SvkBackup56
            DcmDspDidAccess
              DcmDspDidRead: DcmDspDidReadSessionRef=DcmDspSessionRow_DEFAULT_SESSION, DcmDspDidReadSessionRef=DcmDspSessionRow_EXTENDED_DIAGNOSTIC_SESSION
          DcmDspDidInfo_SvkBackup57
            DcmDspDidAccess
              DcmDspDidRead: DcmDspDidReadSessionRef=DcmDspSessionRow_DEFAULT_SESSION, DcmDspDidReadSessionRef=DcmDspSessionRow_EXTENDED_DIAGNOSTIC_SESSION
          DcmDspDidInfo_SvkBackup54
            DcmDspDidAccess
              DcmDspDidRead: DcmDspDidReadSessionRef=DcmDspSessionRow_DEFAULT_SESSION, DcmDspDidReadSessionRef=DcmDspSessionRow_EXTENDED_DIAGNOSTIC_SESSION
        DcmDspRoutine_RcCpp_q1vmL (DcmDspRoutineInfo)
          DcmDspStartRoutineIn_START_RcCpp (DcmDspStartRoutineIn)
            DcmDspStartRoutineInSignal_RcCppRsr (DcmDspStartRoutineInSignal): DcmDspRoutineSignalPos=0, DcmDspRoutineSignalLength=8, DcmDspRoutineSignalType=UINT8
          DcmDspRoutineAuthorization: DcmDspRoutineSessionRef=DcmDspSessionRow_DEFAULT_SESSION, DcmDspRoutineSessionRef=DcmDspSessionRow_EXTENDED_DIAGNOSTIC_SESSION
          DcmDspStartRoutineOut_START_RcCpp (DcmDspStartRoutineOut)
            DcmDspStartRoutineOutSignal_StatDuration (DcmDspStartRoutineOutSignal): DcmDspRoutineSignalEndianness=BIG_ENDIAN, DcmDspRoutineSignalLength=16, DcmDspRoutineSignalPos=0, DcmDspRoutineSignalType=UINT16
            DcmDspStartRoutineOutSignal_StatApprovalChargingState (DcmDspStartRoutineOutSignal): DcmDspRoutineSignalEndianness=opaque, DcmDspRoutineSignalLength=8, DcmDspRoutineSignalPos=16, DcmDspRoutineSignalType=UINT8
        DcmDspDidInfo_SvkBackup55 (DcmDspDidInfo): DcmDspDidDynamicallyDefined=false
          DcmDspDidAccess
            DcmDspDidRead: DcmDspDidReadSessionRef=DcmDspSessionRow_EXTENDED_DIAGNOSTIC_SESSION, DcmDspDidReadSessionRef=DcmDspSessionRow_DEFAULT_SESSION
        DcmDspRoutine_EthWritePhyRegister (DcmDspRoutine):
          DcmDspRoutineIdentifier = 4173
          DcmDspRoutineUsePort = true
          DcmDspRoutineUsed = true
          DcmDspRequestResultsRoutineSupported = false
          DcmDspStopRoutineSupported = false
          DcmDspRoutineFixedLength = false
          DcmDspRoutineInfoRef = DcmDspRoutineInfo_4KQsRC
        DcmDspRoutineInfo_4v65x9 (DcmDspRoutineInfo)
          DcmDspRoutineAuthorization: DcmDspRoutineSessionRef=DcmDspSessionRow_EXTENDED_DIAGNOSTIC_SESSION
        DcmDspData_ListManipulationSecureBoot (DcmDspData): DcmDspDataType=UINT8, DcmDspDataSize=65535, DcmDspDataUsePort=USE_DATA_ASYNCH_CLIENT_SERVER, DcmDspDataInfoRef=DcmDspDataInfo_Dummy
        DcmDspDidInfo_SvkBackup60 (DcmDspDidInfo): DcmDspDidDynamicallyDefined=false
          DcmDspDidAccess
            DcmDspDidRead: DcmDspDidReadSessionRef=DcmDspSessionRow_EXTENDED_DIAGNOSTIC_SESSION, DcmDspDidReadSessionRef=DcmDspSessionRow_DEFAULT_SESSION
        DcmDspRoutineInfo_4fCQ3y (DcmDspRoutineInfo)
          DcmDspRoutineAuthorization: DcmDspRoutineSessionRef=DcmDspSessionRow_EXTENDED_DIAGNOSTIC_SESSION
        DcmDspData_EthPhyLinkState (DcmDspData): DcmDspDataSize=24, DcmDspDataType=UINT8, DcmDspDataUsePort=USE_DATA_ASYNCH_CLIENT_SERVER, DcmDspDataInfoRef=DcmDspDataInfo_Dummy
        DcmDspRoutine_RcPad_q1zPQ (DcmDspRoutineInfo)
          DcmDspStartRoutineIn_START_RcPad (DcmDspStartRoutineIn)
            5 x DcmDspStartRoutineInSignal, all with DcmDspRoutineSignalLength=8, DcmDspRoutineSignalType=UINT8:
              DcmDspStartRoutineInSignal_MemObjIdent: DcmDspRoutineSignalPos=24
              DcmDspStartRoutineInSignal_AppSpecificParam: DcmDspRoutineSignalPos=32
              DcmDspStartRoutineInSignal_Dpt: DcmDspRoutineSignalEndianness=opaque, DcmDspRoutineSignalPos=0
              DcmDspStartRoutineInSignal_MoiAfid: DcmDspRoutineSignalEndianness=opaque, DcmDspRoutineSignalPos=16
              DcmDspStartRoutineInSignal_Rsvd: DcmDspRoutineSignalEndianness=opaque, DcmDspRoutineSignalPos=8
          DcmDspRoutineAuthorization: DcmDspRoutineSessionRef=DcmDspSessionRow_EXTENDED_DIAGNOSTIC_SESSION
          DcmDspStartRoutineOut_START_RcPad (DcmDspStartRoutineOut)
            DcmDspStartRoutineOutSignal_Rs (DcmDspStartRoutineOutSignal): DcmDspRoutineSignalEndianness=opaque, DcmDspRoutineSignalLength=8, DcmDspRoutineSignalPos=0, DcmDspRoutineSignalType=UINT8
        DcmDspDidInfo_SgbdIdx (DcmDspDidInfo): DcmDspDidDynamicallyDefined=false
          DcmDspDidAccess
            DcmDspDidRead: DcmDspDidReadSessionRef=DcmDspSessionRow_EXTENDED_DIAGNOSTIC_SESSION, DcmDspDidReadSessionRef=DcmDspSessionRow_DEFAULT_SESSION
        DcmDspData_ListManipulationApplicationData (DcmDspData): DcmDspDataType=UINT8, DcmDspDataSize=65535, DcmDspDataUsePort=USE_DATA_ASYNCH_CLIENT_SERVER, DcmDspDataInfoRef=DcmDspDataInfo_Dummy
        DcmDspData_ProgrammingCounterMaxValue (DcmDspData):
          DcmDspDataConditionCheckReadFncUsed = false
          DcmDspDataSize = 16
          DcmDspDataType = UINT8
          DcmDspDataUsePort = USE_DATA_SYNCH_CLIENT_SERVER
          DcmDspDataInfoRef = DcmDspDataInfo_Dummy
        DcmDspRoutine_EthArlTable (DcmDspRoutine):
          DcmDspRoutineIdentifier = 4162
          DcmDspRoutineUsePort = true
          DcmDspRoutineUsed = true
          DcmDspRequestResultsRoutineSupported = false
          DcmDspStopRoutineSupported = false
          DcmDspRoutineFixedLength = false
          DcmDspRoutineInfoRef = DcmDspRoutineInfo_1SGY3D
        DcmDspRoutine_ResetAktivierungsleitung (DcmDspRoutine):
          DcmDspRoutineIdentifier = 4132
          DcmDspRoutineUsePort = true
          DcmDspRoutineUsed = true
          DcmDspRequestResultsRoutineSupported = false
          DcmDspStopRoutineSupported = false
          DcmDspRoutineFixedLength = false
          DcmDspRoutineInfoRef = DcmDspRoutineInfo_4HTyTy
        DcmDspData_SvkAktuell (DcmDspData):
          DcmDspDataConditionCheckReadFncUsed = true
          DcmDspDataType = UINT8
          DcmDspDataUsePort = USE_DATA_ASYNCH_CLIENT_SERVER
          DcmDspDataSize = 872
          DcmDspDataInfoRef = DcmDspData_SvkAktuell_57zZ9W
        DcmDspDidInfo_Systemzeit (DcmDspDidInfo): DcmDspDidDynamicallyDefined=false
          DcmDspDidAccess
            DcmDspDidRead: DcmDspDidReadSessionRef=DcmDspSessionRow_EXTENDED_DIAGNOSTIC_SESSION, DcmDspDidReadSessionRef=DcmDspSessionRow_DEFAULT_SESSION
        DcmDspRoutine_CheckCodingSignature (DcmDspRoutine):
          DcmDspRoutineIdentifier = 3841
          DcmDspRoutineUsePort = true
          DcmDspRoutineUsed = true
          DcmDspRequestResultsRoutineSupported = false
          DcmDspStopRoutineSupported = false
          DcmDspRoutineFixedLength = true
          DcmDspRoutineInfoRef = DcmDspRoutineInfo_w6CZ
        DcmDspData_PiaProfileA_1ZT4D9 (DcmDspDataInfo): DcmDspDataFixedLength=false
        DcmDspDidInfo_StatusDmFssMaster (DcmDspDidInfo): DcmDspDidDynamicallyDefined=false
          DcmDspDidAccess
            DcmDspDidRead: DcmDspDidReadSessionRef=DcmDspSessionRow_DEFAULT_SESSION, DcmDspDidReadSessionRef=DcmDspSessionRow_EXTENDED_DIAGNOSTIC_SESSION
        DcmDspData_PiaProfile2_1ZT4CT (DcmDspDataInfo): DcmDspDataFixedLength=false
        DcmDspDidInfo_ListManipulationApplicationData (DcmDspDidInfo): DcmDspDidDynamicallyDefined=false
          DcmDspDidAccess
            DcmDspDidRead: DcmDspDidReadSessionRef=DcmDspSessionRow_EXTENDED_DIAGNOSTIC_SESSION, DcmDspDidReadSessionRef=DcmDspSessionRow_DEFAULT_SESSION
        DcmDspData_DmIsDtcActiveResponse (DcmDspData):
          DcmDspDataConditionCheckReadFncUsed = true
          DcmDspDataType = UINT8
          DcmDspDataUsePort = USE_DATA_SYNCH_CLIENT_SERVER
          DcmDspDataSize = 1248
          DcmDspDataInfoRef = DcmDspDataInfo_GCft1
        5 x DcmDspDid, all with DcmDspDidUsed=true, DcmDspDidUsePort=USE_DATA_ELEMENT_SPECIFIC_INTERFACES:
          DcmDspDid_ExtendedEnergySavingState: DcmDspDidIdentifier=4110, DcmDspDidInfoRef=DcmDspDidInfo_ExtendedEnergySavingState
            DcmDspDidSignal_ExtendedEnergySavingState (DcmDspDidSignal): DcmDspDidDataPos=0, DcmDspDidDataRef=DcmDspData_ExtendedEnergySavingState
          DcmDspDid_SvkBackup61: DcmDspDidIdentifier=61760, DcmDspDidInfoRef=DcmDspDidInfo_SvkBackup61
            DcmDspDidSignal_SvkBackup61 (DcmDspDidSignal): DcmDspDidDataPos=0, DcmDspDidDataRef=DcmDspData_SvkBackup61
          DcmDspDid_PiaProfile0: DcmDspDidIdentifier=9568, DcmDspDidInfoRef=DcmDspDidInfo_PiaProfile0
            DcmDspDidSignal_PiaProfile0 (DcmDspDidSignal): DcmDspDidDataPos=0, DcmDspDidDataRef=DcmDspData_PiaProfile0
          DcmDspDid_SvkBackup60: DcmDspDidIdentifier=61759, DcmDspDidInfoRef=DcmDspDidInfo_SvkBackup60
            DcmDspDidSignal_SvkBackup60 (DcmDspDidSignal): DcmDspDidDataPos=0, DcmDspDidDataRef=DcmDspData_SvkBackup60
          DcmDspDid_PiaProfile1: DcmDspDidIdentifier=9569, DcmDspDidInfoRef=DcmDspDidInfo_PiaProfile1
            DcmDspDidSignal_PiaProfile1 (DcmDspDidSignal): DcmDspDidDataPos=0, DcmDspDidDataRef=DcmDspData_PiaProfile1
        DcmDspDidInfo_SystemSupplierIdentifier (DcmDspDidInfo): DcmDspDidDynamicallyDefined=false
          DcmDspDidAccess
            DcmDspDidRead: DcmDspDidReadSessionRef=DcmDspSessionRow_EXTENDED_DIAGNOSTIC_SESSION, DcmDspDidReadSessionRef=DcmDspSessionRow_DEFAULT_SESSION
        9 x DcmDspDid, all with DcmDspDidUsed=true, DcmDspDidUsePort=USE_DATA_ELEMENT_SPECIFIC_INTERFACES:
          DcmDspDid_PiaProfile2: DcmDspDidIdentifier=9570, DcmDspDidInfoRef=DcmDspDidInfo_PiaProfile2
            DcmDspDidSignal_PiaProfile2 (DcmDspDidSignal): DcmDspDidDataPos=0, DcmDspDidDataRef=DcmDspData_PiaProfile2
          DcmDspDid_SvkSysSupplier: DcmDspDidIdentifier=61698, DcmDspDidInfoRef=DcmDspDidInfo_SvkSysSupplier
            DcmDspDidSignal_SvkSysSupplier (DcmDspDidSignal): DcmDspDidDataPos=0, DcmDspDidDataRef=DcmDspData_SvkSysSupplier
          DcmDspDid_ActiveDiagnosticSession: DcmDspDidIdentifier=61830, DcmDspDidInfoRef=DcmDspDidInfo_ActiveDiagnosticSession
            DcmDspDidSignal_ActiveDiagnosticSession (DcmDspDidSignal): DcmDspDidDataPos=0, DcmDspDidDataRef=DcmDspData_ActiveDiagnosticSession
          DcmDspDid_PiaProfileA: DcmDspDidIdentifier=9571, DcmDspDidInfoRef=DcmDspDidInfo_PiaProfileA
            DcmDspDidSignal_PiaProfileA (DcmDspDidSignal): DcmDspDidDataPos=0, DcmDspDidDataRef=DcmDspData_PiaProfileA
          DcmDspDid_SvkBackup59: DcmDspDidIdentifier=61758, DcmDspDidInfoRef=DcmDspDidInfo_SvkBackup59
            DcmDspDidSignal_SvkBackup59 (DcmDspDidSignal): DcmDspDidDataPos=0, DcmDspDidDataRef=DcmDspData_SvkBackup59
          DcmDspDid_SvkBackup58: DcmDspDidIdentifier=61757, DcmDspDidInfoRef=DcmDspDidInfo_SvkBackup58
            DcmDspDidSignal_SvkBackup58 (DcmDspDidSignal): DcmDspDidDataPos=0, DcmDspDidDataRef=DcmDspData_SvkBackup58
          DcmDspDid_SvkBackup57: DcmDspDidIdentifier=61756, DcmDspDidInfoRef=DcmDspDidInfo_SvkBackup57
            DcmDspDidSignal_SvkBackup57 (DcmDspDidSignal): DcmDspDidDataPos=0, DcmDspDidDataRef=DcmDspData_SvkBackup57
          DcmDspDid_SvkBackup56: DcmDspDidIdentifier=61755, DcmDspDidInfoRef=DcmDspDidInfo_SvkBackup56
            DcmDspDidSignal_SvkBackup56 (DcmDspDidSignal): DcmDspDidDataPos=0, DcmDspDidDataRef=DcmDspData_SvkBackup56
          DcmDspDid_SvkBackup55: DcmDspDidIdentifier=61754, DcmDspDidInfoRef=DcmDspDidInfo_SvkBackup55
            DcmDspDidSignal_SvkBackup55 (DcmDspDidSignal): DcmDspDidDataPos=0, DcmDspDidDataRef=DcmDspData_SvkBackup55
        DcmDspDidInfo_ListManipulationSecurityArtifact (DcmDspDidInfo): DcmDspDidDynamicallyDefined=false
          DcmDspDidAccess
            DcmDspDidRead: DcmDspDidReadSessionRef=DcmDspSessionRow_DEFAULT_SESSION, DcmDspDidReadSessionRef=DcmDspSessionRow_EXTENDED_DIAGNOSTIC_SESSION
        5 x DcmDspDid, all with DcmDspDidUsed=true, DcmDspDidUsePort=USE_DATA_ELEMENT_SPECIFIC_INTERFACES:
          DcmDspDid_SvkBackup54: DcmDspDidIdentifier=61753, DcmDspDidInfoRef=DcmDspDidInfo_SvkBackup54
            DcmDspDidSignal_SvkBackup54 (DcmDspDidSignal): DcmDspDidDataPos=0, DcmDspDidDataRef=DcmDspData_SvkBackup54
          DcmDspDid_SvkBackup53: DcmDspDidIdentifier=61752, DcmDspDidInfoRef=DcmDspDidInfo_SvkBackup53
            DcmDspDidSignal_SvkBackup53 (DcmDspDidSignal): DcmDspDidDataPos=0, DcmDspDidDataRef=DcmDspData_SvkBackup53
          DcmDspDid_SvkBackup52: DcmDspDidIdentifier=61751, DcmDspDidInfoRef=DcmDspDidInfo_SvkBackup52
            DcmDspDidSignal_SvkBackup52 (DcmDspDidSignal): DcmDspDidDataPos=0, DcmDspDidDataRef=DcmDspData_SvkBackup52
          DcmDspDid_SvkBackup51: DcmDspDidIdentifier=61750, DcmDspDidInfoRef=DcmDspDidInfo_SvkBackup51
            DcmDspDidSignal_SvkBackup51 (DcmDspDidSignal): DcmDspDidDataPos=0, DcmDspDidDataRef=DcmDspData_SvkBackup51
          DcmDspDid_SvkBackup50: DcmDspDidIdentifier=61749, DcmDspDidInfoRef=DcmDspDidInfo_SvkBackup50
            DcmDspDidSignal_SvkBackup50 (DcmDspDidSignal): DcmDspDidDataPos=0, DcmDspDidDataRef=DcmDspData_SvkBackup50
        DcmDspRoutineInfo_2X67zg (DcmDspRoutineInfo)
          DcmDspRoutineAuthorization: DcmDspRoutineSessionRef=DcmDspSessionRow_CODING_SESSION
        DcmDspData_SgbdIdx (DcmDspData):
          DcmDspDataConditionCheckReadFncUsed = false
          DcmDspDataSize = 24
          DcmDspDataType = UINT8
          DcmDspDataUsePort = USE_DATA_SYNCH_CLIENT_SERVER
          DcmDspDataInfoRef = DcmDspDataInfo_Dummy
        DcmDspRoutineInfo_pCCkH (DcmDspRoutineInfo)
          DcmDspRoutineAuthorization: DcmDspRoutineSessionRef=DcmDspSessionRow_DEFAULT_SESSION, DcmDspRoutineSessionRef=DcmDspSessionRow_EXTENDED_DIAGNOSTIC_SESSION
          DcmDspStartRoutineOut_START_GetActualConfig (DcmDspStartRoutineOut)
            DcmDspStartRoutineOutSignal_EcuAddress (DcmDspStartRoutineOutSignal): DcmDspRoutineSignalLength=8, DcmDspRoutineSignalPos=8, DcmDspRoutineSignalType=UINT8
            DcmDspStartRoutineOutSignal_StatIdsWert (DcmDspStartRoutineOutSignal): DcmDspRoutineSignalLength=8, DcmDspRoutineSignalPos=0, DcmDspRoutineSignalType=UINT8
        DcmDspRoutine_FsN5034_1Tzr0B (DcmDspRoutineInfo)
          RESULT_FsN5034_OUT (DcmDspRoutineRequestResOut)
            DcmDspRequestRoutineResultsOutSignal_Result2 (DcmDspRoutineRequestResOutSignal): DcmDspRoutineSignalLength=8, DcmDspRoutineSignalPos=8, DcmDspRoutineSignalType=UINT8
            DcmDspRequestRoutineResultsOutSignal_Result1 (DcmDspRoutineRequestResOutSignal): DcmDspRoutineSignalLength=8, DcmDspRoutineSignalPos=0, DcmDspRoutineSignalType=UINT8
          DcmDspRoutineAuthorization: DcmDspRoutineSessionRef=DcmDspSessionRow_DEFAULT_SESSION, DcmDspRoutineSessionRef=DcmDspSessionRow_EXTENDED_DIAGNOSTIC_SESSION
          DcmDspStartRoutineIn_START_FsN5034 (DcmDspStartRoutineIn)
            DcmDspStartRoutineInSignal_Data (DcmDspStartRoutineInSignal): DcmDspRoutineSignalLength=792, DcmDspRoutineSignalPos=0, DcmDspRoutineSignalType=VARIABLE_LENGTH
          DcmDspStartRoutineOut_START_FsN5034 (DcmDspStartRoutineOut)
            DcmDspStartRoutineOutSignal_Result1 (DcmDspStartRoutineOutSignal): DcmDspRoutineSignalLength=8, DcmDspRoutineSignalPos=0, DcmDspRoutineSignalType=UINT8
            DcmDspStartRoutineOutSignal_Result2 (DcmDspStartRoutineOutSignal): DcmDspRoutineSignalLength=8, DcmDspRoutineSignalPos=8, DcmDspRoutineSignalType=UINT8
        DcmDspDid_ProgrammingCounter (DcmDspDid):
          DcmDspDidIdentifier = 9474
          DcmDspDidUsed = true
          DcmDspDidUsePort = USE_DATA_ELEMENT_SPECIFIC_INTERFACES
          DcmDspDidInfoRef = DcmDspDidInfo_ProgrammingCounter
          DcmDspDidSignal_ProgrammingCounter (DcmDspDidSignal): DcmDspDidDataPos=0, DcmDspDidDataRef=DcmDspData_ProgrammingCounter
        DcmDspDid_Systemzeit (DcmDspDid): DcmDspDidIdentifier=5889, DcmDspDidUsed=true, DcmDspDidUsePort=USE_DATA_ELEMENT_SPECIFIC_INTERFACES, DcmDspDidInfoRef=DcmDspDidInfo_Systemzeit
          DcmDspDidSignal_Systemzeit (DcmDspDidSignal): DcmDspDidDataPos=0, DcmDspDidDataRef=DcmDspData_Systemzeit
        DcmDspRoutine_ActivateZgwApplicationmode (DcmDspRoutine):
          DcmDspRoutineIdentifier = 4111
          DcmDspRoutineUsePort = true
          DcmDspRoutineUsed = true
          DcmDspRequestResultsRoutineSupported = false
          DcmDspStopRoutineSupported = false
          DcmDspRoutineFixedLength = false
          DcmDspRoutineInfoRef = DcmDspRoutineInfo_4v65x9
        10 x DcmDspDid, all with DcmDspDidUsed=true, DcmDspDidUsePort=USE_DATA_ELEMENT_SPECIFIC_INTERFACES:
          DcmDspDid_SvkBackup49: DcmDspDidIdentifier=61748, DcmDspDidInfoRef=DcmDspDidInfo_SvkBackup49
            DcmDspDidSignal_SvkBackup49 (DcmDspDidSignal): DcmDspDidDataPos=0, DcmDspDidDataRef=DcmDspData_SvkBackup49
          DcmDspDid_SvkBackup48: DcmDspDidIdentifier=61747, DcmDspDidInfoRef=DcmDspDidInfo_SvkBackup48
            DcmDspDidSignal_SvkBackup48 (DcmDspDidSignal): DcmDspDidDataPos=0, DcmDspDidDataRef=DcmDspData_SvkBackup48
          DcmDspDid_SvkBackup47: DcmDspDidIdentifier=61746, DcmDspDidInfoRef=DcmDspDidInfo_SvkBackup47
            DcmDspDidSignal_SvkBackup47 (DcmDspDidSignal): DcmDspDidDataPos=0, DcmDspDidDataRef=DcmDspData_SvkBackup47
          DcmDspDid_SvkBackup46: DcmDspDidIdentifier=61745, DcmDspDidInfoRef=DcmDspDidInfo_SvkBackup46
            DcmDspDidSignal_SvkBackup46 (DcmDspDidSignal): DcmDspDidDataPos=0, DcmDspDidDataRef=DcmDspData_SvkBackup46
          DcmDspDid_SvkBackup45: DcmDspDidIdentifier=61744, DcmDspDidInfoRef=DcmDspDidInfo_SvkBackup45
            DcmDspDidSignal_SvkBackup45 (DcmDspDidSignal): DcmDspDidDataPos=0, DcmDspDidDataRef=DcmDspData_SvkBackup45
          DcmDspDid_SvkBackup44: DcmDspDidIdentifier=61743, DcmDspDidInfoRef=DcmDspDidInfo_SvkBackup44
            DcmDspDidSignal_SvkBackup44 (DcmDspDidSignal): DcmDspDidDataPos=0, DcmDspDidDataRef=DcmDspData_SvkBackup44
          DcmDspDid_SvkBackup43: DcmDspDidIdentifier=61742, DcmDspDidInfoRef=DcmDspDidInfo_SvkBackup43
            DcmDspDidSignal_SvkBackup43 (DcmDspDidSignal): DcmDspDidDataPos=0, DcmDspDidDataRef=DcmDspData_SvkBackup43
          DcmDspDid_SvkBackup42: DcmDspDidIdentifier=61741, DcmDspDidInfoRef=DcmDspDidInfo_SvkBackup42
            DcmDspDidSignal_SvkBackup42 (DcmDspDidSignal): DcmDspDidDataPos=0, DcmDspDidDataRef=DcmDspData_SvkBackup42
          DcmDspDid_SvkBackup41: DcmDspDidIdentifier=61740, DcmDspDidInfoRef=DcmDspDidInfo_SvkBackup41
            DcmDspDidSignal_SvkBackup41 (DcmDspDidSignal): DcmDspDidDataPos=0, DcmDspDidDataRef=DcmDspData_SvkBackup41
          DcmDspDid_SvkBackup40: DcmDspDidIdentifier=61739, DcmDspDidInfoRef=DcmDspDidInfo_SvkBackup40
            DcmDspDidSignal_SvkBackup40 (DcmDspDidSignal): DcmDspDidDataPos=0, DcmDspDidDataRef=DcmDspData_SvkBackup40
        DcmDspRoutineInfo_w6CZ (DcmDspRoutineInfo)
          DcmDspStartRoutineOut_START_CheckCodingSignature (DcmDspStartRoutineOut)
            DcmDspStartRoutineOutSignal_DataOutX (DcmDspStartRoutineOutSignal): DcmDspRoutineSignalLength=8, DcmDspRoutineSignalPos=0, DcmDspRoutineSignalType=UINT8
          DcmDspRoutineAuthorization: DcmDspRoutineSecurityLevelRef=DcmDspSecurityRow_Coding, DcmDspRoutineSessionRef=DcmDspSessionRow_CODING_SESSION
        DcmDspRoutine_IsLoeschen_26SwJG (DcmDspRoutineInfo)
          DcmDspRoutineAuthorization: DcmDspRoutineSessionRef=DcmDspSessionRow_DEFAULT_SESSION, DcmDspRoutineSessionRef=DcmDspSessionRow_EXTENDED_DIAGNOSTIC_SESSION
        DcmDspRoe:
          DcmDspRoeInitOnDSC = false
          DcmDspRoeInterMessageTime = 0
          DcmDspRoeMaxNumberOfRetry = 0
          DcmDspRoeQueueEnabled = false
          DcmDspRoeBlockIdRef = NVM_BLOCK_DCM_ROE
          DcmDspRoeEvent: DcmDspRoeEventId=0
          DcmDspRoeEventWindowTime: DcmDspRoeEventWindowTime=DCM_ROE_EVENT_WINDOW_INFINITE, DcmDspRoeStorageState=true
        DcmDspDataInfo_Dummy (DcmDspDataInfo): DcmDspDataFixedLength=true
        DidInfo_DID_StartApplication (DcmDspDidInfo)
          DcmDspDidAccess
            DcmDspDidRead
            DcmDspDidWrite
        DataInfo_DID_StartApplication (DcmDspDataInfo): DcmDspDataFixedLength=true
        Data_DID_StartApplication (DcmDspData): DcmDspDataSize=16, DcmDspDataUsePort=USE_DATA_SYNCH_CLIENT_SERVER, DcmDspDataType=UINT16, DcmDspDataInfoRef=DataInfo_DID_StartApplication
        DcmDspComControl
          DcmDspComControlAllChannel: DcmDspAllComMChannelRef=A_FlexRay_5b5a9ac2
        DcmDspMemory: DcmDspUseMemoryId=false
          DcmDspMemoryIdInfo
            DcmDspReadMemoryRangeInfo: DcmDspReadMemoryRangeHigh=4026531968, DcmDspReadMemoryRangeLow=4026531840
            DcmDspWriteMemoryRangeInfo: DcmDspWriteMemoryRangeHigh=4026531968, DcmDspWriteMemoryRangeLow=4026531840
        DcmDspDataInfo_SensorenAnzahlLesen (DcmDspDataInfo): DcmDspDataFixedLength=true
        DID_DcmDspDid_SensorLesen_1 (DcmDspDid):
          DcmDspDidIdentifier = 5633
          DcmDspDidUsed = true
          DcmDspDidUsePort = USE_DATA_ELEMENT_SPECIFIC_INTERFACES
          DcmDspDidInfoRef = DidInfo_DcmDspDid_SensorLesen_1
          DcmDspDidSignal: DcmDspDidDataPos=0, DcmDspDidDataRef=Data_DcmDspDid_SensorLesen_1
        DidInfo_DcmDspDid_SensorLesen_1 (DcmDspDidInfo)
          DcmDspDidAccess
            DcmDspDidRead: DcmDspDidReadSessionRef=DcmDspSessionRow_DEFAULT_SESSION, DcmDspDidReadSessionRef=DcmDspSessionRow_EXTENDED_DIAGNOSTIC_SESSION
        Data_DcmDspDid_SensorLesen_1 (DcmDspData): DcmDspDataSize=64, DcmDspDataUsePort=USE_DATA_ASYNCH_CLIENT_SERVER, DcmDspDataType=UINT8_N, DcmDspDataInfoRef=DataInfo_DcmDspDid_SensorLesen_1
        DataInfo_DcmDspDid_SensorLesen_1 (DcmDspDataInfo): DcmDspDataFixedLength=true
        DID_DcmDspDid_SensorLesen_2 (DcmDspDid):
          DcmDspDidIdentifier = 5634
          DcmDspDidUsed = true
          DcmDspDidUsePort = USE_DATA_ELEMENT_SPECIFIC_INTERFACES
          DcmDspDidInfoRef = DidInfo_DcmDspDid_SensorLesen_2
          DcmDspDidSignal: DcmDspDidDataPos=0, DcmDspDidDataRef=Data_DcmDspDid_SensorLesen_2
        DidInfo_DcmDspDid_SensorLesen_2 (DcmDspDidInfo)
          DcmDspDidAccess
            DcmDspDidRead: DcmDspDidReadSessionRef=DcmDspSessionRow_DEFAULT_SESSION, DcmDspDidReadSessionRef=DcmDspSessionRow_EXTENDED_DIAGNOSTIC_SESSION
        Data_DcmDspDid_SensorLesen_2 (DcmDspData): DcmDspDataSize=64, DcmDspDataUsePort=USE_DATA_ASYNCH_CLIENT_SERVER, DcmDspDataType=UINT8_N, DcmDspDataInfoRef=DataInfo_DcmDspDid_SensorLesen_2
        DataInfo_DcmDspDid_SensorLesen_2 (DcmDspDataInfo): DcmDspDataFixedLength=true
        DID_DcmDspDid_SensorLesen_3 (DcmDspDid):
          DcmDspDidIdentifier = 5635
          DcmDspDidUsed = true
          DcmDspDidUsePort = USE_DATA_ELEMENT_SPECIFIC_INTERFACES
          DcmDspDidInfoRef = DidInfo_DcmDspDid_SensorLesen_3
          DcmDspDidSignal: DcmDspDidDataPos=0, DcmDspDidDataRef=Data_DcmDspDid_SensorLesen_3
        DidInfo_DcmDspDid_SensorLesen_3 (DcmDspDidInfo)
          DcmDspDidAccess
            DcmDspDidRead: DcmDspDidReadSessionRef=DcmDspSessionRow_DEFAULT_SESSION, DcmDspDidReadSessionRef=DcmDspSessionRow_EXTENDED_DIAGNOSTIC_SESSION
        Data_DcmDspDid_SensorLesen_3 (DcmDspData): DcmDspDataSize=64, DcmDspDataUsePort=USE_DATA_ASYNCH_CLIENT_SERVER, DcmDspDataType=UINT8_N, DcmDspDataInfoRef=DataInfo_DcmDspDid_SensorLesen_3
        DataInfo_DcmDspDid_SensorLesen_3 (DcmDspDataInfo): DcmDspDataFixedLength=true
      DcmGeneral:
        DcmRequestManufacturerNotificationEnabled = true
        DcmDspDataDefaultEndianness = BIG_ENDIAN
        DcmRespondAllRequest = false
        DcmDevErrorDetect = true
        DcmRequestSupplierNotificationEnabled = false
        DcmTaskTime = 0.005
        DcmVersionInfoApi = true
        DcmSupportedIDCalculationSuppressionEnabled = false
        DcmDtrDataProvisionViaDemEnabled = true
        DcmForeignDiagnosticRequestDetectionEnabled = false
        DcmSuppressResponseOnCanTpFuncMixedAddrRequests = false
        DcmResetToFblAfterSessionFinalResposeEnabled = true
        DcmSplitTasksEnabled = false
        DcmMainFunctionWorkerTaskTime = 0.001
        DcmDemApiVersion = DCM_DEM_API_4_03_00
        DcmSafeBswChecks = true
      DcmPageBufferCfg: DcmPagedBufferEnabled=false
