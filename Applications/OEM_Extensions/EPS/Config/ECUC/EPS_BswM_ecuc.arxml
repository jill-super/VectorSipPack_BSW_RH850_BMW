AUTOSAR XML (schema 4-3-0)
package /ActiveEcuC
  module config BswM: implementation-config-variant=VARIANT-PRE-COMPILE, module-description=BswM_Impl
    BswMConfig
      BswMModeControl: BswMInitActionListRef=INIT_AL_Initialize
        A_IndicateCodingReset (BswMAction)
          BswMAvailableActions
            BswMUserCallout:
              BswMUserCalloutFunction = EcuM_SelectShutdownCause(EcuMConf_EcuMShutdownCause_ECUM_CAUSE_CODING)
              BswMCreateCallout = false
              BswMUserIncludeFile = Appl_Main.h
        AL_CodingResetExecution (BswMActionList): BswMActionListExecution=BSWM_TRIGGER
          A_IndicateCodingReset (BswMActionListItem): BswMAbortOnFail=false, BswMActionListItemIndex=0, BswMActionListItemRef=BswMModeControl/A_IndicateCodingReset
          AL_ResetExecution (BswMActionListItem): BswMAbortOnFail=false, BswMActionListItemIndex=1, BswMActionListItemRef=BswMModeControl/AL_ResetExecution
        12 x BswMAction:
          INIT_Action_NvMReadAll
            BswMAvailableActions
              BswMUserCallout: BswMUserCalloutFunction=BswM_INIT_NvMReadAll(), BswMCreateCallout=true
          INIT_Action_Fr_Init
            BswMAvailableActions
              BswMUserCallout: BswMUserCalloutFunction=Fr_Init(&Fr_Config), BswMCreateCallout=false, BswMUserIncludeFile=Fr.h
          INIT_Action_FrIf_Init
            BswMAvailableActions
              BswMUserCallout: BswMUserCalloutFunction=FrIf_Init(&FrIf_Config), BswMCreateCallout=false, BswMUserIncludeFile=FrIf.h
          INIT_Action_FrSM_Init
            BswMAvailableActions
              BswMUserCallout: BswMUserCalloutFunction=FrSM_Init(FrSM_Config_Ptr), BswMCreateCallout=false, BswMUserIncludeFile=FrSM.h
          INIT_Action_PduR_Init
            BswMAvailableActions
              BswMUserCallout: BswMUserCalloutFunction=PduR_Init(PduR_Config_Ptr), BswMCreateCallout=false, BswMUserIncludeFile=PduR.h
          INIT_Action_Com_Init
            BswMAvailableActions
              BswMUserCallout: BswMUserCalloutFunction=Com_Init(Com_Config_Ptr), BswMCreateCallout=false, BswMUserIncludeFile=Com.h
          INIT_Action_IpduM_Init
            BswMAvailableActions
              BswMUserCallout: BswMUserCalloutFunction=IpduM_Init(IpduM_Config_Ptr), BswMCreateCallout=false, BswMUserIncludeFile=IpduM.h
          INIT_Action_ComM_Init
            BswMAvailableActions
              BswMUserCallout: BswMUserCalloutFunction=ComM_Init(), BswMCreateCallout=false, BswMUserIncludeFile=ComM.h
          INIT_Action_Dem_Init
            BswMAvailableActions
              BswMUserCallout: BswMUserCalloutFunction=Dem_Init(Dem_Config_Ptr), BswMCreateCallout=false, BswMUserIncludeFile=Dem.h
          INIT_Action_RteStart
            BswMAvailableActions
              BswMUserCallout: BswMUserCalloutFunction=(void)Rte_Start(), BswMCreateCallout=false, BswMUserIncludeFile=Rte_Main.h
          A_USR_ComM_FullCom
            BswMAvailableActions
              BswMUserCallout: BswMUserCalloutFunction=checkNeedForCommunication(), BswMCreateCallout=false, BswMUserIncludeFile=BswM_UserCallouts.h, BswMUserCode=
          A_USR_Fr_AllowCom
            BswMAvailableActions
              BswMComMAllowCom: BswMComAllowed=true, BswMComMAllowChannelRef=A_FlexRay_5b5a9ac2
        5 x BswMActionList, all with BswMActionListExecution=BSWM_TRIGGER:
          AL_Rule_Dlog_Init_True
            A_RteRequest_DLOG_INITIALIZED_Via_MRP_Dlog (BswMActionListItem): BswMAbortOnFail=false, BswMActionListItemIndex=0, BswMActionListItemRef=BswMModeControl/A_RteRequest_DLOG_INITIALIZED_Via_MRP_Dlog
          AL_Rule_Dlog_Run_True
            A_RteRequest_DLOG_RUNNING_Via_MRP_Dlog (BswMActionListItem): BswMAbortOnFail=false, BswMActionListItemIndex=0, BswMActionListItemRef=BswMModeControl/A_RteRequest_DLOG_RUNNING_Via_MRP_Dlog
          AL_Rule_Start_Omc_Init_when_Darh_Run_True
            A_RteRequest_OMC_INITIALIZED_Via_MRP_Omc (BswMActionListItem): BswMAbortOnFail=false, BswMActionListItemIndex=0, BswMActionListItemRef=BswMModeControl/A_RteRequest_OMC_INITIALIZED_Via_MRP_Omc
          AL_Rule_Start_StdDiag_Init_when_Omc_Run_True
            A_RteRequest_STDDIAG_INITIALIZED_Via_MRP_StdDiag (BswMActionListItem): BswMAbortOnFail=false, BswMActionListItemIndex=0, BswMActionListItemRef=BswMModeControl/A_RteRequest_STDDIAG_INITIALIZED_Via_MRP_StdDiag
          AL_RuleDarh_Init_to_Run_True
            A_RteRequest_DARH_RUNNING_Via_MRP_Darh (BswMActionListItem): BswMAbortOnFail=false, BswMActionListItemIndex=0, BswMActionListItemRef=BswMModeControl/A_RteRequest_DARH_RUNNING_Via_MRP_Darh
        MSRP_Systime (BswMRteModeRequestPort): BswMRteModeInitValue=SYSTIME_STOPPED, BswMRteModeRequestPortInterfaceRef=SysTime.LifeCycle.requestMode
        4 x BswMActionList, all with BswMActionListExecution=BSWM_TRIGGER:
          AL_Rule_Start_Omc_Run_when_Omc_Init_True
            A_RteRequest_OMC_RUNNING_Via_MRP_Omc (BswMActionListItem): BswMAbortOnFail=false, BswMActionListItemIndex=0, BswMActionListItemRef=BswMModeControl/A_RteRequest_OMC_RUNNING_Via_MRP_Omc
          AL_Rule_Start_StdDiag_Run_when_StdDiag_Init_True
            A_RteRequest_STDDIAG_RUNNING_Via_MRP_StdDiag (BswMActionListItem): BswMAbortOnFail=false, BswMActionListItemIndex=0, BswMActionListItemRef=BswMModeControl/A_RteRequest_STDDIAG_RUNNING_Via_MRP_StdDiag
          AL_Rule_Start_Systime_Run_when_Systime_Init_True
            A_RteRequest_SYSTIME_RUNNING_Via_MRP_Systime (BswMActionListItem): BswMAbortOnFail=false, BswMActionListItemIndex=0, BswMActionListItemRef=BswMModeControl/A_RteRequest_SYSTIME_RUNNING_Via_MRP_Systime
          AL_ResetExecution
            3 x BswMActionListItem, all with BswMAbortOnFail=false:
              A_IntegrationSample_DisableDiagnostic: BswMActionListItemIndex=0, BswMActionListItemRef=BswMModeControl/A_IntegrationSample_DisableDiagnostic
              A_InitiateReset: BswMActionListItemIndex=1, BswMActionListItemRef=BswMModeControl/A_InitiateReset
              A_StartSimpleTimer0: BswMActionListItemIndex=2, BswMActionListItemRef=BswMModeControl/A_StartSimpleTimer0
        A_IntegrationSample_DisableDiagnostic (BswMAction)
          BswMAvailableActions
            BswMUserCallout: BswMUserCalloutFunction=IntegrationSample_DisableDiagnostic(), BswMCreateCallout=false, BswMUserIncludeFile=IntegrationSample_Prototype.h
        A_InitiateReset (BswMAction)
          BswMAvailableActions
            BswMUserCallout: BswMUserCalloutFunction=Dcm_BAC4_EcuReset_Execute(), BswMCreateCallout=false, BswMUserIncludeFile=Appl_Main.h
        4 x BswMRteModeRequestPort:
          MSRP_Dlog: BswMRteModeInitValue=DLOG_STOPPED, BswMRteModeRequestPortInterfaceRef=Dlog.LifeCycle.requestMode
          MSRP_Darh: BswMRteModeInitValue=DARH_STOPPED, BswMRteModeRequestPortInterfaceRef=Darh.LifeCycle.requestMode
          MSRP_StdDiag: BswMRteModeInitValue=STDDIAG_STOPPED, BswMRteModeRequestPortInterfaceRef=StdDiag_Swc.LifeCycle.requestMode
          MSRP_Omc: BswMRteModeInitValue=OMC_STOPPED, BswMRteModeRequestPortInterfaceRef=Omc.LifeCycle.requestMode
        10 x BswMAction:
          A_RteRequest_DLOG_INITIALIZED_Via_MRP_Dlog
            BswMAvailableActions
              BswMRteModeRequest: BswMRequestedMode=DLOG_INITIALIZED, BswMRteModeRequestPortRef=MSRP_Dlog
          A_RteRequest_DLOG_RUNNING_Via_MRP_Dlog
            BswMAvailableActions
              BswMRteModeRequest: BswMRequestedMode=DLOG_RUNNING, BswMRteModeRequestPortRef=MSRP_Dlog
          A_RteRequest_SYSTIME_INITIALIZED_Via_MRP_Systime
            BswMAvailableActions
              BswMRteModeRequest: BswMRequestedMode=SYSTIME_INITIALIZED, BswMRteModeRequestPortRef=MSRP_Systime
          A_RteRequest_SYSTIME_RUNNING_Via_MRP_Systime
            BswMAvailableActions
              BswMRteModeRequest: BswMRequestedMode=SYSTIME_RUNNING, BswMRteModeRequestPortRef=MSRP_Systime
          A_RteRequest_DARH_INITIALIZED_Via_MRP_Darh
            BswMAvailableActions
              BswMRteModeRequest: BswMRequestedMode=DARH_INITIALIZED, BswMRteModeRequestPortRef=MSRP_Darh
          A_RteRequest_DARH_RUNNING_Via_MRP_Darh
            BswMAvailableActions
              BswMRteModeRequest: BswMRequestedMode=DARH_RUNNING, BswMRteModeRequestPortRef=MSRP_Darh
          A_RteRequest_STDDIAG_INITIALIZED_Via_MRP_StdDiag
            BswMAvailableActions
              BswMRteModeRequest: BswMRequestedMode=STDDIAG_INITIALIZED, BswMRteModeRequestPortRef=MSRP_StdDiag
          A_RteRequest_STDDIAG_RUNNING_Via_MRP_StdDiag
            BswMAvailableActions
              BswMRteModeRequest: BswMRequestedMode=STDDIAG_RUNNING, BswMRteModeRequestPortRef=MSRP_StdDiag
          A_RteRequest_OMC_INITIALIZED_Via_MRP_Omc
            BswMAvailableActions
              BswMRteModeRequest: BswMRequestedMode=OMC_INITIALIZED, BswMRteModeRequestPortRef=MSRP_Omc
          A_RteRequest_OMC_RUNNING_Via_MRP_Omc
            BswMAvailableActions
              BswMRteModeRequest: BswMRequestedMode=OMC_RUNNING, BswMRteModeRequestPortRef=MSRP_Omc
        MSRP_IntegrationSample_EcuRunMode (BswMRteModeRequestPort):
          BswMRteModeInitValue = IntegrationSample_BSW_START
          BswMRteModeRequestPortInterfaceRef = IntegrationSample.EcuRunStateRequest.IntegrationSample_EcuRunStateRequestMode
        A_RteRequest_IntegrationSample_STARTUP_Via_MSRP_IntegrationSample_EcuRunMode (BswMAction)
          BswMAvailableActions
            BswMRteModeRequest: BswMRequestedMode=IntegrationSample_STARTUP, BswMRteModeRequestPortRef=MSRP_IntegrationSample_EcuRunMode
        AL_Rule_Systime_Init_True (BswMActionList): BswMActionListExecution=BSWM_TRIGGER
          A_RteRequest_SYSTIME_INITIALIZED_Via_MRP_Systime (BswMActionListItem): BswMAbortOnFail=false, BswMActionListItemIndex=0, BswMActionListItemRef=BswMModeControl/A_RteRequest_SYSTIME_INITIALIZED_Via_MRP_Systime
        AL_Rule_Darh_Init_True (BswMActionList): BswMActionListExecution=BSWM_TRIGGER
          A_RteRequest_DARH_INITIALIZED_Via_MRP_Darh (BswMActionListItem): BswMAbortOnFail=false, BswMActionListItemIndex=0, BswMActionListItemRef=BswMModeControl/A_RteRequest_DARH_INITIALIZED_Via_MRP_Darh
        A_RteRequest_IntegrationSample_NORMAL_OPERATION_Via_MSRP_IntegrationSample_EcuRunMode (BswMAction)
          BswMAvailableActions
            BswMRteModeRequest: BswMRequestedMode=IntegrationSample_NORMAL_OPERATION, BswMRteModeRequestPortRef=MSRP_IntegrationSample_EcuRunMode
        INIT_Action_Dem_StartOpCycle (BswMAction)
          BswMAvailableActions
            BswMUserCallout:
              BswMUserCalloutFunction = Dem_SetOperationCycleState(DemConf_DemOperationCycle_NON_OBD,DEM_CYCLE_STATE_START)
              BswMCreateCallout = false
              BswMUserIncludeFile = Dem.h
        SwitchPort_Darh_ReportErrorMode (BswMSwitchPort): BswMModeSwitchInterfaceRef=DarhReportErrorModeInterface
        A_Set_Darh_ERROR_ACTIVE (BswMAction)
          BswMAvailableActions
            BswMRteSwitch: BswMSwitchedMode=DARH_REPORT_ERROR_ACTIVE, BswMRteSwitchPortRef=SwitchPort_Darh_ReportErrorMode
        AL_ComM_Channel_is_FULL_COM (BswMActionList): BswMActionListExecution=BSWM_TRIGGER
          A_RteSwitch_Stm_SwitchPort_EM_LOCK_To_EM_LOCK_RECEIVABLE (BswMActionListItem): BswMAbortOnFail=false, BswMActionListItemIndex=0, BswMActionListItemRef=BswMModeControl/A_RteSwitch_Stm_SwitchPort_EM_LOCK_To_EM_LOCK_RECEIVABLE
        SwitchPort_Stm_SwitchPort_EM_LOCK (BswMSwitchPort): BswMModeSwitchInterfaceRef=EMLockSignalReceptionModeInterface
        A_RteSwitch_Stm_SwitchPort_EM_LOCK_To_EM_LOCK_RECEIVABLE (BswMAction)
          BswMAvailableActions
            BswMRteSwitch: BswMSwitchedMode=EM_LOCK_RECEIVABLE, BswMRteSwitchPortRef=SwitchPort_Stm_SwitchPort_EM_LOCK
        A_RteSwitch_Stm_SwitchPort_EM_LOCK_To_EM_LOCK_NOT_RECEIVABLE (BswMAction)
          BswMAvailableActions
            BswMRteSwitch: BswMSwitchedMode=EM_LOCK_NOT_RECEIVABLE, BswMRteSwitchPortRef=SwitchPort_Stm_SwitchPort_EM_LOCK
        AL_ComM_Channel_is_SILENT_COMMUNICATION_BswMActionList_True (BswMActionList): BswMActionListExecution=BSWM_TRIGGER
          A_RteSwitch_Stm_SwitchPort_EM_LOCK_To_EM_LOCK_NOT_RECEIVABLE (BswMActionListItem):
            BswMAbortOnFail = false
            BswMActionListItemIndex = 0
            BswMActionListItemRef = BswMModeControl/A_RteSwitch_Stm_SwitchPort_EM_LOCK_To_EM_LOCK_NOT_RECEIVABLE
        A_Set_Darh_ERROR_INACTIVE (BswMAction)
          BswMAvailableActions
            BswMRteSwitch: BswMSwitchedMode=DARH_REPORT_ERROR_INACTIVE, BswMRteSwitchPortRef=SwitchPort_Darh_ReportErrorMode
        3 x BswMActionList:
          AL_Set_DarhReportError_due_ComM_and_CEL_mode_BswMActionList_True: BswMActionListExecution=BSWM_TRIGGER
            A_Set_Darh_ERROR_ACTIVE (BswMActionListItem): BswMAbortOnFail=false, BswMActionListItemIndex=0, BswMActionListItemRef=BswMModeControl/A_Set_Darh_ERROR_ACTIVE
          AL_Set_DarhReportError_due_ComM_and_CEL_mode_BswMActionList_False: BswMActionListExecution=BSWM_TRIGGER
            A_Set_Darh_ERROR_INACTIVE (BswMActionListItem): BswMAbortOnFail=false, BswMActionListItemIndex=0, BswMActionListItemRef=BswMModeControl/A_Set_Darh_ERROR_INACTIVE
          INIT_AL_Initialize: BswMActionListExecution=BSWM_CONDITION
            25 x BswMActionListItem, all with BswMAbortOnFail=false:
              INIT_Action_NvMReadAll: BswMActionListItemIndex=15, BswMActionListItemRef=BswMModeControl/INIT_Action_NvMReadAll
              INIT_Action_Fr_Init: BswMActionListItemIndex=2, BswMActionListItemRef=BswMModeControl/INIT_Action_Fr_Init
              INIT_Action_FrIf_Init: BswMActionListItemIndex=5, BswMActionListItemRef=BswMModeControl/INIT_Action_FrIf_Init
              INIT_Action_FrSM_Init: BswMActionListItemIndex=10, BswMActionListItemRef=BswMModeControl/INIT_Action_FrSM_Init
              INIT_Action_PduR_Init: BswMActionListItemIndex=9, BswMActionListItemRef=BswMModeControl/INIT_Action_PduR_Init
              INIT_Action_Com_Init: BswMActionListItemIndex=7, BswMActionListItemRef=BswMModeControl/INIT_Action_Com_Init
              INIT_Action_IpduM_Init: BswMActionListItemIndex=8, BswMActionListItemRef=BswMModeControl/INIT_Action_IpduM_Init
              INIT_Action_ComM_Init: BswMActionListItemIndex=16, BswMActionListItemRef=BswMModeControl/INIT_Action_ComM_Init
              INIT_Action_Dem_Init: BswMActionListItemIndex=22, BswMActionListItemRef=BswMModeControl/INIT_Action_Dem_Init
              INIT_Action_RteStart: BswMActionListItemIndex=24, BswMActionListItemRef=BswMModeControl/INIT_Action_RteStart
              INIT_Action_Dem_StartOpCycle: BswMActionListItemIndex=23, BswMActionListItemRef=BswMModeControl/INIT_Action_Dem_StartOpCycle
              A_RteRequest_IntegrationSample_STARTUP_Via_MSRP_IntegrationSample_EcuRunMode: BswMActionListItemIndex=3, BswMActionListItemRef=BswMModeControl/A_RteRequest_IntegrationSample_STARTUP_Via_MSRP_IntegrationSample_EcuRunMode
              A_USR_Fr_AllowCom: BswMActionListItemIndex=18, BswMActionListItemRef=BswMModeControl/A_USR_Fr_AllowCom
              A_USR_ComM_FullCom: BswMActionListItemIndex=19, BswMActionListItemRef=BswMModeControl/A_USR_ComM_FullCom
              INIT_Action_Det_Init: BswMActionListItemIndex=1, BswMActionListItemRef=BswMModeControl/INIT_Action_Det_Init
              INIT_Action_Fee_30_SmallSector_Init: BswMActionListItemIndex=4, BswMActionListItemRef=BswMModeControl/INIT_Action_Fee_30_SmallSector_Init
              INIT_Action_WdgM_Init: BswMActionListItemIndex=6, BswMActionListItemRef=BswMModeControl/INIT_Action_WdgM_Init
              INIT_Action_FrTp_Init: BswMActionListItemIndex=11, BswMActionListItemRef=BswMModeControl/INIT_Action_FrTp_Init
              INIT_Action_FrXcp_Init: BswMActionListItemIndex=12, BswMActionListItemRef=BswMModeControl/INIT_Action_FrXcp_Init
              INIT_Action_Xcp_Init: BswMActionListItemIndex=13, BswMActionListItemRef=BswMModeControl/INIT_Action_Xcp_Init
              INIT_Action_NvM_Init: BswMActionListItemIndex=14, BswMActionListItemRef=BswMModeControl/INIT_Action_NvM_Init
              INIT_Action_Dcm_Init: BswMActionListItemIndex=21, BswMActionListItemRef=BswMModeControl/INIT_Action_Dcm_Init
              BSWM_FULL_COM_USR_A_FlexRay_5b5a9ac2: BswMActionListItemIndex=20, BswMActionListItemRef=BswMModeControl/BSWM_FULL_COM_USR_A_FlexRay_5b5a9ac2
              INIT_Action_EnableInterrupts: BswMActionListItemIndex=0, BswMActionListItemRef=BswMModeControl/INIT_Action_EnableInterrupts
              BswMUserCallout: BswMActionListItemIndex=17, BswMActionListItemRef=BswMModeControl/BswMUserCallout
        SwitchPort_StdDiag_SessionChangeIndication (BswMSwitchPort): BswMModeSwitchInterfaceRef=SessionChangeIndicationInterface
        A_RteSwitch_StdDiag_SessionChangeIndication_To_STDDIAG_DEFAULT_SESSION (BswMAction)
          BswMAvailableActions
            BswMRteSwitch: BswMSwitchedMode=STDDIAG_DEFAULT_SESSION, BswMRteSwitchPortRef=SwitchPort_StdDiag_SessionChangeIndication
        A_RteSwitch_StdDiag_SessionChangeIndication_To_STDDIAG_OTHER_SESSION (BswMAction)
          BswMAvailableActions
            BswMRteSwitch: BswMSwitchedMode=STDDIAG_OTHER_SESSION, BswMRteSwitchPortRef=SwitchPort_StdDiag_SessionChangeIndication
        AL_Switch_StdDiagSessionChangeIndication_True (BswMActionList): BswMActionListExecution=BSWM_TRIGGER
          A_RteSwitch_StdDiag_SessionChangeIndication_To_STDDIAG_DEFAULT_SESSION (BswMActionListItem):
            BswMAbortOnFail = false
            BswMActionListItemIndex = 0
            BswMActionListItemRef = BswMModeControl/A_RteSwitch_StdDiag_SessionChangeIndication_To_STDDIAG_DEFAULT_SESSION
        AL_Switch_StdDiagSessionChangeIndication_False (BswMActionList): BswMActionListExecution=BSWM_TRIGGER
          A_RteSwitch_StdDiag_SessionChangeIndication_To_STDDIAG_OTHER_SESSION (BswMActionListItem):
            BswMAbortOnFail = false
            BswMActionListItemIndex = 0
            BswMActionListItemRef = BswMModeControl/A_RteSwitch_StdDiag_SessionChangeIndication_To_STDDIAG_OTHER_SESSION
        SwitchPort_StdDiagComControlNormalNotificationPort (BswMSwitchPort): BswMModeSwitchInterfaceRef=ComControlNormalNotificationInterface
        A_RteSwitch_StdDiagComControlNormalNotificationPort_To_ENABLE_RX_AND_TX_NORMAL (BswMAction)
          BswMAvailableActions
            BswMRteSwitch: BswMSwitchedMode=ENABLE_RX_AND_TX_NORMAL, BswMRteSwitchPortRef=SwitchPort_StdDiagComControlNormalNotificationPort
        AL_NDC_Enable_RX_AND_TX_NORMAL (BswMActionList): BswMActionListExecution=BSWM_TRIGGER
          A_RteSwitch_StdDiagComControlNormalNotificationPort_To_ENABLE_RX_AND_TX_NORMAL (BswMActionListItem):
            BswMAbortOnFail = false
            BswMActionListItemIndex = 0
            BswMActionListItemRef = BswMModeControl/A_RteSwitch_StdDiagComControlNormalNotificationPort_To_ENABLE_RX_AND_TX_NORMAL
        A_RteSwitch_StdDiagComControlNormalNotificationPort_To_ENABLE_RX_DISABLE_TX_NORMAL (BswMAction)
          BswMAvailableActions
            BswMRteSwitch: BswMSwitchedMode=ENABLE_RX_DISABLE_TX_NORMAL, BswMRteSwitchPortRef=SwitchPort_StdDiagComControlNormalNotificationPort
        AL_NDC_Enable_RX_Disable_TX_NORMAL (BswMActionList): BswMActionListExecution=BSWM_TRIGGER
          A_RteSwitch_StdDiagComControlNormalNotificationPort_To_ENABLE_RX_DISABLE_TX_NORMAL (BswMActionListItem):
            BswMAbortOnFail = false
            BswMActionListItemIndex = 0
            BswMActionListItemRef = BswMModeControl/A_RteSwitch_StdDiagComControlNormalNotificationPort_To_ENABLE_RX_DISABLE_TX_NORMAL
        A_RteSwitch_StdDiagComControlNormalNotificationPort_To_DISABLE_RX_ENABLE_TX_NORMAL (BswMAction)
          BswMAvailableActions
            BswMRteSwitch: BswMSwitchedMode=DISABLE_RX_ENABLE_TX_NORMAL, BswMRteSwitchPortRef=SwitchPort_StdDiagComControlNormalNotificationPort
        AL_NDC_Disable_RX_Enable_TX_NORMAL (BswMActionList): BswMActionListExecution=BSWM_TRIGGER
          A_RteSwitch_StdDiagComControlNormalNotificationPort_To_DISABLE_RX_ENABLE_TX_NORMAL (BswMActionListItem):
            BswMAbortOnFail = false
            BswMActionListItemIndex = 0
            BswMActionListItemRef = BswMModeControl/A_RteSwitch_StdDiagComControlNormalNotificationPort_To_DISABLE_RX_ENABLE_TX_NORMAL
        A_RteSwitch_StdDiagComControlNormalNotificationPort_To_DISABLE_RX_AND_TX_NORMAL (BswMAction)
          BswMAvailableActions
            BswMRteSwitch: BswMSwitchedMode=DISABLE_RX_AND_TX_NORMAL, BswMRteSwitchPortRef=SwitchPort_StdDiagComControlNormalNotificationPort
        AL_NDC_Disable_Rx_And_Tx_Normal (BswMActionList): BswMActionListExecution=BSWM_TRIGGER
          A_RteSwitch_StdDiagComControlNormalNotificationPort_To_DISABLE_RX_AND_TX_NORMAL (BswMActionListItem):
            BswMAbortOnFail = false
            BswMActionListItemIndex = 0
            BswMActionListItemRef = BswMModeControl/A_RteSwitch_StdDiagComControlNormalNotificationPort_To_DISABLE_RX_AND_TX_NORMAL
        A_PrepareForReceivingNm (BswMAction)
          BswMAvailableActions
            BswMUserCallout: BswMUserCalloutFunction=PrepareForReceivingNm(), BswMCreateCallout=false, BswMUserIncludeFile=BswM_UserCallouts.h
        AL_ComM_Channel_is_NO_COM_BswMActionList_True (BswMActionList): BswMActionListExecution=BSWM_TRIGGER
          A_PrepareForReceivingNm (BswMActionListItem): BswMAbortOnFail=false, BswMActionListItemIndex=0, BswMActionListItemRef=BswMModeControl/A_PrepareForReceivingNm
        AL_Set_EcuRunMode_to_Normal_Operation_when_all_modules_run_BswMActionList_True (BswMActionList): BswMActionListExecution=BSWM_TRIGGER
          A_RteRequest_IntegrationSample_NORMAL_OPERATION_Via_MSRP_IntegrationSample_EcuRunMode (BswMActionListItem):
            BswMAbortOnFail = false
            BswMActionListItemIndex = 0
            BswMActionListItemRef = BswMModeControl/A_RteRequest_IntegrationSample_NORMAL_OPERATION_Via_MSRP_IntegrationSample_EcuRunMode
        A_StartSimpleTimer0 (BswMAction)
          BswMAvailableActions
            BswMUserCallout: BswMUserCalloutFunction=BswM_Callout_StartSimpleTimer0(), BswMCreateCallout=false, BswMUserIncludeFile=BswM_UserCallouts.h
        A_MCU_Perform_Reset (BswMAction)
          BswMAvailableActions
            BswMUserCallout: BswMUserCalloutFunction=Mcu_PerformReset(), BswMCreateCallout=false, BswMUserIncludeFile=Mcu.h
        3 x BswMActionList, all with BswMActionListExecution=BSWM_TRIGGER:
          AL_Reset_when_SimpleTimer0_fired_BswMActionList_True
            A_MCU_Perform_Reset (BswMActionListItem): BswMAbortOnFail=false, BswMActionListItemIndex=0, BswMActionListItemRef=BswMModeControl/A_MCU_Perform_Reset
          AL_Bs_Run_when_Bs_Init
            A_RTE_REQUEST_MRSP_Bs_BS_RUNNING (BswMActionListItem): BswMAbortOnFail=false, BswMActionListItemIndex=0, BswMActionListItemRef=BswMModeControl/A_RTE_REQUEST_MRSP_Bs_BS_RUNNING
          AL_BswMActionList_Bs_Init_True
            A_RTE_REQUEST_MRSP_Bs_BS_INITIALIZED (BswMActionListItem): BswMAbortOnFail=false, BswMActionListItemIndex=0, BswMActionListItemRef=BswMModeControl/A_RTE_REQUEST_MRSP_Bs_BS_INITIALIZED
        A_RTE_REQUEST_MRSP_Bs_BS_INITIALIZED (BswMAction)
          BswMAvailableActions
            BswMRteModeRequest: BswMRequestedMode=BS_INITIALIZED, BswMRteModeRequestPortRef=MRSP_Bs
        A_RTE_REQUEST_MRSP_Bs_BS_RUNNING (BswMAction)
          BswMAvailableActions
            BswMRteModeRequest: BswMRequestedMode=BS_RUNNING, BswMRteModeRequestPortRef=MRSP_Bs
        MRSP_Bs (BswMRteModeRequestPort): BswMRteModeInitValue=BS_STOPPED, BswMRteModeRequestPortInterfaceRef=Bs.LifeCycleRequest.requestMode
        8 x BswMAction:
          INIT_Action_Det_Init
            BswMAvailableActions
              BswMUserCallout: BswMUserCalloutFunction=Det_Init(Det_Config_Ptr), BswMCreateCallout=false, BswMUserIncludeFile=Det.h
          INIT_Action_Fee_30_SmallSector_Init
            BswMAvailableActions
              BswMUserCallout: BswMUserCalloutFunction=Fee_30_SmallSector_Init(), BswMCreateCallout=false, BswMUserIncludeFile=Fee_30_SmallSector.h
          INIT_Action_WdgM_Init
            BswMAvailableActions
              BswMUserCallout: BswMUserCalloutFunction=WdgM_Init(&WdgMConfig_Mode0_core0), BswMCreateCallout=false, BswMUserIncludeFile=WdgM.h
          INIT_Action_FrTp_Init
            BswMAvailableActions
              BswMUserCallout: BswMUserCalloutFunction=FrTp_Init(&FrTp_Config), BswMCreateCallout=false, BswMUserIncludeFile=FrTp.h
          INIT_Action_FrXcp_Init
            BswMAvailableActions
              BswMUserCallout: BswMUserCalloutFunction=FrXcp_Init(NULL_PTR), BswMCreateCallout=false, BswMUserIncludeFile=FrXcp.h
          INIT_Action_Xcp_Init
            BswMAvailableActions
              BswMUserCallout: BswMUserCalloutFunction=Xcp_Init(), BswMCreateCallout=false, BswMUserIncludeFile=Xcp.h
          INIT_Action_NvM_Init
            BswMAvailableActions
              BswMUserCallout: BswMUserCalloutFunction=NvM_Init(), BswMCreateCallout=false, BswMUserIncludeFile=NvM.h
          INIT_Action_Dcm_Init
            BswMAvailableActions
              BswMUserCallout: BswMUserCalloutFunction=Dcm_Init(NULL_PTR), BswMCreateCallout=false, BswMUserIncludeFile=Dcm.h
        ESH_AL_ExitRun (BswMActionList): BswMActionListExecution=BSWM_CONDITION
          4 x BswMActionListItem, all with BswMAbortOnFail=false:
            ESH_Action_EnterExclusiveArea: BswMActionListItemIndex=0, BswMActionListItemRef=BswMModeControl/ESH_Action_EnterExclusiveArea
            ESH_Action_ComMCheckPendingRequests: BswMActionListItemIndex=1, BswMActionListItemRef=BswMModeControl/ESH_Action_ComMCheckPendingRequests
            ESH_RunToPostRunNested: BswMActionListItemIndex=2, BswMActionListItemRef=BswMArbitration/ESH_RunToPostRunNested
            ESH_Action_ExitExclusiveArea: BswMActionListItemIndex=3, BswMActionListItemRef=BswMModeControl/ESH_Action_ExitExclusiveArea
        ESH_Action_EnterExclusiveArea (BswMAction)
          BswMAvailableActions
            BswMUserCallout: BswMUserCalloutFunction=SchM_Enter_BswM_BSWM_EXCLUSIVE_AREA_0(), BswMCreateCallout=false, BswMUserIncludeFile=SchM_BswM.h
        ESH_Action_ComMCheckPendingRequests (BswMAction)
          BswMAvailableActions
            BswMUserCallout:
              BswMUserCalloutFunction = ESH_ComM_CheckPendingRequests()
              BswMCreateCallout = true
              BswMUserCode = ComM_StateType A_FlexRay_5b5a9ac2 = COMM_NO_COM_NO_PENDING_REQUEST; (void)ComM_GetState(ComMConf_ComMChannel_A_FlexRay_5b5a9ac2, &A_FlexRay_5b5a9ac2); /* SBSW_BSWM_FCTCALL_LOCALVAR */ if(A_FlexRay_5b5a9ac2 != COMM_NO_COM_NO_PENDING_REQUEST) { BswM_RequestMode(BSWM_GENERIC_ESH_ComMPendingRequests, BSWM_GENERICVALUE_ESH_ComMPendingRequests_ESH_COMM_PENDING_REQUEST); } else { BswM_RequestMode(BSWM_GENERIC_ESH_ComMPendingRequests, BSWM_GENERICVALUE_ESH_ComMPendingRequests_ESH_COMM_NO_REQUEST); }
        ESH_AL_RunToPostRun (BswMActionList): BswMActionListExecution=BSWM_CONDITION
          5 x BswMActionListItem, all with BswMAbortOnFail=false:
            ESH_Action_ComMDisallow_A_FlexRay_5b5a9ac2: BswMActionListItemIndex=0, BswMActionListItemRef=BswMModeControl/ESH_Action_ComMDisallow_A_FlexRay_5b5a9ac2
            ESH_Action_EcuMClearValidatedWakeupEvents: BswMActionListItemIndex=1, BswMActionListItemRef=BswMModeControl/ESH_Action_EcuMClearValidatedWakeupEvents
            ESH_Action_OnEnterPostRun: BswMActionListItemIndex=2, BswMActionListItemRef=BswMModeControl/ESH_Action_OnEnterPostRun
            ESH_Action_SwitchPostRun: BswMActionListItemIndex=3, BswMActionListItemRef=BswMModeControl/ESH_Action_SwitchPostRun
            ESH_Action_ESH_PostRun: BswMActionListItemIndex=4, BswMActionListItemRef=BswMModeControl/ESH_Action_ESH_PostRun
        4 x BswMAction:
          ESH_Action_ComMDisallow_A_FlexRay_5b5a9ac2
            BswMAvailableActions
              BswMComMAllowCom: BswMComAllowed=false, BswMComMAllowChannelRef=A_FlexRay_5b5a9ac2
          ESH_Action_EcuMClearValidatedWakeupEvents
            BswMAvailableActions
              BswMUserCallout: BswMUserCalloutFunction=EcuM_ClearValidatedWakeupEvent(ECUM_WKSOURCE_ALL_SOURCES), BswMCreateCallout=false, BswMUserIncludeFile=EcuM.h
          ESH_Action_OnEnterPostRun
            BswMAvailableActions
              BswMUserCallout: BswMUserCalloutFunction=BswM_ESH_OnEnterPostRun(), BswMCreateCallout=true
          ESH_Action_SwitchPostRun
            BswMAvailableActions
              BswMRteSwitch: BswMSwitchedMode=POSTRUN, BswMRteSwitchPortRef=ESH_ModeSwitch
        ESH_ModeSwitch (BswMSwitchPort): BswMModeSwitchInterfaceRef=BswM_MSI_ESH_Mode
        ESH_Action_ESH_PostRun (BswMAction)
          BswMAvailableActions
            BswMGenericModeSwitch: BswMGenericRequestRef=ESH_State, BswMGenericRequestModeRef=ESH_POST_RUN
        ESH_Action_ExitExclusiveArea (BswMAction)
          BswMAvailableActions
            BswMUserCallout: BswMUserCalloutFunction=SchM_Exit_BswM_BSWM_EXCLUSIVE_AREA_0(), BswMCreateCallout=false, BswMUserIncludeFile=SchM_BswM.h
        ESH_AL_WaitForNvMToShutdown (BswMActionList): BswMActionListExecution=BSWM_CONDITION
          3 x BswMActionListItem, all with BswMAbortOnFail=false:
            ESH_Action_WriteAllTimer_Stop: BswMActionListItemIndex=0, BswMActionListItemRef=BswMModeControl/ESH_Action_WriteAllTimer_Stop
            ESH_Action_OnEnterShutdown: BswMActionListItemIndex=1, BswMActionListItemRef=BswMModeControl/ESH_Action_OnEnterShutdown
            ESH_Action_EcuMGoToSelectedShutdownTarget: BswMActionListItemIndex=2, BswMActionListItemRef=BswMModeControl/ESH_Action_EcuMGoToSelectedShutdownTarget
        3 x BswMAction:
          ESH_Action_WriteAllTimer_Stop
            BswMAvailableActions
              BswMTimerControl: BswMTimerAction=BSWM_TIMER_STOP, BswMTimerValue=0, BswMTimerRef=ESH_NvM_WriteAllTimer
          ESH_Action_OnEnterShutdown
            BswMAvailableActions
              BswMUserCallout: BswMUserCalloutFunction=BswM_ESH_OnEnterShutdown(), BswMCreateCallout=true
          ESH_Action_EcuMGoToSelectedShutdownTarget
            BswMAvailableActions
              BswMUserCallout: BswMUserCalloutFunction=(void)EcuM_GoToSelectedShutdownTarget(), BswMCreateCallout=false, BswMUserIncludeFile=EcuM.h
        ESH_AL_WakeupToPrep (BswMActionList): BswMActionListExecution=BSWM_CONDITION
          3 x BswMActionListItem, all with BswMAbortOnFail=false:
            ESH_Action_OnEnterPrepShutdown: BswMActionListItemIndex=0, BswMActionListItemRef=BswMModeControl/ESH_Action_OnEnterPrepShutdown
            ESH_Action_SwitchShutdown: BswMActionListItemIndex=1, BswMActionListItemRef=BswMModeControl/ESH_Action_SwitchShutdown
            ESH_Action_ESH_PrepShutdown: BswMActionListItemIndex=2, BswMActionListItemRef=BswMModeControl/ESH_Action_ESH_PrepShutdown
        3 x BswMAction:
          ESH_Action_OnEnterPrepShutdown
            BswMAvailableActions
              BswMUserCallout: BswMUserCalloutFunction=BswM_ESH_OnEnterPrepShutdown(), BswMCreateCallout=true
          ESH_Action_SwitchShutdown
            BswMAvailableActions
              BswMRteSwitch: BswMSwitchedMode=SHUTDOWN, BswMRteSwitchPortRef=ESH_ModeSwitch
          ESH_Action_ESH_PrepShutdown
            BswMAvailableActions
              BswMGenericModeSwitch: BswMGenericRequestRef=ESH_State, BswMGenericRequestModeRef=ESH_PREP_SHUTDOWN
        ESH_AL_WaitForNvMWakeup (BswMActionList): BswMActionListExecution=BSWM_CONDITION
          6 x BswMActionListItem, all with BswMAbortOnFail=false:
            ESH_Action_WriteAllTimer_Stop: BswMActionListItemIndex=0, BswMActionListItemRef=BswMModeControl/ESH_Action_WriteAllTimer_Stop
            ESH_Action_CancelWriteAllTimer_Start: BswMActionListItemIndex=1, BswMActionListItemRef=BswMModeControl/ESH_Action_CancelWriteAllTimer_Start
            ESH_Action_CancelNvMWriteAll: BswMActionListItemIndex=2, BswMActionListItemRef=BswMModeControl/ESH_Action_CancelNvMWriteAll
            ESH_Action_OnEnterWakeup: BswMActionListItemIndex=3, BswMActionListItemRef=BswMModeControl/ESH_Action_OnEnterWakeup
            ESH_Action_SwitchWakeup: BswMActionListItemIndex=4, BswMActionListItemRef=BswMModeControl/ESH_Action_SwitchWakeup
            ESH_Action_ESH_Wakeup: BswMActionListItemIndex=5, BswMActionListItemRef=BswMModeControl/ESH_Action_ESH_Wakeup
        5 x BswMAction:
          ESH_Action_CancelWriteAllTimer_Start
            BswMAvailableActions
              BswMTimerControl: BswMTimerAction=BSWM_TIMER_START, BswMTimerValue=60, BswMTimerRef=ESH_NvM_CancelWriteAllTimer
          ESH_Action_CancelNvMWriteAll
            BswMAvailableActions
              BswMUserCallout: BswMUserCalloutFunction=NvM_CancelWriteAll(), BswMCreateCallout=false, BswMUserIncludeFile=NvM.h
          ESH_Action_OnEnterWakeup
            BswMAvailableActions
              BswMUserCallout: BswMUserCalloutFunction=BswM_ESH_OnEnterWakeup(), BswMCreateCallout=true
          ESH_Action_SwitchWakeup
            BswMAvailableActions
              BswMRteSwitch: BswMSwitchedMode=WAKEUP, BswMRteSwitchPortRef=ESH_ModeSwitch
          ESH_Action_ESH_Wakeup
            BswMAvailableActions
              BswMGenericModeSwitch: BswMGenericRequestRef=ESH_State, BswMGenericRequestModeRef=ESH_WAKEUP
        ESH_AL_WakeupToRun (BswMActionList): BswMActionListExecution=BSWM_CONDITION
          7 x BswMActionListItem, all with BswMAbortOnFail=false:
            ESH_Action_CancelWriteAllTimer_Stop: BswMActionListItemIndex=0, BswMActionListItemRef=BswMModeControl/ESH_Action_CancelWriteAllTimer_Stop
            ESH_DemInit: BswMActionListItemIndex=1, BswMActionListItemRef=BswMArbitration/ESH_DemInit
            ESH_Action_ComMAllow_A_FlexRay_5b5a9ac2: BswMActionListItemIndex=2, BswMActionListItemRef=BswMModeControl/ESH_Action_ComMAllow_A_FlexRay_5b5a9ac2
            ESH_Action_SelfRunRequestTimer_Start: BswMActionListItemIndex=3, BswMActionListItemRef=BswMModeControl/ESH_Action_SelfRunRequestTimer_Start
            ESH_Action_OnEnterRun: BswMActionListItemIndex=4, BswMActionListItemRef=BswMModeControl/ESH_Action_OnEnterRun
            ESH_Action_SwitchRun: BswMActionListItemIndex=5, BswMActionListItemRef=BswMModeControl/ESH_Action_SwitchRun
            ESH_Action_ESH_Run: BswMActionListItemIndex=6, BswMActionListItemRef=BswMModeControl/ESH_Action_ESH_Run
        ESH_Action_CancelWriteAllTimer_Stop (BswMAction)
          BswMAvailableActions
            BswMTimerControl: BswMTimerAction=BSWM_TIMER_STOP, BswMTimerValue=0, BswMTimerRef=ESH_NvM_CancelWriteAllTimer
        ESH_AL_DemInit (BswMActionList): BswMActionListExecution=BSWM_CONDITION
          ESH_Action_DemInit (BswMActionListItem): BswMAbortOnFail=false, BswMActionListItemIndex=0, BswMActionListItemRef=BswMModeControl/ESH_Action_DemInit
          ESH_Action_DemInitialized (BswMActionListItem): BswMAbortOnFail=false, BswMActionListItemIndex=1, BswMActionListItemRef=BswMModeControl/ESH_Action_DemInitialized
        7 x BswMAction:
          ESH_Action_DemInit
            BswMAvailableActions
              BswMUserCallout: BswMUserCalloutFunction=Dem_Init(Dem_Config_Ptr), BswMCreateCallout=false, BswMUserIncludeFile=Dem.h
          ESH_Action_DemInitialized
            BswMAvailableActions
              BswMGenericModeSwitch: BswMGenericRequestRef=ESH_DemInitStatus, BswMGenericRequestModeRef=DEM_INITIALIZED
          ESH_Action_ComMAllow_A_FlexRay_5b5a9ac2
            BswMAvailableActions
              BswMComMAllowCom: BswMComAllowed=true, BswMComMAllowChannelRef=A_FlexRay_5b5a9ac2
          ESH_Action_SelfRunRequestTimer_Start
            BswMAvailableActions
              BswMTimerControl: BswMTimerAction=BSWM_TIMER_START, BswMTimerValue=0.1, BswMTimerRef=ESH_SelfRunRequestTimer
          ESH_Action_OnEnterRun
            BswMAvailableActions
              BswMUserCallout: BswMUserCalloutFunction=BswM_ESH_OnEnterRun(), BswMCreateCallout=true
          ESH_Action_SwitchRun
            BswMAvailableActions
              BswMRteSwitch: BswMSwitchedMode=RUN, BswMRteSwitchPortRef=ESH_ModeSwitch
          ESH_Action_ESH_Run
            BswMAvailableActions
              BswMGenericModeSwitch: BswMGenericRequestRef=ESH_State, BswMGenericRequestModeRef=ESH_RUN
        ESH_AL_InitToWakeup (BswMActionList): BswMActionListExecution=BSWM_CONDITION
          3 x BswMActionListItem, all with BswMAbortOnFail=false:
            ESH_Action_OnEnterWakeup: BswMActionListItemIndex=0, BswMActionListItemRef=BswMModeControl/ESH_Action_OnEnterWakeup
            ESH_Action_SwitchWakeup: BswMActionListItemIndex=1, BswMActionListItemRef=BswMModeControl/ESH_Action_SwitchWakeup
            ESH_Action_ESH_Wakeup: BswMActionListItemIndex=2, BswMActionListItemRef=BswMModeControl/ESH_Action_ESH_Wakeup
        ESH_AL_PostRunToPrepShutdown (BswMActionList): BswMActionListExecution=BSWM_CONDITION
          5 x BswMActionListItem, all with BswMAbortOnFail=false:
            ESH_Action_DemShutdown: BswMActionListItemIndex=0, BswMActionListItemRef=BswMModeControl/ESH_Action_DemShutdown
            ESH_Action_DemNotInitialized: BswMActionListItemIndex=1, BswMActionListItemRef=BswMModeControl/ESH_Action_DemNotInitialized
            ESH_Action_OnEnterPrepShutdown: BswMActionListItemIndex=2, BswMActionListItemRef=BswMModeControl/ESH_Action_OnEnterPrepShutdown
            ESH_Action_SwitchShutdown: BswMActionListItemIndex=3, BswMActionListItemRef=BswMModeControl/ESH_Action_SwitchShutdown
            ESH_Action_ESH_PrepShutdown: BswMActionListItemIndex=4, BswMActionListItemRef=BswMModeControl/ESH_Action_ESH_PrepShutdown
        ESH_Action_DemShutdown (BswMAction)
          BswMAvailableActions
            BswMUserCallout: BswMUserCalloutFunction=Dem_Shutdown(), BswMCreateCallout=false, BswMUserIncludeFile=Dem.h
        ESH_Action_DemNotInitialized (BswMAction)
          BswMAvailableActions
            BswMGenericModeSwitch: BswMGenericRequestRef=ESH_DemInitStatus, BswMGenericRequestModeRef=DEM_NOT_INITIALIZED
        4 x BswMActionList, all with BswMActionListExecution=BSWM_CONDITION:
          ESH_AL_ESH_PostRunToPrepCheck
            ESH_PostRunToPrepNested (BswMActionListItem): BswMAbortOnFail=false, BswMActionListItemIndex=0, BswMActionListItemRef=BswMArbitration/ESH_PostRunToPrepNested
          ESH_AL_PostRunToRun
            5 x BswMActionListItem, all with BswMAbortOnFail=false:
              ESH_Action_ComMAllow_A_FlexRay_5b5a9ac2: BswMActionListItemIndex=0, BswMActionListItemRef=BswMModeControl/ESH_Action_ComMAllow_A_FlexRay_5b5a9ac2
              ESH_Action_SelfRunRequestTimer_Start: BswMActionListItemIndex=1, BswMActionListItemRef=BswMModeControl/ESH_Action_SelfRunRequestTimer_Start
              ESH_Action_OnEnterRun: BswMActionListItemIndex=2, BswMActionListItemRef=BswMModeControl/ESH_Action_OnEnterRun
              ESH_Action_SwitchRun: BswMActionListItemIndex=3, BswMActionListItemRef=BswMModeControl/ESH_Action_SwitchRun
              ESH_Action_ESH_Run: BswMActionListItemIndex=4, BswMActionListItemRef=BswMModeControl/ESH_Action_ESH_Run
          ESH_AL_ExitPostRun
            4 x BswMActionListItem, all with BswMAbortOnFail=false:
              ESH_Action_EnterExclusiveArea: BswMActionListItemIndex=0, BswMActionListItemRef=BswMModeControl/ESH_Action_EnterExclusiveArea
              ESH_Action_ComMCheckPendingRequests: BswMActionListItemIndex=1, BswMActionListItemRef=BswMModeControl/ESH_Action_ComMCheckPendingRequests
              ESH_PostRunNested: BswMActionListItemIndex=2, BswMActionListItemRef=BswMArbitration/ESH_PostRunNested
              ESH_Action_ExitExclusiveArea: BswMActionListItemIndex=3, BswMActionListItemRef=BswMModeControl/ESH_Action_ExitExclusiveArea
          ESH_AL_PrepShutdownToWaitForNvM
            5 x BswMActionListItem, all with BswMAbortOnFail=false:
              ESH_Action_WriteAllTimer_Start: BswMActionListItemIndex=0, BswMActionListItemRef=BswMModeControl/ESH_Action_WriteAllTimer_Start
              ESH_Action_NvMWriteAll: BswMActionListItemIndex=1, BswMActionListItemRef=BswMModeControl/ESH_Action_NvMWriteAll
              ESH_Action_ComMCheckPendingRequests: BswMActionListItemIndex=2, BswMActionListItemRef=BswMModeControl/ESH_Action_ComMCheckPendingRequests
              ESH_Action_OnEnterWaitForNvm: BswMActionListItemIndex=3, BswMActionListItemRef=BswMModeControl/ESH_Action_OnEnterWaitForNvm
              ESH_Action_ESH_WaitForNvm: BswMActionListItemIndex=4, BswMActionListItemRef=BswMModeControl/ESH_Action_ESH_WaitForNvm
        4 x BswMAction:
          ESH_Action_WriteAllTimer_Start
            BswMAvailableActions
              BswMTimerControl: BswMTimerAction=BSWM_TIMER_START, BswMTimerValue=60, BswMTimerRef=ESH_NvM_WriteAllTimer
          ESH_Action_NvMWriteAll
            BswMAvailableActions
              BswMUserCallout: BswMUserCalloutFunction=NvM_WriteAll(), BswMCreateCallout=false, BswMUserIncludeFile=NvM.h
          ESH_Action_OnEnterWaitForNvm
            BswMAvailableActions
              BswMUserCallout: BswMUserCalloutFunction=BswM_ESH_OnEnterWaitForNvm(), BswMCreateCallout=true
          ESH_Action_ESH_WaitForNvm
            BswMAvailableActions
              BswMGenericModeSwitch: BswMGenericRequestRef=ESH_State, BswMGenericRequestModeRef=ESH_WAIT_FOR_NVM
        CC_AL_A_FlexRay_5b5a9ac2_TX_Disable (BswMActionList): BswMActionListExecution=BSWM_TRIGGER
          3 x BswMActionListItem, all with BswMAbortOnFail=false:
            CC_DisablePDUGroup_EPS_OUT_PduGroup_7933cc8b: BswMActionListItemIndex=0, BswMActionListItemRef=BswMModeControl/CC_DisablePDUGroup_EPS_OUT_PduGroup_7933cc8b
            CC_DisablePDUGroup_EPS_OUT_PduGroup3_7933cc8b: BswMActionListItemIndex=1, BswMActionListItemRef=BswMModeControl/CC_DisablePDUGroup_EPS_OUT_PduGroup3_7933cc8b
            CC_DisablePDUGroup_EPS_OUT_PduGroup2_7933cc8b: BswMActionListItemIndex=2, BswMActionListItemRef=BswMModeControl/CC_DisablePDUGroup_EPS_OUT_PduGroup2_7933cc8b
        3 x BswMAction:
          CC_DisablePDUGroup_EPS_OUT_PduGroup_7933cc8b
            BswMAvailableActions
              BswMPduGroupSwitch: BswMPduGroupSwitchReinit=false, BswMDisabledPduGroupRef=EPS_OUT_PduGroup_7933cc8b
          CC_DisablePDUGroup_EPS_OUT_PduGroup3_7933cc8b
            BswMAvailableActions
              BswMPduGroupSwitch: BswMPduGroupSwitchReinit=false, BswMDisabledPduGroupRef=EPS_OUT_PduGroup3_7933cc8b
          CC_DisablePDUGroup_EPS_OUT_PduGroup2_7933cc8b
            BswMAvailableActions
              BswMPduGroupSwitch: BswMPduGroupSwitchReinit=false, BswMDisabledPduGroupRef=EPS_OUT_PduGroup2_7933cc8b
        CC_AL_A_FlexRay_5b5a9ac2_TX_EnableNoinit (BswMActionList): BswMActionListExecution=BSWM_TRIGGER
          3 x BswMActionListItem, all with BswMAbortOnFail=false:
            CC_EnablePDUGroup_EPS_OUT_PduGroup_7933cc8b: BswMActionListItemIndex=0, BswMActionListItemRef=BswMModeControl/CC_EnablePDUGroup_EPS_OUT_PduGroup_7933cc8b
            CC_EnablePDUGroup_EPS_OUT_PduGroup3_7933cc8b: BswMActionListItemIndex=1, BswMActionListItemRef=BswMModeControl/CC_EnablePDUGroup_EPS_OUT_PduGroup3_7933cc8b
            CC_EnablePDUGroup_EPS_OUT_PduGroup2_7933cc8b: BswMActionListItemIndex=2, BswMActionListItemRef=BswMModeControl/CC_EnablePDUGroup_EPS_OUT_PduGroup2_7933cc8b
        3 x BswMAction:
          CC_EnablePDUGroup_EPS_OUT_PduGroup_7933cc8b
            BswMAvailableActions
              BswMPduGroupSwitch: BswMPduGroupSwitchReinit=false, BswMEnabledPduGroupRef=EPS_OUT_PduGroup_7933cc8b
          CC_EnablePDUGroup_EPS_OUT_PduGroup3_7933cc8b
            BswMAvailableActions
              BswMPduGroupSwitch: BswMPduGroupSwitchReinit=false, BswMEnabledPduGroupRef=EPS_OUT_PduGroup3_7933cc8b
          CC_EnablePDUGroup_EPS_OUT_PduGroup2_7933cc8b
            BswMAvailableActions
              BswMPduGroupSwitch: BswMPduGroupSwitchReinit=false, BswMEnabledPduGroupRef=EPS_OUT_PduGroup2_7933cc8b
        CC_AL_A_FlexRay_5b5a9ac2_RX_Disable (BswMActionList): BswMActionListExecution=BSWM_TRIGGER
          10 x BswMActionListItem, all with BswMAbortOnFail=false:
            CC_DisablePDUGroup_EPS_IN_PduGroup3_7933cc8b: BswMActionListItemIndex=0, BswMActionListItemRef=BswMModeControl/CC_DisablePDUGroup_EPS_IN_PduGroup3_7933cc8b
            CC_DisablePDUGroup_EPS_IN_PduGroup9_7933cc8b: BswMActionListItemIndex=1, BswMActionListItemRef=BswMModeControl/CC_DisablePDUGroup_EPS_IN_PduGroup9_7933cc8b
            CC_DisablePDUGroup_EPS_IN_PduGroup4_7933cc8b: BswMActionListItemIndex=2, BswMActionListItemRef=BswMModeControl/CC_DisablePDUGroup_EPS_IN_PduGroup4_7933cc8b
            CC_DisablePDUGroup_EPS_IN_PduGroup10_7933cc8b: BswMActionListItemIndex=3, BswMActionListItemRef=BswMModeControl/CC_DisablePDUGroup_EPS_IN_PduGroup10_7933cc8b
            CC_DisablePDUGroup_EPS_IN_PduGroup8_7933cc8b: BswMActionListItemIndex=4, BswMActionListItemRef=BswMModeControl/CC_DisablePDUGroup_EPS_IN_PduGroup8_7933cc8b
            CC_DisablePDUGroup_EPS_IN_PduGroup6_7933cc8b: BswMActionListItemIndex=5, BswMActionListItemRef=BswMModeControl/CC_DisablePDUGroup_EPS_IN_PduGroup6_7933cc8b
            CC_DisablePDUGroup_EPS_IN_PduGroup_7933cc8b: BswMActionListItemIndex=6, BswMActionListItemRef=BswMModeControl/CC_DisablePDUGroup_EPS_IN_PduGroup_7933cc8b
            CC_DisablePDUGroup_EPS_IN_PduGroup5_7933cc8b: BswMActionListItemIndex=7, BswMActionListItemRef=BswMModeControl/CC_DisablePDUGroup_EPS_IN_PduGroup5_7933cc8b
            CC_DisablePDUGroup_EPS_IN_PduGroup2_7933cc8b: BswMActionListItemIndex=8, BswMActionListItemRef=BswMModeControl/CC_DisablePDUGroup_EPS_IN_PduGroup2_7933cc8b
            CC_DisablePDUGroup_EPS_IN_PduGroup7_7933cc8b: BswMActionListItemIndex=9, BswMActionListItemRef=BswMModeControl/CC_DisablePDUGroup_EPS_IN_PduGroup7_7933cc8b
        10 x BswMAction:
          CC_DisablePDUGroup_EPS_IN_PduGroup3_7933cc8b
            BswMAvailableActions
              BswMPduGroupSwitch: BswMPduGroupSwitchReinit=false, BswMDisabledPduGroupRef=EPS_IN_PduGroup3_7933cc8b
          CC_DisablePDUGroup_EPS_IN_PduGroup9_7933cc8b
            BswMAvailableActions
              BswMPduGroupSwitch: BswMPduGroupSwitchReinit=false, BswMDisabledPduGroupRef=EPS_IN_PduGroup9_7933cc8b
          CC_DisablePDUGroup_EPS_IN_PduGroup4_7933cc8b
            BswMAvailableActions
              BswMPduGroupSwitch: BswMPduGroupSwitchReinit=false, BswMDisabledPduGroupRef=EPS_IN_PduGroup4_7933cc8b
          CC_DisablePDUGroup_EPS_IN_PduGroup10_7933cc8b
            BswMAvailableActions
              BswMPduGroupSwitch: BswMPduGroupSwitchReinit=false, BswMDisabledPduGroupRef=EPS_IN_PduGroup10_7933cc8b
          CC_DisablePDUGroup_EPS_IN_PduGroup8_7933cc8b
            BswMAvailableActions
              BswMPduGroupSwitch: BswMPduGroupSwitchReinit=false, BswMDisabledPduGroupRef=EPS_IN_PduGroup8_7933cc8b
          CC_DisablePDUGroup_EPS_IN_PduGroup6_7933cc8b
            BswMAvailableActions
              BswMPduGroupSwitch: BswMPduGroupSwitchReinit=false, BswMDisabledPduGroupRef=EPS_IN_PduGroup6_7933cc8b
          CC_DisablePDUGroup_EPS_IN_PduGroup_7933cc8b
            BswMAvailableActions
              BswMPduGroupSwitch: BswMPduGroupSwitchReinit=false, BswMDisabledPduGroupRef=EPS_IN_PduGroup_7933cc8b
          CC_DisablePDUGroup_EPS_IN_PduGroup5_7933cc8b
            BswMAvailableActions
              BswMPduGroupSwitch: BswMPduGroupSwitchReinit=false, BswMDisabledPduGroupRef=EPS_IN_PduGroup5_7933cc8b
          CC_DisablePDUGroup_EPS_IN_PduGroup2_7933cc8b
            BswMAvailableActions
              BswMPduGroupSwitch: BswMPduGroupSwitchReinit=false, BswMDisabledPduGroupRef=EPS_IN_PduGroup2_7933cc8b
          CC_DisablePDUGroup_EPS_IN_PduGroup7_7933cc8b
            BswMAvailableActions
              BswMPduGroupSwitch: BswMPduGroupSwitchReinit=false, BswMDisabledPduGroupRef=EPS_IN_PduGroup7_7933cc8b
        CC_AL_A_FlexRay_5b5a9ac2_RX_EnableNoinit (BswMActionList): BswMActionListExecution=BSWM_TRIGGER
          10 x BswMActionListItem, all with BswMAbortOnFail=false:
            CC_EnablePDUGroup_EPS_IN_PduGroup3_7933cc8b: BswMActionListItemIndex=0, BswMActionListItemRef=BswMModeControl/CC_EnablePDUGroup_EPS_IN_PduGroup3_7933cc8b
            CC_EnablePDUGroup_EPS_IN_PduGroup9_7933cc8b: BswMActionListItemIndex=1, BswMActionListItemRef=BswMModeControl/CC_EnablePDUGroup_EPS_IN_PduGroup9_7933cc8b
            CC_EnablePDUGroup_EPS_IN_PduGroup4_7933cc8b: BswMActionListItemIndex=2, BswMActionListItemRef=BswMModeControl/CC_EnablePDUGroup_EPS_IN_PduGroup4_7933cc8b
            CC_EnablePDUGroup_EPS_IN_PduGroup10_7933cc8b: BswMActionListItemIndex=3, BswMActionListItemRef=BswMModeControl/CC_EnablePDUGroup_EPS_IN_PduGroup10_7933cc8b
            CC_EnablePDUGroup_EPS_IN_PduGroup8_7933cc8b: BswMActionListItemIndex=4, BswMActionListItemRef=BswMModeControl/CC_EnablePDUGroup_EPS_IN_PduGroup8_7933cc8b
            CC_EnablePDUGroup_EPS_IN_PduGroup6_7933cc8b: BswMActionListItemIndex=5, BswMActionListItemRef=BswMModeControl/CC_EnablePDUGroup_EPS_IN_PduGroup6_7933cc8b
            CC_EnablePDUGroup_EPS_IN_PduGroup_7933cc8b: BswMActionListItemIndex=6, BswMActionListItemRef=BswMModeControl/CC_EnablePDUGroup_EPS_IN_PduGroup_7933cc8b
            CC_EnablePDUGroup_EPS_IN_PduGroup5_7933cc8b: BswMActionListItemIndex=7, BswMActionListItemRef=BswMModeControl/CC_EnablePDUGroup_EPS_IN_PduGroup5_7933cc8b
            CC_EnablePDUGroup_EPS_IN_PduGroup2_7933cc8b: BswMActionListItemIndex=8, BswMActionListItemRef=BswMModeControl/CC_EnablePDUGroup_EPS_IN_PduGroup2_7933cc8b
            CC_EnablePDUGroup_EPS_IN_PduGroup7_7933cc8b: BswMActionListItemIndex=9, BswMActionListItemRef=BswMModeControl/CC_EnablePDUGroup_EPS_IN_PduGroup7_7933cc8b
        13 x BswMAction:
          CC_EnablePDUGroup_EPS_IN_PduGroup3_7933cc8b
            BswMAvailableActions
              BswMPduGroupSwitch: BswMPduGroupSwitchReinit=false, BswMEnabledPduGroupRef=EPS_IN_PduGroup3_7933cc8b
          CC_EnablePDUGroup_EPS_IN_PduGroup9_7933cc8b
            BswMAvailableActions
              BswMPduGroupSwitch: BswMPduGroupSwitchReinit=false, BswMEnabledPduGroupRef=EPS_IN_PduGroup9_7933cc8b
          CC_EnablePDUGroup_EPS_IN_PduGroup4_7933cc8b
            BswMAvailableActions
              BswMPduGroupSwitch: BswMPduGroupSwitchReinit=false, BswMEnabledPduGroupRef=EPS_IN_PduGroup4_7933cc8b
          CC_EnablePDUGroup_EPS_IN_PduGroup10_7933cc8b
            BswMAvailableActions
              BswMPduGroupSwitch: BswMPduGroupSwitchReinit=false, BswMEnabledPduGroupRef=EPS_IN_PduGroup10_7933cc8b
          CC_EnablePDUGroup_EPS_IN_PduGroup8_7933cc8b
            BswMAvailableActions
              BswMPduGroupSwitch: BswMPduGroupSwitchReinit=false, BswMEnabledPduGroupRef=EPS_IN_PduGroup8_7933cc8b
          CC_EnablePDUGroup_EPS_IN_PduGroup6_7933cc8b
            BswMAvailableActions
              BswMPduGroupSwitch: BswMPduGroupSwitchReinit=false, BswMEnabledPduGroupRef=EPS_IN_PduGroup6_7933cc8b
          CC_EnablePDUGroup_EPS_IN_PduGroup_7933cc8b
            BswMAvailableActions
              BswMPduGroupSwitch: BswMPduGroupSwitchReinit=false, BswMEnabledPduGroupRef=EPS_IN_PduGroup_7933cc8b
          CC_EnablePDUGroup_EPS_IN_PduGroup5_7933cc8b
            BswMAvailableActions
              BswMPduGroupSwitch: BswMPduGroupSwitchReinit=false, BswMEnabledPduGroupRef=EPS_IN_PduGroup5_7933cc8b
          CC_EnablePDUGroup_EPS_IN_PduGroup2_7933cc8b
            BswMAvailableActions
              BswMPduGroupSwitch: BswMPduGroupSwitchReinit=false, BswMEnabledPduGroupRef=EPS_IN_PduGroup2_7933cc8b
          CC_EnablePDUGroup_EPS_IN_PduGroup7_7933cc8b
            BswMAvailableActions
              BswMPduGroupSwitch: BswMPduGroupSwitchReinit=false, BswMEnabledPduGroupRef=EPS_IN_PduGroup7_7933cc8b
          BSWM_FULL_COM_USR_A_FlexRay_5b5a9ac2
            BswMAvailableActions
              BswMComMModeSwitch: BswMComMRequestedMode=BSWM_FULL_COM, BswMComMUserRef=USR_A_FlexRay_5b5a9ac2
          INIT_Action_EnableInterrupts
            BswMAvailableActions
              BswMUserCallout: BswMUserCalloutFunction=BswM_AL_SetProgrammableInterrupts(), BswMCreateCallout=true
          BswMUserCallout
            BswMAvailableActions
              BswMUserCallout: BswMUserCalloutFunction=ApplFr_DetFilter(), BswMCreateCallout=false
      BswMArbitration
        LogEx_CodingReset (BswMLogicalExpression): BswMArgumentRef=BswMModeCondition
        Rule_DcmCodingReset (BswMRule):
          BswMNestedExecutionOnly = false
          BswMRuleInitState = BSWM_FALSE
          BswMRuleId = 20
          BswMRuleExpressionRef = LogEx_CodingReset
          BswMRuleTrueActionList = AL_CodingResetExecution
        SWCModeSwitch_IS_EcuRunState (BswMModeRequestPort): BswMRequestProcessing=BSWM_DEFERRED, BswMArbitrateOnInit=true  # Annotation PLAIN_TEXT Contains the global RUN-State of the ECU => Rules for Starting/Stopping modules do not interfere with rules for Starting/Stopping during runtime, e.g. for Partion Networking
          BswMModeRequestSource
            BswMSwcModeNotification: BswMSwcModeNotificationModeDeclarationGroupPrototypeRef=EcuRunStateMode
          BswMModeInitValue
            BswMSwcModeInitValue: BswMSwcModeInitValueRef=IntegrationSample_BSW_START
        Rule_Dlog_Init_when_IS_Startup (BswMRule):
          BswMNestedExecutionOnly = false
          BswMRuleInitState = BSWM_FALSE
          BswMRuleId = 22
          BswMRuleExpressionRef = LogEx_Dlog_Init
          BswMRuleTrueActionList = AL_Rule_Dlog_Init_True
        LogEx_Dlog_Init (BswMLogicalExpression):
          BswMLogicalOperator = BSWM_AND
          BswMArgumentRef = Condition_SWCModeSwitch_Dlog_is_STOPPED
          BswMArgumentRef = Condition_SWCModeSwitch_IS_EcuRunState_BSWM_EQUALS_IntegrationSample_STARTUP
        Condition_Dlog_Lifecycle_is_Run (BswMModeCondition): BswMConditionType=BSWM_EQUALS, BswMConditionMode=SWCModeSwitch_Lifecycle_Dlog
          BswMConditionValue
            BswMModeDeclaration: BswMModeValueRef=DLOG_RUNNING
        SWCModeSwitch_Lifecycle_Dlog (BswMModeRequestPort): BswMRequestProcessing=BSWM_DEFERRED, BswMArbitrateOnInit=true
          BswMModeRequestSource
            BswMSwcModeNotification: BswMSwcModeNotificationModeDeclarationGroupPrototypeRef=Mode
          BswMModeInitValue
            BswMSwcModeInitValue: BswMSwcModeInitValueRef=DLOG_INITIALIZED
        Rule_Dlog_Run_when_Dlog_Init (BswMRule):
          BswMNestedExecutionOnly = false
          BswMRuleInitState = BSWM_FALSE
          BswMRuleId = 23
          BswMRuleExpressionRef = LogEx_Dlog_Lifecycle_Init
          BswMRuleTrueActionList = AL_Rule_Dlog_Run_True
        Condition_Dlog_Lifecycle_Mode_is_INIT (BswMModeCondition): BswMConditionType=BSWM_EQUALS, BswMConditionMode=SWCModeSwitch_Lifecycle_Dlog
          BswMConditionValue
            BswMModeDeclaration: BswMModeValueRef=DLOG_INITIALIZED
        LogEx_Dlog_Lifecycle_Init (BswMLogicalExpression):
          BswMLogicalOperator = BSWM_AND
          BswMArgumentRef = Condition_Dlog_Lifecycle_Mode_is_INIT
          BswMArgumentRef = Condition_SWCModeSwitch_IS_EcuRunState_BSWM_EQUALS_IntegrationSample_STARTUP
        SWCModeSwitch_Lifecycle_Darh (BswMModeRequestPort): BswMRequestProcessing=BSWM_DEFERRED, BswMArbitrateOnInit=true
          BswMModeRequestSource
            BswMSwcModeNotification: BswMSwcModeNotificationModeDeclarationGroupPrototypeRef=Mode
          BswMModeInitValue
            BswMSwcModeInitValue: BswMSwcModeInitValueRef=DARH_STOPPED
        Rule_Start_Omc_Init_when_Darh_Run (BswMRule):
          BswMNestedExecutionOnly = false
          BswMRuleInitState = BSWM_FALSE
          BswMRuleId = 33
          BswMRuleExpressionRef = LogEx_Start_Omc_Init_when_Darh_Run
          BswMRuleTrueActionList = AL_Rule_Start_Omc_Init_when_Darh_Run_True
        Condition_SWCModeSwitch_Mode_BSWM_EQUALS_DARH_RUNNING (BswMModeCondition): BswMConditionType=BSWM_EQUALS, BswMConditionMode=SWCModeSwitch_Lifecycle_Darh
          BswMConditionValue
            BswMModeDeclaration: BswMModeValueRef=DARH_RUNNING
        LogEx_Start_Omc_Init_when_Darh_Run (BswMLogicalExpression):
          BswMLogicalOperator = BSWM_AND
          BswMArgumentRef = Condition_SWCModeSwitch_Mode_BSWM_EQUALS_DARH_RUNNING
          BswMArgumentRef = Condition_SWCModeSwitch_IS_EcuRunState_BSWM_EQUALS_IntegrationSample_STARTUP
          BswMArgumentRef = Condition_SWCModeSwitch_Lifecycle_Omc_BSWM_EQUALS_OMC_STOPPED
        SWCModeSwitch_Lifecycle_Omc (BswMModeRequestPort): BswMRequestProcessing=BSWM_DEFERRED, BswMArbitrateOnInit=true
          BswMModeRequestSource
            BswMSwcModeNotification: BswMSwcModeNotificationModeDeclarationGroupPrototypeRef=Mode
          BswMModeInitValue
            BswMSwcModeInitValue: BswMSwcModeInitValueRef=OMC_STOPPED
        Rule_Start_StdDiag_Init_when_Omc_Run (BswMRule):
          BswMNestedExecutionOnly = false
          BswMRuleInitState = BSWM_FALSE
          BswMRuleId = 35
          BswMRuleExpressionRef = LogEx_Start_StdDiag_Init_when_Omc_Run_and_Dlog_Run
          BswMRuleTrueActionList = AL_Rule_Start_StdDiag_Init_when_Omc_Run_True
        Condition_SWCModeSwitch_Mode_BSWM_EQUALS_OMC_RUNNING (BswMModeCondition): BswMConditionType=BSWM_EQUALS, BswMConditionMode=SWCModeSwitch_Lifecycle_Omc
          BswMConditionValue
            BswMModeDeclaration: BswMModeValueRef=OMC_RUNNING
        LogEx_Start_StdDiag_Init_when_Omc_Run_and_Dlog_Run (BswMLogicalExpression):
          BswMLogicalOperator = BSWM_AND
          BswMArgumentRef = Condition_SWCModeSwitch_Mode_BSWM_EQUALS_OMC_RUNNING
          BswMArgumentRef = Condition_Dlog_Lifecycle_is_Run
          BswMArgumentRef = Condition_SWCModeSwitch_IS_EcuRunState_BSWM_EQUALS_IntegrationSample_STARTUP
          BswMArgumentRef = Condition_SWCModeSwitch_Lifecycle_StdDiag_BSWM_EQUALS_STDDIAG_STOPPED
        Rule_Start_Darh_Run_when_Darh_Init (BswMRule):
          BswMNestedExecutionOnly = false
          BswMRuleInitState = BSWM_FALSE
          BswMRuleId = 32
          BswMRuleExpressionRef = LogEx_Darh_Init_to_Run
          BswMRuleTrueActionList = AL_RuleDarh_Init_to_Run_True
        Condition_SWCModeSwitch_Mode_Darh_BSWM_EQUALS_DARH_INITIALIZED (BswMModeCondition): BswMConditionType=BSWM_EQUALS, BswMConditionMode=SWCModeSwitch_Lifecycle_Darh
          BswMConditionValue
            BswMModeDeclaration: BswMModeValueRef=DARH_INITIALIZED
        LogEx_Darh_Init_to_Run (BswMLogicalExpression):
          BswMLogicalOperator = BSWM_AND
          BswMArgumentRef = Condition_SWCModeSwitch_Mode_Darh_BSWM_EQUALS_DARH_INITIALIZED
          BswMArgumentRef = Condition_SWCModeSwitch_IS_EcuRunState_BSWM_EQUALS_IntegrationSample_STARTUP
        Rule_Start_Omc_Run_when_Omc_Init (BswMRule):
          BswMNestedExecutionOnly = false
          BswMRuleInitState = BSWM_FALSE
          BswMRuleId = 34
          BswMRuleExpressionRef = LogEx_Start_Omc_Run_when_Omc_Init
          BswMRuleTrueActionList = AL_Rule_Start_Omc_Run_when_Omc_Init_True
        Condition_SWCModeSwitch_Mode_Omc_BSWM_EQUALS_OMC_INITIALIZED (BswMModeCondition): BswMConditionType=BSWM_EQUALS, BswMConditionMode=SWCModeSwitch_Lifecycle_Omc
          BswMConditionValue
            BswMModeDeclaration: BswMModeValueRef=OMC_INITIALIZED
        LogEx_Start_Omc_Run_when_Omc_Init (BswMLogicalExpression):
          BswMLogicalOperator = BSWM_AND
          BswMArgumentRef = Condition_SWCModeSwitch_Mode_Omc_BSWM_EQUALS_OMC_INITIALIZED
          BswMArgumentRef = Condition_SWCModeSwitch_IS_EcuRunState_BSWM_EQUALS_IntegrationSample_STARTUP
        SWCModeSwitch_Lifecycle_Systime (BswMModeRequestPort): BswMRequestProcessing=BSWM_DEFERRED, BswMArbitrateOnInit=true
          BswMModeRequestSource
            BswMSwcModeNotification: BswMSwcModeNotificationModeDeclarationGroupPrototypeRef=Mode
          BswMModeInitValue
            BswMSwcModeInitValue: BswMSwcModeInitValueRef=SYSTIME_STOPPED
        SWCModeSwitch_Lifecycle_StdDiag (BswMModeRequestPort): BswMRequestProcessing=BSWM_DEFERRED, BswMArbitrateOnInit=true
          BswMModeRequestSource
            BswMSwcModeNotification: BswMSwcModeNotificationModeDeclarationGroupPrototypeRef=Mode
          BswMModeInitValue
            BswMSwcModeInitValue: BswMSwcModeInitValueRef=STDDIAG_STOPPED
        Rule_Start_StdDiag_Run_when_StdDiag_Init (BswMRule):
          BswMNestedExecutionOnly = false
          BswMRuleInitState = BSWM_FALSE
          BswMRuleId = 36
          BswMRuleExpressionRef = LogEx_Start_StdDiag_Run_when_StdDiag_Init
          BswMRuleTrueActionList = AL_Rule_Start_StdDiag_Run_when_StdDiag_Init_True
        Condition_SWCModeSwitch_Mode_BSWM_EQUALS_STDDIAG_INITIALIZED (BswMModeCondition): BswMConditionType=BSWM_EQUALS, BswMConditionMode=SWCModeSwitch_Lifecycle_StdDiag
          BswMConditionValue
            BswMModeDeclaration: BswMModeValueRef=STDDIAG_INITIALIZED
        LogEx_Start_StdDiag_Run_when_StdDiag_Init (BswMLogicalExpression):
          BswMLogicalOperator = BSWM_AND
          BswMArgumentRef = Condition_SWCModeSwitch_Mode_BSWM_EQUALS_STDDIAG_INITIALIZED
          BswMArgumentRef = Condition_SWCModeSwitch_IS_EcuRunState_BSWM_EQUALS_IntegrationSample_STARTUP
        Rule_Start_Systime_Run_when_Systime_Init (BswMRule):
          BswMNestedExecutionOnly = false
          BswMRuleInitState = BSWM_FALSE
          BswMRuleId = 37
          BswMRuleExpressionRef = LogEx_Start_Systime_Run_when_Systime_Init
          BswMRuleTrueActionList = AL_Rule_Start_Systime_Run_when_Systime_Init_True
        Condition_SWCModeSwitch_Mode_BSWM_EQUALS_SYSTIME_INITIALIZED (BswMModeCondition): BswMConditionType=BSWM_EQUALS, BswMConditionMode=SWCModeSwitch_Lifecycle_Systime
          BswMConditionValue
            BswMModeDeclaration: BswMModeValueRef=SYSTIME_INITIALIZED
        LogEx_Start_Systime_Run_when_Systime_Init (BswMLogicalExpression):
          BswMLogicalOperator = BSWM_AND
          BswMArgumentRef = Condition_SWCModeSwitch_Mode_BSWM_EQUALS_SYSTIME_INITIALIZED
          BswMArgumentRef = Condition_SWCModeSwitch_IS_EcuRunState_BSWM_EQUALS_IntegrationSample_STARTUP
          BswMArgumentRef = Condition_ComMModeInd_BAC4_FlexRay_8e151c3c_BSWM_EQUALS_COMM_FULL_COMMUNICATION
        BSWModeSwitch_DcmEcuReset (BswMModeRequestPort): BswMRequestProcessing=BSWM_DEFERRED, BswMArbitrateOnInit=true
          BswMModeRequestSource
            BswMSwcModeNotification: BswMSwcModeNotificationModeDeclarationGroupPrototypeRef=DcmEcuReset
          BswMModeInitValue
            BswMSwcModeInitValue: BswMSwcModeInitValueRef=NONE
        Rule_DcmEcuReset (BswMRule):
          BswMNestedExecutionOnly = false
          BswMRuleInitState = BSWM_FALSE
          BswMRuleId = 21
          BswMRuleExpressionRef = LogEx_DcmEcuReset
          BswMRuleTrueActionList = BswMModeControl/AL_ResetExecution
        Condition_DcmEcuReset_BSWM_EQUALS_EXECUTE (BswMModeCondition): BswMConditionType=BSWM_EQUALS, BswMConditionMode=BSWModeSwitch_DcmEcuReset
          BswMConditionValue
            BswMModeDeclaration: BswMModeValueRef=EXECUTE
        LogEx_DcmEcuReset (BswMLogicalExpression):
          BswMLogicalOperator = BSWM_AND
          BswMArgumentRef = Condition_DcmEcuReset_BSWM_EQUALS_EXECUTE
          BswMArgumentRef = Condition_SWCModeSwitch_IS_EcuRunState_BSWM_EQUALS_IntegrationSample_NORMAL_OPERATION
        BSWModeSwitch_DcmDiagnosticSessionControl (BswMModeRequestPort): BswMRequestProcessing=BSWM_DEFERRED, BswMArbitrateOnInit=true
          BswMModeRequestSource
            BswMSwcModeNotification: BswMSwcModeNotificationModeDeclarationGroupPrototypeRef=DcmDiagnosticSessionControl
          BswMModeInitValue
            BswMSwcModeInitValue: BswMSwcModeInitValueRef=DEFAULT_SESSION
        Condition_SWCModeSwitch_Dlog_is_STOPPED (BswMModeCondition): BswMConditionType=BSWM_EQUALS, BswMConditionMode=SWCModeSwitch_Lifecycle_Dlog
          BswMConditionValue
            BswMModeDeclaration: BswMModeValueRef=DLOG_STOPPED
        Condition_SWCModeSwitch_IS_EcuRunState_BSWM_EQUALS_IntegrationSample_STARTUP (BswMModeCondition): BswMConditionType=BSWM_EQUALS, BswMConditionMode=SWCModeSwitch_IS_EcuRunState
          BswMConditionValue
            BswMModeDeclaration: BswMModeValueRef=IntegrationSample_STARTUP
        Rule_Systime_Init (BswMRule):
          BswMNestedExecutionOnly = false
          BswMRuleInitState = BSWM_FALSE
          BswMRuleId = 39
          BswMRuleExpressionRef = LogEx_Set_Systime_Init
          BswMRuleTrueActionList = AL_Rule_Systime_Init_True
        LogEx_Set_Systime_Init (BswMLogicalExpression):
          BswMLogicalOperator = BSWM_AND
          BswMArgumentRef = Condition_SWCModeSwitch_Lifecycle_Systime_is_STOPPED
          BswMArgumentRef = Condition_SWCModeSwitch_IS_EcuRunState_BSWM_EQUALS_IntegrationSample_STARTUP
        Condition_SWCModeSwitch_Lifecycle_Systime_is_STOPPED (BswMModeCondition): BswMConditionType=BSWM_EQUALS, BswMConditionMode=SWCModeSwitch_Lifecycle_Systime
          BswMConditionValue
            BswMModeDeclaration: BswMModeValueRef=SYSTIME_STOPPED
        Rule_Darh_Init (BswMRule):
          BswMNestedExecutionOnly = false
          BswMRuleInitState = BSWM_FALSE
          BswMRuleId = 19
          BswMRuleExpressionRef = LogEx_Darh_Init
          BswMRuleTrueActionList = AL_Rule_Darh_Init_True
        LogEx_Darh_Init (BswMLogicalExpression):
          BswMLogicalOperator = BSWM_AND
          BswMArgumentRef = Condition_SWCModeSwitch_Dlog_is_STOPPED
          BswMArgumentRef = Condition_SWCModeSwitch_IS_EcuRunState_BSWM_EQUALS_IntegrationSample_STARTUP
        Condition_SWCModeSwitch_IS_EcuRunState_BSWM_EQUALS_IntegrationSample_NORMAL_OPERATION (BswMModeCondition): BswMConditionType=BSWM_EQUALS, BswMConditionMode=SWCModeSwitch_IS_EcuRunState
          BswMConditionValue
            BswMModeDeclaration: BswMModeValueRef=IntegrationSample_NORMAL_OPERATION
        SWCModeSwitch_DcmCommunicationControl_ComMConf_ComMChannel_BAC4_FlexRay_8e151c3c (BswMModeRequestPort): BswMArbitrateOnInit=true, BswMRequestProcessing=BSWM_DEFERRED
          BswMModeRequestSource
            BswMSwcModeNotification: BswMSwcModeNotificationModeDeclarationGroupPrototypeRef=DcmCommunicationControl_ComMConf_ComMChannel_A_FlexRay_5b5a9ac2
          BswMModeInitValue
            BswMSwcModeInitValue: BswMSwcModeInitValueRef=DCM_ENABLE_RX_TX_NORM_NM
        Condition_SWCModeSwitch_DcmCommunicationControl_FR_BSWM_EQUALS_DCM_ENABLE_RX_TX_NORM (BswMModeCondition): BswMConditionType=BSWM_EQUALS, BswMConditionMode=SWCModeSwitch_DcmCommunicationControl_ComMConf_ComMChannel_BAC4_FlexRay_8e151c3c
          BswMConditionValue
            BswMModeDeclaration: BswMModeValueRef=DCM_ENABLE_RX_TX_NORM
        Condition_SWCModeSwitch_DcmCommunicationControl_FR_BSWM_EQUALS_DCM_ENABLE_RX_TX_NORM_NM (BswMModeCondition): BswMConditionType=BSWM_EQUALS, BswMConditionMode=SWCModeSwitch_DcmCommunicationControl_ComMConf_ComMChannel_BAC4_FlexRay_8e151c3c
          BswMConditionValue
            BswMModeDeclaration: BswMModeValueRef=DCM_ENABLE_RX_TX_NORM_NM
        ComMModeInd_BAC4_FlexRay_8e151c3c (BswMModeRequestPort): BswMArbitrateOnInit=true, BswMRequestProcessing=BSWM_IMMEDIATE
          BswMModeRequestSource
            BswMComMIndication: BswMComMChannelRef=A_FlexRay_5b5a9ac2
          BswMModeInitValue
            BswMBswModeInitValue: BswMBswModeInitValueMode=COMM_NO_COMMUNICATION
        Rule_ComM_Channel_is_FULL_COM (BswMRule):
          BswMNestedExecutionOnly = false
          BswMRuleId = 16
          BswMRuleInitState = BSWM_FALSE
          BswMRuleExpressionRef = LogEx_VinComMode
          BswMRuleTrueActionList = AL_ComM_Channel_is_FULL_COM
        Condition_ComMModeInd_BAC4_FlexRay_8e151c3c_BSWM_EQUALS_COMM_FULL_COMMUNICATION (BswMModeCondition): BswMConditionType=BSWM_EQUALS, BswMConditionMode=ComMModeInd_BAC4_FlexRay_8e151c3c
          BswMConditionValue
            BswMBswMode: BswMBswRequestedMode=COMM_FULL_COMMUNICATION
        LogEx_Set_DarhReportError_due_ComM_and_CEL_mode (BswMLogicalExpression):
          BswMLogicalOperator = BSWM_AND
          BswMArgumentRef = Condition_ComMModeInd_BAC4_FlexRay_8e151c3c_BSWM_EQUALS_COMM_FULL_COMMUNICATION
          BswMArgumentRef = Condition_SWCModeSwitch_currentCentralErrorLockMode_EQUALS_NOT_STM_CEL_LOCKED
        Rule_ComM_Channel_is_SILENT_COMMUNICATION (BswMRule):
          BswMNestedExecutionOnly = false
          BswMRuleId = 18
          BswMRuleInitState = BSWM_FALSE
          BswMRuleExpressionRef = LogEx_ComM_Channel_is_SILENT_COMMUNICATION
          BswMRuleTrueActionList = AL_ComM_Channel_is_SILENT_COMMUNICATION_BswMActionList_True
        Condition_ComMModeInd_BAC4_FlexRay_8e151c3c2_BSWM_EQUALS_COMM_SILENT_COMMUNICATION (BswMModeCondition): BswMConditionType=BSWM_EQUALS, BswMConditionMode=ComMModeInd_BAC4_FlexRay_8e151c3c
          BswMConditionValue
            BswMBswMode: BswMBswRequestedMode=COMM_SILENT_COMMUNICATION
        LogEx_ComM_Channel_is_SILENT_COMMUNICATION (BswMLogicalExpression): BswMArgumentRef=Condition_ComMModeInd_BAC4_FlexRay_8e151c3c2_BSWM_EQUALS_COMM_SILENT_COMMUNICATION
        Rule_Set_DarhReportError_due_ComM_and_CEL_mode (BswMRule):
          BswMNestedExecutionOnly = false
          BswMRuleId = 29
          BswMRuleInitState = BSWM_UNDEFINED
          BswMRuleExpressionRef = LogEx_Set_DarhReportError_due_ComM_and_CEL_mode
          BswMRuleTrueActionList = AL_Set_DarhReportError_due_ComM_and_CEL_mode_BswMActionList_True
          BswMRuleFalseActionList = AL_Set_DarhReportError_due_ComM_and_CEL_mode_BswMActionList_False
        SWCModeSwitch_currentCentralErrorLockMode (BswMModeRequestPort): BswMArbitrateOnInit=true, BswMRequestProcessing=BSWM_DEFERRED
          BswMModeRequestSource
            BswMSwcModeNotification: BswMSwcModeNotificationModeDeclarationGroupPrototypeRef=currentCentralErrorLockMode
          BswMModeInitValue
            BswMSwcModeInitValue: BswMSwcModeInitValueRef=STM_CEL_INVALID
        Condition_SWCModeSwitch_currentCentralErrorLockMode_EQUALS_NOT_STM_CEL_LOCKED (BswMModeCondition): BswMConditionType=BSWM_EQUALS_NOT, BswMConditionMode=SWCModeSwitch_currentCentralErrorLockMode
          BswMConditionValue
            BswMModeDeclaration: BswMModeValueRef=STM_CEL_LOCKED
        Rule_Switch_StdDiagSessionChangeIndication (BswMRule):
          BswMNestedExecutionOnly = false
          BswMRuleId = 38
          BswMRuleInitState = BSWM_FALSE
          BswMRuleExpressionRef = LogEx_Switch_StdDiagSessionChangeIndication
          BswMRuleTrueActionList = AL_Switch_StdDiagSessionChangeIndication_True
          BswMRuleFalseActionList = AL_Switch_StdDiagSessionChangeIndication_False
        Condition_BSWModeSwitch_DcmDiagnosticSessionControl_BSWM_EQUALS_DefaultSession (BswMModeCondition): BswMConditionType=BSWM_EQUALS, BswMConditionMode=BSWModeSwitch_DcmDiagnosticSessionControl
          BswMConditionValue
            BswMModeDeclaration: BswMModeValueRef=DEFAULT_SESSION
        LogEx_Switch_StdDiagSessionChangeIndication (BswMLogicalExpression): BswMArgumentRef=Condition_BSWModeSwitch_DcmDiagnosticSessionControl_BSWM_EQUALS_DefaultSession
        4 x BswMModeCondition, all with BswMConditionType=BSWM_EQUALS, BswMConditionMode=SWCModeSwitch_DcmCommunicationControl_ComMConf_ComMChannel_BAC4_FlexRay_8e151c3c:
          Condition_SWCModeSwitch_DcmCommunicationControl_FR_BSWM_EQUALS_DCM_ENABLE_RX_DISABLE_TX_NORM
            BswMConditionValue
              BswMModeDeclaration: BswMModeValueRef=DCM_ENABLE_RX_DISABLE_TX_NORM
          Condition_SWCModeSwitch_DcmCommunicationControl_FR_BSWM_EQUALS_DCM_DISABLE_RX_ENABLE_TX_NORM
            BswMConditionValue
              BswMModeDeclaration: BswMModeValueRef=DCM_DISABLE_RX_ENABLE_TX_NORM
          Condition_SWCModeSwitch_DcmCommunicationControl_FR_BSWM_EQUALS_DCM_ENABLE_RX_DISABLE_TX_NORM_NM
            BswMConditionValue
              BswMModeDeclaration: BswMModeValueRef=DCM_ENABLE_RX_DISABLE_TX_NORM_NM
          Condition_SWCModeSwitch_DcmCommunicationControl_FR_BSWM_EQUALS_DCM_DISABLE_RX_ENABLE_TX_NORM_NM
            BswMConditionValue
              BswMModeDeclaration: BswMModeValueRef=DCM_DISABLE_RX_ENABLE_TX_NORM_NM
        SWCModeReq_StdDiag_CommunicationModeDeclarationGroup (BswMModeRequestPort): BswMArbitrateOnInit=true, BswMRequestProcessing=BSWM_IMMEDIATE
          BswMModeRequestSource
            BswMSwcModeRequest: BswMSwcModeRequestPortInterfaceRef=StdDiag_Swc.ComControlModeRequestPort.requestedMode
          BswMModeInitValue
            BswMSwcModeInitValue: BswMSwcModeInitValueRef=ENABLE_RX_AND_TX_NORMAL
        4 x BswMModeCondition, all with BswMConditionType=BSWM_EQUALS:
          Condition_SWCModeReq_StdDiag_CommunicationMDG_IS_ENABLE_RX_AND_TX_NORMAL: BswMConditionMode=SWCModeReq_StdDiag_CommunicationModeDeclarationGroup
            BswMConditionValue
              BswMModeDeclaration: BswMModeValueRef=ENABLE_RX_AND_TX_NORMAL
          Condition_SWCModeReq_StdDiag_CommunicationMDG_IS_ENABLE_RX_DISABLE_TX_NORMAL: BswMConditionMode=SWCModeReq_StdDiag_CommunicationModeDeclarationGroup
            BswMConditionValue
              BswMModeDeclaration: BswMModeValueRef=ENABLE_RX_DISABLE_TX_NORMAL
          Condition_SWCModeReq_StdDiag_CommunicationMDG_IS_DISABLE_RX_ENABLE_TX_NORMAL: BswMConditionMode=SWCModeReq_StdDiag_CommunicationModeDeclarationGroup
            BswMConditionValue
              BswMModeDeclaration: BswMModeValueRef=DISABLE_RX_ENABLE_TX_NORMAL
          Condition_ComMModeInd_BAC4_FlexRay_8e151c3c_BSWM_EQUALS_COMM_NO_COMMUNICATION: BswMConditionMode=ComMModeInd_BAC4_FlexRay_8e151c3c
            BswMConditionValue
              BswMBswMode: BswMBswRequestedMode=COMM_NO_COMMUNICATION
        13 x BswMLogicalExpression:
          LogEx_ComM_Channel_is_NO_COM: BswMArgumentRef=Condition_ComMModeInd_BAC4_FlexRay_8e151c3c_BSWM_EQUALS_COMM_NO_COMMUNICATION
          LogEx_NDC_Dcm_Tx_Enabled: BswMLogicalOperator=BSWM_OR, BswMArgumentRef=Condition_SWCModeSwitch_DcmCommunicationControl_FR_BSWM_EQUALS_DCM_DISABLE_RX_ENABLE_TX_NORM, BswMArgumentRef=Condition_SWCModeSwitch_DcmCommunicationControl_FR_BSWM_EQUALS_DCM_DISABLE_RX_ENABLE_TX_NORM_NM, BswMArgumentRef=Condition_SWCModeSwitch_DcmCommunicationControl_FR_BSWM_EQUALS_DCM_ENABLE_RX_TX_NORM, BswMArgumentRef=Condition_SWCModeSwitch_DcmCommunicationControl_FR_BSWM_EQUALS_DCM_ENABLE_RX_TX_NORM_NM
          LogEx_NDC_StdDiag_Tx_Enabled: BswMLogicalOperator=BSWM_OR, BswMArgumentRef=Condition_SWCModeReq_StdDiag_CommunicationMDG_IS_DISABLE_RX_ENABLE_TX_NORMAL, BswMArgumentRef=Condition_SWCModeReq_StdDiag_CommunicationMDG_IS_ENABLE_RX_AND_TX_NORMAL
          LogEx_NDC_Dcm_Rx_Enabled: BswMLogicalOperator=BSWM_OR, BswMArgumentRef=Condition_SWCModeSwitch_DcmCommunicationControl_FR_BSWM_EQUALS_DCM_ENABLE_RX_DISABLE_TX_NORM, BswMArgumentRef=Condition_SWCModeSwitch_DcmCommunicationControl_FR_BSWM_EQUALS_DCM_ENABLE_RX_DISABLE_TX_NORM_NM, BswMArgumentRef=Condition_SWCModeSwitch_DcmCommunicationControl_FR_BSWM_EQUALS_DCM_ENABLE_RX_TX_NORM, BswMArgumentRef=Condition_SWCModeSwitch_DcmCommunicationControl_FR_BSWM_EQUALS_DCM_ENABLE_RX_TX_NORM_NM
          LogEx_NDC_StdDiag_Rx_Enabled: BswMLogicalOperator=BSWM_OR, BswMArgumentRef=Condition_SWCModeReq_StdDiag_CommunicationMDG_IS_ENABLE_RX_AND_TX_NORMAL, BswMArgumentRef=Condition_SWCModeReq_StdDiag_CommunicationMDG_IS_ENABLE_RX_DISABLE_TX_NORMAL
          LogEx_NDC_Rx_Enabled: BswMLogicalOperator=BSWM_AND, BswMArgumentRef=LogEx_NDC_Dcm_Rx_Enabled, BswMArgumentRef=LogEx_NDC_StdDiag_Rx_Enabled
          LogEx_NDC_Tx_Enabled: BswMLogicalOperator=BSWM_AND, BswMArgumentRef=LogEx_NDC_Dcm_Tx_Enabled, BswMArgumentRef=LogEx_NDC_StdDiag_Tx_Enabled
          LogEx_NDC_Rx_Disabled: BswMLogicalOperator=BSWM_NAND, BswMArgumentRef=LogEx_NDC_Dcm_Rx_Enabled, BswMArgumentRef=LogEx_NDC_StdDiag_Rx_Enabled
          LogEx_NDC_Tx_Disabled: BswMLogicalOperator=BSWM_NAND, BswMArgumentRef=LogEx_NDC_Dcm_Tx_Enabled, BswMArgumentRef=LogEx_NDC_StdDiag_Tx_Enabled
          LogEx_NDC_Rx_Enabled_Tx_Enabled: BswMLogicalOperator=BSWM_AND, BswMArgumentRef=LogEx_NDC_Rx_Enabled, BswMArgumentRef=LogEx_NDC_Tx_Enabled
          LogEx_NDC_Rx_Enabled_Tx_Disabled: BswMLogicalOperator=BSWM_AND, BswMArgumentRef=LogEx_NDC_Rx_Enabled, BswMArgumentRef=LogEx_NDC_Tx_Disabled
          LogEx_NDC_Rx_Disabled_Tx_Enabled: BswMLogicalOperator=BSWM_AND, BswMArgumentRef=LogEx_NDC_Rx_Disabled, BswMArgumentRef=LogEx_NDC_Tx_Enabled
          LogEx_NDC_Rx_Disabled_Tx_Disabled: BswMLogicalOperator=BSWM_AND, BswMArgumentRef=LogEx_NDC_Rx_Disabled, BswMArgumentRef=LogEx_NDC_Tx_Disabled
        4 x BswMRule, all with BswMNestedExecutionOnly=false, BswMRuleInitState=BSWM_FALSE:
          Rule_NDC_Enable_Rx_Enable_Tx: BswMRuleId=27, BswMRuleExpressionRef=LogEx_NDC_Rx_Enabled_Tx_Enabled, BswMRuleTrueActionList=AL_NDC_Enable_RX_AND_TX_NORMAL
          Rule_NDC_Enable_Rx_Disable_Tx: BswMRuleId=26, BswMRuleExpressionRef=LogEx_NDC_Rx_Enabled_Tx_Disabled, BswMRuleTrueActionList=AL_NDC_Enable_RX_Disable_TX_NORMAL
          Rule_NDC_Disable_Rx_Enable_Tx: BswMRuleId=25, BswMRuleExpressionRef=LogEx_NDC_Rx_Disabled_Tx_Enabled, BswMRuleTrueActionList=AL_NDC_Disable_RX_Enable_TX_NORMAL
          Rule_NDC_Disable_Rx_Disable_Tx: BswMRuleId=24, BswMRuleExpressionRef=LogEx_NDC_Rx_Disabled_Tx_Disabled, BswMRuleTrueActionList=AL_NDC_Disable_Rx_And_Tx_Normal
        LogEx_VinComMode (BswMLogicalExpression):
          BswMLogicalOperator = BSWM_AND
          BswMArgumentRef = Condition_ComMModeInd_BAC4_FlexRay_8e151c3c_BSWM_EQUALS_COMM_FULL_COMMUNICATION
          BswMArgumentRef = LogEx_NDC_Rx_Enabled_Tx_Enabled
        Rule_Shutdown (BswMRule):
          BswMNestedExecutionOnly = false
          BswMRuleId = 31
          BswMRuleInitState = BSWM_FALSE
          BswMRuleExpressionRef = LogEx_Shutdown
          BswMRuleTrueActionList = BswMModeControl/AL_ResetExecution
        LogEx_Shutdown (BswMLogicalExpression): BswMLogicalOperator=BSWM_AND, BswMArgumentRef=Condition_SWCModeSwitch_IS_EcuRunState_BSWM_EQUALS_IntegrationSample_SHUTDOWN
        3 x BswMModeCondition, all with BswMConditionType=BSWM_EQUALS:
          Condition_SWCModeSwitch_IS_EcuRunState_BSWM_EQUALS_IntegrationSample_SHUTDOWN: BswMConditionMode=SWCModeSwitch_IS_EcuRunState
            BswMConditionValue
              BswMModeDeclaration: BswMModeValueRef=IntegrationSample_SHUTDOWN
          Condition_SWCModeSwitch_Lifecycle_Omc_BSWM_EQUALS_OMC_STOPPED: BswMConditionMode=SWCModeSwitch_Lifecycle_Omc
            BswMConditionValue
              BswMModeDeclaration: BswMModeValueRef=OMC_STOPPED
          Condition_SWCModeSwitch_Lifecycle_StdDiag_BSWM_EQUALS_STDDIAG_STOPPED: BswMConditionMode=SWCModeSwitch_Lifecycle_StdDiag
            BswMConditionValue
              BswMModeDeclaration: BswMModeValueRef=STDDIAG_STOPPED
        Rule_ComM_Channel_is_NO_COM (BswMRule):
          BswMNestedExecutionOnly = false
          BswMRuleId = 17
          BswMRuleInitState = BSWM_FALSE
          BswMRuleExpressionRef = LogEx_ComM_Channel_is_NO_COM
          BswMRuleTrueActionList = AL_ComM_Channel_is_NO_COM_BswMActionList_True
        Rule_Set_EcuRunMode_to_Normal_Operation_when_all_modules_run (BswMRule):
          BswMNestedExecutionOnly = false
          BswMRuleId = 30
          BswMRuleInitState = BSWM_FALSE
          BswMRuleExpressionRef = LogEx_Set_EcuRunMode_to_Normal_Operation_when_all_modules_run_BswMLogicalExpression
          BswMRuleTrueActionList = AL_Set_EcuRunMode_to_Normal_Operation_when_all_modules_run_BswMActionList_True
        LogEx_Set_EcuRunMode_to_Normal_Operation_when_all_modules_run_BswMLogicalExpression (BswMLogicalExpression):
          BswMLogicalOperator = BSWM_AND
          BswMArgumentRef = Condition_SWCModeSwitch_IS_EcuRunState_BSWM_EQUALS_IntegrationSample_STARTUP
          BswMArgumentRef = Condition_Dlog_Lifecycle_is_Run
          BswMArgumentRef = Condition_SWCModeSwitch_Mode_BSWM_EQUALS_DARH_RUNNING
          BswMArgumentRef = Condition_SWCModeSwitch_Mode_BSWM_EQUALS_OMC_RUNNING
          BswMArgumentRef = Condition_SWCModeSwitch_Lifecycle_Systime_BSWM_EQUALS_SYSTIME_RUNNING
          BswMArgumentRef = Condition_SWCModeSwitch_Lifecycle_StdDiag_BSWM_EQUALS_STDDIAG_RUNNING
        Condition_SWCModeSwitch_Lifecycle_Systime_BSWM_EQUALS_SYSTIME_RUNNING (BswMModeCondition): BswMConditionType=BSWM_EQUALS, BswMConditionMode=SWCModeSwitch_Lifecycle_Systime
          BswMConditionValue
            BswMModeDeclaration: BswMModeValueRef=SYSTIME_RUNNING
        Condition_SWCModeSwitch_Lifecycle_StdDiag_BSWM_EQUALS_STDDIAG_RUNNING (BswMModeCondition): BswMConditionType=BSWM_EQUALS, BswMConditionMode=SWCModeSwitch_Lifecycle_StdDiag
          BswMConditionValue
            BswMModeDeclaration: BswMModeValueRef=STDDIAG_RUNNING
        SWC_Mode_Notification_SimpleTimerMode (BswMModeRequestPort): BswMArbitrateOnInit=false, BswMRequestProcessing=BSWM_DEFERRED
          BswMModeRequestSource
            BswMSwcModeNotification: BswMSwcModeNotificationModeDeclarationGroupPrototypeRef=SimpleTimerMode
          BswMModeInitValue
            BswMSwcModeInitValue: BswMSwcModeInitValueRef=IntegrationSample_Timer_IDLE
        Rule_Reset_when_SimpleTimer0_fired (BswMRule):
          BswMNestedExecutionOnly = false
          BswMRuleId = 28
          BswMRuleInitState = BSWM_FALSE
          BswMRuleExpressionRef = LogEx_Reset_when_SimpleTimer0_fired_BswMLogicalExpression
          BswMRuleTrueActionList = AL_Reset_when_SimpleTimer0_fired_BswMActionList_True
        Condition_SWC_Mode_Notification_SimpleTimerMode_BSWM_EQUALS_IntegrationSample_Timer_FIRE (BswMModeCondition): BswMConditionType=BSWM_EQUALS, BswMConditionMode=SWC_Mode_Notification_SimpleTimerMode
          BswMConditionValue
            BswMModeDeclaration: BswMModeValueRef=IntegrationSample_Timer_FIRE
        3 x BswMLogicalExpression:
          LogEx_Reset_when_SimpleTimer0_fired_BswMLogicalExpression: BswMArgumentRef=Condition_SWC_Mode_Notification_SimpleTimerMode_BSWM_EQUALS_IntegrationSample_Timer_FIRE
          LogEx_Bs_Run: BswMLogicalOperator=BSWM_AND, BswMArgumentRef=Condition_ModeNotification_Lifecycle_Bs2, BswMArgumentRef=Condition_SWCModeSwitch_IS_EcuRunState_BSWM_EQUALS_IntegrationSample_STARTUP
          LogEx_Bs_Init: BswMLogicalOperator=BSWM_AND, BswMArgumentRef=Condition_ModeNotification_Lifecycle_Bs, BswMArgumentRef=Condition_SWCModeSwitch_IS_EcuRunState_BSWM_EQUALS_IntegrationSample_STARTUP
        Condition_ModeNotification_Lifecycle_Bs (BswMModeCondition): BswMConditionType=BSWM_EQUALS, BswMConditionMode=SWC_ModeNotification_Lifecycle_Bs
          BswMConditionValue
            BswMModeDeclaration: BswMModeValueRef=BS_STOPPED
        Condition_ModeNotification_Lifecycle_Bs2 (BswMModeCondition): BswMConditionType=BSWM_EQUALS, BswMConditionMode=SWC_ModeNotification_Lifecycle_Bs
          BswMConditionValue
            BswMModeDeclaration: BswMModeValueRef=BS_INITIALIZED
        Rule_BS_Init (BswMRule):
          BswMNestedExecutionOnly = false
          BswMRuleId = 14
          BswMRuleInitState = BSWM_FALSE
          BswMRuleExpressionRef = LogEx_Bs_Init
          BswMRuleTrueActionList = AL_BswMActionList_Bs_Init_True
        Rule_Bs_Run (BswMRule):
          BswMNestedExecutionOnly = false
          BswMRuleId = 15
          BswMRuleInitState = BSWM_FALSE
          BswMRuleExpressionRef = LogEx_Bs_Run
          BswMRuleTrueActionList = AL_Bs_Run_when_Bs_Init
        4 x BswMModeRequestPort:
          SWC_ModeNotification_Lifecycle_Bs: BswMArbitrateOnInit=false, BswMRequestProcessing=BSWM_DEFERRED
            BswMModeInitValue
              BswMSwcModeInitValue: BswMSwcModeInitValueRef=BS_STOPPED
            BswMModeRequestSource
              BswMSwcModeNotification: BswMSwcModeNotificationModeDeclarationGroupPrototypeRef=Mode
          NvmReadAll: BswMArbitrateOnInit=false, BswMRequestProcessing=BSWM_IMMEDIATE
            BswMModeRequestSource
              BswMNvMJobModeIndication: BswMNvmService=NvmReadAll
            BswMModeInitValue
              BswMBswModeInitValue: BswMBswModeInitValueMode=NVM_REQ_OK
          NvmWriteAll: BswMArbitrateOnInit=false, BswMRequestProcessing=BSWM_IMMEDIATE
            BswMModeRequestSource
              BswMNvMJobModeIndication: BswMNvmService=NvmWriteAll
            BswMModeInitValue
              BswMBswModeInitValue: BswMBswModeInitValueMode=NVM_REQ_OK
          GenericModeRequestPort_IS_CodingReset: BswMArbitrateOnInit=true, BswMRequestProcessing=BSWM_IMMEDIATE
            BswMModeRequestSource
              BswMGenericRequest: BswMModeRequesterId=0, BswMRequestedModeMax=1
                IS_CodingReset_EXECUTE (BswMGenericRequestMode): BswMGenericRequestModeValue=1
                IS_CodingReset_NONE (BswMGenericRequestMode): BswMGenericRequestModeValue=0
            BswMModeInitValue
              BswMBswModeInitValue: BswMBswModeInitValueMode=0
        BswMModeCondition: BswMConditionType=BSWM_EQUALS, BswMConditionMode=GenericModeRequestPort_IS_CodingReset
          BswMConditionValue
            BswMBswMode: BswMBswRequestedMode=IS_CodingReset_EXECUTE
        ESH_RunToPostRun (BswMRule):
          BswMNestedExecutionOnly = false
          BswMRuleId = 8
          BswMRuleInitState = BSWM_FALSE
          BswMRuleExpressionRef = ESH_LE_RunToPostRun
          BswMRuleTrueActionList = ESH_AL_ExitRun
        ESH_LE_RunToPostRun (BswMLogicalExpression):
          BswMLogicalOperator = BSWM_AND
          BswMArgumentRef = ESH_Cond_StateIsRun
          BswMArgumentRef = ESH_LE_AllChannelsNoCom
          BswMArgumentRef = ESH_LE_RunReleased
          BswMArgumentRef = ESH_Cond_SelfRunReqTimerExpired
          BswMArgumentRef = ESH_Cond_ModeIsRun
        ESH_Cond_StateIsRun (BswMModeCondition): BswMConditionType=BSWM_EQUALS, BswMConditionMode=ESH_State
          BswMConditionValue
            BswMBswMode: BswMBswRequestedMode=ESH_RUN
        ESH_State (BswMModeRequestPort): BswMArbitrateOnInit=true, BswMRequestProcessing=BSWM_IMMEDIATE
          BswMModeRequestSource
            BswMGenericRequest: BswMModeRequesterId=230, BswMRequestedModeMax=7
              7 x BswMGenericRequestMode:
                ESH_INIT: BswMGenericRequestModeValue=0
                ESH_RUN: BswMGenericRequestModeValue=1
                ESH_POST_RUN: BswMGenericRequestModeValue=2
                ESH_PREP_SHUTDOWN: BswMGenericRequestModeValue=3
                ESH_WAIT_FOR_NVM: BswMGenericRequestModeValue=4
                ESH_SHUTDOWN: BswMGenericRequestModeValue=5
                ESH_WAKEUP: BswMGenericRequestModeValue=6
          BswMModeInitValue
            BswMBswModeInitValue: BswMBswModeInitValueMode=ESH_INIT
        ESH_LE_AllChannelsNoCom (BswMLogicalExpression): BswMLogicalOperator=BSWM_AND, BswMArgumentRef=ESH_Cond_NoComOn_A_FlexRay_5b5a9ac2
        ESH_Cond_NoComOn_A_FlexRay_5b5a9ac2 (BswMModeCondition): BswMConditionType=BSWM_EQUALS, BswMConditionMode=ESH_ComMIndication_A_FlexRay_5b5a9ac2
          BswMConditionValue
            BswMBswMode: BswMBswRequestedMode=COMM_NO_COMMUNICATION
        ESH_ComMIndication_A_FlexRay_5b5a9ac2 (BswMModeRequestPort): BswMArbitrateOnInit=false, BswMRequestProcessing=BSWM_DEFERRED
          BswMModeRequestSource
            BswMComMIndication: BswMComMChannelRef=A_FlexRay_5b5a9ac2
          BswMModeInitValue
            BswMBswModeInitValue: BswMBswModeInitValueMode=COMM_NO_COMMUNICATION
        ESH_LE_RunReleased (BswMLogicalExpression): BswMLogicalOperator=BSWM_AND, BswMArgumentRef=ESH_Cond_RunRequest0IsReleased, BswMArgumentRef=ESH_Cond_RunRequest1IsReleased
        ESH_Cond_RunRequest0IsReleased (BswMModeCondition): BswMConditionType=BSWM_EQUALS, BswMConditionMode=ESH_RunRequest_0
          BswMConditionValue
            BswMModeDeclaration: BswMModeValueRef=RELEASED
        ESH_RunRequest_0 (BswMModeRequestPort): BswMArbitrateOnInit=false, BswMRequestProcessing=BSWM_DEFERRED
          BswMModeRequestSource
            BswMSwcModeRequest: BswMModeRequestDataElementPrototypeName=requestedMode, BswMSwcModeRequestModeDeclarationGroupPrototypeRef=BswM_MDGP_ESH_RunRequest
          BswMModeInitValue
            BswMSwcModeInitValue: BswMSwcModeInitValueRef=RELEASED
        ESH_Cond_RunRequest1IsReleased (BswMModeCondition): BswMConditionType=BSWM_EQUALS, BswMConditionMode=ESH_RunRequest_1
          BswMConditionValue
            BswMModeDeclaration: BswMModeValueRef=RELEASED
        ESH_RunRequest_1 (BswMModeRequestPort): BswMArbitrateOnInit=false, BswMRequestProcessing=BSWM_DEFERRED
          BswMModeRequestSource
            BswMSwcModeRequest: BswMModeRequestDataElementPrototypeName=requestedMode, BswMSwcModeRequestModeDeclarationGroupPrototypeRef=BswM_MDGP_ESH_RunRequest
          BswMModeInitValue
            BswMSwcModeInitValue: BswMSwcModeInitValueRef=RELEASED
        ESH_Cond_SelfRunReqTimerExpired (BswMModeCondition): BswMConditionType=BSWM_EQUALS, BswMConditionMode=ESH_SelfRunRequestTimer
          BswMConditionValue
            BswMBswMode: BswMBswRequestedMode=BSWM_TIMER_EXPIRED
        ESH_SelfRunRequestTimer (BswMModeRequestPort): BswMArbitrateOnInit=false, BswMRequestProcessing=BSWM_DEFERRED
          BswMModeRequestSource
            BswMTimer
          BswMModeInitValue
            BswMBswModeInitValue: BswMBswModeInitValueMode=BSWM_TIMER_STOPPED
        ESH_Cond_ModeIsRun (BswMModeCondition): BswMConditionType=BSWM_EQUALS, BswMConditionMode=ESH_ModeNotification
          BswMConditionValue
            BswMModeDeclaration: BswMModeValueRef=RUN
        ESH_ModeNotification (BswMModeRequestPort): BswMArbitrateOnInit=false, BswMRequestProcessing=BSWM_DEFERRED
          BswMModeRequestSource
            BswMSwcModeNotification: BswMSwcModeNotificationModeDeclarationGroupPrototypeRef=BswM_MDGP_ESH_Mode
          BswMModeInitValue
            BswMSwcModeInitValue: BswMSwcModeInitValueRef=STARTUP
        ESH_RunToPostRunNested (BswMRule):
          BswMNestedExecutionOnly = true
          BswMRuleId = 9
          BswMRuleInitState = BSWM_FALSE
          BswMRuleExpressionRef = ESH_LE_ComMNoPendingRequests
          BswMRuleTrueActionList = ESH_AL_RunToPostRun
        ESH_LE_ComMNoPendingRequests (BswMLogicalExpression): BswMLogicalOperator=BSWM_AND, BswMArgumentRef=ESH_Cond_ComMNoPendingRequests
        ESH_Cond_ComMNoPendingRequests (BswMModeCondition): BswMConditionType=BSWM_EQUALS, BswMConditionMode=ESH_ComMPendingRequests
          BswMConditionValue
            BswMBswMode: BswMBswRequestedMode=ESH_COMM_NO_REQUEST
        ESH_ComMPendingRequests (BswMModeRequestPort): BswMArbitrateOnInit=false, BswMRequestProcessing=BSWM_DEFERRED
          BswMModeRequestSource
            BswMGenericRequest: BswMModeRequesterId=232, BswMRequestedModeMax=2
              ESH_COMM_NO_REQUEST (BswMGenericRequestMode): BswMGenericRequestModeValue=0
              ESH_COMM_PENDING_REQUEST (BswMGenericRequestMode): BswMGenericRequestModeValue=1
          BswMModeInitValue
            BswMBswModeInitValue: BswMBswModeInitValueMode=ESH_COMM_NO_REQUEST
        ESH_WaitToShutdown (BswMRule):
          BswMNestedExecutionOnly = false
          BswMRuleId = 10
          BswMRuleInitState = BSWM_FALSE
          BswMRuleExpressionRef = ESH_LE_WaitForNvMToShutdown
          BswMRuleTrueActionList = ESH_AL_WaitForNvMToShutdown
        ESH_LE_WaitForNvMToShutdown (BswMLogicalExpression): BswMLogicalOperator=BSWM_AND, BswMArgumentRef=ESH_Cond_StateIsWaitForNvm, BswMArgumentRef=ESH_LE_WriteNotPending, BswMArgumentRef=ESH_LE_NoWakeup
        ESH_Cond_StateIsWaitForNvm (BswMModeCondition): BswMConditionType=BSWM_EQUALS, BswMConditionMode=ESH_State
          BswMConditionValue
            BswMBswMode: BswMBswRequestedMode=ESH_WAIT_FOR_NVM
        ESH_LE_WriteNotPending (BswMLogicalExpression): BswMLogicalOperator=BSWM_OR, BswMArgumentRef=ESH_Cond_NvMWAIsNotPending, BswMArgumentRef=ESH_Cond_NvWWriteAllTimerNotRunning
        ESH_Cond_NvMWAIsNotPending (BswMModeCondition): BswMConditionType=BSWM_EQUALS_NOT, BswMConditionMode=ESH_NvMIndication
          BswMConditionValue
            BswMBswMode: BswMBswRequestedMode=NVM_REQ_PENDING
        ESH_NvMIndication (BswMModeRequestPort): BswMArbitrateOnInit=false, BswMRequestProcessing=BSWM_DEFERRED
          BswMModeRequestSource
            BswMNvMJobModeIndication: BswMNvmService=NvmWriteAll
          BswMModeInitValue
            BswMBswModeInitValue: BswMBswModeInitValueMode=NVM_REQ_OK
        ESH_Cond_NvWWriteAllTimerNotRunning (BswMModeCondition): BswMConditionType=BSWM_EQUALS_NOT, BswMConditionMode=ESH_NvM_WriteAllTimer
          BswMConditionValue
            BswMBswMode: BswMBswRequestedMode=BSWM_TIMER_STARTED
        ESH_NvM_WriteAllTimer (BswMModeRequestPort): BswMArbitrateOnInit=false, BswMRequestProcessing=BSWM_DEFERRED
          BswMModeRequestSource
            BswMTimer
          BswMModeInitValue
            BswMBswModeInitValue: BswMBswModeInitValueMode=BSWM_TIMER_STOPPED
        ESH_LE_NoWakeup (BswMLogicalExpression): BswMLogicalOperator=BSWM_AND, BswMArgumentRef=ESH_Cond_NoValidatedWakeups, BswMArgumentRef=ESH_Cond_ComMNoPendingRequests
        ESH_Cond_NoValidatedWakeups (BswMModeCondition): BswMConditionType=BSWM_EQUALS, BswMConditionMode=ESH_EcuM_GetValidatedWakeupEvents
          BswMConditionValue
            BswMBswMode: BswMBswRequestedMode=0
        ESH_EcuM_GetValidatedWakeupEvents (BswMModeRequestPort): BswMArbitrateOnInit=false, BswMRequestProcessing=BSWM_DEFERRED
          BswMModeRequestSource
            BswMUserConditionRequest: BswMUserCondition=EcuM_GetValidatedWakeupEvents()
        ESH_WakeupToPrep (BswMRule):
          BswMNestedExecutionOnly = false
          BswMRuleId = 12
          BswMRuleInitState = BSWM_FALSE
          BswMRuleExpressionRef = ESH_LE_WakeupToPrepShutdown
          BswMRuleTrueActionList = ESH_AL_WakeupToPrep
        ESH_LE_WakeupToPrepShutdown (BswMLogicalExpression):
          BswMLogicalOperator = BSWM_AND
          BswMArgumentRef = ESH_Cond_StateIsWakeup
          BswMArgumentRef = ESH_LE_CancelNotPending
          BswMArgumentRef = ESH_Cond_NoPendingWakeups
          BswMArgumentRef = ESH_LE_NoWakeup
          BswMArgumentRef = ESH_Cond_ModeIsWakeup
        ESH_Cond_StateIsWakeup (BswMModeCondition): BswMConditionType=BSWM_EQUALS, BswMConditionMode=ESH_State
          BswMConditionValue
            BswMBswMode: BswMBswRequestedMode=ESH_WAKEUP
        ESH_LE_CancelNotPending (BswMLogicalExpression): BswMLogicalOperator=BSWM_OR, BswMArgumentRef=ESH_Cond_NvMWAIsNotPending, BswMArgumentRef=ESH_Cond_NvWCancelTimerNotRunning
        ESH_Cond_NvWCancelTimerNotRunning (BswMModeCondition): BswMConditionType=BSWM_EQUALS_NOT, BswMConditionMode=ESH_NvM_CancelWriteAllTimer
          BswMConditionValue
            BswMBswMode: BswMBswRequestedMode=BSWM_TIMER_STARTED
        ESH_NvM_CancelWriteAllTimer (BswMModeRequestPort): BswMArbitrateOnInit=false, BswMRequestProcessing=BSWM_DEFERRED
          BswMModeRequestSource
            BswMTimer
          BswMModeInitValue
            BswMBswModeInitValue: BswMBswModeInitValueMode=BSWM_TIMER_STOPPED
        ESH_Cond_NoPendingWakeups (BswMModeCondition): BswMConditionType=BSWM_EQUALS, BswMConditionMode=ESH_EcuM_GetPendingWakeupEvents
          BswMConditionValue
            BswMBswMode: BswMBswRequestedMode=0
        ESH_EcuM_GetPendingWakeupEvents (BswMModeRequestPort): BswMArbitrateOnInit=false, BswMRequestProcessing=BSWM_DEFERRED
          BswMModeRequestSource
            BswMUserConditionRequest: BswMUserCondition=EcuM_GetPendingWakeupEvents()
        ESH_Cond_ModeIsWakeup (BswMModeCondition): BswMConditionType=BSWM_EQUALS, BswMConditionMode=ESH_ModeNotification
          BswMConditionValue
            BswMModeDeclaration: BswMModeValueRef=WAKEUP
        ESH_WaitToWakeup (BswMRule):
          BswMNestedExecutionOnly = false
          BswMRuleId = 11
          BswMRuleInitState = BSWM_FALSE
          BswMRuleExpressionRef = ESH_LE_WaitForNvMToWakeup
          BswMRuleTrueActionList = ESH_AL_WaitForNvMWakeup
        ESH_LE_WaitForNvMToWakeup (BswMLogicalExpression): BswMLogicalOperator=BSWM_AND, BswMArgumentRef=ESH_Cond_StateIsWaitForNvm, BswMArgumentRef=ESH_LE_ValidWakeup
        ESH_LE_ValidWakeup (BswMLogicalExpression): BswMLogicalOperator=BSWM_OR, BswMArgumentRef=ESH_Cond_ValidatedWakeups, BswMArgumentRef=ESH_Cond_ComMPendingRequests
        ESH_Cond_ValidatedWakeups (BswMModeCondition): BswMConditionType=BSWM_EQUALS_NOT, BswMConditionMode=ESH_EcuM_GetValidatedWakeupEvents
          BswMConditionValue
            BswMBswMode: BswMBswRequestedMode=0
        ESH_Cond_ComMPendingRequests (BswMModeCondition): BswMConditionType=BSWM_EQUALS, BswMConditionMode=ESH_ComMPendingRequests
          BswMConditionValue
            BswMBswMode: BswMBswRequestedMode=ESH_COMM_PENDING_REQUEST
        ESH_WakeupToRun (BswMRule):
          BswMNestedExecutionOnly = false
          BswMRuleId = 13
          BswMRuleInitState = BSWM_FALSE
          BswMRuleExpressionRef = ESH_LE_WakeupToRun
          BswMRuleTrueActionList = ESH_AL_WakeupToRun
        ESH_LE_WakeupToRun (BswMLogicalExpression):
          BswMLogicalOperator = BSWM_AND
          BswMArgumentRef = ESH_Cond_StateIsWakeup
          BswMArgumentRef = ESH_LE_ValidWakeup
          BswMArgumentRef = ESH_LE_CancelNotPending
          BswMArgumentRef = ESH_Cond_ModeIsWakeup
        ESH_DemInit (BswMRule):
          BswMNestedExecutionOnly = true
          BswMRuleId = 2
          BswMRuleInitState = BSWM_FALSE
          BswMRuleExpressionRef = ESH_LE_DemNotInitialized
          BswMRuleTrueActionList = ESH_AL_DemInit
        ESH_LE_DemNotInitialized (BswMLogicalExpression): BswMLogicalOperator=BSWM_OR, BswMArgumentRef=ESH_Cond_DemNotInitialized
        ESH_Cond_DemNotInitialized (BswMModeCondition): BswMConditionType=BSWM_EQUALS, BswMConditionMode=ESH_DemInitStatus
          BswMConditionValue
            BswMBswMode: BswMBswRequestedMode=DEM_NOT_INITIALIZED
        ESH_DemInitStatus (BswMModeRequestPort): BswMArbitrateOnInit=false, BswMRequestProcessing=BSWM_IMMEDIATE
          BswMModeRequestSource
            BswMGenericRequest: BswMModeRequesterId=231, BswMRequestedModeMax=2
              DEM_INITIALIZED (BswMGenericRequestMode): BswMGenericRequestModeValue=0
              DEM_NOT_INITIALIZED (BswMGenericRequestMode): BswMGenericRequestModeValue=1
          BswMModeInitValue
            BswMBswModeInitValue: BswMBswModeInitValueMode=DEM_INITIALIZED
        ESH_InitToWakeup (BswMRule):
          BswMNestedExecutionOnly = false
          BswMRuleId = 3
          BswMRuleInitState = BSWM_FALSE
          BswMRuleExpressionRef = ESH_LE_InitToWakeup
          BswMRuleTrueActionList = ESH_AL_InitToWakeup
        ESH_LE_InitToWakeup (BswMLogicalExpression): BswMLogicalOperator=BSWM_AND, BswMArgumentRef=ESH_Cond_StateIsInit
        ESH_Cond_StateIsInit (BswMModeCondition): BswMConditionType=BSWM_EQUALS, BswMConditionMode=ESH_State
          BswMConditionValue
            BswMBswMode: BswMBswRequestedMode=ESH_INIT
        ESH_PostRunToPrepNested (BswMRule):
          BswMNestedExecutionOnly = true
          BswMRuleId = 6
          BswMRuleInitState = BSWM_FALSE
          BswMRuleExpressionRef = ESH_LE_PostRunToPrep
          BswMRuleTrueActionList = ESH_AL_PostRunToPrepShutdown
        ESH_LE_PostRunToPrep (BswMLogicalExpression): BswMLogicalOperator=BSWM_AND, BswMArgumentRef=ESH_LE_PostRunReleased
        ESH_LE_PostRunReleased (BswMLogicalExpression): BswMLogicalOperator=BSWM_AND, BswMArgumentRef=ESH_Cond_PostRunRequest0IsReleased, BswMArgumentRef=ESH_Cond_PostRunRequest1IsReleased
        ESH_Cond_PostRunRequest0IsReleased (BswMModeCondition): BswMConditionType=BSWM_EQUALS, BswMConditionMode=ESH_PostRunRequest_0
          BswMConditionValue
            BswMModeDeclaration: BswMModeValueRef=RELEASED
        ESH_PostRunRequest_0 (BswMModeRequestPort): BswMArbitrateOnInit=false, BswMRequestProcessing=BSWM_DEFERRED
          BswMModeRequestSource
            BswMSwcModeRequest: BswMModeRequestDataElementPrototypeName=requestedMode, BswMSwcModeRequestModeDeclarationGroupPrototypeRef=BswM_MDGP_ESH_RunRequest
          BswMModeInitValue
            BswMSwcModeInitValue: BswMSwcModeInitValueRef=RELEASED
        ESH_Cond_PostRunRequest1IsReleased (BswMModeCondition): BswMConditionType=BSWM_EQUALS, BswMConditionMode=ESH_PostRunRequest_1
          BswMConditionValue
            BswMModeDeclaration: BswMModeValueRef=RELEASED
        ESH_PostRunRequest_1 (BswMModeRequestPort): BswMArbitrateOnInit=false, BswMRequestProcessing=BSWM_DEFERRED
          BswMModeRequestSource
            BswMSwcModeRequest: BswMModeRequestDataElementPrototypeName=requestedMode, BswMSwcModeRequestModeDeclarationGroupPrototypeRef=BswM_MDGP_ESH_RunRequest
          BswMModeInitValue
            BswMSwcModeInitValue: BswMSwcModeInitValueRef=RELEASED
        ESH_PostRunNested (BswMRule):
          BswMNestedExecutionOnly = true
          BswMRuleId = 5
          BswMRuleInitState = BSWM_FALSE
          BswMRuleExpressionRef = ESH_LE_RunRequestsOrWakeup
          BswMRuleFalseActionList = ESH_AL_ESH_PostRunToPrepCheck
          BswMRuleTrueActionList = ESH_AL_PostRunToRun
        ESH_LE_RunRequestsOrWakeup (BswMLogicalExpression): BswMLogicalOperator=BSWM_OR, BswMArgumentRef=ESH_LE_RunRequested, BswMArgumentRef=ESH_LE_ValidWakeup
        ESH_LE_RunRequested (BswMLogicalExpression): BswMLogicalOperator=BSWM_OR, BswMArgumentRef=ESH_Cond_RunRequest0IsRequested, BswMArgumentRef=ESH_Cond_RunRequest1IsRequested
        ESH_Cond_RunRequest0IsRequested (BswMModeCondition): BswMConditionType=BSWM_EQUALS, BswMConditionMode=ESH_RunRequest_0
          BswMConditionValue
            BswMModeDeclaration: BswMModeValueRef=REQUESTED
        ESH_Cond_RunRequest1IsRequested (BswMModeCondition): BswMConditionType=BSWM_EQUALS, BswMConditionMode=ESH_RunRequest_1
          BswMConditionValue
            BswMModeDeclaration: BswMModeValueRef=REQUESTED
        ESH_PostRun (BswMRule):
          BswMNestedExecutionOnly = false
          BswMRuleId = 4
          BswMRuleInitState = BSWM_FALSE
          BswMRuleExpressionRef = ESH_LE_PostRun
          BswMRuleTrueActionList = ESH_AL_ExitPostRun
        ESH_LE_PostRun (BswMLogicalExpression): BswMLogicalOperator=BSWM_AND, BswMArgumentRef=ESH_Cond_StateIsPostRun, BswMArgumentRef=ESH_Cond_ModeIsPostRun
        ESH_Cond_StateIsPostRun (BswMModeCondition): BswMConditionType=BSWM_EQUALS, BswMConditionMode=ESH_State
          BswMConditionValue
            BswMBswMode: BswMBswRequestedMode=ESH_POST_RUN
        ESH_Cond_ModeIsPostRun (BswMModeCondition): BswMConditionType=BSWM_EQUALS, BswMConditionMode=ESH_ModeNotification
          BswMConditionValue
            BswMModeDeclaration: BswMModeValueRef=POSTRUN
        ESH_PrepToWait (BswMRule):
          BswMNestedExecutionOnly = false
          BswMRuleId = 7
          BswMRuleInitState = BSWM_FALSE
          BswMRuleExpressionRef = ESH_LE_PrepShutdownToWaitForNvM
          BswMRuleTrueActionList = ESH_AL_PrepShutdownToWaitForNvM
        ESH_LE_PrepShutdownToWaitForNvM (BswMLogicalExpression): BswMLogicalOperator=BSWM_AND, BswMArgumentRef=ESH_Cond_StateIsPrepShutdown, BswMArgumentRef=ESH_Cond_ModeIsShutdown
        ESH_Cond_StateIsPrepShutdown (BswMModeCondition): BswMConditionType=BSWM_EQUALS, BswMConditionMode=ESH_State
          BswMConditionValue
            BswMBswMode: BswMBswRequestedMode=ESH_PREP_SHUTDOWN
        ESH_Cond_ModeIsShutdown (BswMModeCondition): BswMConditionType=BSWM_EQUALS, BswMConditionMode=ESH_ModeNotification
          BswMConditionValue
            BswMModeDeclaration: BswMModeValueRef=SHUTDOWN
        CC_A_FlexRay_5b5a9ac2_TX (BswMRule):
          BswMNestedExecutionOnly = false
          BswMRuleId = 1
          BswMRuleInitState = BSWM_FALSE
          BswMRuleExpressionRef = CC_LE_A_FlexRay_5b5a9ac2_TX
          BswMRuleFalseActionList = CC_AL_A_FlexRay_5b5a9ac2_TX_Disable
          BswMRuleTrueActionList = CC_AL_A_FlexRay_5b5a9ac2_TX_EnableNoinit
        CC_LE_A_FlexRay_5b5a9ac2_TX (BswMLogicalExpression): BswMLogicalOperator=BSWM_AND, BswMArgumentRef=CC_LE_FrSMIndication_A_FlexRay_5b5a9ac2_Online
        CC_LE_FrSMIndication_A_FlexRay_5b5a9ac2_Online (BswMLogicalExpression):
          BswMLogicalOperator = BSWM_OR
          BswMArgumentRef = CC_Cond_FrSMIndication_A_FlexRay_5b5a9ac2_EQ_FRSM_BSWM_ONLINE
          BswMArgumentRef = CC_Cond_FrSMIndication_A_FlexRay_5b5a9ac2_EQ_FRSM_BSWM_ONLINE_ECU_PASSIVE
        CC_Cond_FrSMIndication_A_FlexRay_5b5a9ac2_EQ_FRSM_BSWM_ONLINE (BswMModeCondition): BswMConditionType=BSWM_EQUALS, BswMConditionMode=CC_FrSMIndication_A_FlexRay_5b5a9ac2
          BswMConditionValue
            BswMBswMode: BswMBswRequestedMode=FRSM_BSWM_ONLINE
        CC_FrSMIndication_A_FlexRay_5b5a9ac2 (BswMModeRequestPort): BswMArbitrateOnInit=false, BswMRequestProcessing=BSWM_IMMEDIATE
          BswMModeRequestSource
            BswMFrSMIndication: BswMFrSMChannelRef=A_FlexRay_5b5a9ac2
          BswMModeInitValue
            BswMBswModeInitValue: BswMBswModeInitValueMode=FRSM_BSWM_READY
        CC_Cond_FrSMIndication_A_FlexRay_5b5a9ac2_EQ_FRSM_BSWM_ONLINE_ECU_PASSIVE (BswMModeCondition): BswMConditionType=BSWM_EQUALS, BswMConditionMode=CC_FrSMIndication_A_FlexRay_5b5a9ac2
          BswMConditionValue
            BswMBswMode: BswMBswRequestedMode=FRSM_BSWM_ONLINE_ECU_PASSIVE
        CC_A_FlexRay_5b5a9ac2_RX (BswMRule):
          BswMNestedExecutionOnly = false
          BswMRuleId = 0
          BswMRuleInitState = BSWM_FALSE
          BswMRuleExpressionRef = CC_LE_A_FlexRay_5b5a9ac2_RX
          BswMRuleFalseActionList = CC_AL_A_FlexRay_5b5a9ac2_RX_Disable
          BswMRuleTrueActionList = CC_AL_A_FlexRay_5b5a9ac2_RX_EnableNoinit
        CC_LE_A_FlexRay_5b5a9ac2_RX (BswMLogicalExpression): BswMLogicalOperator=BSWM_AND, BswMArgumentRef=CC_LE_FrSMIndication_A_FlexRay_5b5a9ac2_Online
      BswMRteModeDclGroup: BswMInitMode=BswMRteMode
        BswMRteMode: BswMModePhysicalValue=0
      BswMDataTypeMappingSets:
        BswMDataTypeMappingSetRef = DlogTypeMappings
        BswMDataTypeMappingSetRef = DataTMappingSet1
        BswMDataTypeMappingSetRef = BswMMappingSet
        BswMDataTypeMappingSetRef = Darh_ModeRequestTypeMappings
        BswMDataTypeMappingSetRef = Omc_DataTypeMappingSets
        BswMDataTypeMappingSetRef = StdDiag_DataTypeMappingSet
        BswMDataTypeMappingSetRef = IntegrationSampleModemappingEcuRunState
        BswMDataTypeMappingSetRef = Stm_CentralErrorLockModeRequestTypeMap
        BswMDataTypeMappingSetRef = Stm_EMLS_Mapping
        BswMDataTypeMappingSetRef = Stm_EnergyStateModeRequestTypeMap
        BswMDataTypeMappingSetRef = Stm_VehicleStatModeRequestTypeMap
      ESH_Mode (BswMRteModeDclGroup): BswMInitMode=STARTUP
        5 x BswMRteMode:
          STARTUP: BswMModePhysicalValue=0
          RUN: BswMModePhysicalValue=1
          POSTRUN: BswMModePhysicalValue=2
          WAKEUP: BswMModePhysicalValue=3
          SHUTDOWN: BswMModePhysicalValue=4
      ESH_RunRequest (BswMRteModeDclGroup): BswMInitMode=RELEASED
        RELEASED (BswMRteMode): BswMModePhysicalValue=0
        REQUESTED (BswMRteMode): BswMModePhysicalValue=1
    BswMGeneral:
      BswMDevErrorDetect = true
      BswMJ1939NmEnabled = false
      BswMNmEnabled = false
      BswMSdEnabled = false
      BswMVersionInfoApi = false
      BswMCanSMEnabled = false
      BswMComMEnabled = true
      BswMDcmEnabled = true
      BswMNvMEnabled = true
      BswMMainFunctionPeriod = 0.002
      BswMEcuMEnabled = true
      BswMGenericRequestEnabled = true
      BswMFrSMEnabled = true
      BswMRuleControlEnabled = false
      BswMModeCheck = true
      BswMPduREnabled = false
      BswMEthSMEnabled = false
      BswMJ1939DcmEnabled = false
      BswMLinSMEnabled = false
      BswMLinTPEnabled = false
      BswMWdgMEnabled = true
      BswMEthIfEnabled = false
      BswMCommonData
      BswMGeneration:
        BswMOutOfBoundsWriteSanitizer = false
        BswMOutOfBoundsReadSanitizer = false
        BswMReduceConstantData2Define = true
        BswMReduceDataByStreaming = false
        BswMBoolDataInArrayOfStructStrategy = BITMASKING
        BswMInterfacesForDeactivatedData = false
