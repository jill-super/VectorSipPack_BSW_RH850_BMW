AUTOSAR XML (schema 4-3-0)
package /ActiveEcuC
  module config Fls: implementation-config-variant=VARIANT-POST-BUILD, module-description=Fls_Impl
    FlsGeneral:
      FlsVersionCheckExternalModules = false
      FlsDevErrorDetect = true
      FlsAcLoadOnJobStart = false
      FlsCancelApi = true
      FlsCompareApi = true
      FlsDriverIndex = 0
      FlsGetJobResultApi = true
      FlsGetStatusApi = true
      FlsSetModeApi = true
      FlsUseInterrupts = false
      FlsVersionInfoApi = false
      FlsCriticalSectionProtection = true
      FlsFaciEccCheck = true
      FlsInterruptConsistencyCheck = false
      FlsWriteVerify = WV_DISABLE
      FlsUseWVErrorInterface = false
      FlsLoopCount = 32
      FlsVirtualBoundaryAddress = 65536
      FlsDeviceName = R7F701319
      FlsBaseAddress = 0
      FlsTotalSize = 65536
      FlsTimeoutMonitoring = false
      FlsDataFlash:
        FlsDFBaseAddress = 4280287232
        FlsDFBlockSize = 64
        FlsDFTotalBlocks = 1024
        FlsDataFlashSize = 65536
        FlsBlankCheckApi = true
        FlsReadImmediateApi = true
        FlsSuspendApi = true
        FlsResumeApi = true
        FlsEccDedNotification = NULL
        FlsEccSedNotification = NULL
        FlsFdlCpuFrequency = McuClockSettingConfig
    FlsConfigSet:
      FlsAcErase = 0
      FlsAcWrite = 0
      FlsCallCycle = 0
      FlsDefaultMode = MEMIF_MODE_SLOW
      FlsMaxReadFastMode = 512
      FlsMaxReadNormalMode = 256
      FlsMaxWriteFastMode = 0
      FlsMaxWriteNormalMode = 4
      FlsMaxEraseNormalMode = 64
      FlsProtection = 0
      FlsJobEndNotification = Fee_30_SmallSector_JobEndNotification
      FlsJobErrorNotification = Fee_30_SmallSector_JobErrorNotification
      FlsSectorList
        FlsSector: FlsNumberOfSectors=1024, FlsPageSize=4, FlsSectorIndex=0, FlsSectorSize=64, FlsSectorStartaddress=0
      FlsDemEventParameterRefs:
        FLS_E_COMPARE_FAILED = DemEventParameter_FlsConfigSet_FLS_E_COMPARE_FAILED
        FLS_E_ERASE_FAILED = DemEventParameter_FlsConfigSet_FLS_E_ERASE_FAILED
        FLS_E_READ_FAILED = DemEventParameter_FlsConfigSet_FLS_E_READ_FAILED
        FLS_E_WRITE_FAILED = DemEventParameter_FlsConfigSet_FLS_E_WRITE_FAILED
        FLS_E_READ_FAILED_DED = DemEventParameter_FlsConfigSet_FLS_E_READ_DED_FAILED
        FLS_E_HW_FAILURE = DemEventParameter_FlsConfigSet_FLS_E_HW_FAILED
        FLS_E_ECC_FAILED = DemEventParameter_FlsConfigSet_FLS_E_ECC_FAILED
        FLS_E_INT_INCONSISTENT = DemEventParameter_FlsConfigSet_FLS_E_INT_FAILED
        FLS_E_REG_WRITE_VERIFY = DemEventParameter_FlsConfigSet_FLS_E_VRFY_FAILED
        FLS_E_UNEXPECTED_FLASH_ID = DemEventParameter_FlsConfigSet_FLS_E_UNEXPECTED_FLASH_ID
    FlsPublishedInformation:
      FlsAcLocationErase = 0
      FlsAcLocationWrite = 0
      FlsAcSizeErase = 0
      FlsAcSizeWrite = 0
      FlsEraseTime = 0.01
      FlsErasedValue = 4294967295
      FlsExpectedHwId = NULL
      FlsSpecifiedEraseCycles = 125000
      FlsWriteTime = 0.0017
      FlsBlankCheckTime = 0.000213
      FlsSuspendTime = 0.0003
      FlsCancelTime = 0.00005
