AUTOSAR XML (schema 4-3-0)
package /ActiveEcuC
  module config Det: implementation-config-variant=VARIANT-PRE-COMPILE, module-description=Det_Impl
    DetGeneral:
      DetVersionInfoApi = false
      DetEnableDet = true
      DetExtDebugSupport = true
      DetGlobalFilterSize = 1
      DetBreakFilterSize = 0
      DetLogBufferSize = 0
      DetReportErrorRecursionLimit = 0
      DetReportRuntimeErrorRecursionLimit = 0
      DetReportTransientFaultRecursionLimit = 0
      DetDltFilterSize = 0
    DetConfigSet
      7 x DetModule:
        DetModule: DetModuleId=4096
        DetServicePort_Coding: DetModuleId=4097
        DetServicePort_Darh: DetModuleId=4098
        DetServicePort_Dlog: DetModuleId=4099
        DetServicePort_Omc: DetModuleId=4100
        DetServicePort_StdDiag: DetModuleId=4101
        DetServicePort_SysTime: DetModuleId=4102
    DetNotification
