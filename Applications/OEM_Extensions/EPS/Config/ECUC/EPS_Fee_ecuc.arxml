AUTOSAR XML (schema 4-3-0)
package /ActiveEcuC
  module config Fee: implementation-config-variant=VARIANT-PRE-COMPILE, module-description=Fee_Impl
    FeeGeneral:
      FeeSafeBswChecks = true
      FeeDevErrorDetect = true
      FeeIndex = 0
      FeeNvmJobEndNotification = NvM_JobEndNotification
      FeeNvmJobErrorNotification = NvM_JobErrorNotification
      FeePollingMode = false
      FeeSetModeSupported = true
      FeeVersionInfoApi = false
      FeeVirtualPageSize = 8
      FeeMainFunctionPeriod = 0.005
      FeeMainFunctionTriggering = FixedCycleTime
      FeeCorrectSingleBitFlips = false
      FeeNvmCbkIncludeFile = NvM_Cbk.h
      FeeFlsApi:
        FeeFlsIncludeFile = Fls.h
        FeeFlsSetMode = Fls_SetMode
        FeeFlsRead = Fls_Read
        FeeFlsWrite = Fls_Write
        FeeFlsCancel = Fls_Cancel
        FeeFlsGetStatus = Fls_GetStatus
        FeeFlsGetJobResult = Fls_GetJobResult
        FeeFlsErase = Fls_Erase
        FeeFlsCompare = Fls_Compare
        FeeFlsBlankCheck = Fls_BlankCheck
        FeeFlsDeviceIndex = FlsGeneral
    FeeBlockConfiguration:
      FeeBlockNumber = 16
      FeeBlockSize = 4
      FeeImmediateData = false
      FeeNumberOfWriteCycles = 10000
      FeeNumberOfDatasets = 2
      FeeNumberOfInstances = 1
      FeeVerifyWrittenData = false
      FeeBlockId = 0
      FeeDeviceIndex = FlsGeneral
      FeePartition = FeePartitionConfiguration_APPL
    FeePublishedInformation: FeeBlockOverhead=2, FeeMaximumBlockingTime=1, FeePageOverhead=0
    FeePartitionConfiguration_APPL (FeePartitionConfiguration):
      FeePartitionStartAddress = 512
      FeePartitionSize = 2240
      FeePartitionAddressAlignment = 64
      FeePartitionWriteAlignment = 4
      FeePartitionReadAlignment = 1
      FeeFlsBlankCheckApi = true
      FeePartitionDevice = FlsConfigSet
    10 x FeeBlockConfiguration, all with FeeImmediateData=false, FeeNumberOfWriteCycles=10000, FeeNumberOfDatasets=1, FeeNumberOfInstances=1, FeeVerifyWrittenData=false, FeeDeviceIndex=FlsGeneral, FeePartition=FeePartitionConfiguration_APPL:
      FeeDemPrimaryDataBlock0: FeeBlockNumber=32, FeeBlockSize=32, FeeBlockId=1
      FeeDemPrimaryDataBlock2: FeeBlockNumber=48, FeeBlockSize=32, FeeBlockId=5
      FeeDemPrimaryDataBlock3: FeeBlockNumber=64, FeeBlockSize=32, FeeBlockId=6
      FeeDemPrimaryDataBlock4: FeeBlockNumber=80, FeeBlockSize=32, FeeBlockId=7
      FeeDemPrimaryDataBlock5: FeeBlockNumber=96, FeeBlockSize=32, FeeBlockId=8
      FeeDemPrimaryDataBlock6: FeeBlockNumber=112, FeeBlockSize=32, FeeBlockId=9
      FeeDemPrimaryDataBlock7: FeeBlockNumber=128, FeeBlockSize=32, FeeBlockId=10
      FeeDemAdminDataBlock: FeeBlockNumber=144, FeeBlockSize=12, FeeBlockId=3
      FeeDemStatusDataBlock: FeeBlockNumber=160, FeeBlockSize=48, FeeBlockId=4
      FeeDemPrimaryDataBlock1: FeeBlockNumber=176, FeeBlockSize=32, FeeBlockId=2
    FeePartitionConfiguration_BTLD (FeePartitionConfiguration):
      FeePartitionStartAddress = 0
      FeePartitionSize = 512
      FeePartitionAddressAlignment = 64
      FeePartitionWriteAlignment = 4
      FeePartitionReadAlignment = 1
      FeeFlsBlankCheckApi = true
      FeePartitionDevice = FlsConfigSet
    18 x FeeBlockConfiguration, all with FeeImmediateData=false, FeeNumberOfWriteCycles=10000, FeeNumberOfInstances=1, FeeVerifyWrittenData=false, FeeDeviceIndex=FlsGeneral:
      FeeNVM_BLOCK_DCM_ROE: FeeBlockNumber=192, FeeBlockSize=6, FeeNumberOfDatasets=1, FeeBlockId=11, FeePartition=FeePartitionConfiguration_APPL
      FeeTestStampDefaults: FeeBlockNumber=208, FeeBlockSize=3, FeeNumberOfDatasets=1, FeeBlockId=12, FeePartition=FeePartitionConfiguration_APPL
      FeeNVM_BLOCK_DLOG_SVK_SYS_SUPP: FeeBlockNumber=224, FeeBlockSize=41, FeeNumberOfDatasets=1, FeeBlockId=2, FeePartition=FeePartitionConfiguration_BTLD
      FeeNVM_BLOCK_DLOG_SVK_PLANT: FeeBlockNumber=240, FeeBlockSize=57, FeeNumberOfDatasets=1, FeeBlockId=1, FeePartition=FeePartitionConfiguration_BTLD
      FeeNVM_BLOCK_BOOT_SVK_HISTORY: FeeBlockNumber=256, FeeBlockSize=4, FeeNumberOfDatasets=1, FeeBlockId=0, FeePartition=FeePartitionConfiguration_BTLD
      FeeNVM_BLOCK_BOOT_PROG_STATUS: FeeBlockNumber=272, FeeBlockSize=1, FeeNumberOfDatasets=1, FeeBlockId=3, FeePartition=FeePartitionConfiguration_BTLD
      FeeNVM_BLOCK_BOOT_PROG_DATA: FeeBlockNumber=288, FeeBlockSize=21, FeeNumberOfDatasets=1, FeeBlockId=4, FeePartition=FeePartitionConfiguration_BTLD
      FeeNVM_BLOCK_BOOT_PROG_COUNTER: FeeBlockNumber=304, FeeBlockSize=4, FeeNumberOfDatasets=1, FeeBlockId=5, FeePartition=FeePartitionConfiguration_BTLD
      FeeOmcDependencyNVMData: FeeBlockNumber=320, FeeBlockSize=2, FeeNumberOfDatasets=1, FeeBlockId=13, FeePartition=FeePartitionConfiguration_APPL
      FeeDemSecondaryDataBlock0: FeeBlockNumber=336, FeeBlockSize=1, FeeNumberOfDatasets=1, FeeBlockId=14, FeePartition=FeePartitionConfiguration_APPL
      FeeDemSecondaryDataBlock1: FeeBlockNumber=352, FeeBlockSize=1, FeeNumberOfDatasets=1, FeeBlockId=15, FeePartition=FeePartitionConfiguration_APPL
      FeeDemSecondaryDataBlock2: FeeBlockNumber=368, FeeBlockSize=1, FeeNumberOfDatasets=1, FeeBlockId=16, FeePartition=FeePartitionConfiguration_APPL
      FeeDLOG_SVK_BACKUP_0: FeeBlockNumber=384, FeeBlockSize=41, FeeNumberOfDatasets=1, FeeBlockId=17, FeePartition=FeePartitionConfiguration_APPL
      FeeDLOG_SVK_BACKUP_1: FeeBlockNumber=400, FeeBlockSize=41, FeeNumberOfDatasets=1, FeeBlockId=18, FeePartition=FeePartitionConfiguration_APPL
      FeeDLOG_SVK_BACKUP_2: FeeBlockNumber=416, FeeBlockSize=41, FeeNumberOfDatasets=1, FeeBlockId=19, FeePartition=FeePartitionConfiguration_APPL
      FeeNVM_BLOCK_DARH_DiagnoseMasterEnable: FeeBlockNumber=432, FeeBlockSize=1, FeeNumberOfDatasets=1, FeeBlockId=20, FeePartition=FeePartitionConfiguration_APPL
      Fee_BLOCK_DARH: FeeBlockNumber=448, FeeBlockSize=30, FeeNumberOfDatasets=1, FeeBlockId=21, FeePartition=FeePartitionConfiguration_APPL
      FeeNVM_BLOCK_DLOG_SvkEntry: FeeBlockNumber=464, FeeBlockSize=97, FeeNumberOfDatasets=5, FeeBlockId=22, FeePartition=FeePartitionConfiguration_APPL
