AUTOSAR XML (schema 4-3-0)
package /ActiveEcuC
  module config FrIf: implementation-config-variant=VARIANT-PRE-COMPILE, module-description=FrIf_Impl
    FrIfConfig
      TAR_QTA_STRMOM_DV (FrIfPdu)
        FrIfPduDirection
          FrIfRxPdu_TAR_QTA_STRMOM_DV (FrIfRxPdu): FrIfUserRxIndicationUL=PDUR, FrIfRxPduId=20, FrIfRxPduRef=pduTr_TAR_QTA_STRMOM_DV_A_FlexRay_pduPort_EPS_A_FlexRay_IN_7d601c47_052bff33  # TAR_QTA_STRMOM_DV
      TL_BRC_FR_32 (FrIfPdu)
        FrIfPduDirection
          FrIfRxPdu_TL_BRC_FR_32 (FrIfRxPdu): FrIfUserRxIndicationUL=FR_TP, FrIfRxPduId=12, FrIfRxPduRef=pduTr_TL_BRC_FR_32_A_FlexRay_pduPort_EPS_A_FlexRay_IN_7d601c47_052bff33  # TL_BRC_FR_32
      FrStr_xcpstatic_7ff9780c_Out (FrIfFrameStructure): FrIfByteOrder=LITTLE_ENDIAN  # xcpstatic
        sn_d6c051138a624b7197665ea502ed9c68_3_9779c0f9609648bfa4441a0865c580a6_3 (FrIfPdusInFrame): FrIfPduOffset=0, FrIfMappedPduId=23, FrIfPduRef=dummy16bstatic
      FrStr_STEA_OFFS (FrIfFrameStructure): FrIfByteOrder=LITTLE_ENDIAN  # STEA_OFFS
        sn_58cceca224fe40fc80675725acb2e3e1_11_55e086fa3cb3405c9e0849033f661450_11 (FrIfPdusInFrame): FrIfPduOffset=0, FrIfMappedPduId=33, FrIfPduRef=STEA_OFFS
      dummy32bmaster (FrIfPdu)
        FrIfPduDirection
          FrIfRxPdu_dummy32bmaster (FrIfRxPdu): FrIfUserRxIndicationUL=XCP, FrIfRxPduId=10, FrIfRxPduRef=pduTr_dummy32bmaster_A_FlexRay_pduPort_EPS_A_FlexRay_IN_7d601c47_052bff33  # dummy32bmaster
      ENERG_DGR_DRDY (FrIfPdu)
        FrIfPduDirection
          FrIfRxPdu_ENERG_DGR_DRDY (FrIfRxPdu): FrIfUserRxIndicationUL=PDUR, FrIfRxPduId=22, FrIfRxPduRef=pduTr_ENERG_DGR_DRDY_A_FlexRay_pduPort_EPS_A_FlexRay_IN_7d601c47_052bff33  # ENERG_DGR_DRDY
      FrStr_AVL_STMOM_DV_ACT_AVL_FORC_GRD (FrIfFrameStructure): FrIfByteOrder=LITTLE_ENDIAN  # AVL_STMOM_DV_ACT_AVL_FORC_GRD
        sn_742c7ae2ecf94fc080e798e25ca70247_16_09e4bde6148d45f99746b23c44ef9b67_14 (FrIfPdusInFrame): FrIfPduOffset=8, FrIfMappedPduId=20, FrIfPduRef=AVL_FORC_GRD
        sn_742c7ae2ecf94fc080e798e25ca70247_16_1edf400c871b41dab29d318a6fc3ec64_13 (FrIfPdusInFrame): FrIfPduOffset=0, FrIfMappedPduId=19, FrIfPduRef=AVL_STMOM_DV_ACT
      AVL_STMOM_DV_ACT (FrIfPdu)
        FrIfPduDirection
          FrIfTxPdu_AVL_STMOM_DV_ACT (FrIfTxPdu):  # AVL_STMOM_DV_ACT
            FrIfUserTxUL = PDUR
            FrIfConfirm = false
            FrIfCounterLimit = 1
            FrIfImmediate = false
            FrIfNoneMode = false
            FrIfTxPduId = 19
            FrIfTxPduRef = pduTr_AVL_STMOM_DV_ACT_A_FlexRay_pduPort_EPS_A_FlexRay_OUT_7d601c47_052bff33
      6 x FrIfFrameStructure, all with FrIfByteOrder=LITTLE_ENDIAN:
        FrStr_SVC_c13cc884_Out  # SVC
          sn_9dd8c6cee627483a83c881709979081d_77_017541877cab44569267610f7b9dbbd6_78 (FrIfPdusInFrame): FrIfPduOffset=0, FrIfMappedPduId=14, FrIfPduRef=SVC_Out
        FrStr_SU_EPS  # SU_EPS
          sn_c217e50a54da493a879e8e4514e8c562_4_ecced8165aea4835a2a17dc224344598_4 (FrIfPdusInFrame): FrIfPduOffset=0, FrIfMappedPduId=10, FrIfPduRef=SU_EPS
        FrStr_ST_EST  # ST_EST
          sn_2f3b1c2990d8434f9d60c8bc0223380a_14_0d521c7c53964f869478fa5c12f4ec50_14 (FrIfPdusInFrame): FrIfPduOffset=0, FrIfMappedPduId=12, FrIfPduRef=ST_EST
        FrStr_AVL_RPM_WHL  # AVL_RPM_WHL
          sn_708b545e63774a48974a2e012c342c56_18_ca307c7178fd4cb8b1f0845b9598b7e4_18 (FrIfPdusInFrame): FrIfPduOffset=0, FrIfMappedPduId=45, FrIfPduRef=AVL_RPM_WHL
        FrStr_TL_MST_GW_TRNSM_FR_254  # TL_MST_GW_TRNSM_FR_254
          sn_d187a29661e448debbfa1c1db2495add_2_161ebe01a13246f5bc130ce6f196d980_1 (FrIfPdusInFrame): FrIfPduOffset=0, FrIfMappedPduId=29, FrIfPduRef=TL_MST_GW_TRNSM_FR_254
        FrStr_xcpstatic_1fa5cd47_Out  # xcpstatic
          sn_d6c051138a624b7197665ea502ed9c68_3_9779c0f9609648bfa4441a0865c580a6_3 (FrIfPdusInFrame): FrIfPduOffset=0, FrIfMappedPduId=21, FrIfPduRef=dummy16bstatic
      ENGTORQ_EPS (FrIfPdu)
        FrIfPduDirection
          FrIfTxPdu_ENGTORQ_EPS (FrIfTxPdu):  # ENGTORQ_EPS
            FrIfUserTxUL = PDUR
            FrIfConfirm = false
            FrIfCounterLimit = 1
            FrIfImmediate = false
            FrIfNoneMode = false
            FrIfTxPduId = 17
            FrIfTxPduRef = pduTr_ENGTORQ_EPS_A_FlexRay_pduPort_EPS_A_FlexRay_OUT_7d601c47_052bff33
      FrStr_CTR_VIB_STW_DISP_EXMI_SP2015_FDBK_VIB_STW_DISP_EXMI (FrIfFrameStructure): FrIfByteOrder=LITTLE_ENDIAN  # CTR_VIB_STW_DISP_EXMI_SP2015_FDBK_VIB_STW_DISP_EXMI
        sn_6d8a461ff30049dfbb2df9138651c35b_3_8e1fc510f7a3427998068160382540c0_4 (FrIfPdusInFrame): FrIfPduOffset=0, FrIfMappedPduId=4, FrIfPduRef=CTR_VIB_STW_DISP_EXMI_SP2015
      FrStr_RELATIVZEIT (FrIfFrameStructure): FrIfByteOrder=LITTLE_ENDIAN  # RELATIVZEIT
        sn_ccc09e8b2c1e432a8f2a272e558c8566_3_acb3c9a426bf4887ba724efd428ad5a4_3 (FrIfPdusInFrame): FrIfPduOffset=0, FrIfMappedPduId=0, FrIfPduRef=RELATIVZEIT
      4 x FrIfPdu:
        SU_EPS
          FrIfPduDirection
            FrIfTxPdu_SU_EPS (FrIfTxPdu):  # SU_EPS
              FrIfUserTxUL = PDUR
              FrIfConfirm = true
              FrIfCounterLimit = 1
              FrIfImmediate = false
              FrIfNoneMode = false
              FrIfTxPduId = 10
              FrIfTxPduRef = pduTr_SU_EPS_A_FlexRay_pduPort_EPS_A_FlexRay_OUT_7d601c47_052bff33
        ERRM_BN_U
          FrIfPduDirection
            FrIfRxPdu_ERRM_BN_U (FrIfRxPdu): FrIfUserRxIndicationUL=PDUR, FrIfRxPduId=19, FrIfRxPduRef=pduTr_ERRM_BN_U_A_FlexRay_pduPort_EPS_A_FlexRay_IN_7d601c47_052bff33  # ERRM_BN_U
        dummy32bslave
          FrIfPduDirection
            FrIfTxPdu_dummy32bslave (FrIfTxPdu):  # dummy32bslave
              FrIfUserTxUL = XCP
              FrIfConfirm = true
              FrIfCounterLimit = 1
              FrIfImmediate = false
              FrIfNoneMode = false
              FrIfTxPduId = 13
              FrIfTxPduRef = pduTr_dummy32bslave_A_FlexRay_pduPort_EPS_A_FlexRay_OUT_7d601c47_052bff33
        SVC_In
          FrIfPduDirection
            FrIfRxPdu_SVC (FrIfRxPdu): FrIfUserRxIndicationUL=PDUR, FrIfRxPduId=11, FrIfRxIndicationName=PduR_FrIfRxIndication, FrIfRxPduRef=SVC_434514f6_In  # SVC
      FrStr_ENSU_SFY (FrIfFrameStructure): FrIfByteOrder=LITTLE_ENDIAN  # ENSU_SFY
        sn_34b57a760af141aaa6b7f792f94a53b8_2_4145eaff72594a8e9989935517b189e9_2 (FrIfPdusInFrame): FrIfPduOffset=0, FrIfMappedPduId=31, FrIfPduRef=ENSU_SFY
      A_FlexRay (FrIfCluster):
        FrIfDetectNITError = false
        FrIfGChannels = FR_CHANNEL_A
        FrIfGColdStartAttempts = 8
        FrIfGCycleCountMax = 63
        FrIfGListenNoise = 2
        FrIfGMacroPerCycle = 3636
        FrIfGMaxWithoutClockCorrectFatal = 2
        FrIfGMaxWithoutClockCorrectPassive = 2
        FrIfGNetworkManagementVectorLength = 0
        FrIfGNumberOfMinislots = 289
        FrIfGNumberOfStaticSlots = 91
        FrIfGPayloadLengthStatic = 8
        FrIfGSyncFrameIDCountMax = 15
        FrIfGdActionPointOffset = 2
        FrIfGdBit = T100NS
        FrIfGdCasRxLowMax = 79
        FrIfGdCycle = 0.005
        FrIfGdDynamicSlotIdlePhase = 1
        FrIfGdIgnoreAfterTx = 0
        FrIfGdMacrotick = 0.000001375
        FrIfGdMiniSlotActionPointOffset = 2
        FrIfGdMinislot = 5
        FrIfGdNit = 7
        FrIfGdSampleClockPeriod = T12_5NS
        FrIfGdStaticSlot = 24
        FrIfGdSymbolWindow = 0
        FrIfGdSymbolWindowActionPointOffset = 2
        FrIfGdTSSTransmitter = 9
        FrIfGdWakeupRxIdle = 59
        FrIfGdWakeupRxLow = 50
        FrIfGdWakeupRxWindow = 301
        FrIfGdWakeupTxActive = 60
        FrIfGdWakeupTxIdle = 180
        FrIfSafetyMargin = 100
        FrIfClstIdx = 0
        FrIfJobList
          4 x FrIfJob, all with FrIfCycle=0:
            FrIf_TxJob_01: FrIfMacrotick=2273, FrIfStartSlot=1, FrIfEndSlot=76, FrIfMaxIsrDelay=909, FrIfIsRxJob=false, FrIfJobId=0, FrIfTxConfJobRef=FrIf_RxJob_01
              8 x FrIfCommunicationOperation, all with FrIfCommunicationAction=DECOUPLED_TRANSMISSION, FrIfRxComOpMaxLoop=512, FrIfManualAssignedLPdu=false:
                DECOUPLED_TRANSMISSION_LPdu_frTrig_FR_3a54c8219f12452dafc00b243d0703e0_1201_A_FlexRay_S_12_B_0_R_1_ChA_OUT: FrIfCommunicationOperationIdx=4, FrIfLPduIdxRef=LPdu_frTrig_FR_3a54c8219f12452dafc00b243d0703e0_1201_A_FlexRay_S_12_B_0_R_1_ChA_OUT
                DECOUPLED_TRANSMISSION_LPdu_frTrig_FR_3a54c8219f12452dafc00b243d0703e0_4912_A_FlexRay_S_49_B_1_R_2_ChA_OUT: FrIfCommunicationOperationIdx=8, FrIfLPduIdxRef=LPdu_frTrig_FR_3a54c8219f12452dafc00b243d0703e0_4912_A_FlexRay_S_49_B_1_R_2_ChA_OUT
                DECOUPLED_TRANSMISSION_LPdu_frTrig_FR_3a54c8219f12452dafc00b243d0703e0_1001_A_FlexRay_S_10_B_0_R_1_ChA_OUT: FrIfCommunicationOperationIdx=0, FrIfLPduIdxRef=LPdu_frTrig_FR_3a54c8219f12452dafc00b243d0703e0_1001_A_FlexRay_S_10_B_0_R_1_ChA_OUT
                DECOUPLED_TRANSMISSION_LPdu_frTrig_FR_3a54c8219f12452dafc00b243d0703e0_801_A_FlexRay_S_8_B_0_R_1_ChA_OUT: FrIfCommunicationOperationIdx=12, FrIfLPduIdxRef=LPdu_frTrig_FR_3a54c8219f12452dafc00b243d0703e0_801_A_FlexRay_S_8_B_0_R_1_ChA_OUT
                DECOUPLED_TRANSMISSION_LPdu_frTrig_FR_3a54c8219f12452dafc00b243d0703e0_901_A_FlexRay_S_9_B_0_R_1_ChA_OUT: FrIfCommunicationOperationIdx=14, FrIfLPduIdxRef=LPdu_frTrig_FR_3a54c8219f12452dafc00b243d0703e0_901_A_FlexRay_S_9_B_0_R_1_ChA_OUT
                DECOUPLED_TRANSMISSION_LPdu_frTrig_FR_3a54c8219f12452dafc00b243d0703e0_4902_A_FlexRay_S_49_B_0_R_2_ChA_OUT: FrIfCommunicationOperationIdx=6, FrIfLPduIdxRef=LPdu_frTrig_FR_3a54c8219f12452dafc00b243d0703e0_4902_A_FlexRay_S_49_B_0_R_2_ChA_OUT
                DECOUPLED_TRANSMISSION_LPdu_frTrig_FR_3a54c8219f12452dafc00b243d0703e0_5102_A_FlexRay_S_51_B_0_R_2_ChA_OUT: FrIfCommunicationOperationIdx=10, FrIfLPduIdxRef=LPdu_frTrig_FR_3a54c8219f12452dafc00b243d0703e0_5102_A_FlexRay_S_51_B_0_R_2_ChA_OUT
                DECOUPLED_TRANSMISSION_LPdu_frTrig_FR_3a54c8219f12452dafc00b243d0703e0_1101_A_FlexRay_S_11_B_0_R_1_ChA_OUT: FrIfCommunicationOperationIdx=2, FrIfLPduIdxRef=LPdu_frTrig_FR_3a54c8219f12452dafc00b243d0703e0_1101_A_FlexRay_S_11_B_0_R_1_ChA_OUT
            FrIf_TxJob_02: FrIfMacrotick=455, FrIfStartSlot=77, FrIfEndSlot=380, FrIfMaxIsrDelay=909, FrIfIsRxJob=false, FrIfJobId=1, FrIfTxConfJobRef=FrIf_RxJob_02
              16 x FrIfCommunicationOperation, all with FrIfCommunicationAction=DECOUPLED_TRANSMISSION, FrIfRxComOpMaxLoop=512, FrIfManualAssignedLPdu=false:
                DECOUPLED_TRANSMISSION_LPdu_frTrig_FR_3a54c8219f12452dafc00b243d0703e0_22001_A_FlexRay_S_220_B_0_R_1_ChA_OUT: FrIfCommunicationOperationIdx=4, FrIfLPduIdxRef=LPdu_frTrig_FR_3a54c8219f12452dafc00b243d0703e0_22001_A_FlexRay_S_220_B_0_R_1_ChA_OUT
                DECOUPLED_TRANSMISSION_LPdu_frTrig_FR_3a54c8219f12452dafc00b243d0703e0_31501_A_FlexRay_S_315_B_0_R_1_ChA_OUT: FrIfCommunicationOperationIdx=30, FrIfLPduIdxRef=LPdu_frTrig_FR_3a54c8219f12452dafc00b243d0703e0_31501_A_FlexRay_S_315_B_0_R_1_ChA_OUT
                DECOUPLED_TRANSMISSION_LPdu_frTrig_FR_3a54c8219f12452dafc00b243d0703e0_18301_A_FlexRay_S_183_B_0_R_1_ChA_OUT: FrIfCommunicationOperationIdx=0, FrIfLPduIdxRef=LPdu_frTrig_FR_3a54c8219f12452dafc00b243d0703e0_18301_A_FlexRay_S_183_B_0_R_1_ChA_OUT
                DECOUPLED_TRANSMISSION_LPdu_frTrig_FR_3a54c8219f12452dafc00b243d0703e0_27408_A_FlexRay_S_274_B_0_R_8_ChA_OUT: FrIfCommunicationOperationIdx=10, FrIfLPduIdxRef=LPdu_frTrig_FR_3a54c8219f12452dafc00b243d0703e0_27408_A_FlexRay_S_274_B_0_R_8_ChA_OUT
                DECOUPLED_TRANSMISSION_LPdu_frTrig_FR_3a54c8219f12452dafc00b243d0703e0_29901_A_FlexRay_S_299_B_0_R_1_ChA_OUT: FrIfCommunicationOperationIdx=24, FrIfLPduIdxRef=LPdu_frTrig_FR_3a54c8219f12452dafc00b243d0703e0_29901_A_FlexRay_S_299_B_0_R_1_ChA_OUT
                DECOUPLED_TRANSMISSION_LPdu_frTrig_FR_3a54c8219f12452dafc00b243d0703e0_29701_A_FlexRay_S_297_B_0_R_1_ChA_OUT: FrIfCommunicationOperationIdx=20, FrIfLPduIdxRef=LPdu_frTrig_FR_3a54c8219f12452dafc00b243d0703e0_29701_A_FlexRay_S_297_B_0_R_1_ChA_OUT
                DECOUPLED_TRANSMISSION_LPdu_frTrig_FR_3a54c8219f12452dafc00b243d0703e0_29801_A_FlexRay_S_298_B_0_R_1_ChA_OUT: FrIfCommunicationOperationIdx=22, FrIfLPduIdxRef=LPdu_frTrig_FR_3a54c8219f12452dafc00b243d0703e0_29801_A_FlexRay_S_298_B_0_R_1_ChA_OUT
                DECOUPLED_TRANSMISSION_LPdu_frTrig_FR_3a54c8219f12452dafc00b243d0703e0_23412_A_FlexRay_S_234_B_1_R_2_ChA_OUT: FrIfCommunicationOperationIdx=6, FrIfLPduIdxRef=LPdu_frTrig_FR_3a54c8219f12452dafc00b243d0703e0_23412_A_FlexRay_S_234_B_1_R_2_ChA_OUT
                DECOUPLED_TRANSMISSION_LPdu_frTrig_FR_3a54c8219f12452dafc00b243d0703e0_216916_A_FlexRay_S_216_B_9_R_16_ChA_OUT: FrIfCommunicationOperationIdx=2, FrIfLPduIdxRef=LPdu_frTrig_FR_3a54c8219f12452dafc00b243d0703e0_216916_A_FlexRay_S_216_B_9_R_16_ChA_OUT
                DECOUPLED_TRANSMISSION_LPdu_frTrig_FR_3a54c8219f12452dafc00b243d0703e0_29601_A_FlexRay_S_296_B_0_R_1_ChA_OUT: FrIfCommunicationOperationIdx=18, FrIfLPduIdxRef=LPdu_frTrig_FR_3a54c8219f12452dafc00b243d0703e0_29601_A_FlexRay_S_296_B_0_R_1_ChA_OUT
                DECOUPLED_TRANSMISSION_LPdu_frTrig_FR_3a54c8219f12452dafc00b243d0703e0_30001_A_FlexRay_S_300_B_0_R_1_ChA_OUT: FrIfCommunicationOperationIdx=26, FrIfLPduIdxRef=LPdu_frTrig_FR_3a54c8219f12452dafc00b243d0703e0_30001_A_FlexRay_S_300_B_0_R_1_ChA_OUT
                DECOUPLED_TRANSMISSION_LPdu_frTrig_FR_3a54c8219f12452dafc00b243d0703e0_29501_A_FlexRay_S_295_B_0_R_1_ChA_OUT: FrIfCommunicationOperationIdx=16, FrIfLPduIdxRef=LPdu_frTrig_FR_3a54c8219f12452dafc00b243d0703e0_29501_A_FlexRay_S_295_B_0_R_1_ChA_OUT
                DECOUPLED_TRANSMISSION_LPdu_frTrig_FR_3a54c8219f12452dafc00b243d0703e0_2481032_A_FlexRay_S_248_B_10_R_32_ChA_OUT: FrIfCommunicationOperationIdx=8, FrIfLPduIdxRef=LPdu_frTrig_FR_3a54c8219f12452dafc00b243d0703e0_2481032_A_FlexRay_S_248_B_10_R_32_ChA_OUT
                DECOUPLED_TRANSMISSION_LPdu_frTrig_FR_3a54c8219f12452dafc00b243d0703e0_29401_A_FlexRay_S_294_B_0_R_1_ChA_OUT: FrIfCommunicationOperationIdx=14, FrIfLPduIdxRef=LPdu_frTrig_FR_3a54c8219f12452dafc00b243d0703e0_29401_A_FlexRay_S_294_B_0_R_1_ChA_OUT
                DECOUPLED_TRANSMISSION_LPdu_frTrig_FR_3a54c8219f12452dafc00b243d0703e0_30101_A_FlexRay_S_301_B_0_R_1_ChA_OUT: FrIfCommunicationOperationIdx=28, FrIfLPduIdxRef=LPdu_frTrig_FR_3a54c8219f12452dafc00b243d0703e0_30101_A_FlexRay_S_301_B_0_R_1_ChA_OUT
                DECOUPLED_TRANSMISSION_LPdu_frTrig_FR_3a54c8219f12452dafc00b243d0703e0_27424_A_FlexRay_S_274_B_2_R_4_ChA_OUT: FrIfCommunicationOperationIdx=12, FrIfLPduIdxRef=LPdu_frTrig_FR_3a54c8219f12452dafc00b243d0703e0_27424_A_FlexRay_S_274_B_2_R_4_ChA_OUT
            FrIf_RxJob_02: FrIfMacrotick=17, FrIfStartSlot=77, FrIfEndSlot=380, FrIfMaxIsrDelay=1363, FrIfIsRxJob=true, FrIfJobId=1
              52 x FrIfCommunicationOperation, all with FrIfRxComOpMaxLoop=512, FrIfManualAssignedLPdu=false:
                RECEIVE_AND_INDICATE_LPdu_frTrig_FR_3a54c8219f12452dafc00b243d0703e0_215516_A_FlexRay_S_215_B_5_R_16_ChA_IN: FrIfCommunicationAction=RECEIVE_AND_INDICATE, FrIfCommunicationOperationIdx=30, FrIfLPduIdxRef=LPdu_frTrig_FR_3a54c8219f12452dafc00b243d0703e0_215516_A_FlexRay_S_215_B_5_R_16_ChA_IN
                RECEIVE_AND_INDICATE_LPdu_frTrig_FR_3a54c8219f12452dafc00b243d0703e0_24404_A_FlexRay_S_244_B_0_R_4_ChA_IN: FrIfCommunicationAction=RECEIVE_AND_INDICATE, FrIfCommunicationOperationIdx=54, FrIfLPduIdxRef=LPdu_frTrig_FR_3a54c8219f12452dafc00b243d0703e0_24404_A_FlexRay_S_244_B_0_R_4_ChA_IN
                RECEIVE_AND_INDICATE_LPdu_frTrig_FR_3a54c8219f12452dafc00b243d0703e0_2151016_A_FlexRay_S_215_B_10_R_16_ChA_IN: FrIfCommunicationAction=RECEIVE_AND_INDICATE, FrIfCommunicationOperationIdx=26, FrIfLPduIdxRef=LPdu_frTrig_FR_3a54c8219f12452dafc00b243d0703e0_2151016_A_FlexRay_S_215_B_10_R_16_ChA_IN
                RECEIVE_AND_INDICATE_LPdu_frTrig_FR_3a54c8219f12452dafc00b243d0703e0_25214_A_FlexRay_S_252_B_1_R_4_ChA_IN: FrIfCommunicationAction=RECEIVE_AND_INDICATE, FrIfCommunicationOperationIdx=60, FrIfLPduIdxRef=LPdu_frTrig_FR_3a54c8219f12452dafc00b243d0703e0_25214_A_FlexRay_S_252_B_1_R_4_ChA_IN
                RECEIVE_AND_INDICATE_LPdu_frTrig_FR_3a54c8219f12452dafc00b243d0703e0_11912_A_FlexRay_S_119_B_1_R_2_ChA_IN: FrIfCommunicationAction=RECEIVE_AND_INDICATE, FrIfCommunicationOperationIdx=8, FrIfLPduIdxRef=LPdu_frTrig_FR_3a54c8219f12452dafc00b243d0703e0_11912_A_FlexRay_S_119_B_1_R_2_ChA_IN
                RECEIVE_AND_INDICATE_LPdu_frTrig_FR_3a54c8219f12452dafc00b243d0703e0_2161216_A_FlexRay_S_216_B_12_R_16_ChA_IN: FrIfCommunicationAction=RECEIVE_AND_INDICATE, FrIfCommunicationOperationIdx=38, FrIfLPduIdxRef=LPdu_frTrig_FR_3a54c8219f12452dafc00b243d0703e0_2161216_A_FlexRay_S_216_B_12_R_16_ChA_IN
                RECEIVE_AND_INDICATE_LPdu_frTrig_FR_3a54c8219f12452dafc00b243d0703e0_24702_A_FlexRay_S_247_B_0_R_2_ChA_IN: FrIfCommunicationAction=RECEIVE_AND_INDICATE, FrIfCommunicationOperationIdx=56, FrIfLPduIdxRef=LPdu_frTrig_FR_3a54c8219f12452dafc00b243d0703e0_24702_A_FlexRay_S_247_B_0_R_2_ChA_IN
                RECEIVE_AND_INDICATE_LPdu_frTrig_FR_3a54c8219f12452dafc00b243d0703e0_27518_A_FlexRay_S_275_B_1_R_8_ChA_IN: FrIfCommunicationAction=RECEIVE_AND_INDICATE, FrIfCommunicationOperationIdx=64, FrIfLPduIdxRef=LPdu_frTrig_FR_3a54c8219f12452dafc00b243d0703e0_27518_A_FlexRay_S_275_B_1_R_8_ChA_IN
                RECEIVE_AND_INDICATE_LPdu_frTrig_FR_3a54c8219f12452dafc00b243d0703e0_12112_A_FlexRay_S_121_B_1_R_2_ChA_IN: FrIfCommunicationAction=RECEIVE_AND_INDICATE, FrIfCommunicationOperationIdx=10, FrIfLPduIdxRef=LPdu_frTrig_FR_3a54c8219f12452dafc00b243d0703e0_12112_A_FlexRay_S_121_B_1_R_2_ChA_IN
                TX_CONFIRMATION_LPdu_frTrig_FR_3a54c8219f12452dafc00b243d0703e0_29601_A_FlexRay_S_296_B_0_R_1_ChA_OUT: FrIfCommunicationAction=TX_CONFIRMATION, FrIfCommunicationOperationIdx=54, FrIfLPduIdxRef=LPdu_frTrig_FR_3a54c8219f12452dafc00b243d0703e0_29601_A_FlexRay_S_296_B_0_R_1_ChA_OUT
                RECEIVE_AND_INDICATE_LPdu_frTrig_FR_3a54c8219f12452dafc00b243d0703e0_215916_A_FlexRay_S_215_B_9_R_16_ChA_IN: FrIfCommunicationAction=RECEIVE_AND_INDICATE, FrIfCommunicationOperationIdx=34, FrIfLPduIdxRef=LPdu_frTrig_FR_3a54c8219f12452dafc00b243d0703e0_215916_A_FlexRay_S_215_B_9_R_16_ChA_IN
                TX_CONFIRMATION_LPdu_frTrig_FR_3a54c8219f12452dafc00b243d0703e0_29401_A_FlexRay_S_294_B_0_R_1_ChA_OUT: FrIfCommunicationAction=TX_CONFIRMATION, FrIfCommunicationOperationIdx=50, FrIfLPduIdxRef=LPdu_frTrig_FR_3a54c8219f12452dafc00b243d0703e0_29401_A_FlexRay_S_294_B_0_R_1_ChA_OUT
                TX_CONFIRMATION_LPdu_frTrig_FR_3a54c8219f12452dafc00b243d0703e0_30101_A_FlexRay_S_301_B_0_R_1_ChA_OUT: FrIfCommunicationAction=TX_CONFIRMATION, FrIfCommunicationOperationIdx=64, FrIfLPduIdxRef=LPdu_frTrig_FR_3a54c8219f12452dafc00b243d0703e0_30101_A_FlexRay_S_301_B_0_R_1_ChA_OUT
                RECEIVE_AND_INDICATE_LPdu_frTrig_FR_3a54c8219f12452dafc00b243d0703e0_20901_A_FlexRay_S_209_B_0_R_1_ChA_IN: FrIfCommunicationAction=RECEIVE_AND_INDICATE, FrIfCommunicationOperationIdx=14, FrIfLPduIdxRef=LPdu_frTrig_FR_3a54c8219f12452dafc00b243d0703e0_20901_A_FlexRay_S_209_B_0_R_1_ChA_IN
                TX_CONFIRMATION_LPdu_frTrig_FR_3a54c8219f12452dafc00b243d0703e0_2481032_A_FlexRay_S_248_B_10_R_32_ChA_OUT: FrIfCommunicationAction=TX_CONFIRMATION, FrIfCommunicationOperationIdx=44, FrIfLPduIdxRef=LPdu_frTrig_FR_3a54c8219f12452dafc00b243d0703e0_2481032_A_FlexRay_S_248_B_10_R_32_ChA_OUT
                RECEIVE_AND_INDICATE_LPdu_frTrig_FR_3a54c8219f12452dafc00b243d0703e0_216616_A_FlexRay_S_216_B_6_R_16_ChA_IN: FrIfCommunicationAction=RECEIVE_AND_INDICATE, FrIfCommunicationOperationIdx=46, FrIfLPduIdxRef=LPdu_frTrig_FR_3a54c8219f12452dafc00b243d0703e0_216616_A_FlexRay_S_216_B_6_R_16_ChA_IN
                RECEIVE_AND_INDICATE_LPdu_frTrig_FR_3a54c8219f12452dafc00b243d0703e0_21201_A_FlexRay_S_212_B_0_R_1_ChA_IN: FrIfCommunicationAction=RECEIVE_AND_INDICATE, FrIfCommunicationOperationIdx=20, FrIfLPduIdxRef=LPdu_frTrig_FR_3a54c8219f12452dafc00b243d0703e0_21201_A_FlexRay_S_212_B_0_R_1_ChA_IN
                RECEIVE_AND_INDICATE_LPdu_frTrig_FR_3a54c8219f12452dafc00b243d0703e0_11702_A_FlexRay_S_117_B_0_R_2_ChA_IN: FrIfCommunicationAction=RECEIVE_AND_INDICATE, FrIfCommunicationOperationIdx=6, FrIfLPduIdxRef=LPdu_frTrig_FR_3a54c8219f12452dafc00b243d0703e0_11702_A_FlexRay_S_117_B_0_R_2_ChA_IN
                RECEIVE_AND_INDICATE_LPdu_frTrig_FR_3a54c8219f12452dafc00b243d0703e0_21101_A_FlexRay_S_211_B_0_R_1_ChA_IN: FrIfCommunicationAction=RECEIVE_AND_INDICATE, FrIfCommunicationOperationIdx=18, FrIfLPduIdxRef=LPdu_frTrig_FR_3a54c8219f12452dafc00b243d0703e0_21101_A_FlexRay_S_211_B_0_R_1_ChA_IN
                RECEIVE_AND_INDICATE_LPdu_frTrig_FR_3a54c8219f12452dafc00b243d0703e0_2161016_A_FlexRay_S_216_B_10_R_16_ChA_IN: FrIfCommunicationAction=RECEIVE_AND_INDICATE, FrIfCommunicationOperationIdx=36, FrIfLPduIdxRef=LPdu_frTrig_FR_3a54c8219f12452dafc00b243d0703e0_2161016_A_FlexRay_S_216_B_10_R_16_ChA_IN
                TX_CONFIRMATION_LPdu_frTrig_FR_3a54c8219f12452dafc00b243d0703e0_27408_A_FlexRay_S_274_B_0_R_8_ChA_OUT: FrIfCommunicationAction=TX_CONFIRMATION, FrIfCommunicationOperationIdx=46, FrIfLPduIdxRef=LPdu_frTrig_FR_3a54c8219f12452dafc00b243d0703e0_27408_A_FlexRay_S_274_B_0_R_8_ChA_OUT
                RECEIVE_AND_INDICATE_LPdu_frTrig_FR_3a54c8219f12452dafc00b243d0703e0_24712_A_FlexRay_S_247_B_1_R_2_ChA_IN: FrIfCommunicationAction=RECEIVE_AND_INDICATE, FrIfCommunicationOperationIdx=58, FrIfLPduIdxRef=LPdu_frTrig_FR_3a54c8219f12452dafc00b243d0703e0_24712_A_FlexRay_S_247_B_1_R_2_ChA_IN
                TX_CONFIRMATION_LPdu_frTrig_FR_3a54c8219f12452dafc00b243d0703e0_29801_A_FlexRay_S_298_B_0_R_1_ChA_OUT: FrIfCommunicationAction=TX_CONFIRMATION, FrIfCommunicationOperationIdx=58, FrIfLPduIdxRef=LPdu_frTrig_FR_3a54c8219f12452dafc00b243d0703e0_29801_A_FlexRay_S_298_B_0_R_1_ChA_OUT
                RECEIVE_AND_INDICATE_LPdu_frTrig_FR_3a54c8219f12452dafc00b243d0703e0_2161316_A_FlexRay_S_216_B_13_R_16_ChA_IN: FrIfCommunicationAction=RECEIVE_AND_INDICATE, FrIfCommunicationOperationIdx=40, FrIfLPduIdxRef=LPdu_frTrig_FR_3a54c8219f12452dafc00b243d0703e0_2161316_A_FlexRay_S_216_B_13_R_16_ChA_IN
                RECEIVE_AND_INDICATE_LPdu_frTrig_FR_3a54c8219f12452dafc00b243d0703e0_10802_A_FlexRay_S_108_B_0_R_2_ChA_IN: FrIfCommunicationAction=RECEIVE_AND_INDICATE, FrIfCommunicationOperationIdx=4, FrIfLPduIdxRef=LPdu_frTrig_FR_3a54c8219f12452dafc00b243d0703e0_10802_A_FlexRay_S_108_B_0_R_2_ChA_IN
                RECEIVE_AND_INDICATE_LPdu_frTrig_FR_3a54c8219f12452dafc00b243d0703e0_14701_A_FlexRay_S_147_B_0_R_1_ChA_IN: FrIfCommunicationAction=RECEIVE_AND_INDICATE, FrIfCommunicationOperationIdx=12, FrIfLPduIdxRef=LPdu_frTrig_FR_3a54c8219f12452dafc00b243d0703e0_14701_A_FlexRay_S_147_B_0_R_1_ChA_IN
                RECEIVE_AND_INDICATE_LPdu_frTrig_FR_3a54c8219f12452dafc00b243d0703e0_26924_A_FlexRay_S_269_B_2_R_4_ChA_IN: FrIfCommunicationAction=RECEIVE_AND_INDICATE, FrIfCommunicationOperationIdx=62, FrIfLPduIdxRef=LPdu_frTrig_FR_3a54c8219f12452dafc00b243d0703e0_26924_A_FlexRay_S_269_B_2_R_4_ChA_IN
                TX_CONFIRMATION_LPdu_frTrig_FR_3a54c8219f12452dafc00b243d0703e0_23412_A_FlexRay_S_234_B_1_R_2_ChA_OUT: FrIfCommunicationAction=TX_CONFIRMATION, FrIfCommunicationOperationIdx=42, FrIfLPduIdxRef=LPdu_frTrig_FR_3a54c8219f12452dafc00b243d0703e0_23412_A_FlexRay_S_234_B_1_R_2_ChA_OUT
                RECEIVE_AND_INDICATE_LPdu_frTrig_FR_3a54c8219f12452dafc00b243d0703e0_216716_A_FlexRay_S_216_B_7_R_16_ChA_IN: FrIfCommunicationAction=RECEIVE_AND_INDICATE, FrIfCommunicationOperationIdx=48, FrIfLPduIdxRef=LPdu_frTrig_FR_3a54c8219f12452dafc00b243d0703e0_216716_A_FlexRay_S_216_B_7_R_16_ChA_IN
                RECEIVE_AND_INDICATE_LPdu_frTrig_FR_3a54c8219f12452dafc00b243d0703e0_21901_A_FlexRay_S_219_B_0_R_1_ChA_IN: FrIfCommunicationAction=RECEIVE_AND_INDICATE, FrIfCommunicationOperationIdx=50, FrIfLPduIdxRef=LPdu_frTrig_FR_3a54c8219f12452dafc00b243d0703e0_21901_A_FlexRay_S_219_B_0_R_1_ChA_IN
                TX_CONFIRMATION_LPdu_frTrig_FR_3a54c8219f12452dafc00b243d0703e0_30001_A_FlexRay_S_300_B_0_R_1_ChA_OUT: FrIfCommunicationAction=TX_CONFIRMATION, FrIfCommunicationOperationIdx=62, FrIfLPduIdxRef=LPdu_frTrig_FR_3a54c8219f12452dafc00b243d0703e0_30001_A_FlexRay_S_300_B_0_R_1_ChA_OUT
                RECEIVE_AND_INDICATE_LPdu_frTrig_FR_3a54c8219f12452dafc00b243d0703e0_27628_A_FlexRay_S_276_B_2_R_8_ChA_IN: FrIfCommunicationAction=RECEIVE_AND_INDICATE, FrIfCommunicationOperationIdx=68, FrIfLPduIdxRef=LPdu_frTrig_FR_3a54c8219f12452dafc00b243d0703e0_27628_A_FlexRay_S_276_B_2_R_8_ChA_IN
                RECEIVE_AND_INDICATE_LPdu_frTrig_FR_3a54c8219f12452dafc00b243d0703e0_10701_A_FlexRay_S_107_B_0_R_1_ChA_IN: FrIfCommunicationAction=RECEIVE_AND_INDICATE, FrIfCommunicationOperationIdx=2, FrIfLPduIdxRef=LPdu_frTrig_FR_3a54c8219f12452dafc00b243d0703e0_10701_A_FlexRay_S_107_B_0_R_1_ChA_IN
                RECEIVE_AND_INDICATE_LPdu_frTrig_FR_3a54c8219f12452dafc00b243d0703e0_10401_A_FlexRay_S_104_B_0_R_1_ChA_IN: FrIfCommunicationAction=RECEIVE_AND_INDICATE, FrIfCommunicationOperationIdx=0, FrIfLPduIdxRef=LPdu_frTrig_FR_3a54c8219f12452dafc00b243d0703e0_10401_A_FlexRay_S_104_B_0_R_1_ChA_IN
                TX_CONFIRMATION_LPdu_frTrig_FR_3a54c8219f12452dafc00b243d0703e0_22001_A_FlexRay_S_220_B_0_R_1_ChA_OUT: FrIfCommunicationAction=TX_CONFIRMATION, FrIfCommunicationOperationIdx=40, FrIfLPduIdxRef=LPdu_frTrig_FR_3a54c8219f12452dafc00b243d0703e0_22001_A_FlexRay_S_220_B_0_R_1_ChA_OUT
                TX_CONFIRMATION_LPdu_frTrig_FR_3a54c8219f12452dafc00b243d0703e0_216916_A_FlexRay_S_216_B_9_R_16_ChA_OUT: FrIfCommunicationAction=TX_CONFIRMATION, FrIfCommunicationOperationIdx=38, FrIfLPduIdxRef=LPdu_frTrig_FR_3a54c8219f12452dafc00b243d0703e0_216916_A_FlexRay_S_216_B_9_R_16_ChA_OUT
                TX_CONFIRMATION_LPdu_frTrig_FR_3a54c8219f12452dafc00b243d0703e0_29501_A_FlexRay_S_295_B_0_R_1_ChA_OUT: FrIfCommunicationAction=TX_CONFIRMATION, FrIfCommunicationOperationIdx=52, FrIfLPduIdxRef=LPdu_frTrig_FR_3a54c8219f12452dafc00b243d0703e0_29501_A_FlexRay_S_295_B_0_R_1_ChA_OUT
                RECEIVE_AND_INDICATE_LPdu_frTrig_FR_3a54c8219f12452dafc00b243d0703e0_21434_A_FlexRay_S_214_B_3_R_4_ChA_IN: FrIfCommunicationAction=RECEIVE_AND_INDICATE, FrIfCommunicationOperationIdx=24, FrIfLPduIdxRef=LPdu_frTrig_FR_3a54c8219f12452dafc00b243d0703e0_21434_A_FlexRay_S_214_B_3_R_4_ChA_IN
                RECEIVE_AND_INDICATE_LPdu_frTrig_FR_3a54c8219f12452dafc00b243d0703e0_23212_A_FlexRay_S_232_B_1_R_2_ChA_IN: FrIfCommunicationAction=RECEIVE_AND_INDICATE, FrIfCommunicationOperationIdx=52, FrIfLPduIdxRef=LPdu_frTrig_FR_3a54c8219f12452dafc00b243d0703e0_23212_A_FlexRay_S_232_B_1_R_2_ChA_IN
                RECEIVE_AND_INDICATE_LPdu_frTrig_FR_3a54c8219f12452dafc00b243d0703e0_2161416_A_FlexRay_S_216_B_14_R_16_ChA_IN: FrIfCommunicationAction=RECEIVE_AND_INDICATE, FrIfCommunicationOperationIdx=42, FrIfLPduIdxRef=LPdu_frTrig_FR_3a54c8219f12452dafc00b243d0703e0_2161416_A_FlexRay_S_216_B_14_R_16_ChA_IN
                TX_CONFIRMATION_LPdu_frTrig_FR_3a54c8219f12452dafc00b243d0703e0_27424_A_FlexRay_S_274_B_2_R_4_ChA_OUT: FrIfCommunicationAction=TX_CONFIRMATION, FrIfCommunicationOperationIdx=48, FrIfLPduIdxRef=LPdu_frTrig_FR_3a54c8219f12452dafc00b243d0703e0_27424_A_FlexRay_S_274_B_2_R_4_ChA_OUT
                RECEIVE_AND_INDICATE_LPdu_frTrig_FR_3a54c8219f12452dafc00b243d0703e0_27648_A_FlexRay_S_276_B_4_R_8_ChA_IN: FrIfCommunicationAction=RECEIVE_AND_INDICATE, FrIfCommunicationOperationIdx=70, FrIfLPduIdxRef=LPdu_frTrig_FR_3a54c8219f12452dafc00b243d0703e0_27648_A_FlexRay_S_276_B_4_R_8_ChA_IN
                TX_CONFIRMATION_LPdu_frTrig_FR_3a54c8219f12452dafc00b243d0703e0_29901_A_FlexRay_S_299_B_0_R_1_ChA_OUT: FrIfCommunicationAction=TX_CONFIRMATION, FrIfCommunicationOperationIdx=60, FrIfLPduIdxRef=LPdu_frTrig_FR_3a54c8219f12452dafc00b243d0703e0_29901_A_FlexRay_S_299_B_0_R_1_ChA_OUT
                TX_CONFIRMATION_LPdu_frTrig_FR_3a54c8219f12452dafc00b243d0703e0_29701_A_FlexRay_S_297_B_0_R_1_ChA_OUT: FrIfCommunicationAction=TX_CONFIRMATION, FrIfCommunicationOperationIdx=56, FrIfLPduIdxRef=LPdu_frTrig_FR_3a54c8219f12452dafc00b243d0703e0_29701_A_FlexRay_S_297_B_0_R_1_ChA_OUT
                RECEIVE_AND_INDICATE_LPdu_frTrig_FR_3a54c8219f12452dafc00b243d0703e0_27578_A_FlexRay_S_275_B_7_R_8_ChA_IN: FrIfCommunicationAction=RECEIVE_AND_INDICATE, FrIfCommunicationOperationIdx=66, FrIfLPduIdxRef=LPdu_frTrig_FR_3a54c8219f12452dafc00b243d0703e0_27578_A_FlexRay_S_275_B_7_R_8_ChA_IN
                RECEIVE_AND_INDICATE_LPdu_frTrig_FR_3a54c8219f12452dafc00b243d0703e0_21301_A_FlexRay_S_213_B_0_R_1_ChA_IN: FrIfCommunicationAction=RECEIVE_AND_INDICATE, FrIfCommunicationOperationIdx=22, FrIfLPduIdxRef=LPdu_frTrig_FR_3a54c8219f12452dafc00b243d0703e0_21301_A_FlexRay_S_213_B_0_R_1_ChA_IN
                TX_CONFIRMATION_LPdu_frTrig_FR_3a54c8219f12452dafc00b243d0703e0_31501_A_FlexRay_S_315_B_0_R_1_ChA_OUT: FrIfCommunicationAction=TX_CONFIRMATION, FrIfCommunicationOperationIdx=66, FrIfLPduIdxRef=LPdu_frTrig_FR_3a54c8219f12452dafc00b243d0703e0_31501_A_FlexRay_S_315_B_0_R_1_ChA_OUT
                RECEIVE_AND_INDICATE_LPdu_frTrig_FR_3a54c8219f12452dafc00b243d0703e0_215216_A_FlexRay_S_215_B_2_R_16_ChA_IN: FrIfCommunicationAction=RECEIVE_AND_INDICATE, FrIfCommunicationOperationIdx=28, FrIfLPduIdxRef=LPdu_frTrig_FR_3a54c8219f12452dafc00b243d0703e0_215216_A_FlexRay_S_215_B_2_R_16_ChA_IN
                RECEIVE_AND_INDICATE_LPdu_frTrig_FR_3a54c8219f12452dafc00b243d0703e0_21001_A_FlexRay_S_210_B_0_R_1_ChA_IN: FrIfCommunicationAction=RECEIVE_AND_INDICATE, FrIfCommunicationOperationIdx=16, FrIfLPduIdxRef=LPdu_frTrig_FR_3a54c8219f12452dafc00b243d0703e0_21001_A_FlexRay_S_210_B_0_R_1_ChA_IN
                TX_CONFIRMATION_LPdu_frTrig_FR_3a54c8219f12452dafc00b243d0703e0_18301_A_FlexRay_S_183_B_0_R_1_ChA_OUT: FrIfCommunicationAction=TX_CONFIRMATION, FrIfCommunicationOperationIdx=36, FrIfLPduIdxRef=LPdu_frTrig_FR_3a54c8219f12452dafc00b243d0703e0_18301_A_FlexRay_S_183_B_0_R_1_ChA_OUT
                RECEIVE_AND_INDICATE_LPdu_frTrig_FR_3a54c8219f12452dafc00b243d0703e0_215616_A_FlexRay_S_215_B_6_R_16_ChA_IN: FrIfCommunicationAction=RECEIVE_AND_INDICATE, FrIfCommunicationOperationIdx=32, FrIfLPduIdxRef=LPdu_frTrig_FR_3a54c8219f12452dafc00b243d0703e0_215616_A_FlexRay_S_215_B_6_R_16_ChA_IN
                RECEIVE_AND_INDICATE_LPdu_frTrig_FR_3a54c8219f12452dafc00b243d0703e0_2161516_A_FlexRay_S_216_B_15_R_16_ChA_IN: FrIfCommunicationAction=RECEIVE_AND_INDICATE, FrIfCommunicationOperationIdx=44, FrIfLPduIdxRef=LPdu_frTrig_FR_3a54c8219f12452dafc00b243d0703e0_2161516_A_FlexRay_S_216_B_15_R_16_ChA_IN
            FrIf_RxJob_01: FrIfMacrotick=1842, FrIfStartSlot=1, FrIfEndSlot=76, FrIfMaxIsrDelay=1363, FrIfIsRxJob=true, FrIfJobId=0
              17 x FrIfCommunicationOperation, all with FrIfRxComOpMaxLoop=512, FrIfManualAssignedLPdu=false:
                TX_CONFIRMATION_LPdu_frTrig_FR_3a54c8219f12452dafc00b243d0703e0_1101_A_FlexRay_S_11_B_0_R_1_ChA_OUT: FrIfCommunicationAction=TX_CONFIRMATION, FrIfCommunicationOperationIdx=11, FrIfLPduIdxRef=LPdu_frTrig_FR_3a54c8219f12452dafc00b243d0703e0_1101_A_FlexRay_S_11_B_0_R_1_ChA_OUT
                TX_CONFIRMATION_LPdu_frTrig_FR_3a54c8219f12452dafc00b243d0703e0_4902_A_FlexRay_S_49_B_0_R_2_ChA_OUT: FrIfCommunicationAction=TX_CONFIRMATION, FrIfCommunicationOperationIdx=15, FrIfLPduIdxRef=LPdu_frTrig_FR_3a54c8219f12452dafc00b243d0703e0_4902_A_FlexRay_S_49_B_0_R_2_ChA_OUT
                RECEIVE_AND_INDICATE_LPdu_frTrig_FR_3a54c8219f12452dafc00b243d0703e0_5534_A_FlexRay_S_55_B_3_R_4_ChA_IN: FrIfCommunicationAction=RECEIVE_AND_INDICATE, FrIfCommunicationOperationIdx=8, FrIfLPduIdxRef=LPdu_frTrig_FR_3a54c8219f12452dafc00b243d0703e0_5534_A_FlexRay_S_55_B_3_R_4_ChA_IN
                RECEIVE_AND_INDICATE_LPdu_frTrig_FR_3a54c8219f12452dafc00b243d0703e0_4601_A_FlexRay_S_46_B_0_R_1_ChA_IN: FrIfCommunicationAction=RECEIVE_AND_INDICATE, FrIfCommunicationOperationIdx=0, FrIfLPduIdxRef=LPdu_frTrig_FR_3a54c8219f12452dafc00b243d0703e0_4601_A_FlexRay_S_46_B_0_R_1_ChA_IN
                TX_CONFIRMATION_LPdu_frTrig_FR_3a54c8219f12452dafc00b243d0703e0_1201_A_FlexRay_S_12_B_0_R_1_ChA_OUT: FrIfCommunicationAction=TX_CONFIRMATION, FrIfCommunicationOperationIdx=13, FrIfLPduIdxRef=LPdu_frTrig_FR_3a54c8219f12452dafc00b243d0703e0_1201_A_FlexRay_S_12_B_0_R_1_ChA_OUT
                TX_CONFIRMATION_LPdu_frTrig_FR_3a54c8219f12452dafc00b243d0703e0_1001_A_FlexRay_S_10_B_0_R_1_ChA_OUT: FrIfCommunicationAction=TX_CONFIRMATION, FrIfCommunicationOperationIdx=9, FrIfLPduIdxRef=LPdu_frTrig_FR_3a54c8219f12452dafc00b243d0703e0_1001_A_FlexRay_S_10_B_0_R_1_ChA_OUT
                RECEIVE_AND_INDICATE_LPdu_frTrig_FR_3a54c8219f12452dafc00b243d0703e0_5602_A_FlexRay_S_56_B_0_R_2_ChA_IN: FrIfCommunicationAction=RECEIVE_AND_INDICATE, FrIfCommunicationOperationIdx=10, FrIfLPduIdxRef=LPdu_frTrig_FR_3a54c8219f12452dafc00b243d0703e0_5602_A_FlexRay_S_56_B_0_R_2_ChA_IN
                TX_CONFIRMATION_LPdu_frTrig_FR_3a54c8219f12452dafc00b243d0703e0_801_A_FlexRay_S_8_B_0_R_1_ChA_OUT: FrIfCommunicationAction=TX_CONFIRMATION, FrIfCommunicationOperationIdx=21, FrIfLPduIdxRef=LPdu_frTrig_FR_3a54c8219f12452dafc00b243d0703e0_801_A_FlexRay_S_8_B_0_R_1_ChA_OUT
                RECEIVE_AND_INDICATE_LPdu_frTrig_FR_3a54c8219f12452dafc00b243d0703e0_5502_A_FlexRay_S_55_B_0_R_2_ChA_IN: FrIfCommunicationAction=RECEIVE_AND_INDICATE, FrIfCommunicationOperationIdx=6, FrIfLPduIdxRef=LPdu_frTrig_FR_3a54c8219f12452dafc00b243d0703e0_5502_A_FlexRay_S_55_B_0_R_2_ChA_IN
                TX_CONFIRMATION_LPdu_frTrig_FR_3a54c8219f12452dafc00b243d0703e0_901_A_FlexRay_S_9_B_0_R_1_ChA_OUT: FrIfCommunicationAction=TX_CONFIRMATION, FrIfCommunicationOperationIdx=23, FrIfLPduIdxRef=LPdu_frTrig_FR_3a54c8219f12452dafc00b243d0703e0_901_A_FlexRay_S_9_B_0_R_1_ChA_OUT
                TX_CONFIRMATION_LPdu_frTrig_FR_3a54c8219f12452dafc00b243d0703e0_4912_A_FlexRay_S_49_B_1_R_2_ChA_OUT: FrIfCommunicationAction=TX_CONFIRMATION, FrIfCommunicationOperationIdx=17, FrIfLPduIdxRef=LPdu_frTrig_FR_3a54c8219f12452dafc00b243d0703e0_4912_A_FlexRay_S_49_B_1_R_2_ChA_OUT
                TX_CONFIRMATION_LPdu_frTrig_FR_3a54c8219f12452dafc00b243d0703e0_5102_A_FlexRay_S_51_B_0_R_2_ChA_OUT: FrIfCommunicationAction=TX_CONFIRMATION, FrIfCommunicationOperationIdx=19, FrIfLPduIdxRef=LPdu_frTrig_FR_3a54c8219f12452dafc00b243d0703e0_5102_A_FlexRay_S_51_B_0_R_2_ChA_OUT
                RECEIVE_AND_INDICATE_LPdu_frTrig_FR_3a54c8219f12452dafc00b243d0703e0_4712_A_FlexRay_S_47_B_1_R_2_ChA_IN: FrIfCommunicationAction=RECEIVE_AND_INDICATE, FrIfCommunicationOperationIdx=2, FrIfLPduIdxRef=LPdu_frTrig_FR_3a54c8219f12452dafc00b243d0703e0_4712_A_FlexRay_S_47_B_1_R_2_ChA_IN
                RECEIVE_AND_INDICATE_LPdu_frTrig_FR_3a54c8219f12452dafc00b243d0703e0_6512_A_FlexRay_S_65_B_1_R_2_ChA_IN: FrIfCommunicationAction=RECEIVE_AND_INDICATE, FrIfCommunicationOperationIdx=12, FrIfLPduIdxRef=LPdu_frTrig_FR_3a54c8219f12452dafc00b243d0703e0_6512_A_FlexRay_S_65_B_1_R_2_ChA_IN
                RECEIVE_AND_INDICATE_LPdu_frTrig_FR_3a54c8219f12452dafc00b243d0703e0_5338_A_FlexRay_S_53_B_3_R_8_ChA_IN: FrIfCommunicationAction=RECEIVE_AND_INDICATE, FrIfCommunicationOperationIdx=4, FrIfLPduIdxRef=LPdu_frTrig_FR_3a54c8219f12452dafc00b243d0703e0_5338_A_FlexRay_S_53_B_3_R_8_ChA_IN
                RECEIVE_AND_INDICATE_LPdu_frTrig_FR_3a54c8219f12452dafc00b243d0703e0_6802_A_FlexRay_S_68_B_0_R_2_ChA_IN: FrIfCommunicationAction=RECEIVE_AND_INDICATE, FrIfCommunicationOperationIdx=14, FrIfLPduIdxRef=LPdu_frTrig_FR_3a54c8219f12452dafc00b243d0703e0_6802_A_FlexRay_S_68_B_0_R_2_ChA_IN
                RECEIVE_AND_INDICATE_LPdu_frTrig_FR_3a54c8219f12452dafc00b243d0703e0_6812_A_FlexRay_S_68_B_1_R_2_ChA_IN: FrIfCommunicationAction=RECEIVE_AND_INDICATE, FrIfCommunicationOperationIdx=16, FrIfLPduIdxRef=LPdu_frTrig_FR_3a54c8219f12452dafc00b243d0703e0_6812_A_FlexRay_S_68_B_1_R_2_ChA_IN
        contr_EPS_A_FlexRay (FrIfController): FrIfCtrlIdx=0, FrIfFrCtrlRef=contr_EPS_A_FlexRay
          5 x FrIfLPdu, all with FrIfReconfigurable=false:
            LPdu_frTrig_FR_3a54c8219f12452dafc00b243d0703e0_21301_A_FlexRay_S_213_B_0_R_1_ChA_IN: FrIfLPduIdx=48, FrIfVBTriggeringRef=frTrig_FR_3a54c8219f12452dafc00b243d0703e0_21301_A_FlexRay_S_213_B_0_R_1_ChA_IN  # frTrig_FR_3a54c8219f12452dafc00b243d0703e0_21301_A_FlexRay
            LPdu_frTrig_FR_3a54c8219f12452dafc00b243d0703e0_2161316_A_FlexRay_S_216_B_13_R_16_ChA_IN: FrIfLPduIdx=39, FrIfVBTriggeringRef=frTrig_FR_3a54c8219f12452dafc00b243d0703e0_2161316_A_FlexRay_S_216_B_13_R_16_ChA_IN  # frTrig_FR_3a54c8219f12452dafc00b243d0703e0_2161316_A_FlexRay
            LPdu_frTrig_FR_3a54c8219f12452dafc00b243d0703e0_31501_A_FlexRay_S_315_B_0_R_1_ChA_OUT: FrIfLPduIdx=0, FrIfVBTriggeringRef=frTrig_FR_3a54c8219f12452dafc00b243d0703e0_31501_A_FlexRay_S_315_B_0_R_1_ChA_OUT  # frTrig_FR_3a54c8219f12452dafc00b243d0703e0_31501_A_FlexRay
            LPdu_frTrig_FR_3a54c8219f12452dafc00b243d0703e0_216616_A_FlexRay_S_216_B_6_R_16_ChA_IN: FrIfLPduIdx=35, FrIfVBTriggeringRef=frTrig_FR_3a54c8219f12452dafc00b243d0703e0_216616_A_FlexRay_S_216_B_6_R_16_ChA_IN  # frTrig_FR_3a54c8219f12452dafc00b243d0703e0_216616_A_FlexRay
            LPdu_frTrig_FR_3a54c8219f12452dafc00b243d0703e0_1001_A_FlexRay_S_10_B_0_R_1_ChA_OUT: FrIfLPduIdx=21, FrIfVBTriggeringRef=frTrig_FR_3a54c8219f12452dafc00b243d0703e0_1001_A_FlexRay_S_10_B_0_R_1_ChA_OUT  # frTrig_FR_3a54c8219f12452dafc00b243d0703e0_1001_A_FlexRay
          frTrig_FR_3a54c8219f12452dafc00b243d0703e0_5502_A_FlexRay_S_55_B_0_R_2_ChA_IN (FrIfFrameTriggering):
            FrIfAllowDynamicLSduLength = false
            FrIfBaseCycle = 0
            FrIfChannel = FRIF_CHANNEL_A
            FrIfCycleRepetition = 2
            FrIfLSduLength = 14
            FrIfPayloadPreamble = false
            FrIfSlotId = 55
            FrIfAlwaysTransmit = false
            FrIfFrameStructureRef = FrStr_ACLNX_MASSCNTR_ACLNY_MASSCNTR
          frTrig_FR_3a54c8219f12452dafc00b243d0703e0_27628_A_FlexRay_S_276_B_2_R_8_ChA_IN (FrIfFrameTriggering):
            FrIfAllowDynamicLSduLength = false
            FrIfBaseCycle = 2
            FrIfChannel = FRIF_CHANNEL_A
            FrIfCycleRepetition = 8
            FrIfLSduLength = 6
            FrIfPayloadPreamble = false
            FrIfSlotId = 276
            FrIfAlwaysTransmit = false
            FrIfFrameStructureRef = FrStr_RELATIVZEIT
          3 x FrIfLPdu, all with FrIfReconfigurable=false:
            LPdu_frTrig_FR_3a54c8219f12452dafc00b243d0703e0_29701_A_FlexRay_S_297_B_0_R_1_ChA_OUT: FrIfLPduIdx=5, FrIfVBTriggeringRef=frTrig_FR_3a54c8219f12452dafc00b243d0703e0_29701_A_FlexRay_S_297_B_0_R_1_ChA_OUT  # frTrig_FR_3a54c8219f12452dafc00b243d0703e0_29701_A_FlexRay
            LPdu_frTrig_FR_3a54c8219f12452dafc00b243d0703e0_4912_A_FlexRay_S_49_B_1_R_2_ChA_OUT: FrIfLPduIdx=17, FrIfVBTriggeringRef=frTrig_FR_3a54c8219f12452dafc00b243d0703e0_4912_A_FlexRay_S_49_B_1_R_2_ChA_OUT  # frTrig_FR_3a54c8219f12452dafc00b243d0703e0_4912_A_FlexRay
            LPdu_frTrig_FR_3a54c8219f12452dafc00b243d0703e0_24404_A_FlexRay_S_244_B_0_R_4_ChA_IN: FrIfLPduIdx=32, FrIfVBTriggeringRef=frTrig_FR_3a54c8219f12452dafc00b243d0703e0_24404_A_FlexRay_S_244_B_0_R_4_ChA_IN  # frTrig_FR_3a54c8219f12452dafc00b243d0703e0_24404_A_FlexRay
          frTrig_FR_3a54c8219f12452dafc00b243d0703e0_6812_A_FlexRay_S_68_B_1_R_2_ChA_IN (FrIfFrameTriggering):
            FrIfAllowDynamicLSduLength = false
            FrIfBaseCycle = 1
            FrIfChannel = FRIF_CHANNEL_A
            FrIfCycleRepetition = 2
            FrIfLSduLength = 8
            FrIfPayloadPreamble = false
            FrIfSlotId = 68
            FrIfAlwaysTransmit = false
            FrIfFrameStructureRef = FrStr_ENERG_DGR_DRDY
          LPdu_frTrig_FR_3a54c8219f12452dafc00b243d0703e0_23412_A_FlexRay_S_234_B_1_R_2_ChA_OUT (FrIfLPdu): FrIfLPduIdx=12, FrIfReconfigurable=false, FrIfVBTriggeringRef=frTrig_FR_3a54c8219f12452dafc00b243d0703e0_23412_A_FlexRay_S_234_B_1_R_2_ChA_OUT  # frTrig_FR_3a54c8219f12452dafc00b243d0703e0_23412_A_FlexRay
          frTrig_FR_3a54c8219f12452dafc00b243d0703e0_216616_A_FlexRay_S_216_B_6_R_16_ChA_IN (FrIfFrameTriggering):
            FrIfAllowDynamicLSduLength = false
            FrIfBaseCycle = 6
            FrIfChannel = FRIF_CHANNEL_A
            FrIfCycleRepetition = 16
            FrIfLSduLength = 8
            FrIfPayloadPreamble = false
            FrIfSlotId = 216
            FrIfAlwaysTransmit = false
            FrIfFrameStructureRef = FrStr_SVC_e64c1db1_In
          LPdu_frTrig_FR_3a54c8219f12452dafc00b243d0703e0_215216_A_FlexRay_S_215_B_2_R_16_ChA_IN (FrIfLPdu): FrIfLPduIdx=42, FrIfReconfigurable=false, FrIfVBTriggeringRef=frTrig_FR_3a54c8219f12452dafc00b243d0703e0_215216_A_FlexRay_S_215_B_2_R_16_ChA_IN  # frTrig_FR_3a54c8219f12452dafc00b243d0703e0_215216_A_FlexRay
          LPdu_frTrig_FR_3a54c8219f12452dafc00b243d0703e0_21001_A_FlexRay_S_210_B_0_R_1_ChA_IN (FrIfLPdu): FrIfLPduIdx=51, FrIfReconfigurable=false, FrIfVBTriggeringRef=frTrig_FR_3a54c8219f12452dafc00b243d0703e0_21001_A_FlexRay_S_210_B_0_R_1_ChA_IN  # frTrig_FR_3a54c8219f12452dafc00b243d0703e0_21001_A_FlexRay
          frTrig_FR_3a54c8219f12452dafc00b243d0703e0_2161416_A_FlexRay_S_216_B_14_R_16_ChA_IN (FrIfFrameTriggering):
            FrIfAllowDynamicLSduLength = false
            FrIfBaseCycle = 14
            FrIfChannel = FRIF_CHANNEL_A
            FrIfCycleRepetition = 16
            FrIfLSduLength = 8
            FrIfPayloadPreamble = false
            FrIfSlotId = 216
            FrIfAlwaysTransmit = false
            FrIfFrameStructureRef = FrStr_SVC_e1225ba8_In
          frTrig_FR_3a54c8219f12452dafc00b243d0703e0_26924_A_FlexRay_S_269_B_2_R_4_ChA_IN (FrIfFrameTriggering):
            FrIfAllowDynamicLSduLength = false
            FrIfBaseCycle = 2
            FrIfChannel = FRIF_CHANNEL_A
            FrIfCycleRepetition = 4
            FrIfLSduLength = 16
            FrIfPayloadPreamble = false
            FrIfSlotId = 269
            FrIfAlwaysTransmit = false
            FrIfFrameStructureRef = FrStr_CTR_VIB_STW_DISP_EXMI_SP2015_FDBK_VIB_STW_DISP_EXMI
          LPdu_frTrig_FR_3a54c8219f12452dafc00b243d0703e0_30001_A_FlexRay_S_300_B_0_R_1_ChA_OUT (FrIfLPdu): FrIfLPduIdx=2, FrIfReconfigurable=false, FrIfVBTriggeringRef=frTrig_FR_3a54c8219f12452dafc00b243d0703e0_30001_A_FlexRay_S_300_B_0_R_1_ChA_OUT  # frTrig_FR_3a54c8219f12452dafc00b243d0703e0_30001_A_FlexRay
          LPdu_frTrig_FR_3a54c8219f12452dafc00b243d0703e0_2161416_A_FlexRay_S_216_B_14_R_16_ChA_IN (FrIfLPdu):  # frTrig_FR_3a54c8219f12452dafc00b243d0703e0_2161416_A_FlexRay
            FrIfLPduIdx = 40
            FrIfReconfigurable = false
            FrIfVBTriggeringRef = frTrig_FR_3a54c8219f12452dafc00b243d0703e0_2161416_A_FlexRay_S_216_B_14_R_16_ChA_IN
          5 x FrIfFrameTriggering, all with FrIfAllowDynamicLSduLength=false, FrIfChannel=FRIF_CHANNEL_A, FrIfPayloadPreamble=false, FrIfAlwaysTransmit=false:
            frTrig_FR_3a54c8219f12452dafc00b243d0703e0_216916_A_FlexRay_S_216_B_9_R_16_ChA_OUT: FrIfBaseCycle=9, FrIfCycleRepetition=16, FrIfLSduLength=8, FrIfSlotId=216, FrIfFrameStructureRef=FrStr_SVC_c13cc884_Out
            frTrig_FR_3a54c8219f12452dafc00b243d0703e0_5338_A_FlexRay_S_53_B_3_R_8_ChA_IN: FrIfBaseCycle=3, FrIfCycleRepetition=8, FrIfLSduLength=16, FrIfSlotId=53, FrIfFrameStructureRef=FrStr_SU_CLE_DRDY_DXP_SPEC_ADPT_MOD_DXP_ST_IDLV_COOD_DBE_DXP
            frTrig_FR_3a54c8219f12452dafc00b243d0703e0_215216_A_FlexRay_S_215_B_2_R_16_ChA_IN: FrIfBaseCycle=2, FrIfCycleRepetition=16, FrIfLSduLength=8, FrIfSlotId=215, FrIfFrameStructureRef=FrStr_SVC_5a9452fc_In
            frTrig_FR_3a54c8219f12452dafc00b243d0703e0_24702_A_FlexRay_S_247_B_0_R_2_ChA_IN: FrIfBaseCycle=0, FrIfCycleRepetition=2, FrIfLSduLength=2, FrIfSlotId=247, FrIfFrameStructureRef=FrStr_CTR_DIAG_OBD_DRDY
            frTrig_FR_3a54c8219f12452dafc00b243d0703e0_20901_A_FlexRay_S_209_B_0_R_1_ChA_IN: FrIfBaseCycle=0, FrIfCycleRepetition=1, FrIfLSduLength=32, FrIfSlotId=209, FrIfFrameStructureRef=FrStr_TL_BRC_FR_32_7c67e8dd_In
          LPdu_frTrig_FR_3a54c8219f12452dafc00b243d0703e0_4902_A_FlexRay_S_49_B_0_R_2_ChA_OUT (FrIfLPdu): FrIfLPduIdx=18, FrIfReconfigurable=false, FrIfVBTriggeringRef=frTrig_FR_3a54c8219f12452dafc00b243d0703e0_4902_A_FlexRay_S_49_B_0_R_2_ChA_OUT  # frTrig_FR_3a54c8219f12452dafc00b243d0703e0_4902_A_FlexRay
          frTrig_FR_3a54c8219f12452dafc00b243d0703e0_801_A_FlexRay_S_8_B_0_R_1_ChA_OUT (FrIfFrameTriggering):
            FrIfAllowDynamicLSduLength = false
            FrIfBaseCycle = 0
            FrIfChannel = FRIF_CHANNEL_A
            FrIfCycleRepetition = 1
            FrIfLSduLength = 16
            FrIfPayloadPreamble = false
            FrIfSlotId = 8
            FrIfAlwaysTransmit = false
            FrIfFrameStructureRef = FrStr_xcpstatic_31d6b02c_Out
          LPdu_frTrig_FR_3a54c8219f12452dafc00b243d0703e0_21901_A_FlexRay_S_219_B_0_R_1_ChA_IN (FrIfLPdu): FrIfLPduIdx=34, FrIfReconfigurable=false, FrIfVBTriggeringRef=frTrig_FR_3a54c8219f12452dafc00b243d0703e0_21901_A_FlexRay_S_219_B_0_R_1_ChA_IN  # frTrig_FR_3a54c8219f12452dafc00b243d0703e0_21901_A_FlexRay
          6 x FrIfFrameTriggering, all with FrIfAllowDynamicLSduLength=false, FrIfChannel=FRIF_CHANNEL_A, FrIfPayloadPreamble=false, FrIfAlwaysTransmit=false:
            frTrig_FR_3a54c8219f12452dafc00b243d0703e0_4712_A_FlexRay_S_47_B_1_R_2_ChA_IN: FrIfBaseCycle=1, FrIfCycleRepetition=2, FrIfLSduLength=16, FrIfSlotId=47, FrIfFrameStructureRef=FrStr_ST_STAB_DSC_ST_STAB_DSC_2
            frTrig_FR_3a54c8219f12452dafc00b243d0703e0_21434_A_FlexRay_S_214_B_3_R_4_ChA_IN: FrIfBaseCycle=3, FrIfCycleRepetition=4, FrIfLSduLength=8, FrIfSlotId=214, FrIfFrameStructureRef=FrStr_SVC_a08d1767_In
            frTrig_FR_3a54c8219f12452dafc00b243d0703e0_2161316_A_FlexRay_S_216_B_13_R_16_ChA_IN: FrIfBaseCycle=13, FrIfCycleRepetition=16, FrIfLSduLength=8, FrIfSlotId=216, FrIfFrameStructureRef=FrStr_SVC_9c515df0_In
            frTrig_FR_3a54c8219f12452dafc00b243d0703e0_4912_A_FlexRay_S_49_B_1_R_2_ChA_OUT: FrIfBaseCycle=1, FrIfCycleRepetition=2, FrIfLSduLength=16, FrIfSlotId=49, FrIfFrameStructureRef=FrStr_DT_EST
            frTrig_FR_3a54c8219f12452dafc00b243d0703e0_21201_A_FlexRay_S_212_B_0_R_1_ChA_IN: FrIfBaseCycle=0, FrIfCycleRepetition=1, FrIfLSduLength=32, FrIfSlotId=212, FrIfFrameStructureRef=FrStr_TL_BRC_FR_32_06a1b608_In
            frTrig_FR_3a54c8219f12452dafc00b243d0703e0_29701_A_FlexRay_S_297_B_0_R_1_ChA_OUT: FrIfBaseCycle=0, FrIfCycleRepetition=1, FrIfLSduLength=254, FrIfSlotId=297, FrIfFrameStructureRef=FrStr_xcpdynamic254_4
          LPdu_frTrig_FR_3a54c8219f12452dafc00b243d0703e0_10701_A_FlexRay_S_107_B_0_R_1_ChA_IN (FrIfLPdu): FrIfLPduIdx=58, FrIfReconfigurable=false, FrIfVBTriggeringRef=frTrig_FR_3a54c8219f12452dafc00b243d0703e0_10701_A_FlexRay_S_107_B_0_R_1_ChA_IN  # frTrig_FR_3a54c8219f12452dafc00b243d0703e0_10701_A_FlexRay
          LPdu_frTrig_FR_3a54c8219f12452dafc00b243d0703e0_29401_A_FlexRay_S_294_B_0_R_1_ChA_OUT (FrIfLPdu): FrIfLPduIdx=8, FrIfReconfigurable=false, FrIfVBTriggeringRef=frTrig_FR_3a54c8219f12452dafc00b243d0703e0_29401_A_FlexRay_S_294_B_0_R_1_ChA_OUT  # frTrig_FR_3a54c8219f12452dafc00b243d0703e0_29401_A_FlexRay
          frTrig_FR_3a54c8219f12452dafc00b243d0703e0_23412_A_FlexRay_S_234_B_1_R_2_ChA_OUT (FrIfFrameTriggering):
            FrIfAllowDynamicLSduLength = false
            FrIfBaseCycle = 1
            FrIfChannel = FRIF_CHANNEL_A
            FrIfCycleRepetition = 2
            FrIfLSduLength = 5
            FrIfPayloadPreamble = false
            FrIfSlotId = 234
            FrIfAlwaysTransmit = false
            FrIfFrameStructureRef = FrStr_ST_EST
          LPdu_frTrig_FR_3a54c8219f12452dafc00b243d0703e0_14701_A_FlexRay_S_147_B_0_R_1_ChA_IN (FrIfLPdu): FrIfLPduIdx=53, FrIfReconfigurable=false, FrIfVBTriggeringRef=frTrig_FR_3a54c8219f12452dafc00b243d0703e0_14701_A_FlexRay_S_147_B_0_R_1_ChA_IN  # frTrig_FR_3a54c8219f12452dafc00b243d0703e0_14701_A_FlexRay
          LPdu_frTrig_FR_3a54c8219f12452dafc00b243d0703e0_29801_A_FlexRay_S_298_B_0_R_1_ChA_OUT (FrIfLPdu): FrIfLPduIdx=4, FrIfReconfigurable=false, FrIfVBTriggeringRef=frTrig_FR_3a54c8219f12452dafc00b243d0703e0_29801_A_FlexRay_S_298_B_0_R_1_ChA_OUT  # frTrig_FR_3a54c8219f12452dafc00b243d0703e0_29801_A_FlexRay
          frTrig_FR_3a54c8219f12452dafc00b243d0703e0_30001_A_FlexRay_S_300_B_0_R_1_ChA_OUT (FrIfFrameTriggering):
            FrIfAllowDynamicLSduLength = false
            FrIfBaseCycle = 0
            FrIfChannel = FRIF_CHANNEL_A
            FrIfCycleRepetition = 1
            FrIfLSduLength = 254
            FrIfPayloadPreamble = false
            FrIfSlotId = 300
            FrIfAlwaysTransmit = false
            FrIfFrameStructureRef = FrStr_xcpdynamic254_7
          LPdu_frTrig_FR_3a54c8219f12452dafc00b243d0703e0_27628_A_FlexRay_S_276_B_2_R_8_ChA_IN (FrIfLPdu): FrIfLPduIdx=24, FrIfReconfigurable=false, FrIfVBTriggeringRef=frTrig_FR_3a54c8219f12452dafc00b243d0703e0_27628_A_FlexRay_S_276_B_2_R_8_ChA_IN  # frTrig_FR_3a54c8219f12452dafc00b243d0703e0_27628_A_FlexRay
          3 x FrIfFrameTriggering, all with FrIfAllowDynamicLSduLength=false, FrIfChannel=FRIF_CHANNEL_A, FrIfPayloadPreamble=false, FrIfAlwaysTransmit=false:
            frTrig_FR_3a54c8219f12452dafc00b243d0703e0_31501_A_FlexRay_S_315_B_0_R_1_ChA_OUT: FrIfBaseCycle=0, FrIfCycleRepetition=1, FrIfLSduLength=58, FrIfSlotId=315, FrIfFrameStructureRef=FrStr_FR_DBG_EPS
            frTrig_FR_3a54c8219f12452dafc00b243d0703e0_2481032_A_FlexRay_S_248_B_10_R_32_ChA_OUT: FrIfBaseCycle=10, FrIfCycleRepetition=32, FrIfLSduLength=8, FrIfSlotId=248, FrIfFrameStructureRef=FrStr_ST_DIAG_OBD_3_DRDY
            frTrig_FR_3a54c8219f12452dafc00b243d0703e0_25214_A_FlexRay_S_252_B_1_R_4_ChA_IN: FrIfBaseCycle=1, FrIfCycleRepetition=4, FrIfLSduLength=2, FrIfSlotId=252, FrIfFrameStructureRef=FrStr_A_TEMP
          LPdu_frTrig_FR_3a54c8219f12452dafc00b243d0703e0_11702_A_FlexRay_S_117_B_0_R_2_ChA_IN (FrIfLPdu): FrIfLPduIdx=56, FrIfReconfigurable=false, FrIfVBTriggeringRef=frTrig_FR_3a54c8219f12452dafc00b243d0703e0_11702_A_FlexRay_S_117_B_0_R_2_ChA_IN  # frTrig_FR_3a54c8219f12452dafc00b243d0703e0_11702_A_FlexRay
          frTrig_FR_3a54c8219f12452dafc00b243d0703e0_5534_A_FlexRay_S_55_B_3_R_4_ChA_IN (FrIfFrameTriggering):
            FrIfAllowDynamicLSduLength = false
            FrIfBaseCycle = 3
            FrIfChannel = FRIF_CHANNEL_A
            FrIfCycleRepetition = 4
            FrIfLSduLength = 16
            FrIfPayloadPreamble = false
            FrIfSlotId = 55
            FrIfAlwaysTransmit = false
            FrIfFrameStructureRef = FrStr_V_VEH_V_VEH_2
          LPdu_frTrig_FR_3a54c8219f12452dafc00b243d0703e0_30101_A_FlexRay_S_301_B_0_R_1_ChA_OUT (FrIfLPdu): FrIfLPduIdx=1, FrIfReconfigurable=false, FrIfVBTriggeringRef=frTrig_FR_3a54c8219f12452dafc00b243d0703e0_30101_A_FlexRay_S_301_B_0_R_1_ChA_OUT  # frTrig_FR_3a54c8219f12452dafc00b243d0703e0_30101_A_FlexRay
          frTrig_FR_3a54c8219f12452dafc00b243d0703e0_4902_A_FlexRay_S_49_B_0_R_2_ChA_OUT (FrIfFrameTriggering):
            FrIfAllowDynamicLSduLength = false
            FrIfBaseCycle = 0
            FrIfChannel = FRIF_CHANNEL_A
            FrIfCycleRepetition = 2
            FrIfLSduLength = 16
            FrIfPayloadPreamble = false
            FrIfSlotId = 49
            FrIfAlwaysTransmit = false
            FrIfFrameStructureRef = FrStr_AVL_STMOM_DV_ACT_AVL_FORC_GRD
          5 x FrIfLPdu, all with FrIfReconfigurable=false:
            LPdu_frTrig_FR_3a54c8219f12452dafc00b243d0703e0_6812_A_FlexRay_S_68_B_1_R_2_ChA_IN: FrIfLPduIdx=61, FrIfVBTriggeringRef=frTrig_FR_3a54c8219f12452dafc00b243d0703e0_6812_A_FlexRay_S_68_B_1_R_2_ChA_IN  # frTrig_FR_3a54c8219f12452dafc00b243d0703e0_6812_A_FlexRay
            LPdu_frTrig_FR_3a54c8219f12452dafc00b243d0703e0_18301_A_FlexRay_S_183_B_0_R_1_ChA_OUT: FrIfLPduIdx=15, FrIfVBTriggeringRef=frTrig_FR_3a54c8219f12452dafc00b243d0703e0_18301_A_FlexRay_S_183_B_0_R_1_ChA_OUT  # frTrig_FR_3a54c8219f12452dafc00b243d0703e0_18301_A_FlexRay
            LPdu_frTrig_FR_3a54c8219f12452dafc00b243d0703e0_6802_A_FlexRay_S_68_B_0_R_2_ChA_IN: FrIfLPduIdx=60, FrIfVBTriggeringRef=frTrig_FR_3a54c8219f12452dafc00b243d0703e0_6802_A_FlexRay_S_68_B_0_R_2_ChA_IN  # frTrig_FR_3a54c8219f12452dafc00b243d0703e0_6802_A_FlexRay
            LPdu_frTrig_FR_3a54c8219f12452dafc00b243d0703e0_24702_A_FlexRay_S_247_B_0_R_2_ChA_IN: FrIfLPduIdx=30, FrIfVBTriggeringRef=frTrig_FR_3a54c8219f12452dafc00b243d0703e0_24702_A_FlexRay_S_247_B_0_R_2_ChA_IN  # frTrig_FR_3a54c8219f12452dafc00b243d0703e0_24702_A_FlexRay
            LPdu_frTrig_FR_3a54c8219f12452dafc00b243d0703e0_901_A_FlexRay_S_9_B_0_R_1_ChA_OUT: FrIfLPduIdx=22, FrIfVBTriggeringRef=frTrig_FR_3a54c8219f12452dafc00b243d0703e0_901_A_FlexRay_S_9_B_0_R_1_ChA_OUT  # frTrig_FR_3a54c8219f12452dafc00b243d0703e0_901_A_FlexRay
          frTrig_FR_3a54c8219f12452dafc00b243d0703e0_21101_A_FlexRay_S_211_B_0_R_1_ChA_IN (FrIfFrameTriggering):
            FrIfAllowDynamicLSduLength = false
            FrIfBaseCycle = 0
            FrIfChannel = FRIF_CHANNEL_A
            FrIfCycleRepetition = 1
            FrIfLSduLength = 32
            FrIfPayloadPreamble = false
            FrIfSlotId = 211
            FrIfAlwaysTransmit = false
            FrIfFrameStructureRef = FrStr_TL_BRC_FR_32_bb6bdac6_In
          frTrig_FR_3a54c8219f12452dafc00b243d0703e0_11912_A_FlexRay_S_119_B_1_R_2_ChA_IN (FrIfFrameTriggering):
            FrIfAllowDynamicLSduLength = false
            FrIfBaseCycle = 1
            FrIfChannel = FRIF_CHANNEL_A
            FrIfCycleRepetition = 2
            FrIfLSduLength = 8
            FrIfPayloadPreamble = false
            FrIfSlotId = 119
            FrIfAlwaysTransmit = false
            FrIfFrameStructureRef = FrStr_ENSU_SFY
          LPdu_frTrig_FR_3a54c8219f12452dafc00b243d0703e0_215516_A_FlexRay_S_215_B_5_R_16_ChA_IN (FrIfLPdu): FrIfLPduIdx=43, FrIfReconfigurable=false, FrIfVBTriggeringRef=frTrig_FR_3a54c8219f12452dafc00b243d0703e0_215516_A_FlexRay_S_215_B_5_R_16_ChA_IN  # frTrig_FR_3a54c8219f12452dafc00b243d0703e0_215516_A_FlexRay
          LPdu_frTrig_FR_3a54c8219f12452dafc00b243d0703e0_21201_A_FlexRay_S_212_B_0_R_1_ChA_IN (FrIfLPdu): FrIfLPduIdx=49, FrIfReconfigurable=false, FrIfVBTriggeringRef=frTrig_FR_3a54c8219f12452dafc00b243d0703e0_21201_A_FlexRay_S_212_B_0_R_1_ChA_IN  # frTrig_FR_3a54c8219f12452dafc00b243d0703e0_21201_A_FlexRay
          3 x FrIfFrameTriggering, all with FrIfAllowDynamicLSduLength=false, FrIfChannel=FRIF_CHANNEL_A, FrIfPayloadPreamble=false, FrIfAlwaysTransmit=false:
            frTrig_FR_3a54c8219f12452dafc00b243d0703e0_29601_A_FlexRay_S_296_B_0_R_1_ChA_OUT: FrIfBaseCycle=0, FrIfCycleRepetition=1, FrIfLSduLength=254, FrIfSlotId=296, FrIfFrameStructureRef=FrStr_xcpdynamic254_3
            frTrig_FR_3a54c8219f12452dafc00b243d0703e0_6512_A_FlexRay_S_65_B_1_R_2_ChA_IN: FrIfBaseCycle=1, FrIfCycleRepetition=2, FrIfLSduLength=8, FrIfSlotId=65, FrIfFrameStructureRef=FrStr_TAR_ESTP_VIRT_FTAX
            frTrig_FR_3a54c8219f12452dafc00b243d0703e0_23212_A_FlexRay_S_232_B_1_R_2_ChA_IN: FrIfBaseCycle=1, FrIfCycleRepetition=2, FrIfLSduLength=8, FrIfSlotId=232, FrIfFrameStructureRef=FrStr_ST_ENERG_GEN
          LPdu_frTrig_FR_3a54c8219f12452dafc00b243d0703e0_4712_A_FlexRay_S_47_B_1_R_2_ChA_IN (FrIfLPdu): FrIfLPduIdx=67, FrIfReconfigurable=false, FrIfVBTriggeringRef=frTrig_FR_3a54c8219f12452dafc00b243d0703e0_4712_A_FlexRay_S_47_B_1_R_2_ChA_IN  # frTrig_FR_3a54c8219f12452dafc00b243d0703e0_4712_A_FlexRay
          3 x FrIfFrameTriggering, all with FrIfAllowDynamicLSduLength=false, FrIfChannel=FRIF_CHANNEL_A, FrIfLSduLength=8, FrIfPayloadPreamble=false, FrIfAlwaysTransmit=false:
            frTrig_FR_3a54c8219f12452dafc00b243d0703e0_215516_A_FlexRay_S_215_B_5_R_16_ChA_IN: FrIfBaseCycle=5, FrIfCycleRepetition=16, FrIfSlotId=215, FrIfFrameStructureRef=FrStr_SVC_27e754a4_In
            frTrig_FR_3a54c8219f12452dafc00b243d0703e0_27518_A_FlexRay_S_275_B_1_R_8_ChA_IN: FrIfBaseCycle=1, FrIfCycleRepetition=8, FrIfSlotId=275, FrIfFrameStructureRef=FrStr_FZZSTD
            frTrig_FR_3a54c8219f12452dafc00b243d0703e0_10802_A_FlexRay_S_108_B_0_R_2_ChA_IN: FrIfBaseCycle=0, FrIfCycleRepetition=2, FrIfSlotId=108, FrIfFrameStructureRef=FrStr_STEA_OFFS
          LPdu_frTrig_FR_3a54c8219f12452dafc00b243d0703e0_12112_A_FlexRay_S_121_B_1_R_2_ChA_IN (FrIfLPdu): FrIfLPduIdx=54, FrIfReconfigurable=false, FrIfVBTriggeringRef=frTrig_FR_3a54c8219f12452dafc00b243d0703e0_12112_A_FlexRay_S_121_B_1_R_2_ChA_IN  # frTrig_FR_3a54c8219f12452dafc00b243d0703e0_12112_A_FlexRay
          frTrig_FR_3a54c8219f12452dafc00b243d0703e0_1201_A_FlexRay_S_12_B_0_R_1_ChA_OUT (FrIfFrameTriggering):
            FrIfAllowDynamicLSduLength = false
            FrIfBaseCycle = 0
            FrIfChannel = FRIF_CHANNEL_A
            FrIfCycleRepetition = 1
            FrIfLSduLength = 16
            FrIfPayloadPreamble = false
            FrIfSlotId = 12
            FrIfAlwaysTransmit = false
            FrIfFrameStructureRef = FrStr_xcpstatic_1fa5cd47_Out
          LPdu_frTrig_FR_3a54c8219f12452dafc00b243d0703e0_22001_A_FlexRay_S_220_B_0_R_1_ChA_OUT (FrIfLPdu): FrIfLPduIdx=13, FrIfReconfigurable=false, FrIfVBTriggeringRef=frTrig_FR_3a54c8219f12452dafc00b243d0703e0_22001_A_FlexRay_S_220_B_0_R_1_ChA_OUT  # frTrig_FR_3a54c8219f12452dafc00b243d0703e0_22001_A_FlexRay
          LPdu_frTrig_FR_3a54c8219f12452dafc00b243d0703e0_29501_A_FlexRay_S_295_B_0_R_1_ChA_OUT (FrIfLPdu): FrIfLPduIdx=7, FrIfReconfigurable=false, FrIfVBTriggeringRef=frTrig_FR_3a54c8219f12452dafc00b243d0703e0_29501_A_FlexRay_S_295_B_0_R_1_ChA_OUT  # frTrig_FR_3a54c8219f12452dafc00b243d0703e0_29501_A_FlexRay
          3 x FrIfFrameTriggering, all with FrIfAllowDynamicLSduLength=false, FrIfBaseCycle=0, FrIfChannel=FRIF_CHANNEL_A, FrIfCycleRepetition=1, FrIfPayloadPreamble=false, FrIfAlwaysTransmit=false:
            frTrig_FR_3a54c8219f12452dafc00b243d0703e0_14701_A_FlexRay_S_147_B_0_R_1_ChA_IN: FrIfLSduLength=254, FrIfSlotId=147, FrIfFrameStructureRef=FrStr_TL_MST_GW_TRNSM_FR_254
            frTrig_FR_3a54c8219f12452dafc00b243d0703e0_10701_A_FlexRay_S_107_B_0_R_1_ChA_IN: FrIfLSduLength=5, FrIfSlotId=107, FrIfFrameStructureRef=FrStr_OFFS_QUAD_EPS
            frTrig_FR_3a54c8219f12452dafc00b243d0703e0_30101_A_FlexRay_S_301_B_0_R_1_ChA_OUT: FrIfLSduLength=254, FrIfSlotId=301, FrIfFrameStructureRef=FrStr_xcpdynamic254_8
          4 x FrIfLPdu, all with FrIfReconfigurable=false:
            LPdu_frTrig_FR_3a54c8219f12452dafc00b243d0703e0_24712_A_FlexRay_S_247_B_1_R_2_ChA_IN: FrIfLPduIdx=31, FrIfVBTriggeringRef=frTrig_FR_3a54c8219f12452dafc00b243d0703e0_24712_A_FlexRay_S_247_B_1_R_2_ChA_IN  # frTrig_FR_3a54c8219f12452dafc00b243d0703e0_24712_A_FlexRay
            LPdu_frTrig_FR_3a54c8219f12452dafc00b243d0703e0_4601_A_FlexRay_S_46_B_0_R_1_ChA_IN: FrIfLPduIdx=68, FrIfVBTriggeringRef=frTrig_FR_3a54c8219f12452dafc00b243d0703e0_4601_A_FlexRay_S_46_B_0_R_1_ChA_IN  # frTrig_FR_3a54c8219f12452dafc00b243d0703e0_4601_A_FlexRay
            LPdu_frTrig_FR_3a54c8219f12452dafc00b243d0703e0_215616_A_FlexRay_S_215_B_6_R_16_ChA_IN: FrIfLPduIdx=44, FrIfVBTriggeringRef=frTrig_FR_3a54c8219f12452dafc00b243d0703e0_215616_A_FlexRay_S_215_B_6_R_16_ChA_IN  # frTrig_FR_3a54c8219f12452dafc00b243d0703e0_215616_A_FlexRay
            LPdu_frTrig_FR_3a54c8219f12452dafc00b243d0703e0_2481032_A_FlexRay_S_248_B_10_R_32_ChA_OUT: FrIfLPduIdx=11, FrIfVBTriggeringRef=frTrig_FR_3a54c8219f12452dafc00b243d0703e0_2481032_A_FlexRay_S_248_B_10_R_32_ChA_OUT  # frTrig_FR_3a54c8219f12452dafc00b243d0703e0_2481032_A_FlexRay
          frTrig_FR_3a54c8219f12452dafc00b243d0703e0_11702_A_FlexRay_S_117_B_0_R_2_ChA_IN (FrIfFrameTriggering):
            FrIfAllowDynamicLSduLength = false
            FrIfBaseCycle = 0
            FrIfChannel = FRIF_CHANNEL_A
            FrIfCycleRepetition = 2
            FrIfLSduLength = 8
            FrIfPayloadPreamble = false
            FrIfSlotId = 117
            FrIfAlwaysTransmit = false
            FrIfFrameStructureRef = FrStr_ST_CENG
          frTrig_FR_3a54c8219f12452dafc00b243d0703e0_2161016_A_FlexRay_S_216_B_10_R_16_ChA_IN (FrIfFrameTriggering):
            FrIfAllowDynamicLSduLength = false
            FrIfBaseCycle = 10
            FrIfChannel = FRIF_CHANNEL_A
            FrIfCycleRepetition = 16
            FrIfLSduLength = 8
            FrIfPayloadPreamble = false
            FrIfSlotId = 216
            FrIfAlwaysTransmit = false
            FrIfFrameStructureRef = FrStr_SVC_219b313e_In
          3 x FrIfLPdu, all with FrIfReconfigurable=false:
            LPdu_frTrig_FR_3a54c8219f12452dafc00b243d0703e0_25214_A_FlexRay_S_252_B_1_R_4_ChA_IN: FrIfLPduIdx=29, FrIfVBTriggeringRef=frTrig_FR_3a54c8219f12452dafc00b243d0703e0_25214_A_FlexRay_S_252_B_1_R_4_ChA_IN  # frTrig_FR_3a54c8219f12452dafc00b243d0703e0_25214_A_FlexRay
            LPdu_frTrig_FR_3a54c8219f12452dafc00b243d0703e0_27424_A_FlexRay_S_274_B_2_R_4_ChA_OUT: FrIfLPduIdx=9, FrIfVBTriggeringRef=frTrig_FR_3a54c8219f12452dafc00b243d0703e0_27424_A_FlexRay_S_274_B_2_R_4_ChA_OUT  # frTrig_FR_3a54c8219f12452dafc00b243d0703e0_27424_A_FlexRay
            LPdu_frTrig_FR_3a54c8219f12452dafc00b243d0703e0_27648_A_FlexRay_S_276_B_4_R_8_ChA_IN: FrIfLPduIdx=25, FrIfVBTriggeringRef=frTrig_FR_3a54c8219f12452dafc00b243d0703e0_27648_A_FlexRay_S_276_B_4_R_8_ChA_IN  # frTrig_FR_3a54c8219f12452dafc00b243d0703e0_27648_A_FlexRay
          frTrig_FR_3a54c8219f12452dafc00b243d0703e0_5102_A_FlexRay_S_51_B_0_R_2_ChA_OUT (FrIfFrameTriggering):
            FrIfAllowDynamicLSduLength = false
            FrIfBaseCycle = 0
            FrIfChannel = FRIF_CHANNEL_A
            FrIfCycleRepetition = 2
            FrIfLSduLength = 16
            FrIfPayloadPreamble = false
            FrIfSlotId = 51
            FrIfAlwaysTransmit = false
            FrIfFrameStructureRef = FrStr_AVL_PO_EPS_ENGTORQ_EPS
          frTrig_FR_3a54c8219f12452dafc00b243d0703e0_215616_A_FlexRay_S_215_B_6_R_16_ChA_IN (FrIfFrameTriggering):
            FrIfAllowDynamicLSduLength = false
            FrIfBaseCycle = 6
            FrIfChannel = FRIF_CHANNEL_A
            FrIfCycleRepetition = 16
            FrIfLSduLength = 8
            FrIfPayloadPreamble = false
            FrIfSlotId = 215
            FrIfAlwaysTransmit = false
            FrIfFrameStructureRef = FrStr_SVC_9a2d386a_In
          LPdu_frTrig_FR_3a54c8219f12452dafc00b243d0703e0_10401_A_FlexRay_S_104_B_0_R_1_ChA_IN (FrIfLPdu): FrIfLPduIdx=59, FrIfReconfigurable=false, FrIfVBTriggeringRef=frTrig_FR_3a54c8219f12452dafc00b243d0703e0_10401_A_FlexRay_S_104_B_0_R_1_ChA_IN  # frTrig_FR_3a54c8219f12452dafc00b243d0703e0_10401_A_FlexRay
          LPdu_frTrig_FR_3a54c8219f12452dafc00b243d0703e0_11912_A_FlexRay_S_119_B_1_R_2_ChA_IN (FrIfLPdu): FrIfLPduIdx=55, FrIfReconfigurable=false, FrIfVBTriggeringRef=frTrig_FR_3a54c8219f12452dafc00b243d0703e0_11912_A_FlexRay_S_119_B_1_R_2_ChA_IN  # frTrig_FR_3a54c8219f12452dafc00b243d0703e0_11912_A_FlexRay
          frTrig_FR_3a54c8219f12452dafc00b243d0703e0_21001_A_FlexRay_S_210_B_0_R_1_ChA_IN (FrIfFrameTriggering):
            FrIfAllowDynamicLSduLength = false
            FrIfBaseCycle = 0
            FrIfChannel = FRIF_CHANNEL_A
            FrIfCycleRepetition = 1
            FrIfLSduLength = 32
            FrIfPayloadPreamble = false
            FrIfSlotId = 210
            FrIfAlwaysTransmit = false
            FrIfFrameStructureRef = FrStr_TL_BRC_FR_32_66fd0343_In
          LPdu_frTrig_FR_3a54c8219f12452dafc00b243d0703e0_27518_A_FlexRay_S_275_B_1_R_8_ChA_IN (FrIfLPdu): FrIfLPduIdx=26, FrIfReconfigurable=false, FrIfVBTriggeringRef=frTrig_FR_3a54c8219f12452dafc00b243d0703e0_27518_A_FlexRay_S_275_B_1_R_8_ChA_IN  # frTrig_FR_3a54c8219f12452dafc00b243d0703e0_27518_A_FlexRay
          frTrig_FR_3a54c8219f12452dafc00b243d0703e0_27408_A_FlexRay_S_274_B_0_R_8_ChA_OUT (FrIfFrameTriggering):
            FrIfAllowDynamicLSduLength = false
            FrIfBaseCycle = 0
            FrIfChannel = FRIF_CHANNEL_A
            FrIfCycleRepetition = 8
            FrIfLSduLength = 8
            FrIfPayloadPreamble = false
            FrIfSlotId = 274
            FrIfAlwaysTransmit = false
            FrIfFrameStructureRef = FrStr_SU_EPS
          5 x FrIfLPdu, all with FrIfReconfigurable=false:
            LPdu_frTrig_FR_3a54c8219f12452dafc00b243d0703e0_2161016_A_FlexRay_S_216_B_10_R_16_ChA_IN: FrIfLPduIdx=37, FrIfVBTriggeringRef=frTrig_FR_3a54c8219f12452dafc00b243d0703e0_2161016_A_FlexRay_S_216_B_10_R_16_ChA_IN  # frTrig_FR_3a54c8219f12452dafc00b243d0703e0_2161016_A_FlexRay
            LPdu_frTrig_FR_3a54c8219f12452dafc00b243d0703e0_21101_A_FlexRay_S_211_B_0_R_1_ChA_IN: FrIfLPduIdx=50, FrIfVBTriggeringRef=frTrig_FR_3a54c8219f12452dafc00b243d0703e0_21101_A_FlexRay_S_211_B_0_R_1_ChA_IN  # frTrig_FR_3a54c8219f12452dafc00b243d0703e0_21101_A_FlexRay
            LPdu_frTrig_FR_3a54c8219f12452dafc00b243d0703e0_27578_A_FlexRay_S_275_B_7_R_8_ChA_IN: FrIfLPduIdx=27, FrIfVBTriggeringRef=frTrig_FR_3a54c8219f12452dafc00b243d0703e0_27578_A_FlexRay_S_275_B_7_R_8_ChA_IN  # frTrig_FR_3a54c8219f12452dafc00b243d0703e0_27578_A_FlexRay
            LPdu_frTrig_FR_3a54c8219f12452dafc00b243d0703e0_1101_A_FlexRay_S_11_B_0_R_1_ChA_OUT: FrIfLPduIdx=20, FrIfVBTriggeringRef=frTrig_FR_3a54c8219f12452dafc00b243d0703e0_1101_A_FlexRay_S_11_B_0_R_1_ChA_OUT  # frTrig_FR_3a54c8219f12452dafc00b243d0703e0_1101_A_FlexRay
            LPdu_frTrig_FR_3a54c8219f12452dafc00b243d0703e0_5102_A_FlexRay_S_51_B_0_R_2_ChA_OUT: FrIfLPduIdx=16, FrIfVBTriggeringRef=frTrig_FR_3a54c8219f12452dafc00b243d0703e0_5102_A_FlexRay_S_51_B_0_R_2_ChA_OUT  # frTrig_FR_3a54c8219f12452dafc00b243d0703e0_5102_A_FlexRay
          frTrig_FR_3a54c8219f12452dafc00b243d0703e0_18301_A_FlexRay_S_183_B_0_R_1_ChA_OUT (FrIfFrameTriggering):
            FrIfAllowDynamicLSduLength = false
            FrIfBaseCycle = 0
            FrIfChannel = FRIF_CHANNEL_A
            FrIfCycleRepetition = 1
            FrIfLSduLength = 32
            FrIfPayloadPreamble = false
            FrIfSlotId = 183
            FrIfAlwaysTransmit = false
            FrIfFrameStructureRef = FrStr_TL_ECU_TRNSM_FR_32
          frTrig_FR_3a54c8219f12452dafc00b243d0703e0_6802_A_FlexRay_S_68_B_0_R_2_ChA_IN (FrIfFrameTriggering):
            FrIfAllowDynamicLSduLength = false
            FrIfBaseCycle = 0
            FrIfChannel = FRIF_CHANNEL_A
            FrIfCycleRepetition = 2
            FrIfLSduLength = 16
            FrIfPayloadPreamble = false
            FrIfSlotId = 68
            FrIfAlwaysTransmit = false
            FrIfFrameStructureRef = FrStr_TAR_QTA_STRMOM_DV_TAR_STMOM_DV_ACT
          LPdu_frTrig_FR_3a54c8219f12452dafc00b243d0703e0_216916_A_FlexRay_S_216_B_9_R_16_ChA_OUT (FrIfLPdu): FrIfLPduIdx=14, FrIfReconfigurable=false, FrIfVBTriggeringRef=frTrig_FR_3a54c8219f12452dafc00b243d0703e0_216916_A_FlexRay_S_216_B_9_R_16_ChA_OUT  # frTrig_FR_3a54c8219f12452dafc00b243d0703e0_216916_A_FlexRay
          5 x FrIfFrameTriggering, all with FrIfAllowDynamicLSduLength=false, FrIfBaseCycle=0, FrIfChannel=FRIF_CHANNEL_A, FrIfPayloadPreamble=false, FrIfAlwaysTransmit=false:
            frTrig_FR_3a54c8219f12452dafc00b243d0703e0_22001_A_FlexRay_S_220_B_0_R_1_ChA_OUT: FrIfCycleRepetition=1, FrIfLSduLength=32, FrIfSlotId=220, FrIfFrameStructureRef=FrStr_xcpslave
            frTrig_FR_3a54c8219f12452dafc00b243d0703e0_29501_A_FlexRay_S_295_B_0_R_1_ChA_OUT: FrIfCycleRepetition=1, FrIfLSduLength=254, FrIfSlotId=295, FrIfFrameStructureRef=FrStr_xcpdynamic254_2
            frTrig_FR_3a54c8219f12452dafc00b243d0703e0_901_A_FlexRay_S_9_B_0_R_1_ChA_OUT: FrIfCycleRepetition=1, FrIfLSduLength=16, FrIfSlotId=9, FrIfFrameStructureRef=FrStr_xcpstatic_ec4069a9_Out
            frTrig_FR_3a54c8219f12452dafc00b243d0703e0_29901_A_FlexRay_S_299_B_0_R_1_ChA_OUT: FrIfCycleRepetition=1, FrIfLSduLength=254, FrIfSlotId=299, FrIfFrameStructureRef=FrStr_xcpdynamic254_6
            frTrig_FR_3a54c8219f12452dafc00b243d0703e0_5602_A_FlexRay_S_56_B_0_R_2_ChA_IN: FrIfCycleRepetition=2, FrIfLSduLength=14, FrIfSlotId=56, FrIfFrameStructureRef=FrStr_DT_DRDYSEN_EXT_VYAW_VEH
          3 x FrIfLPdu, all with FrIfReconfigurable=false:
            LPdu_frTrig_FR_3a54c8219f12452dafc00b243d0703e0_5502_A_FlexRay_S_55_B_0_R_2_ChA_IN: FrIfLPduIdx=64, FrIfVBTriggeringRef=frTrig_FR_3a54c8219f12452dafc00b243d0703e0_5502_A_FlexRay_S_55_B_0_R_2_ChA_IN  # frTrig_FR_3a54c8219f12452dafc00b243d0703e0_5502_A_FlexRay
            LPdu_frTrig_FR_3a54c8219f12452dafc00b243d0703e0_6512_A_FlexRay_S_65_B_1_R_2_ChA_IN: FrIfLPduIdx=62, FrIfVBTriggeringRef=frTrig_FR_3a54c8219f12452dafc00b243d0703e0_6512_A_FlexRay_S_65_B_1_R_2_ChA_IN  # frTrig_FR_3a54c8219f12452dafc00b243d0703e0_6512_A_FlexRay
            LPdu_frTrig_FR_3a54c8219f12452dafc00b243d0703e0_23212_A_FlexRay_S_232_B_1_R_2_ChA_IN: FrIfLPduIdx=33, FrIfVBTriggeringRef=frTrig_FR_3a54c8219f12452dafc00b243d0703e0_23212_A_FlexRay_S_232_B_1_R_2_ChA_IN  # frTrig_FR_3a54c8219f12452dafc00b243d0703e0_23212_A_FlexRay
          frTrig_FR_3a54c8219f12452dafc00b243d0703e0_12112_A_FlexRay_S_121_B_1_R_2_ChA_IN (FrIfFrameTriggering):
            FrIfAllowDynamicLSduLength = false
            FrIfBaseCycle = 1
            FrIfChannel = FRIF_CHANNEL_A
            FrIfCycleRepetition = 2
            FrIfLSduLength = 8
            FrIfPayloadPreamble = false
            FrIfSlotId = 121
            FrIfAlwaysTransmit = false
            FrIfFrameStructureRef = FrStr_CON_VEH
          frTrig_FR_3a54c8219f12452dafc00b243d0703e0_27424_A_FlexRay_S_274_B_2_R_4_ChA_OUT (FrIfFrameTriggering):
            FrIfAllowDynamicLSduLength = false
            FrIfBaseCycle = 2
            FrIfChannel = FRIF_CHANNEL_A
            FrIfCycleRepetition = 4
            FrIfLSduLength = 5
            FrIfPayloadPreamble = false
            FrIfSlotId = 274
            FrIfAlwaysTransmit = false
            FrIfFrameStructureRef = FrStr_DISP_CC_EPS
          LPdu_frTrig_FR_3a54c8219f12452dafc00b243d0703e0_10802_A_FlexRay_S_108_B_0_R_2_ChA_IN (FrIfLPdu): FrIfLPduIdx=57, FrIfReconfigurable=false, FrIfVBTriggeringRef=frTrig_FR_3a54c8219f12452dafc00b243d0703e0_10802_A_FlexRay_S_108_B_0_R_2_ChA_IN  # frTrig_FR_3a54c8219f12452dafc00b243d0703e0_10802_A_FlexRay
          frTrig_FR_3a54c8219f12452dafc00b243d0703e0_21301_A_FlexRay_S_213_B_0_R_1_ChA_IN (FrIfFrameTriggering):
            FrIfAllowDynamicLSduLength = false
            FrIfBaseCycle = 0
            FrIfChannel = FRIF_CHANNEL_A
            FrIfCycleRepetition = 1
            FrIfLSduLength = 32
            FrIfPayloadPreamble = false
            FrIfSlotId = 213
            FrIfAlwaysTransmit = false
            FrIfFrameStructureRef = FrStr_TL_BRC_FR_32_db376f8d_In
          frTrig_FR_3a54c8219f12452dafc00b243d0703e0_4601_A_FlexRay_S_46_B_0_R_1_ChA_IN (FrIfFrameTriggering):
            FrIfAllowDynamicLSduLength = false
            FrIfBaseCycle = 0
            FrIfChannel = FRIF_CHANNEL_A
            FrIfCycleRepetition = 1
            FrIfLSduLength = 12
            FrIfPayloadPreamble = false
            FrIfSlotId = 46
            FrIfAlwaysTransmit = false
            FrIfFrameStructureRef = FrStr_AVL_RPM_WHL
          LPdu_frTrig_FR_3a54c8219f12452dafc00b243d0703e0_215916_A_FlexRay_S_215_B_9_R_16_ChA_IN (FrIfLPdu): FrIfLPduIdx=45, FrIfReconfigurable=false, FrIfVBTriggeringRef=frTrig_FR_3a54c8219f12452dafc00b243d0703e0_215916_A_FlexRay_S_215_B_9_R_16_ChA_IN  # frTrig_FR_3a54c8219f12452dafc00b243d0703e0_215916_A_FlexRay
          frTrig_FR_3a54c8219f12452dafc00b243d0703e0_2151016_A_FlexRay_S_215_B_10_R_16_ChA_IN (FrIfFrameTriggering):
            FrIfAllowDynamicLSduLength = false
            FrIfBaseCycle = 10
            FrIfChannel = FRIF_CHANNEL_A
            FrIfCycleRepetition = 16
            FrIfLSduLength = 8
            FrIfPayloadPreamble = false
            FrIfSlotId = 215
            FrIfAlwaysTransmit = false
            FrIfFrameStructureRef = FrStr_SVC_30e65b47_In
          frTrig_FR_3a54c8219f12452dafc00b243d0703e0_24712_A_FlexRay_S_247_B_1_R_2_ChA_IN (FrIfFrameTriggering):
            FrIfAllowDynamicLSduLength = false
            FrIfBaseCycle = 1
            FrIfChannel = FRIF_CHANNEL_A
            FrIfCycleRepetition = 2
            FrIfLSduLength = 7
            FrIfPayloadPreamble = false
            FrIfSlotId = 247
            FrIfAlwaysTransmit = false
            FrIfFrameStructureRef = FrStr_DIAG_OBD_ENG
          LPdu_frTrig_FR_3a54c8219f12452dafc00b243d0703e0_29601_A_FlexRay_S_296_B_0_R_1_ChA_OUT (FrIfLPdu): FrIfLPduIdx=6, FrIfReconfigurable=false, FrIfVBTriggeringRef=frTrig_FR_3a54c8219f12452dafc00b243d0703e0_29601_A_FlexRay_S_296_B_0_R_1_ChA_OUT  # frTrig_FR_3a54c8219f12452dafc00b243d0703e0_29601_A_FlexRay
          LPdu_frTrig_FR_3a54c8219f12452dafc00b243d0703e0_2151016_A_FlexRay_S_215_B_10_R_16_ChA_IN (FrIfLPdu):  # frTrig_FR_3a54c8219f12452dafc00b243d0703e0_2151016_A_FlexRay
            FrIfLPduIdx = 46
            FrIfReconfigurable = false
            FrIfVBTriggeringRef = frTrig_FR_3a54c8219f12452dafc00b243d0703e0_2151016_A_FlexRay_S_215_B_10_R_16_ChA_IN
          3 x FrIfFrameTriggering, all with FrIfAllowDynamicLSduLength=false, FrIfChannel=FRIF_CHANNEL_A, FrIfLSduLength=8, FrIfPayloadPreamble=false, FrIfAlwaysTransmit=false:
            frTrig_FR_3a54c8219f12452dafc00b243d0703e0_24404_A_FlexRay_S_244_B_0_R_4_ChA_IN: FrIfBaseCycle=0, FrIfCycleRepetition=4, FrIfSlotId=244, FrIfFrameStructureRef=FrStr_SECU_FAHRGESTELLNUMMER
            frTrig_FR_3a54c8219f12452dafc00b243d0703e0_27648_A_FlexRay_S_276_B_4_R_8_ChA_IN: FrIfBaseCycle=4, FrIfCycleRepetition=8, FrIfSlotId=276, FrIfFrameStructureRef=FrStr_KILOMETERSTAND
            frTrig_FR_3a54c8219f12452dafc00b243d0703e0_2161216_A_FlexRay_S_216_B_12_R_16_ChA_IN: FrIfBaseCycle=12, FrIfCycleRepetition=16, FrIfSlotId=216, FrIfFrameStructureRef=FrStr_SVC_41c78475_In
          LPdu_frTrig_FR_3a54c8219f12452dafc00b243d0703e0_1201_A_FlexRay_S_12_B_0_R_1_ChA_OUT (FrIfLPdu): FrIfLPduIdx=19, FrIfReconfigurable=false, FrIfVBTriggeringRef=frTrig_FR_3a54c8219f12452dafc00b243d0703e0_1201_A_FlexRay_S_12_B_0_R_1_ChA_OUT  # frTrig_FR_3a54c8219f12452dafc00b243d0703e0_1201_A_FlexRay
          LPdu_frTrig_FR_3a54c8219f12452dafc00b243d0703e0_27408_A_FlexRay_S_274_B_0_R_8_ChA_OUT (FrIfLPdu): FrIfLPduIdx=10, FrIfReconfigurable=false, FrIfVBTriggeringRef=frTrig_FR_3a54c8219f12452dafc00b243d0703e0_27408_A_FlexRay_S_274_B_0_R_8_ChA_OUT  # frTrig_FR_3a54c8219f12452dafc00b243d0703e0_27408_A_FlexRay
          frTrig_FR_3a54c8219f12452dafc00b243d0703e0_1101_A_FlexRay_S_11_B_0_R_1_ChA_OUT (FrIfFrameTriggering):
            FrIfAllowDynamicLSduLength = false
            FrIfBaseCycle = 0
            FrIfChannel = FRIF_CHANNEL_A
            FrIfCycleRepetition = 1
            FrIfLSduLength = 16
            FrIfPayloadPreamble = false
            FrIfSlotId = 11
            FrIfAlwaysTransmit = false
            FrIfFrameStructureRef = FrStr_xcpstatic_a26fa189_Out
          4 x FrIfLPdu, all with FrIfReconfigurable=false:
            LPdu_frTrig_FR_3a54c8219f12452dafc00b243d0703e0_2161516_A_FlexRay_S_216_B_15_R_16_ChA_IN: FrIfLPduIdx=41, FrIfVBTriggeringRef=frTrig_FR_3a54c8219f12452dafc00b243d0703e0_2161516_A_FlexRay_S_216_B_15_R_16_ChA_IN  # frTrig_FR_3a54c8219f12452dafc00b243d0703e0_2161516_A_FlexRay
            LPdu_frTrig_FR_3a54c8219f12452dafc00b243d0703e0_26924_A_FlexRay_S_269_B_2_R_4_ChA_IN: FrIfLPduIdx=28, FrIfVBTriggeringRef=frTrig_FR_3a54c8219f12452dafc00b243d0703e0_26924_A_FlexRay_S_269_B_2_R_4_ChA_IN  # frTrig_FR_3a54c8219f12452dafc00b243d0703e0_26924_A_FlexRay
            LPdu_frTrig_FR_3a54c8219f12452dafc00b243d0703e0_5602_A_FlexRay_S_56_B_0_R_2_ChA_IN: FrIfLPduIdx=63, FrIfVBTriggeringRef=frTrig_FR_3a54c8219f12452dafc00b243d0703e0_5602_A_FlexRay_S_56_B_0_R_2_ChA_IN  # frTrig_FR_3a54c8219f12452dafc00b243d0703e0_5602_A_FlexRay
            LPdu_frTrig_FR_3a54c8219f12452dafc00b243d0703e0_2161216_A_FlexRay_S_216_B_12_R_16_ChA_IN: FrIfLPduIdx=38, FrIfVBTriggeringRef=frTrig_FR_3a54c8219f12452dafc00b243d0703e0_2161216_A_FlexRay_S_216_B_12_R_16_ChA_IN  # frTrig_FR_3a54c8219f12452dafc00b243d0703e0_2161216_A_FlexRay
          frTrig_FR_3a54c8219f12452dafc00b243d0703e0_10401_A_FlexRay_S_104_B_0_R_1_ChA_IN (FrIfFrameTriggering):
            FrIfAllowDynamicLSduLength = false
            FrIfBaseCycle = 0
            FrIfChannel = FRIF_CHANNEL_A
            FrIfCycleRepetition = 1
            FrIfLSduLength = 2
            FrIfPayloadPreamble = false
            FrIfSlotId = 104
            FrIfAlwaysTransmit = false
            FrIfFrameStructureRef = FrStr_ERRM_BN_U
          frTrig_FR_3a54c8219f12452dafc00b243d0703e0_216716_A_FlexRay_S_216_B_7_R_16_ChA_IN (FrIfFrameTriggering):
            FrIfAllowDynamicLSduLength = false
            FrIfBaseCycle = 7
            FrIfChannel = FRIF_CHANNEL_A
            FrIfCycleRepetition = 16
            FrIfLSduLength = 8
            FrIfPayloadPreamble = false
            FrIfSlotId = 216
            FrIfAlwaysTransmit = false
            FrIfFrameStructureRef = FrStr_SVC_3bdac434_In
          LPdu_frTrig_FR_3a54c8219f12452dafc00b243d0703e0_5534_A_FlexRay_S_55_B_3_R_4_ChA_IN (FrIfLPdu): FrIfLPduIdx=65, FrIfReconfigurable=false, FrIfVBTriggeringRef=frTrig_FR_3a54c8219f12452dafc00b243d0703e0_5534_A_FlexRay_S_55_B_3_R_4_ChA_IN  # frTrig_FR_3a54c8219f12452dafc00b243d0703e0_5534_A_FlexRay
          LPdu_frTrig_FR_3a54c8219f12452dafc00b243d0703e0_216716_A_FlexRay_S_216_B_7_R_16_ChA_IN (FrIfLPdu): FrIfLPduIdx=36, FrIfReconfigurable=false, FrIfVBTriggeringRef=frTrig_FR_3a54c8219f12452dafc00b243d0703e0_216716_A_FlexRay_S_216_B_7_R_16_ChA_IN  # frTrig_FR_3a54c8219f12452dafc00b243d0703e0_216716_A_FlexRay
          frTrig_FR_3a54c8219f12452dafc00b243d0703e0_29401_A_FlexRay_S_294_B_0_R_1_ChA_OUT (FrIfFrameTriggering):
            FrIfAllowDynamicLSduLength = false
            FrIfBaseCycle = 0
            FrIfChannel = FRIF_CHANNEL_A
            FrIfCycleRepetition = 1
            FrIfLSduLength = 254
            FrIfPayloadPreamble = false
            FrIfSlotId = 294
            FrIfAlwaysTransmit = false
            FrIfFrameStructureRef = FrStr_xcpdynamic254_1
          LPdu_frTrig_FR_3a54c8219f12452dafc00b243d0703e0_801_A_FlexRay_S_8_B_0_R_1_ChA_OUT (FrIfLPdu): FrIfLPduIdx=23, FrIfReconfigurable=false, FrIfVBTriggeringRef=frTrig_FR_3a54c8219f12452dafc00b243d0703e0_801_A_FlexRay_S_8_B_0_R_1_ChA_OUT  # frTrig_FR_3a54c8219f12452dafc00b243d0703e0_801_A_FlexRay
          3 x FrIfFrameTriggering, all with FrIfAllowDynamicLSduLength=false, FrIfChannel=FRIF_CHANNEL_A, FrIfPayloadPreamble=false, FrIfAlwaysTransmit=false:
            frTrig_FR_3a54c8219f12452dafc00b243d0703e0_215916_A_FlexRay_S_215_B_9_R_16_ChA_IN: FrIfBaseCycle=9, FrIfCycleRepetition=16, FrIfLSduLength=8, FrIfSlotId=215, FrIfFrameStructureRef=FrStr_SVC_bd5ded5f_In
            frTrig_FR_3a54c8219f12452dafc00b243d0703e0_1001_A_FlexRay_S_10_B_0_R_1_ChA_OUT: FrIfBaseCycle=0, FrIfCycleRepetition=1, FrIfLSduLength=16, FrIfSlotId=10, FrIfFrameStructureRef=FrStr_xcpstatic_7ff9780c_Out
            frTrig_FR_3a54c8219f12452dafc00b243d0703e0_27578_A_FlexRay_S_275_B_7_R_8_ChA_IN: FrIfBaseCycle=7, FrIfCycleRepetition=8, FrIfLSduLength=7, FrIfSlotId=275, FrIfFrameStructureRef=FrStr_FAHRGESTELLNUMMER
          LPdu_frTrig_FR_3a54c8219f12452dafc00b243d0703e0_5338_A_FlexRay_S_53_B_3_R_8_ChA_IN (FrIfLPdu): FrIfLPduIdx=66, FrIfReconfigurable=false, FrIfVBTriggeringRef=frTrig_FR_3a54c8219f12452dafc00b243d0703e0_5338_A_FlexRay_S_53_B_3_R_8_ChA_IN  # frTrig_FR_3a54c8219f12452dafc00b243d0703e0_5338_A_FlexRay
          frTrig_FR_3a54c8219f12452dafc00b243d0703e0_21901_A_FlexRay_S_219_B_0_R_1_ChA_IN (FrIfFrameTriggering):
            FrIfAllowDynamicLSduLength = false
            FrIfBaseCycle = 0
            FrIfChannel = FRIF_CHANNEL_A
            FrIfCycleRepetition = 1
            FrIfLSduLength = 32
            FrIfPayloadPreamble = false
            FrIfSlotId = 219
            FrIfAlwaysTransmit = false
            FrIfFrameStructureRef = FrStr_xcpmaster
          LPdu_frTrig_FR_3a54c8219f12452dafc00b243d0703e0_21434_A_FlexRay_S_214_B_3_R_4_ChA_IN (FrIfLPdu): FrIfLPduIdx=47, FrIfReconfigurable=false, FrIfVBTriggeringRef=frTrig_FR_3a54c8219f12452dafc00b243d0703e0_21434_A_FlexRay_S_214_B_3_R_4_ChA_IN  # frTrig_FR_3a54c8219f12452dafc00b243d0703e0_21434_A_FlexRay
          LPdu_frTrig_FR_3a54c8219f12452dafc00b243d0703e0_29901_A_FlexRay_S_299_B_0_R_1_ChA_OUT (FrIfLPdu): FrIfLPduIdx=3, FrIfReconfigurable=false, FrIfVBTriggeringRef=frTrig_FR_3a54c8219f12452dafc00b243d0703e0_29901_A_FlexRay_S_299_B_0_R_1_ChA_OUT  # frTrig_FR_3a54c8219f12452dafc00b243d0703e0_29901_A_FlexRay
          frTrig_FR_3a54c8219f12452dafc00b243d0703e0_29801_A_FlexRay_S_298_B_0_R_1_ChA_OUT (FrIfFrameTriggering):
            FrIfAllowDynamicLSduLength = false
            FrIfBaseCycle = 0
            FrIfChannel = FRIF_CHANNEL_A
            FrIfCycleRepetition = 1
            FrIfLSduLength = 254
            FrIfPayloadPreamble = false
            FrIfSlotId = 298
            FrIfAlwaysTransmit = false
            FrIfFrameStructureRef = FrStr_xcpdynamic254_5
          LPdu_frTrig_FR_3a54c8219f12452dafc00b243d0703e0_20901_A_FlexRay_S_209_B_0_R_1_ChA_IN (FrIfLPdu): FrIfLPduIdx=52, FrIfReconfigurable=false, FrIfVBTriggeringRef=frTrig_FR_3a54c8219f12452dafc00b243d0703e0_20901_A_FlexRay_S_209_B_0_R_1_ChA_IN  # frTrig_FR_3a54c8219f12452dafc00b243d0703e0_20901_A_FlexRay
          frTrig_FR_3a54c8219f12452dafc00b243d0703e0_2161516_A_FlexRay_S_216_B_15_R_16_ChA_IN (FrIfFrameTriggering):
            FrIfAllowDynamicLSduLength = false
            FrIfBaseCycle = 15
            FrIfChannel = FRIF_CHANNEL_A
            FrIfCycleRepetition = 16
            FrIfLSduLength = 8
            FrIfPayloadPreamble = false
            FrIfSlotId = 216
            FrIfAlwaysTransmit = false
            FrIfFrameStructureRef = FrStr_SVC_3cb4822d_In
      FrStr_KILOMETERSTAND (FrIfFrameStructure): FrIfByteOrder=LITTLE_ENDIAN  # KILOMETERSTAND
        sn_23b23ec8e79d4821a4fd4f71addacbb8_10_209e4b614ee044c4bbf1020e8ad2a6e0_10 (FrIfPdusInFrame): FrIfPduOffset=0, FrIfMappedPduId=1, FrIfPduRef=KILOMETERSTAND
      SU_CLE_DRDY_DXP (FrIfPdu)
        FrIfPduDirection
          FrIfRxPdu_SU_CLE_DRDY_DXP (FrIfRxPdu): FrIfUserRxIndicationUL=PDUR, FrIfRxPduId=27, FrIfRxPduRef=pduTr_SU_CLE_DRDY_DXP_A_FlexRay_pduPort_EPS_A_FlexRay_IN_7d601c47_052bff33  # SU_CLE_DRDY_DXP
      3 x FrIfFrameStructure, all with FrIfByteOrder=LITTLE_ENDIAN:
        FrStr_ACLNX_MASSCNTR_ACLNY_MASSCNTR  # ACLNX_MASSCNTR_ACLNY_MASSCNTR
          sn_5d864f4a266e40639fe6abc57cceb758_17_060886cf9e88403f9df14c319aa0ae95_20 (FrIfPdusInFrame): FrIfPduOffset=8, FrIfMappedPduId=41, FrIfPduRef=ACLNY_MASSCNTR
        FrStr_SVC_9a2d386a_In  # SVC
          sn_9dd8c6cee627483a83c881709979081d_77_017541877cab44569267610f7b9dbbd6_78 (FrIfPdusInFrame): FrIfPduOffset=0, FrIfMappedPduId=20, FrIfPduRef=SVC_In
        FrStr_DISP_CC_EPS  # DISP_CC_EPS
          sn_bbacfb13291a4ee286c905592a1bb973_2_39a2ac19c7164f0385b879ca14e85e7b_2 (FrIfPdusInFrame): FrIfPduOffset=0, FrIfMappedPduId=9, FrIfPduRef=DISP_CC_EPS
      5 x FrIfPdu:
        TL_ECU_TRNSM_FR_32
          FrIfPduDirection
            FrIfTxPdu_TL_ECU_TRNSM_FR_32 (FrIfTxPdu):  # TL_ECU_TRNSM_FR_32
              FrIfUserTxUL = FR_TP
              FrIfConfirm = true
              FrIfCounterLimit = 1
              FrIfImmediate = false
              FrIfNoneMode = false
              FrIfTxPduId = 15
              FrIfTxPduRef = pduTr_TL_ECU_TRNSM_FR_32_A_FlexRay_pduPort_EPS_A_FlexRay_OUT_7d601c47_052bff33
        AVL_PO_EPS
          FrIfPduDirection
            FrIfTxPdu_AVL_PO_EPS (FrIfTxPdu):  # AVL_PO_EPS
              FrIfUserTxUL = PDUR
              FrIfConfirm = false
              FrIfCounterLimit = 1
              FrIfImmediate = false
              FrIfNoneMode = false
              FrIfTxPduId = 16
              FrIfTxPduRef = pduTr_AVL_PO_EPS_A_FlexRay_pduPort_EPS_A_FlexRay_OUT_7d601c47_052bff33
        CTR_VIB_STW_DISP_EXMI_SP2015
          FrIfPduDirection
            FrIfRxPdu_CTR_VIB_STW_DISP_EXMI_SP2015 (FrIfRxPdu): FrIfUserRxIndicationUL=PDUR, FrIfRxPduId=4, FrIfRxPduRef=pduTr_CTR_VIB_STW_DISP_EXMI_SP2015_A_FlexRay_pduPort_EPS_A_FlexRay_IN_7d601c47_052bff33  # CTR_VIB_STW_DISP_EXMI_SP2015
        FR_DBG_EPS
          FrIfPduDirection
            FrIfTxPdu_FR_DBG_EPS (FrIfTxPdu):  # FR_DBG_EPS
              FrIfUserTxUL = PDUR
              FrIfConfirm = false
              FrIfCounterLimit = 1
              FrIfImmediate = false
              FrIfNoneMode = false
              FrIfTxPduId = 0
              FrIfTxPduRef = pduTr_FR_DBG_EPS_A_FlexRay_pduPort_EPS_A_FlexRay_OUT_7d601c47_052bff33
        DT_EST
          FrIfPduDirection
            FrIfTxPdu_DT_EST (FrIfTxPdu):  # DT_EST
              FrIfUserTxUL = PDUR
              FrIfConfirm = false
              FrIfCounterLimit = 1
              FrIfImmediate = false
              FrIfNoneMode = false
              FrIfTxPduId = 18
              FrIfTxPduRef = pduTr_DT_EST_A_FlexRay_pduPort_EPS_A_FlexRay_OUT_7d601c47_052bff33
      6 x FrIfFrameStructure, all with FrIfByteOrder=LITTLE_ENDIAN:
        FrStr_SVC_bd5ded5f_In  # SVC
          sn_9dd8c6cee627483a83c881709979081d_77_017541877cab44569267610f7b9dbbd6_78 (FrIfPdusInFrame): FrIfPduOffset=0, FrIfMappedPduId=21, FrIfPduRef=SVC_In
        FrStr_SVC_219b313e_In  # SVC
          sn_9dd8c6cee627483a83c881709979081d_77_017541877cab44569267610f7b9dbbd6_78 (FrIfPdusInFrame): FrIfPduOffset=0, FrIfMappedPduId=13, FrIfPduRef=SVC_In
        FrStr_TL_BRC_FR_32_06a1b608_In  # TL_BRC_FR_32
          sn_b89d750f03b54dc591beef3d97af79e1_6_99b35db8d0034c95bddada0c4e168dbd_5 (FrIfPdusInFrame): FrIfPduOffset=0, FrIfMappedPduId=25, FrIfPduRef=TL_BRC_FR_32
        FrStr_A_TEMP  # A_TEMP
          sn_ffb3893c37a446b6bb48321cc292082f_18_d0ea1fc2c1ca4e2295bae82b1e156e9a_18 (FrIfPdusInFrame): FrIfPduOffset=0, FrIfMappedPduId=5, FrIfPduRef=A_TEMP
        FrStr_SECU_FAHRGESTELLNUMMER  # SECU_FAHRGESTELLNUMMER
          sn_45fe7c1444bb44a182e3c698da50983a_3_ff5ad01b69a64f2fa3482d8ab369f18a_3 (FrIfPdusInFrame): FrIfPduOffset=0, FrIfMappedPduId=8, FrIfPduRef=SECU_FAHRGESTELLNUMMER
        FrStr_DT_DRDYSEN_EXT_VYAW_VEH  # DT_DRDYSEN_EXT_VYAW_VEH
          sn_1a6c54ef470342899c8af77346d5f01c_20_27f7c756a0e24349b8e230b415458184_21 (FrIfPdusInFrame): FrIfPduOffset=8, FrIfMappedPduId=40, FrIfPduRef=VYAW_VEH
      STEA_OFFS (FrIfPdu)
        FrIfPduDirection
          FrIfRxPdu_STEA_OFFS (FrIfRxPdu): FrIfUserRxIndicationUL=PDUR, FrIfRxPduId=17, FrIfRxPduRef=pduTr_STEA_OFFS_A_FlexRay_pduPort_EPS_A_FlexRay_IN_7d601c47_052bff33  # STEA_OFFS
      ST_EST (FrIfPdu)
        FrIfPduDirection
          FrIfTxPdu_ST_EST (FrIfTxPdu):  # ST_EST
            FrIfUserTxUL = PDUR
            FrIfConfirm = true
            FrIfCounterLimit = 1
            FrIfImmediate = false
            FrIfNoneMode = false
            FrIfTxPduId = 12
            FrIfTxPduRef = pduTr_ST_EST_A_FlexRay_pduPort_EPS_A_FlexRay_OUT_7d601c47_052bff33
      FrStr_CON_VEH (FrIfFrameStructure): FrIfByteOrder=LITTLE_ENDIAN  # CON_VEH
        sn_a07de7dfbad342e18d0517336a8ccb12_11_f39dc9b4f18c4462a3ca3222d270f882_11 (FrIfPdusInFrame): FrIfPduOffset=0, FrIfMappedPduId=30, FrIfPduRef=CON_VEH
      SECU_FAHRGESTELLNUMMER (FrIfPdu)
        FrIfPduDirection
          FrIfRxPdu_SECU_FAHRGESTELLNUMMER (FrIfRxPdu): FrIfUserRxIndicationUL=PDUR, FrIfRxPduId=8, FrIfRxPduRef=pduTr_SECU_FAHRGESTELLNUMMER_A_FlexRay_pduPort_EPS_A_FlexRay_IN_7d601c47_052bff33  # SECU_FAHRGESTELLNUMMER
      FrStr_OFFS_QUAD_EPS (FrIfFrameStructure): FrIfByteOrder=LITTLE_ENDIAN  # OFFS_QUAD_EPS
        sn_4b75d7aade684404a40181123f5e091e_13_2538d099b88d4657ae03c10c9544a047_14 (FrIfPdusInFrame): FrIfPduOffset=0, FrIfMappedPduId=34, FrIfPduRef=OFFS_QUAD_EPS
      VYAW_VEH (FrIfPdu)
        FrIfPduDirection
          FrIfRxPdu_VYAW_VEH (FrIfRxPdu): FrIfUserRxIndicationUL=PDUR, FrIfRxPduId=24, FrIfRxPduRef=pduTr_VYAW_VEH_A_FlexRay_pduPort_EPS_A_FlexRay_IN_7d601c47_052bff33  # VYAW_VEH
      KILOMETERSTAND (FrIfPdu)
        FrIfPduDirection
          FrIfRxPdu_KILOMETERSTAND (FrIfRxPdu): FrIfUserRxIndicationUL=PDUR, FrIfRxPduId=1, FrIfRxPduRef=pduTr_KILOMETERSTAND_A_FlexRay_pduPort_EPS_A_FlexRay_IN_7d601c47_052bff33  # KILOMETERSTAND
      FrStr_TAR_ESTP_VIRT_FTAX (FrIfFrameStructure): FrIfByteOrder=LITTLE_ENDIAN  # TAR_ESTP_VIRT_FTAX
        sn_d9f1ff037ed147f1bcd2f969afda82c4_5_12963b5f55914150b9f8aacada47bf44_5 (FrIfPdusInFrame): FrIfPduOffset=0, FrIfMappedPduId=39, FrIfPduRef=TAR_ESTP_VIRT_FTAX
      RELATIVZEIT (FrIfPdu)
        FrIfPduDirection
          FrIfRxPdu_RELATIVZEIT (FrIfRxPdu): FrIfUserRxIndicationUL=PDUR, FrIfRxPduId=0, FrIfRxPduRef=pduTr_RELATIVZEIT_A_FlexRay_pduPort_EPS_A_FlexRay_IN_7d601c47_052bff33  # RELATIVZEIT
      xcpdynamic254_8 (FrIfPdu)
        FrIfPduDirection
          FrIfTxPdu_xcpdynamic254_8 (FrIfTxPdu):  # xcpdynamic254_8
            FrIfUserTxUL = XCP
            FrIfConfirm = true
            FrIfCounterLimit = 1
            FrIfImmediate = false
            FrIfNoneMode = false
            FrIfTxPduId = 1
            FrIfTxPduRef = pduTr_xcpdynamic254_8_A_FlexRay_pduPort_EPS_A_FlexRay_OUT_7d601c47_052bff33
      FrStr_ST_ENERG_GEN (FrIfFrameStructure): FrIfByteOrder=LITTLE_ENDIAN  # ST_ENERG_GEN
        sn_efdccab807464c4ab076173048647d90_15_085b67cff4b142a59fb46d892b9938f0_15 (FrIfPdusInFrame): FrIfPduOffset=0, FrIfMappedPduId=9, FrIfPduRef=ST_ENERG_GEN
      FAHRGESTELLNUMMER (FrIfPdu)
        FrIfPduDirection
          FrIfRxPdu_FAHRGESTELLNUMMER (FrIfRxPdu): FrIfUserRxIndicationUL=PDUR, FrIfRxPduId=3, FrIfRxPduRef=pduTr_FAHRGESTELLNUMMER_A_FlexRay_pduPort_EPS_A_FlexRay_IN_7d601c47_052bff33  # FAHRGESTELLNUMMER
      FrStr_xcpstatic_31d6b02c_Out (FrIfFrameStructure): FrIfByteOrder=LITTLE_ENDIAN  # xcpstatic
        sn_d6c051138a624b7197665ea502ed9c68_3_9779c0f9609648bfa4441a0865c580a6_3 (FrIfPdusInFrame): FrIfPduOffset=0, FrIfMappedPduId=25, FrIfPduRef=dummy16bstatic
      ST_CENG (FrIfPdu)
        FrIfPduDirection
          FrIfRxPdu_ST_CENG (FrIfRxPdu): FrIfUserRxIndicationUL=PDUR, FrIfRxPduId=16, FrIfRxPduRef=pduTr_ST_CENG_A_FlexRay_pduPort_EPS_A_FlexRay_IN_7d601c47_052bff33  # ST_CENG
      FrStr_CTR_DIAG_OBD_DRDY (FrIfFrameStructure): FrIfByteOrder=LITTLE_ENDIAN  # CTR_DIAG_OBD_DRDY
        sn_62b9b444be3144e4afdbe2e8f65ae37b_4_eb2aaf9fde954786857e30879fbebab8_4 (FrIfPdusInFrame): FrIfPduOffset=0, FrIfMappedPduId=6, FrIfPduRef=CTR_DIAG_OBD_DRDY
      FrStr_xcpstatic_ec4069a9_Out (FrIfFrameStructure): FrIfByteOrder=LITTLE_ENDIAN  # xcpstatic
        sn_d6c051138a624b7197665ea502ed9c68_3_9779c0f9609648bfa4441a0865c580a6_3 (FrIfPdusInFrame): FrIfPduOffset=0, FrIfMappedPduId=24, FrIfPduRef=dummy16bstatic
      DIAG_OBD_ENG (FrIfPdu)
        FrIfPduDirection
          FrIfRxPdu_DIAG_OBD_ENG (FrIfRxPdu): FrIfUserRxIndicationUL=PDUR, FrIfRxPduId=7, FrIfRxPduRef=pduTr_DIAG_OBD_ENG_A_FlexRay_pduPort_EPS_A_FlexRay_IN_7d601c47_052bff33  # DIAG_OBD_ENG
      TL_MST_GW_TRNSM_FR_254 (FrIfPdu)
        FrIfPduDirection
          FrIfRxPdu_TL_MST_GW_TRNSM_FR_254 (FrIfRxPdu): FrIfUserRxIndicationUL=FR_TP, FrIfRxPduId=13, FrIfRxPduRef=pduTr_TL_MST_GW_TRNSM_FR_254_A_FlexRay_pduPort_EPS_A_FlexRay_IN_7d601c47_052bff33  # TL_MST_GW_TRNSM_FR_254
      FrStr_xcpmaster (FrIfFrameStructure): FrIfByteOrder=LITTLE_ENDIAN  # xcpmaster
        sn_6acd24342b914dee85c6ec4bb84bea56_4_2e91d703d77a465ba5c92f45777cf2d1_4 (FrIfPdusInFrame): FrIfPduOffset=0, FrIfMappedPduId=10, FrIfPduRef=dummy32bmaster
      FrStr_SVC_a08d1767_In (FrIfFrameStructure): FrIfByteOrder=LITTLE_ENDIAN  # SVC
        sn_9dd8c6cee627483a83c881709979081d_77_017541877cab44569267610f7b9dbbd6_78 (FrIfPdusInFrame): FrIfPduOffset=0, FrIfMappedPduId=23, FrIfPduRef=SVC_In
      xcpdynamic254_7 (FrIfPdu)
        FrIfPduDirection
          FrIfTxPdu_xcpdynamic254_7 (FrIfTxPdu):  # xcpdynamic254_7
            FrIfUserTxUL = XCP
            FrIfConfirm = true
            FrIfCounterLimit = 1
            FrIfImmediate = false
            FrIfNoneMode = false
            FrIfTxPduId = 2
            FrIfTxPduRef = pduTr_xcpdynamic254_7_A_FlexRay_pduPort_EPS_A_FlexRay_OUT_7d601c47_052bff33
      xcpdynamic254_6 (FrIfPdu)
        FrIfPduDirection
          FrIfTxPdu_xcpdynamic254_6 (FrIfTxPdu):  # xcpdynamic254_6
            FrIfUserTxUL = XCP
            FrIfConfirm = true
            FrIfCounterLimit = 1
            FrIfImmediate = false
            FrIfNoneMode = false
            FrIfTxPduId = 3
            FrIfTxPduRef = pduTr_xcpdynamic254_6_A_FlexRay_pduPort_EPS_A_FlexRay_OUT_7d601c47_052bff33
      FrStr_SVC_30e65b47_In (FrIfFrameStructure): FrIfByteOrder=LITTLE_ENDIAN  # SVC
        sn_9dd8c6cee627483a83c881709979081d_77_017541877cab44569267610f7b9dbbd6_78 (FrIfPdusInFrame): FrIfPduOffset=0, FrIfMappedPduId=22, FrIfPduRef=SVC_In
      xcpdynamic254_5 (FrIfPdu)
        FrIfPduDirection
          FrIfTxPdu_xcpdynamic254_5 (FrIfTxPdu):  # xcpdynamic254_5
            FrIfUserTxUL = XCP
            FrIfConfirm = true
            FrIfCounterLimit = 1
            FrIfImmediate = false
            FrIfNoneMode = false
            FrIfTxPduId = 4
            FrIfTxPduRef = pduTr_xcpdynamic254_5_A_FlexRay_pduPort_EPS_A_FlexRay_OUT_7d601c47_052bff33
      FrStr_FR_DBG_EPS (FrIfFrameStructure): FrIfByteOrder=LITTLE_ENDIAN  # FR_DBG_EPS
        sn_6b68fdbc63d54758bff55913fcd344ba_5_43f7a9daf64d4ee7b94a0fd106743903_5 (FrIfPdusInFrame): FrIfPduOffset=0, FrIfMappedPduId=0, FrIfPduRef=FR_DBG_EPS
      6 x FrIfPdu:
        xcpdynamic254_4
          FrIfPduDirection
            FrIfTxPdu_xcpdynamic254_4 (FrIfTxPdu):  # xcpdynamic254_4
              FrIfUserTxUL = XCP
              FrIfConfirm = true
              FrIfCounterLimit = 1
              FrIfImmediate = false
              FrIfNoneMode = false
              FrIfTxPduId = 5
              FrIfTxPduRef = pduTr_xcpdynamic254_4_A_FlexRay_pduPort_EPS_A_FlexRay_OUT_7d601c47_052bff33
        DISP_CC_EPS
          FrIfPduDirection
            FrIfTxPdu_DISP_CC_EPS (FrIfTxPdu):  # DISP_CC_EPS
              FrIfUserTxUL = PDUR
              FrIfConfirm = true
              FrIfCounterLimit = 1
              FrIfImmediate = false
              FrIfNoneMode = false
              FrIfTxPduId = 9
              FrIfTxPduRef = pduTr_DISP_CC_EPS_A_FlexRay_pduPort_EPS_A_FlexRay_OUT_7d601c47_052bff33
        xcpdynamic254_3
          FrIfPduDirection
            FrIfTxPdu_xcpdynamic254_3 (FrIfTxPdu):  # xcpdynamic254_3
              FrIfUserTxUL = XCP
              FrIfConfirm = true
              FrIfCounterLimit = 1
              FrIfImmediate = false
              FrIfNoneMode = false
              FrIfTxPduId = 6
              FrIfTxPduRef = pduTr_xcpdynamic254_3_A_FlexRay_pduPort_EPS_A_FlexRay_OUT_7d601c47_052bff33
        FZZSTD
          FrIfPduDirection
            FrIfRxPdu_FZZSTD (FrIfRxPdu): FrIfUserRxIndicationUL=PDUR, FrIfRxPduId=2, FrIfRxPduRef=pduTr_FZZSTD_A_FlexRay_pduPort_EPS_A_FlexRay_IN_7d601c47_052bff33  # FZZSTD
        xcpdynamic254_2
          FrIfPduDirection
            FrIfTxPdu_xcpdynamic254_2 (FrIfTxPdu):  # xcpdynamic254_2
              FrIfUserTxUL = XCP
              FrIfConfirm = true
              FrIfCounterLimit = 1
              FrIfImmediate = false
              FrIfNoneMode = false
              FrIfTxPduId = 7
              FrIfTxPduRef = pduTr_xcpdynamic254_2_A_FlexRay_pduPort_EPS_A_FlexRay_OUT_7d601c47_052bff33
        xcpdynamic254_1
          FrIfPduDirection
            FrIfTxPdu_xcpdynamic254_1 (FrIfTxPdu):  # xcpdynamic254_1
              FrIfUserTxUL = XCP
              FrIfConfirm = true
              FrIfCounterLimit = 1
              FrIfImmediate = false
              FrIfNoneMode = false
              FrIfTxPduId = 8
              FrIfTxPduRef = pduTr_xcpdynamic254_1_A_FlexRay_pduPort_EPS_A_FlexRay_OUT_7d601c47_052bff33
      3 x FrIfFrameStructure, all with FrIfByteOrder=LITTLE_ENDIAN:
        FrStr_AVL_PO_EPS_ENGTORQ_EPS  # AVL_PO_EPS_ENGTORQ_EPS
          sn_0b01e810a8bf4aa3b3ead1e4c09f2b68_4_e0f63d36315c4773ba837e73d6faaadd_15 (FrIfPdusInFrame): FrIfPduOffset=0, FrIfMappedPduId=16, FrIfPduRef=AVL_PO_EPS
          sn_0b01e810a8bf4aa3b3ead1e4c09f2b68_4_0c0ed9ed2c324b648cea19ccfdcf4017_2 (FrIfPdusInFrame): FrIfPduOffset=8, FrIfMappedPduId=17, FrIfPduRef=ENGTORQ_EPS
        FrStr_V_VEH_V_VEH_2  # V_VEH_V_VEH_2
          sn_2891826c350d482582f167e1fc0f401f_10_af83ce37179a45aca7ac57646532416b_18 (FrIfPdusInFrame): FrIfPduOffset=0, FrIfMappedPduId=42, FrIfPduRef=V_VEH
        FrStr_SVC_5a9452fc_In  # SVC
          sn_9dd8c6cee627483a83c881709979081d_77_017541877cab44569267610f7b9dbbd6_78 (FrIfPdusInFrame): FrIfPduOffset=0, FrIfMappedPduId=18, FrIfPduRef=SVC_In
      OFFS_QUAD_EPS (FrIfPdu)
        FrIfPduDirection
          FrIfRxPdu_OFFS_QUAD_EPS (FrIfRxPdu): FrIfUserRxIndicationUL=PDUR, FrIfRxPduId=18, FrIfRxPduRef=pduTr_OFFS_QUAD_EPS_A_FlexRay_pduPort_EPS_A_FlexRay_IN_7d601c47_052bff33  # OFFS_QUAD_EPS
      5 x FrIfFrameStructure, all with FrIfByteOrder=LITTLE_ENDIAN:
        FrStr_ERRM_BN_U  # ERRM_BN_U
          sn_8e8d5ba824d24f699ca284a4f92ea5fd_4_677e18af96434b57a7947ca5849af5e4_4 (FrIfPdusInFrame): FrIfPduOffset=0, FrIfMappedPduId=35, FrIfPduRef=ERRM_BN_U
        FrStr_xcpslave  # xcpslave
          sn_2ed003fa08904453b0dfb985d50da316_4_039aef2810e44f2c9248813621a8312e_4 (FrIfPdusInFrame): FrIfPduOffset=0, FrIfMappedPduId=13, FrIfPduRef=dummy32bslave
        FrStr_SVC_27e754a4_In  # SVC
          sn_9dd8c6cee627483a83c881709979081d_77_017541877cab44569267610f7b9dbbd6_78 (FrIfPdusInFrame): FrIfPduOffset=0, FrIfMappedPduId=19, FrIfPduRef=SVC_In
        FrStr_DIAG_OBD_ENG  # DIAG_OBD_ENG
          sn_f26c29b5554146b48da2e76fdc87f59b_13_d8833aa6063240d791b5384f59f75d9a_13 (FrIfPdusInFrame): FrIfPduOffset=0, FrIfMappedPduId=7, FrIfPduRef=DIAG_OBD_ENG
        FrStr_ST_DIAG_OBD_3_DRDY  # ST_DIAG_OBD_3_DRDY
          sn_f1b37dec817945749ac7e14f80df159d_4_95dff1578f214757b23c8394af12aa48_4 (FrIfPdusInFrame): FrIfPduOffset=0, FrIfMappedPduId=11, FrIfPduRef=ST_DIAG_OBD_3_DRDY
      CTR_DIAG_OBD_DRDY (FrIfPdu)
        FrIfPduDirection
          FrIfRxPdu_CTR_DIAG_OBD_DRDY (FrIfRxPdu): FrIfUserRxIndicationUL=PDUR, FrIfRxPduId=6, FrIfRxPduRef=pduTr_CTR_DIAG_OBD_DRDY_A_FlexRay_pduPort_EPS_A_FlexRay_IN_7d601c47_052bff33  # CTR_DIAG_OBD_DRDY
      FrStr_ST_STAB_DSC_ST_STAB_DSC_2 (FrIfFrameStructure): FrIfByteOrder=LITTLE_ENDIAN  # ST_STAB_DSC_ST_STAB_DSC_2
        sn_2c6859f532c740fd851c07438c6639fd_20_3e35ac63fc494d0fb399c763aeb7057b_24 (FrIfPdusInFrame): FrIfPduOffset=0, FrIfMappedPduId=44, FrIfPduRef=ST_STAB_DSC
      V_VEH (FrIfPdu)
        FrIfPduDirection
          FrIfRxPdu_V_VEH (FrIfRxPdu): FrIfUserRxIndicationUL=PDUR, FrIfRxPduId=26, FrIfRxPduRef=pduTr_V_VEH_A_FlexRay_pduPort_EPS_A_FlexRay_IN_7d601c47_052bff33  # V_VEH
      ST_STAB_DSC (FrIfPdu)
        FrIfPduDirection
          FrIfRxPdu_ST_STAB_DSC (FrIfRxPdu): FrIfUserRxIndicationUL=PDUR, FrIfRxPduId=28, FrIfRxPduRef=pduTr_ST_STAB_DSC_A_FlexRay_pduPort_EPS_A_FlexRay_IN_7d601c47_052bff33  # ST_STAB_DSC
      FrStr_ENERG_DGR_DRDY (FrIfFrameStructure): FrIfByteOrder=LITTLE_ENDIAN  # ENERG_DGR_DRDY
        sn_a8f1d204f2ad40669d1acf24a5cd893e_8_39c3f0eb640a4f78a081a30d189b0df4_8 (FrIfPdusInFrame): FrIfPduOffset=0, FrIfMappedPduId=38, FrIfPduRef=ENERG_DGR_DRDY
      FrStr_SVC_9c515df0_In (FrIfFrameStructure): FrIfByteOrder=LITTLE_ENDIAN  # SVC
        sn_9dd8c6cee627483a83c881709979081d_77_017541877cab44569267610f7b9dbbd6_78 (FrIfPdusInFrame): FrIfPduOffset=0, FrIfMappedPduId=15, FrIfPduRef=SVC_In
      SVC_Out (FrIfPdu)
        FrIfPduDirection
          FrIfTxPdu_SVC (FrIfTxPdu): FrIfUserTxUL=PDUR, FrIfConfirm=true, FrIfCounterLimit=1, FrIfImmediate=false, FrIfNoneMode=false, FrIfTxPduId=14, FrIfTxPduRef=SVC_434514f6_Out  # SVC
      FrStr_SVC_3cb4822d_In (FrIfFrameStructure): FrIfByteOrder=LITTLE_ENDIAN  # SVC
        sn_9dd8c6cee627483a83c881709979081d_77_017541877cab44569267610f7b9dbbd6_78 (FrIfPdusInFrame): FrIfPduOffset=0, FrIfMappedPduId=17, FrIfPduRef=SVC_In
      FrStr_DT_EST (FrIfFrameStructure): FrIfByteOrder=LITTLE_ENDIAN  # DT_EST
        sn_47f7335f9e884cfebf3cf85a43b03f09_9_f1c2ea448b5742e6a930415b5321c120_9 (FrIfPdusInFrame): FrIfPduOffset=0, FrIfMappedPduId=18, FrIfPduRef=DT_EST
      CON_VEH (FrIfPdu)
        FrIfPduDirection
          FrIfRxPdu_CON_VEH (FrIfRxPdu): FrIfUserRxIndicationUL=PDUR, FrIfRxPduId=14, FrIfRxPduRef=pduTr_CON_VEH_A_FlexRay_pduPort_EPS_A_FlexRay_IN_7d601c47_052bff33  # CON_VEH
      AVL_RPM_WHL (FrIfPdu)
        FrIfPduDirection
          FrIfRxPdu_AVL_RPM_WHL (FrIfRxPdu): FrIfUserRxIndicationUL=PDUR, FrIfRxPduId=29, FrIfRxPduRef=pduTr_AVL_RPM_WHL_A_FlexRay_pduPort_EPS_A_FlexRay_IN_7d601c47_052bff33  # AVL_RPM_WHL
      FrStr_FAHRGESTELLNUMMER (FrIfFrameStructure): FrIfByteOrder=LITTLE_ENDIAN  # FAHRGESTELLNUMMER
        sn_1e39d529353949ad94ad72cd99e0239e_13_9007d271e9154737bbd9f3c54ab3098b_12 (FrIfPdusInFrame): FrIfPduOffset=0, FrIfMappedPduId=3, FrIfPduRef=FAHRGESTELLNUMMER
      ST_ENERG_GEN (FrIfPdu)
        FrIfPduDirection
          FrIfRxPdu_ST_ENERG_GEN (FrIfRxPdu): FrIfUserRxIndicationUL=PDUR, FrIfRxPduId=9, FrIfRxPduRef=pduTr_ST_ENERG_GEN_A_FlexRay_pduPort_EPS_A_FlexRay_IN_7d601c47_052bff33  # ST_ENERG_GEN
      ENSU_SFY (FrIfPdu)
        FrIfPduDirection
          FrIfRxPdu_ENSU_SFY (FrIfRxPdu): FrIfUserRxIndicationUL=PDUR, FrIfRxPduId=15, FrIfRxPduRef=pduTr_ENSU_SFY_A_FlexRay_pduPort_EPS_A_FlexRay_IN_7d601c47_052bff33  # ENSU_SFY
      FrStr_TL_BRC_FR_32_66fd0343_In (FrIfFrameStructure): FrIfByteOrder=LITTLE_ENDIAN  # TL_BRC_FR_32
        sn_b89d750f03b54dc591beef3d97af79e1_6_99b35db8d0034c95bddada0c4e168dbd_5 (FrIfPdusInFrame): FrIfPduOffset=0, FrIfMappedPduId=27, FrIfPduRef=TL_BRC_FR_32
      A_TEMP (FrIfPdu)
        FrIfPduDirection
          FrIfRxPdu_A_TEMP (FrIfRxPdu): FrIfUserRxIndicationUL=PDUR, FrIfRxPduId=5, FrIfRxPduRef=pduTr_A_TEMP_A_FlexRay_pduPort_EPS_A_FlexRay_IN_7d601c47_052bff33  # A_TEMP
      5 x FrIfFrameStructure, all with FrIfByteOrder=LITTLE_ENDIAN:
        FrStr_SVC_e1225ba8_In  # SVC
          sn_9dd8c6cee627483a83c881709979081d_77_017541877cab44569267610f7b9dbbd6_78 (FrIfPdusInFrame): FrIfPduOffset=0, FrIfMappedPduId=16, FrIfPduRef=SVC_In
        FrStr_SVC_41c78475_In  # SVC
          sn_9dd8c6cee627483a83c881709979081d_77_017541877cab44569267610f7b9dbbd6_78 (FrIfPdusInFrame): FrIfPduOffset=0, FrIfMappedPduId=14, FrIfPduRef=SVC_In
        FrStr_ST_CENG  # ST_CENG
          sn_cf4a41801d9a44e3ad6339c69f3c4e8c_9_6e55c14d93c64aaa86e33b57aac2ae43_9 (FrIfPdusInFrame): FrIfPduOffset=0, FrIfMappedPduId=32, FrIfPduRef=ST_CENG
        FrStr_SVC_3bdac434_In  # SVC
          sn_9dd8c6cee627483a83c881709979081d_77_017541877cab44569267610f7b9dbbd6_78 (FrIfPdusInFrame): FrIfPduOffset=0, FrIfMappedPduId=12, FrIfPduRef=SVC_In
        FrStr_xcpdynamic254_1  # xcpdynamic254_1
          sn_fdeafba7ae254e1e80d60b106053d532_1_7d44d6d889bf437cb0ff888debf8555c_1 (FrIfPdusInFrame): FrIfPduOffset=0, FrIfMappedPduId=8, FrIfPduRef=xcpdynamic254_1
      ST_DIAG_OBD_3_DRDY (FrIfPdu)
        FrIfPduDirection
          FrIfTxPdu_ST_DIAG_OBD_3_DRDY (FrIfTxPdu):  # ST_DIAG_OBD_3_DRDY
            FrIfUserTxUL = PDUR
            FrIfConfirm = true
            FrIfCounterLimit = 1
            FrIfImmediate = false
            FrIfNoneMode = false
            FrIfTxPduId = 11
            FrIfTxPduRef = pduTr_ST_DIAG_OBD_3_DRDY_A_FlexRay_pduPort_EPS_A_FlexRay_OUT_7d601c47_052bff33
      12 x FrIfFrameStructure, all with FrIfByteOrder=LITTLE_ENDIAN:
        FrStr_SVC_e64c1db1_In  # SVC
          sn_9dd8c6cee627483a83c881709979081d_77_017541877cab44569267610f7b9dbbd6_78 (FrIfPdusInFrame): FrIfPduOffset=0, FrIfMappedPduId=11, FrIfPduRef=SVC_In
        FrStr_xcpdynamic254_2  # xcpdynamic254_2
          sn_ED55AF29C91C2294E0402EA019874515_1_ED55B6DAA560EF99E0402EA019870214_1 (FrIfPdusInFrame): FrIfPduOffset=0, FrIfMappedPduId=7, FrIfPduRef=xcpdynamic254_2
        FrStr_xcpdynamic254_3  # xcpdynamic254_3
          sn_ED55AF29C91F2294E0402EA019874515_1_ED55CA2D406A1E52E0402EA01987021E_1 (FrIfPdusInFrame): FrIfPduOffset=0, FrIfMappedPduId=6, FrIfPduRef=xcpdynamic254_3
        FrStr_xcpdynamic254_4  # xcpdynamic254_4
          sn_ED55D3C388349965E0402EA019872AD5_1_ED55AF29C92D2294E0402EA019874515_1 (FrIfPdusInFrame): FrIfPduOffset=0, FrIfMappedPduId=5, FrIfPduRef=xcpdynamic254_4
        FrStr_xcpdynamic254_5  # xcpdynamic254_5
          sn_ED55AF29C9332294E0402EA019874515_1_ED55D568B7B1E932E0402EA019874AD0_1 (FrIfPdusInFrame): FrIfPduOffset=0, FrIfMappedPduId=4, FrIfPduRef=xcpdynamic254_5
        FrStr_TL_ECU_TRNSM_FR_32  # TL_ECU_TRNSM_FR_32
          sn_ada9591f59be44a18409d95fca100f53_5_c623861e6a0749cc9d81d43585ea7f81_4 (FrIfPdusInFrame): FrIfPduOffset=0, FrIfMappedPduId=15, FrIfPduRef=TL_ECU_TRNSM_FR_32
        FrStr_xcpdynamic254_6  # xcpdynamic254_6
          sn_ED55D568B7B7E932E0402EA019874AD0_1_ED55DDBF3F3F1652E0402EA01987662B_1 (FrIfPdusInFrame): FrIfPduOffset=0, FrIfMappedPduId=3, FrIfPduRef=xcpdynamic254_6
        FrStr_TL_BRC_FR_32_7c67e8dd_In  # TL_BRC_FR_32
          sn_b89d750f03b54dc591beef3d97af79e1_6_99b35db8d0034c95bddada0c4e168dbd_5 (FrIfPdusInFrame): FrIfPduOffset=0, FrIfMappedPduId=28, FrIfPduRef=TL_BRC_FR_32
        FrStr_xcpdynamic254_7  # xcpdynamic254_7
          sn_ED55EE5E9A7A36A4E0402EA019872B37_1_ED55EF63738BA24EE0402EA019872B3F_1 (FrIfPdusInFrame): FrIfPduOffset=0, FrIfMappedPduId=2, FrIfPduRef=xcpdynamic254_7
        FrStr_xcpdynamic254_8  # xcpdynamic254_8
          sn_ED55EE5E9A8836A4E0402EA019872B37_1_ED55FD352928D633E0402EA019872B44_1 (FrIfPdusInFrame): FrIfPduOffset=0, FrIfMappedPduId=1, FrIfPduRef=xcpdynamic254_8
        FrStr_TL_BRC_FR_32_bb6bdac6_In  # TL_BRC_FR_32
          sn_b89d750f03b54dc591beef3d97af79e1_6_99b35db8d0034c95bddada0c4e168dbd_5 (FrIfPdusInFrame): FrIfPduOffset=0, FrIfMappedPduId=26, FrIfPduRef=TL_BRC_FR_32
        FrStr_SU_CLE_DRDY_DXP_SPEC_ADPT_MOD_DXP_ST_IDLV_COOD_DBE_DXP  # SU_CLE_DRDY_DXP_SPEC_ADPT_MOD_DXP_ST_IDLV_COOD_DBE_DXP
          sn_642c67ac547c477491d482d6f4297c8a_10_04b89dc3c26d4ca08465c4eec950ef56_8 (FrIfPdusInFrame): FrIfPduOffset=0, FrIfMappedPduId=43, FrIfPduRef=SU_CLE_DRDY_DXP
      ACLNY_MASSCNTR (FrIfPdu)
        FrIfPduDirection
          FrIfRxPdu_ACLNY_MASSCNTR (FrIfRxPdu): FrIfUserRxIndicationUL=PDUR, FrIfRxPduId=25, FrIfRxPduRef=pduTr_ACLNY_MASSCNTR_A_FlexRay_pduPort_EPS_A_FlexRay_IN_7d601c47_052bff33  # ACLNY_MASSCNTR
      FrStr_TAR_QTA_STRMOM_DV_TAR_STMOM_DV_ACT (FrIfFrameStructure): FrIfByteOrder=LITTLE_ENDIAN  # TAR_QTA_STRMOM_DV_TAR_STMOM_DV_ACT
        sn_13aa1571427746dfa4ddec6f8fe46d9d_12_d81fd7307a29409f9d9a2c110d5f1a3d_9 (FrIfPdusInFrame): FrIfPduOffset=8, FrIfMappedPduId=37, FrIfPduRef=TAR_STMOM_DV_ACT
        sn_13aa1571427746dfa4ddec6f8fe46d9d_12_2b4b9cfb3a644a13aeec78e06779be78_9 (FrIfPdusInFrame): FrIfPduOffset=0, FrIfMappedPduId=36, FrIfPduRef=TAR_QTA_STRMOM_DV
      TAR_STMOM_DV_ACT (FrIfPdu)
        FrIfPduDirection
          FrIfRxPdu_TAR_STMOM_DV_ACT (FrIfRxPdu): FrIfUserRxIndicationUL=PDUR, FrIfRxPduId=21, FrIfRxPduRef=pduTr_TAR_STMOM_DV_ACT_A_FlexRay_pduPort_EPS_A_FlexRay_IN_7d601c47_052bff33  # TAR_STMOM_DV_ACT
      dummy16bstatic (FrIfPdu)
        FrIfPduDirection
          FrIfTxPdu_dummy16bstatic (FrIfTxPdu):  # dummy16bstatic
            FrIfUserTxUL = XCP
            FrIfConfirm = true
            FrIfCounterLimit = 1
            FrIfImmediate = false
            FrIfNoneMode = false
            FrIfTxPduId = 21
            FrIfTxPduRef = pduTr_dummy16bstatic_A_FlexRay_pduPort_EPS_A_FlexRay_OUT_7d601c47_052bff33
      FrStr_TL_BRC_FR_32_db376f8d_In (FrIfFrameStructure): FrIfByteOrder=LITTLE_ENDIAN  # TL_BRC_FR_32
        sn_b89d750f03b54dc591beef3d97af79e1_6_99b35db8d0034c95bddada0c4e168dbd_5 (FrIfPdusInFrame): FrIfPduOffset=0, FrIfMappedPduId=24, FrIfPduRef=TL_BRC_FR_32
      TAR_ESTP_VIRT_FTAX (FrIfPdu)
        FrIfPduDirection
          FrIfRxPdu_TAR_ESTP_VIRT_FTAX (FrIfRxPdu): FrIfUserRxIndicationUL=PDUR, FrIfRxPduId=23, FrIfRxPduRef=pduTr_TAR_ESTP_VIRT_FTAX_A_FlexRay_pduPort_EPS_A_FlexRay_IN_7d601c47_052bff33  # TAR_ESTP_VIRT_FTAX
      FrStr_xcpstatic_a26fa189_Out (FrIfFrameStructure): FrIfByteOrder=LITTLE_ENDIAN  # xcpstatic
        sn_d6c051138a624b7197665ea502ed9c68_3_9779c0f9609648bfa4441a0865c580a6_3 (FrIfPdusInFrame): FrIfPduOffset=0, FrIfMappedPduId=22, FrIfPduRef=dummy16bstatic
      AVL_FORC_GRD (FrIfPdu)
        FrIfPduDirection
          FrIfTxPdu_AVL_FORC_GRD (FrIfTxPdu):  # AVL_FORC_GRD
            FrIfUserTxUL = PDUR
            FrIfConfirm = false
            FrIfCounterLimit = 1
            FrIfImmediate = false
            FrIfNoneMode = false
            FrIfTxPduId = 20
            FrIfTxPduRef = pduTr_AVL_FORC_GRD_A_FlexRay_pduPort_EPS_A_FlexRay_OUT_7d601c47_052bff33
      FrStr_FZZSTD (FrIfFrameStructure): FrIfByteOrder=LITTLE_ENDIAN  # FZZSTD
        sn_e5dc33323d8e4047bef88bdbfc641fb1_12_47c848be64324d52af177d4eda36b369_12 (FrIfPdusInFrame): FrIfPduOffset=0, FrIfMappedPduId=2, FrIfPduRef=FZZSTD
    FrIfGeneral:
      FrIfAbsTimerIdx = 1
      FrIfAllSlotsSupport = false
      FrIfCancelTransmitSupport = false
      FrIfDevErrorDetect = true
      FrIfDisableLPduSupport = false
      FrIfDisableTransceiverBranchSupport = false
      FrIfEnableTransceiverBranchSupport = false
      FrIfGetClockCorrectionSupport = false
      FrIfGetGetChannelStatusSupport = false
      FrIfGetNmVectorSupport = false
      FrIfGetNumOfStartupFramesSupport = false
      FrIfGetSyncFrameListSupport = false
      FrIfGetTransceiverErrorSupport = false
      FrIfGetWakeupRxStatusSupport = false
      FrIfNumClstSupported = 1
      FrIfNumCtrlSupported = 1
      FrIfReadCCConfigApi = false
      FrIfReconfigLPduSupport = false
      FrIfUnusedBitValue = 0
      FrIfVersionInfoApi = false
      FrIfFrameBufferLength = 254
      FrIfJobConcatenationEnable = false
      FrIfAbortCommunicationDisable = false
      FrIfCounterLimitDisable = false
      FrIfPduDirtyByteUsage = false
      FrIfSchedulingAlgorithm = Default
      FrIfSetWakeupChannelDisable = false
      FrIfSingleChannelAPI = false
      FrIfTxVirtualBufferIndexType = uint8
      FrIfRxVirtualBufferIndexType = uint8
      FrIfWrapperAPIsAsMacro = false
      FrIfUniformUpdateBytePos = false
      FrIfGlobalUniformUpdateBytePos = false
      FrIfFreeOpCallbackSupport = false
      FrIfJobsUseFreeOpCallback = false
      FrIfDualChannelRedundancySupport = false
      FrIfEnablePrepareLpdu = false
      FrIfDelayedTxConfirmationSupport = false
      FrIf3rdPartyDriverSupport = false
      FrIfSuppressProtectedRangeCheck = false
      FrIfRuntimeMeasurementSupport = false
      FrIfSafeBswChecks = true
