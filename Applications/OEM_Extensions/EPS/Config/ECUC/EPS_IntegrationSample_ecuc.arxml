AUTOSAR XML (schema 4-3-0)
package /ActiveEcuC
  module config IntegrationSample: implementation-config-variant=VARIANT-PRE-COMPILE
    CommonPublishedInformation: SwMajorVersion=5, SwMinorVersion=0, SwPatchVersion=3
    IntegrationSampleGeneral:
      IntegrationSample_Enable_PP_DemDatalElementClass_KmStand = true
      IntegrationSample_Enable_PP_DemDataElementClass_ObdMuxFehler = false
      IntegrationSample_Enable_PP_DemDataElementClass_PWF = false
      IntegrationSampleSwitchDcmNotification = true
      IntegrationSampleSwitchGlobalEcuRunState = true
      IntegrationSampleSwitchProvideTestStampDefaults = true
      IntegrationSampleSwitchProvide_ST_CON_VEH = true
      IntegrationSampleSwitchProvide_PRTNT_CON_VEH = false
      IntegrationSampleSwitchSimpleTimer = true
      IntegrationSample_Number_of_Simple_Timers = 1
      IntegrationSample_EnableServiceInterface = false
      IntegrationSample_EnableSplitVehicleStatus = true
