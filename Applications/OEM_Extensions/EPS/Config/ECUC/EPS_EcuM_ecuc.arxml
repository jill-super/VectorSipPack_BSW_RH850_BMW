AUTOSAR XML (schema 4-3-0)
package /ActiveEcuC
  module config EcuM: implementation-config-variant=VARIANT-PRE-COMPILE, module-description=EcuM_Impl
    EcuMConfiguration
      EcuMFlexConfiguration: EcuMNormalMcuModeRef=McuModeSettingConf
        ECUM_CAUSE_UNKNOWN (EcuMShutdownCause): EcuMShutdownCauseId=0
        ECUM_RESET_IO (EcuMResetMode): EcuMResetModeId=2
        ECUM_RESET_MCU (EcuMResetMode): EcuMResetModeId=0
        ECUM_CAUSE_DCM (EcuMShutdownCause): EcuMShutdownCauseId=3
        ECUM_RESET_WAKEUP (EcuMResetMode): EcuMResetModeId=3
        ECUM_CAUSE_ECU_STATE (EcuMShutdownCause): EcuMShutdownCauseId=1
        ECUM_RESET_WDG (EcuMResetMode): EcuMResetModeId=1
        ECUM_CAUSE_WDGM (EcuMShutdownCause): EcuMShutdownCauseId=2
        ECUM_RESET_PROGRAMMING (EcuMResetMode): EcuMResetModeId=4
        ECUM_RESET_APPLICATIONRESTART (EcuMResetMode): EcuMResetModeId=5
        ECUM_CAUSE_CODING (EcuMShutdownCause): EcuMShutdownCauseId=4
      EcuMCommonConfiguration: EcuMConfigConsistencyHash=5673379598631677133, EcuMDefaultAppMode=OSDEFAULTAPPMODE, EcuMOSResource=OsResource
        4 x EcuMWakeupSource, all with EcuMValidationTimeout=0, EcuMCheckWakeupTimeout=0, EcuMWakeupSourcePolling=false:
          ECUM_WKSOURCE_POWER: EcuMWakeupSourceId=0
          ECUM_WKSOURCE_INTERNAL_WDG: EcuMWakeupSourceId=3
          ECUM_WKSOURCE_INTERNAL_RESET: EcuMWakeupSourceId=2
          ECUM_WKSOURCE_RESET: EcuMWakeupSourceId=1
        EcuMDefaultShutdownTarget: EcuMDefaultState=EcuMStateOff
        ECUM_WKSOURCE_EXTERNAL_WDG (EcuMWakeupSource): EcuMWakeupSourceId=4, EcuMValidationTimeout=0, EcuMCheckWakeupTimeout=0, EcuMWakeupSourcePolling=false
        EcuMDriverInitListOne
          6 x EcuMDriverInitItem:
            Fls_Init: index=0, EcuMModuleID=Fls, EcuMModuleService=Fls_Init, EcuMModuleHeader=Fls.h
            Mcu_Init: index=2, EcuMModuleID=Mcu, EcuMModuleService=Mcu_Init, EcuMModuleHeader=Mcu.h
            Mcu_InitClock_AdditionalCode: index=2, EcuMModuleID=Code, EcuMAdditionalInitCode=Mcu_InitClock(McuConf_McuClockSettingConfig_McuClockSettingConfig), EcuMModuleHeader=Mcu.h
            Mcu_DistributePllClock: index=3, EcuMModuleID=Mcu, EcuMModuleService=Mcu_DistributePllClock, EcuMModuleHeader=Mcu.h
            Port_Init: index=4, EcuMModuleID=Port, EcuMModuleService=Port_Init, EcuMModuleHeader=Port.h
            Wdg_59_DriverA_Init: index=5, EcuMModuleID=Wdg, EcuMModuleService=Wdg_59_DriverA_Init, EcuMModuleHeader=Wdg_59_DriverA.h
        EcuMDriverInitListZero
          16 x EcuMDriverInitItem:
            FrSM_InitMemory: index=0, EcuMModuleID=FrSM, EcuMModuleService=FrSM_InitMemory, EcuMModuleHeader=FrSM.h
            Det_InitMemory: index=1, EcuMModuleID=Det, EcuMModuleService=Det_InitMemory, EcuMModuleHeader=Det.h
            Fr_InitMemory: index=3, EcuMModuleID=Fr, EcuMModuleService=Fr_InitMemory, EcuMModuleHeader=Fr.h
            PduR_InitMemory: index=4, EcuMModuleID=PduR, EcuMModuleService=PduR_InitMemory, EcuMModuleHeader=PduR.h
            FrIf_InitMemory: index=6, EcuMModuleID=FrIf, EcuMModuleService=FrIf_InitMemory, EcuMModuleHeader=FrIf.h
            Com_InitMemory: index=7, EcuMModuleID=Com, EcuMModuleService=Com_InitMemory, EcuMModuleHeader=Com.h
            IpduM_InitMemory: index=8, EcuMModuleID=IpduM, EcuMModuleService=IpduM_InitMemory, EcuMModuleHeader=IpduM.h
            Xcp_InitMemory: index=9, EcuMModuleID=Xcp, EcuMModuleService=Xcp_InitMemory, EcuMModuleHeader=Xcp.h
            BswM_InitMemory: index=10, EcuMModuleID=BswM, EcuMModuleService=BswM_InitMemory, EcuMModuleHeader=BswM.h
            ComM_InitMemory: index=11, EcuMModuleID=ComM, EcuMModuleService=ComM_InitMemory, EcuMModuleHeader=ComM.h
            Rte_InitMemory: index=12, EcuMModuleID=Rte, EcuMModuleService=Rte_InitMemory, EcuMModuleHeader=Rte_Main.h
            FrXcp_InitMemory: index=13, EcuMModuleID=Xcp, EcuMModuleService=FrXcp_InitMemory, EcuMModuleHeader=FrXcp.h
            Dcm_InitMemory: index=14, EcuMModuleID=Dcm, EcuMModuleService=Dcm_InitMemory, EcuMModuleHeader=Dcm.h
            Dem_InitMemory: index=16, EcuMModuleID=Dem, EcuMModuleService=Dem_InitMemory, EcuMModuleHeader=Dem.h
            FrTp_InitMemory: index=17, EcuMModuleID=FrTp, EcuMModuleService=FrTp_InitMemory, EcuMModuleHeader=FrTp.h
            Dem_PreInit: index=18, EcuMModuleID=Dem, EcuMModuleService=Dem_PreInit, EcuMModuleHeader=Dem.h
        EcuMDriverRestartList
    EcuMGeneral:
      EcuMDevErrorDetect = true
      EcuMIncludeDem = false
      EcuMIncludeDet = false
      EcuMMainFunctionPeriod = 0.01
      EcuMVersionInfoApi = false
      EcuMDeferredBswMNotification = true
      EcuMSlaveCoreHandling = true
      EcuMEnableFixBehavior = false
      EcuMGeneration: EcuMOutOfBoundsWriteSanitizer=false, EcuMOutOfBoundsReadSanitizer=false, EcuMInterfacesForDeactivatedData=false
    EcuMFlexGeneral
