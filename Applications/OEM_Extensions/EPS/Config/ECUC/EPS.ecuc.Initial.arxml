[part 3 of 3: package /InitialEcuC]
AUTOSAR XML (schema 4-3-0)
package /InitialEcuC  (continued)
  module config Dem
    DemConfigSet  # Project Standard Configuration
      59 x DemEventParameter, all with DemEventAvailable=true:
        CansmEBusACanOff: DemEventKind=DEM_EVENT_KIND_SWC  # Project Standard Configuration
        CansmEBusB2CanOff: DemEventKind=DEM_EVENT_KIND_SWC  # Project Standard Configuration
        CansmEBusBodyCanOff: DemEventKind=DEM_EVENT_KIND_SWC  # Project Standard Configuration
        CansmEBusFaCanOff: DemEventKind=DEM_EVENT_KIND_SWC  # Project Standard Configuration
        CansmEBusIukCanOff: DemEventKind=DEM_EVENT_KIND_SWC  # Project Standard Configuration
        CansmEBusKCanOff: DemEventKind=DEM_EVENT_KIND_SWC  # Project Standard Configuration
        CansmEBusLeCanOff: DemEventKind=DEM_EVENT_KIND_SWC  # Project Standard Configuration
        CansmEBusLpCanOff: DemEventKind=DEM_EVENT_KIND_SWC  # Project Standard Configuration
        CansmEBusZsgCanOff: DemEventKind=DEM_EVENT_KIND_SWC  # Project Standard Configuration
        CantrcvEBusACanError: DemEventKind=DEM_EVENT_KIND_SWC  # Project Standard Configuration
        CantrcvEBusB2CanError: DemEventKind=DEM_EVENT_KIND_SWC  # Project Standard Configuration
        CantrcvEBusBodyCanError: DemEventKind=DEM_EVENT_KIND_SWC  # Project Standard Configuration
        CantrcvEBusFaCanError: DemEventKind=DEM_EVENT_KIND_SWC  # Project Standard Configuration
        CantrcvEBusIukError: DemEventKind=DEM_EVENT_KIND_SWC  # Project Standard Configuration
        CantrcvEBusKCanError: DemEventKind=DEM_EVENT_KIND_SWC  # Project Standard Configuration
        CantrcvEBusLeCanError: DemEventKind=DEM_EVENT_KIND_SWC  # Project Standard Configuration
        CantrcvEBusLpCanError: DemEventKind=DEM_EVENT_KIND_SWC  # Project Standard Configuration
        CantrcvEBusZsgCanError: DemEventKind=DEM_EVENT_KIND_SWC  # Project Standard Configuration
        CbsReplacementValue: DemEventKind=DEM_EVENT_KIND_SWC  # Project Standard Configuration
        CodingEventInvalidData: DemEventKind=DEM_EVENT_KIND_SWC  # Project Standard Configuration
        CodingEventNotCoded: DemEventKind=DEM_EVENT_KIND_SWC  # Project Standard Configuration
          DemCallbackClearEventAllowed: DemClearEventAllowedBehavior=DEM_NO_STATUS_BYTE_CHANGE  # Project Standard Configuration
        CodingEventSignatureError: DemEventKind=DEM_EVENT_KIND_SWC  # Project Standard Configuration
        CodingEventTransactionFailed: DemEventKind=DEM_EVENT_KIND_SWC  # Project Standard Configuration
        CodingEventUnqualifiedData: DemEventKind=DEM_EVENT_KIND_SWC  # Project Standard Configuration
        CodingEventWrongVehicle: DemEventKind=DEM_EVENT_KIND_SWC  # Project Standard Configuration
        DmTestAppl: DemEventKind=DEM_EVENT_KIND_SWC  # Project Standard Configuration
        DmTestCom: DemEventKind=DEM_EVENT_KIND_SWC  # Project Standard Configuration
        Dtc{000030..000034}: DemEventKind=DEM_EVENT_KIND_SWC  # Project Standard Configuration
        DtcCd0601: DemEventKind=DEM_EVENT_KIND_SWC  # Project Standard Configuration
        DtcCd{0605..0607}: DemEventKind=DEM_EVENT_KIND_SWC  # Project Standard Configuration
        EthSignalQualityLow: DemEventKind=DEM_EVENT_KIND_SWC  # Project Standard Configuration
        FrifEAcsChA: DemEventKind=DEM_EVENT_KIND_SWC  # Project Standard Configuration
        FrifENitChA: DemEventKind=DEM_EVENT_KIND_SWC  # Project Standard Configuration
        FrsmEClusterStartup: DemEventKind=DEM_EVENT_KIND_SWC  # Project Standard Configuration
        FrsmEClusterSyncLoss: DemEventKind=DEM_EVENT_KIND_SWC  # Project Standard Configuration
        FrtrcvEFrBuserrorTrcv0: DemEventKind=DEM_EVENT_KIND_SWC  # Project Standard Configuration
        FrtrcvEFrErrnTrcv{0..7}: DemEventKind=DEM_EVENT_KIND_SWC  # Project Standard Configuration
        LIN_E_TIMEOUT: DemEventKind=DEM_EVENT_KIND_BSW  # Project Standard Configuration
        NVM_E_HARDWARE: DemEventKind=DEM_EVENT_KIND_BSW  # Project Standard Configuration
        Overvoltage: DemEventKind=DEM_EVENT_KIND_SWC  # Project Standard Configuration
        PiaEIoError: DemEventKind=DEM_EVENT_KIND_SWC  # Project Standard Configuration
        SwtExternalCheckFailure: DemEventKind=DEM_EVENT_KIND_SWC  # Project Standard Configuration
        SwtInternalCheckFailure: DemEventKind=DEM_EVENT_KIND_SWC  # Project Standard Configuration
        UDPNM_E_TCPIP_TRANSMIT_ERROR: DemEventKind=DEM_EVENT_KIND_BSW  # Project Standard Configuration
        Undervoltage: DemEventKind=DEM_EVENT_KIND_SWC  # Project Standard Configuration
        VsmEventOpmode: DemEventKind=DEM_EVENT_KIND_SWC  # Project Standard Configuration
          DemCallbackClearEventAllowed: DemClearEventAllowedBehavior=DEM_NO_STATUS_BYTE_CHANGE  # Project Standard Configuration
    DemGeneral:  # Project Standard Configuration
      DemAgingCycleCounterProcessing = DEM_PROCESS_AGINGCTR_INTERN
      DemAgingRequieresTestedCycle = true
      DemClearDTCBehavior = DEM_CLRRESP_NONVOLATILE_FINISH
      DemClearDTCLimitation = DEM_ALL_SUPPORTED_DTCS
      DemDataElementDefaultEndianness = BIG_ENDIAN
      DemEventDisplacementStrategy = DEM_DISPLACEMENT_FULL
      DemEventMemoryEntryStorageTrigger = DEM_TRIGGER_ON_TEST_FAILED
      DemOccurrenceCounterProcessing = DEM_PROCESS_OCCCTR_TF
      DemOperationCycleStatusStorage = true
      DemPTOSupport = false
      DemResetConfirmedBitOnOverflow = true
      DemStatusBitHandlingTestFailedSinceLastClear = DEM_STATUS_BIT_AGING_AND_DISPLACEMENT
      DemStatusBitStorageTestFailed = true
      DemTriggerMonitorInitBeforeClearOk = true
      DemTypeOfDTCSupported = DEM_DTC_TRANSLATION_ISO14229_1
      DemTypeOfFreezeFrameRecordNumeration = DEM_FF_RECNUM_CALCULATED
      18 x DemDataElementClass:
        DemDataElementClass_ConditionByte  # Project Standard Configuration
          DemInternalDataElementClass_ConditionByte (DemInternalDataElementClass): DemDataElementDataSize=1, DemInternalDataElement=DEM_OVFLIND  # Project Standard Configuration
        DemDataElementClass_DuplicateIpAddress  # Project Standard Configuration
        DemDataElementClass_EthArpDiscardType  # Project Standard Configuration
        DemDataElementClass_EthDiscardedArpEntry  # Project Standard Configuration
        DemDataElementClass_EthDroppedFrameStatus  # Project Standard Configuration
        DemDataElementClass_EthSourceMacOfDuplicateIpAddress  # Project Standard Configuration
          DemExternalCSDataElementClass_EthSourceMacOfDuplicateIpAddress (DemExternalCSDataElementClass): DemDataElementDataSize=6  # Project Standard Configuration
        DemDataElementClass_FUwBn  # Project Standard Configuration
        DemDataElementClass_FUwTn  # Project Standard Configuration
          DemExternalCSDataElementClass_FUwTn (DemExternalCSDataElementClass): DemDataElementDataSize=3  # Project Standard Configuration
        DemDataElementClass_FileManipulated  # Project Standard Configuration
          DemExternalCSDataElementClass_FileManipulated (DemExternalCSDataElementClass): DemDataElementDataSize=18  # Project Standard Configuration
        DemDataElementClass_HealingCounter  # Project Standard Configuration
          DemInternalDataElementClass_HealingCounter (DemInternalDataElementClass): DemDataElementDataSize=1, DemInternalDataElement=DEM_AGINGCTR_UPCNT  # Project Standard Configuration
        DemDataElementClass_KmStand  # Project Standard Configuration
          DemExternalCSDataElementClass_KmStand (DemExternalCSDataElementClass): DemDataElementDataSize=3, DemDataElementUsePort=true  # Project Standard Configuration
        DemDataElementClass_OccurrenceCounter  # Project Standard Configuration
          DemInternalDataElementClass_OccurrenceCounter (DemInternalDataElementClass): DemDataElementDataSize=1, DemInternalDataElement=DEM_OCCCTR  # Project Standard Configuration
        DemDataElementClass_Port0CrcErrorCount  # Project Standard Configuration
        DemDataElementClass_Port0LowSignalQualityStatus  # Project Standard Configuration
          DemExternalCSDataElementClass_Port0LowSignalQualityStatus (DemExternalCSDataElementClass): DemDataElementDataSize=1  # Project Standard Configuration
        DemDataElementClass_SwtFehlerwert  # Project Standard Configuration
          DemExternalSRDataElementClass_SwtFehlerwert (DemExternalSRDataElementClass): DemDataElementDataSize=8, DemDataElementDataType=UINT8  # Project Standard Configuration
        DemDataElementClass_SwtSwid  # Project Standard Configuration
          DemExternalCSDataElementClass_SwtSwid (DemExternalCSDataElementClass): DemDataElementDataSize=4, DemDataElementUsePort=true  # Project Standard Configuration
        DemDataElementClass_SwtVin  # Project Standard Configuration
          DemExternalCSDataElementClass_SwtVin (DemExternalCSDataElementClass): DemDataElementDataSize=7  # Project Standard Configuration
        DemDataElementClass_Systemzeit  # Project Standard Configuration
          DemExternalCSDataElementClass_Systemzeit (DemExternalCSDataElementClass): DemDataElementDataSize=4, DemDataElementUsePort=true  # Project Standard Configuration
      15 x DemDidClass:
        DemDidClass_DuplicateIpAddress: DemDidIdentifier=6080, DemDidDataElementClassRef=DemDataElementClass_DuplicateIpAddress  # Project Standard Configuration
        DemDidClass_EthArpDiscardType: DemDidIdentifier=5983, DemDidDataElementClassRef=DemDataElementClass_EthArpDiscardType  # Project Standard Configuration
        DemDidClass_EthDiscardedArpEntry: DemDidIdentifier=5982, DemDidDataElementClassRef=DemDataElementClass_EthDiscardedArpEntry  # Project Standard Configuration
        DemDidClass_EthDroppedFrameStatus: DemDidIdentifier=5981, DemDidDataElementClassRef=DemDataElementClass_EthDroppedFrameStatus  # Project Standard Configuration
        DemDidClass_EthSourceMacOfDuplicateIpAddress: DemDidIdentifier=6081, DemDidDataElementClassRef=DemDataElementClass_EthSourceMacOfDuplicateIpAddress  # Project Standard Configuration
        DemDidClass_FUwBn: DemDidIdentifier=5968, DemDidDataElementClassRef=DemDataElementClass_FUwBn  # Project Standard Configuration
        DemDidClass_FUwTn: DemDidIdentifier=5969, DemDidDataElementClassRef=DemDataElementClass_FUwTn  # Project Standard Configuration
        DemDidClass_FileManipulated: DemDidIdentifier=5985, DemDidDataElementClassRef=DemDataElementClass_FileManipulated  # Project Standard Configuration
        DemDidClass_KmStand: DemDidIdentifier=5888, DemDidDataElementClassRef=DemDataElementClass_KmStand  # Project Standard Configuration
        DemDidClass_Port0CrcErrorCount: DemDidIdentifier=5971, DemDidDataElementClassRef=DemDataElementClass_Port0CrcErrorCount  # Project Standard Configuration
        DemDidClass_Port0LowSignalQualityStatus: DemDidIdentifier=5974, DemDidDataElementClassRef=DemDataElementClass_Port0LowSignalQualityStatus  # Project Standard Configuration
        DemDidClass_SwtFehlerwert: DemDidIdentifier=5954, DemDidDataElementClassRef=DemDataElementClass_SwtFehlerwert  # Project Standard Configuration
        DemDidClass_SwtSwid: DemDidIdentifier=5956, DemDidDataElementClassRef=DemDataElementClass_SwtSwid  # Project Standard Configuration
        DemDidClass_SwtVin: DemDidIdentifier=5955, DemDidDataElementClassRef=DemDataElementClass_SwtVin  # Project Standard Configuration
        DemDidClass_Systemzeit: DemDidIdentifier=5889, DemDidDataElementClassRef=DemDataElementClass_Systemzeit  # Project Standard Configuration
      3 x DemEnableCondition, all with DemEnableConditionStatus=true:
        DemEnableCondition_Omc  # Project Standard Configuration
        DemEnableCondition_StdDiag  # Project Standard Configuration
        DemEnableCondition_Stm  # Project Standard Configuration
      3 x DemEnableConditionGroup, all with DemEnableConditionRef=DemEnableCondition_StdDiag:
        DEM_CONDITION_GROUP_ComErrorLock: DemEnableConditionRef=DemEnableCondition_Stm  # Project Standard Configuration
        DEM_CONDITION_GROUP_ComErrorLockFlAsTr: DemEnableConditionRef=DemEnableCondition_Omc, DemEnableConditionRef=DemEnableCondition_Stm  # Project Standard Configuration
        DEM_CONDITION_GROUP_DefaultErrorLock  # Project Standard Configuration
      DemExtendedDataClass_Healing (DemExtendedDataClass):  # Project Standard Configuration
        DemExtendedDataRecordClassRef = DemExtendedDataRecordClass_OccurrenceCounter
        DemExtendedDataRecordClassRef = DemExtendedDataRecordClass_HealingCounter
        DemExtendedDataRecordClassRef = DemExtendedDataRecordClass_ConditionByte
      DemExtendedDataClass_NoHealing (DemExtendedDataClass):  # Project Standard Configuration
        DemExtendedDataRecordClassRef = DemExtendedDataRecordClass_ConditionByte
        DemExtendedDataRecordClassRef = DemExtendedDataRecordClass_OccurrenceCounter
      3 x DemExtendedDataRecordClass, all with DemExtendedDataRecordUpdate=DEM_UPDATE_RECORD_YES:
        DemExtendedDataRecordClass_ConditionByte: DemExtendedDataRecordNumber=1, DemDataElementClassRef=DemDataElementClass_ConditionByte  # Project Standard Configuration
        DemExtendedDataRecordClass_HealingCounter: DemExtendedDataRecordNumber=3, DemDataElementClassRef=DemDataElementClass_HealingCounter  # Project Standard Configuration
        DemExtendedDataRecordClass_OccurrenceCounter: DemExtendedDataRecordNumber=2, DemDataElementClassRef=DemDataElementClass_OccurrenceCounter  # Project Standard Configuration
      9 x DemFreezeFrameClass, all with DemDidClassRef=DemDidClass_FUwBn, DemDidClassRef=DemDidClass_FUwTn, DemDidClassRef=DemDidClass_KmStand, DemDidClassRef=DemDidClass_Systemzeit:
        DemFreezeFrameClass_711871ef  # Project Standard Configuration
        DemFreezeFrameClass_7febc690: DemDidClassRef=DemDidClass_DuplicateIpAddress, DemDidClassRef=DemDidClass_EthSourceMacOfDuplicateIpAddress  # Project Standard Configuration
        DemFreezeFrameClass_8ef63883: DemDidClassRef=DemDidClass_SwtFehlerwert  # Project Standard Configuration
        DemFreezeFrameClass_95fb4a10: DemDidClassRef=DemDidClass_EthArpDiscardType, DemDidClassRef=DemDidClass_EthDiscardedArpEntry  # Project Standard Configuration
        DemFreezeFrameClass_9ec24f64: DemDidClassRef=DemDidClass_SwtFehlerwert, DemDidClassRef=DemDidClass_SwtSwid, DemDidClassRef=DemDidClass_SwtVin  # Project Standard Configuration
        DemFreezeFrameClass_ebef819c: DemDidClassRef=DemDidClass_Port0CrcErrorCount  # Project Standard Configuration
        DemFreezeFrameClass_ebef819f: DemDidClassRef=DemDidClass_Port0LowSignalQualityStatus  # Project Standard Configuration
        DemFreezeFrameClass_ebef81bb: DemDidClassRef=DemDidClass_EthDroppedFrameStatus  # Project Standard Configuration
        DemFreezeFrameClass_ebef81bf: DemDidClassRef=DemDidClass_FileManipulated  # Project Standard Configuration
      NON_OBD (DemOperationCycle): DemOperationCycleType=DEM_OPCYC_POWER  # Project Standard Configuration
  module config EcuC
    EcucPduCollection: PduIdTypeEnum=UINT8, PduLengthTypeEnum=UINT8
      59 x Pdu:
        ANFRAGE_434514f6_In: PduLength=8
        ANFRAGE_434514f6_Out: PduLength=8
        SVC_434514f6_In: PduLength=8, SysTPduToFrameMappingRef=sn_9dd8c6cee627483a83c881709979081d_77_017541877cab44569267610f7b9dbbd6_78
        SVC_434514f6_Out: PduLength=8, SysTPduToFrameMappingRef=sn_9dd8c6cee627483a83c881709979081d_77_017541877cab44569267610f7b9dbbd6_78
        pduTr_ACLNY_MASSCNTR_A_FlexRay_pduPort_EPS_A_FlexRay_IN_7d601c47_052bff33: PduLength=6, SysTPduToFrameMappingRef=sn_5d864f4a266e40639fe6abc57cceb758_17_060886cf9e88403f9df14c319aa0ae95_20  # ACLNY_MASSCNTR
        pduTr_AVL_FORC_GRD_A_FlexRay_pduPort_EPS_A_FlexRay_OUT_7d601c47_052bff33: PduLength=5, SysTPduToFrameMappingRef=sn_742c7ae2ecf94fc080e798e25ca70247_16_09e4bde6148d45f99746b23c44ef9b67_14  # AVL_FORC_GRD
        pduTr_AVL_PO_EPS_A_FlexRay_pduPort_EPS_A_FlexRay_OUT_7d601c47_052bff33: PduLength=8, SysTPduToFrameMappingRef=sn_0b01e810a8bf4aa3b3ead1e4c09f2b68_4_e0f63d36315c4773ba837e73d6faaadd_15  # AVL_PO_EPS
        pduTr_AVL_RPM_WHL_A_FlexRay_pduPort_EPS_A_FlexRay_IN_7d601c47_052bff33: PduLength=12, SysTPduToFrameMappingRef=sn_708b545e63774a48974a2e012c342c56_18_ca307c7178fd4cb8b1f0845b9598b7e4_18  # AVL_RPM_WHL
        pduTr_AVL_STMOM_DV_ACT_A_FlexRay_pduPort_EPS_A_FlexRay_OUT_7d601c47_052bff33: PduLength=4, SysTPduToFrameMappingRef=sn_742c7ae2ecf94fc080e798e25ca70247_16_1edf400c871b41dab29d318a6fc3ec64_13  # AVL_STMOM_DV_ACT
        pduTr_A_TEMP_A_FlexRay_pduPort_EPS_A_FlexRay_IN_7d601c47_052bff33: PduLength=2, SysTPduToFrameMappingRef=sn_ffb3893c37a446b6bb48321cc292082f_18_d0ea1fc2c1ca4e2295bae82b1e156e9a_18  # A_TEMP
        pduTr_CON_VEH_A_FlexRay_pduPort_EPS_A_FlexRay_IN_7d601c47_052bff33: PduLength=8, SysTPduToFrameMappingRef=sn_a07de7dfbad342e18d0517336a8ccb12_11_f39dc9b4f18c4462a3ca3222d270f882_11  # CON_VEH
        pduTr_CTR_DIAG_OBD_DRDY_A_FlexRay_pduPort_EPS_A_FlexRay_IN_7d601c47_052bff33: PduLength=2, SysTPduToFrameMappingRef=sn_62b9b444be3144e4afdbe2e8f65ae37b_4_eb2aaf9fde954786857e30879fbebab8_4  # CTR_DIAG_OBD_DRDY
        pduTr_CTR_VIB_STW_DISP_EXMI_SP2015_A_FlexRay_pduPort_EPS_A_FlexRay_IN_7d601c47_052bff33: PduLength=8, SysTPduToFrameMappingRef=sn_6d8a461ff30049dfbb2df9138651c35b_3_8e1fc510f7a3427998068160382540c0_4  # CTR_VIB_STW_DISP_EXMI_SP2015
        pduTr_DBG_EPS_BS_MOD_58_BYTE_A_FlexRay_pduPort_EPS_A_FlexRay_OUT_7d601c47_052bff33: PduLength=58  # DBG_EPS_BS_MOD_58_BYTE
        pduTr_DBG_EPS_MOD_EXT_120_BYTE_A_FlexRay_pduPort_EPS_A_FlexRay_OUT_7d601c47_052bff33: PduLength=58  # DBG_EPS_MOD_EXT_120_BYTE
        pduTr_DIAG_OBD_ENG_A_FlexRay_pduPort_EPS_A_FlexRay_IN_7d601c47_052bff33: PduLength=7, SysTPduToFrameMappingRef=sn_f26c29b5554146b48da2e76fdc87f59b_13_d8833aa6063240d791b5384f59f75d9a_13  # DIAG_OBD_ENG
        pduTr_DISP_CC_EPS_A_FlexRay_pduPort_EPS_A_FlexRay_OUT_7d601c47_052bff33: PduLength=5, SysTPduToFrameMappingRef=sn_bbacfb13291a4ee286c905592a1bb973_2_39a2ac19c7164f0385b879ca14e85e7b_2  # DISP_CC_EPS
        pduTr_DT_EST_A_FlexRay_pduPort_EPS_A_FlexRay_OUT_7d601c47_052bff33: PduLength=16, SysTPduToFrameMappingRef=sn_47f7335f9e884cfebf3cf85a43b03f09_9_f1c2ea448b5742e6a930415b5321c120_9  # DT_EST
        pduTr_ENERG_DGR_DRDY_A_FlexRay_pduPort_EPS_A_FlexRay_IN_7d601c47_052bff33: PduLength=8, SysTPduToFrameMappingRef=sn_a8f1d204f2ad40669d1acf24a5cd893e_8_39c3f0eb640a4f78a081a30d189b0df4_8  # ENERG_DGR_DRDY
        pduTr_ENGTORQ_EPS_A_FlexRay_pduPort_EPS_A_FlexRay_OUT_7d601c47_052bff33: PduLength=8, SysTPduToFrameMappingRef=sn_0b01e810a8bf4aa3b3ead1e4c09f2b68_4_0c0ed9ed2c324b648cea19ccfdcf4017_2  # ENGTORQ_EPS
        pduTr_ENSU_SFY_A_FlexRay_pduPort_EPS_A_FlexRay_IN_7d601c47_052bff33: PduLength=8, SysTPduToFrameMappingRef=sn_34b57a760af141aaa6b7f792f94a53b8_2_4145eaff72594a8e9989935517b189e9_2  # ENSU_SFY
        pduTr_ERRM_BN_U_A_FlexRay_pduPort_EPS_A_FlexRay_IN_7d601c47_052bff33: PduLength=2, SysTPduToFrameMappingRef=sn_8e8d5ba824d24f699ca284a4f92ea5fd_4_677e18af96434b57a7947ca5849af5e4_4  # ERRM_BN_U
        pduTr_FAHRGESTELLNUMMER_A_FlexRay_pduPort_EPS_A_FlexRay_IN_7d601c47_052bff33: PduLength=7, SysTPduToFrameMappingRef=sn_1e39d529353949ad94ad72cd99e0239e_13_9007d271e9154737bbd9f3c54ab3098b_12  # FAHRGESTELLNUMMER
        pduTr_FR_DBG_EPS_A_FlexRay_pduPort_EPS_A_FlexRay_OUT_7d601c47_052bff33: PduLength=58, SysTPduToFrameMappingRef=sn_6b68fdbc63d54758bff55913fcd344ba_5_43f7a9daf64d4ee7b94a0fd106743903_5  # FR_DBG_EPS
        pduTr_FZZSTD_A_FlexRay_pduPort_EPS_A_FlexRay_IN_7d601c47_052bff33: PduLength=8, SysTPduToFrameMappingRef=sn_e5dc33323d8e4047bef88bdbfc641fb1_12_47c848be64324d52af177d4eda36b369_12  # FZZSTD
        pduTr_KILOMETERSTAND_A_FlexRay_pduPort_EPS_A_FlexRay_IN_7d601c47_052bff33: PduLength=8, SysTPduToFrameMappingRef=sn_23b23ec8e79d4821a4fd4f71addacbb8_10_209e4b614ee044c4bbf1020e8ad2a6e0_10  # KILOMETERSTAND
        pduTr_OFFS_QUAD_EPS_A_FlexRay_pduPort_EPS_A_FlexRay_IN_7d601c47_052bff33: PduLength=5, SysTPduToFrameMappingRef=sn_4b75d7aade684404a40181123f5e091e_13_2538d099b88d4657ae03c10c9544a047_14  # OFFS_QUAD_EPS
        pduTr_RELATIVZEIT_A_FlexRay_pduPort_EPS_A_FlexRay_IN_7d601c47_052bff33: PduLength=6, SysTPduToFrameMappingRef=sn_ccc09e8b2c1e432a8f2a272e558c8566_3_acb3c9a426bf4887ba724efd428ad5a4_3  # RELATIVZEIT
        pduTr_RQ_STG_EFAN_A_FlexRay_pduPort_EPS_A_FlexRay_OUT_7d601c47_052bff33: PduLength=8  # RQ_STG_EFAN
        pduTr_SECU_CHAL_A_FlexRay_pduPort_EPS_A_FlexRay_OUT_7d601c47_052bff33: PduLength=8  # SECU_CHAL
        pduTr_SECU_FAHRGESTELLNUMMER_A_FlexRay_pduPort_EPS_A_FlexRay_IN_7d601c47_052bff33: PduLength=8, SysTPduToFrameMappingRef=sn_45fe7c1444bb44a182e3c698da50983a_3_ff5ad01b69a64f2fa3482d8ab369f18a_3  # SECU_FAHRGESTELLNUMMER
        pduTr_SECU_RESP_A_FlexRay_pduPort_EPS_A_FlexRay_IN_7d601c47_052bff33: PduLength=8  # SECU_RESP
        pduTr_STEA_OFFS_A_FlexRay_pduPort_EPS_A_FlexRay_IN_7d601c47_052bff33: PduLength=8, SysTPduToFrameMappingRef=sn_58cceca224fe40fc80675725acb2e3e1_11_55e086fa3cb3405c9e0849033f661450_11  # STEA_OFFS
        pduTr_ST_CENG_A_FlexRay_pduPort_EPS_A_FlexRay_IN_7d601c47_052bff33: PduLength=8, SysTPduToFrameMappingRef=sn_cf4a41801d9a44e3ad6339c69f3c4e8c_9_6e55c14d93c64aaa86e33b57aac2ae43_9  # ST_CENG
        pduTr_ST_DIAG_OBD_3_DRDY_A_FlexRay_pduPort_EPS_A_FlexRay_OUT_7d601c47_052bff33: PduLength=8, SysTPduToFrameMappingRef=sn_f1b37dec817945749ac7e14f80df159d_4_95dff1578f214757b23c8394af12aa48_4  # ST_DIAG_OBD_3_DRDY
        pduTr_ST_ENERG_GEN_A_FlexRay_pduPort_EPS_A_FlexRay_IN_7d601c47_052bff33: PduLength=8, SysTPduToFrameMappingRef=sn_efdccab807464c4ab076173048647d90_15_085b67cff4b142a59fb46d892b9938f0_15  # ST_ENERG_GEN
        pduTr_ST_EST_A_FlexRay_pduPort_EPS_A_FlexRay_OUT_7d601c47_052bff33: PduLength=5, SysTPduToFrameMappingRef=sn_2f3b1c2990d8434f9d60c8bc0223380a_14_0d521c7c53964f869478fa5c12f4ec50_14  # ST_EST
        pduTr_ST_STAB_DSC_A_FlexRay_pduPort_EPS_A_FlexRay_IN_7d601c47_052bff33: PduLength=8, SysTPduToFrameMappingRef=sn_2c6859f532c740fd851c07438c6639fd_20_3e35ac63fc494d0fb399c763aeb7057b_24  # ST_STAB_DSC
        pduTr_SU_CLE_DRDY_DXP_A_FlexRay_pduPort_EPS_A_FlexRay_IN_7d601c47_052bff33: PduLength=8, SysTPduToFrameMappingRef=sn_642c67ac547c477491d482d6f4297c8a_10_04b89dc3c26d4ca08465c4eec950ef56_8  # SU_CLE_DRDY_DXP
        pduTr_SU_EPS_A_FlexRay_pduPort_EPS_A_FlexRay_OUT_7d601c47_052bff33: PduLength=8, SysTPduToFrameMappingRef=sn_c217e50a54da493a879e8e4514e8c562_4_ecced8165aea4835a2a17dc224344598_4  # SU_EPS
        pduTr_TAR_ESTP_VIRT_FTAX_A_FlexRay_pduPort_EPS_A_FlexRay_IN_7d601c47_052bff33: PduLength=8, SysTPduToFrameMappingRef=sn_d9f1ff037ed147f1bcd2f969afda82c4_5_12963b5f55914150b9f8aacada47bf44_5  # TAR_ESTP_VIRT_FTAX
        pduTr_TAR_QTA_STRMOM_DV_A_FlexRay_pduPort_EPS_A_FlexRay_IN_7d601c47_052bff33: PduLength=8, SysTPduToFrameMappingRef=sn_13aa1571427746dfa4ddec6f8fe46d9d_12_2b4b9cfb3a644a13aeec78e06779be78_9  # TAR_QTA_STRMOM_DV
        pduTr_TAR_STMOM_DV_ACT_A_FlexRay_pduPort_EPS_A_FlexRay_IN_7d601c47_052bff33: PduLength=8, SysTPduToFrameMappingRef=sn_13aa1571427746dfa4ddec6f8fe46d9d_12_d81fd7307a29409f9d9a2c110d5f1a3d_9  # TAR_STMOM_DV_ACT
        pduTr_TL_BRC_FR_32_A_FlexRay_pduPort_EPS_A_FlexRay_IN_7d601c47_052bff33: PduLength=32, SysTPduToFrameMappingRef=sn_b89d750f03b54dc591beef3d97af79e1_6_99b35db8d0034c95bddada0c4e168dbd_5  # TL_BRC_FR_32
        pduTr_TL_ECU_TRNSM_FR_32_A_FlexRay_pduPort_EPS_A_FlexRay_OUT_7d601c47_052bff33: PduLength=32, SysTPduToFrameMappingRef=sn_ada9591f59be44a18409d95fca100f53_5_c623861e6a0749cc9d81d43585ea7f81_4  # TL_ECU_TRNSM_FR_32
        pduTr_TL_MST_GW_TRNSM_FR_254_A_FlexRay_pduPort_EPS_A_FlexRay_IN_7d601c47_052bff33: PduLength=254, SysTPduToFrameMappingRef=sn_d187a29661e448debbfa1c1db2495add_2_161ebe01a13246f5bc130ce6f196d980_1  # TL_MST_GW_TRNSM_FR_254
        pduTr_VYAW_VEH_A_FlexRay_pduPort_EPS_A_FlexRay_IN_7d601c47_052bff33: PduLength=6, SysTPduToFrameMappingRef=sn_1a6c54ef470342899c8af77346d5f01c_20_27f7c756a0e24349b8e230b415458184_21  # VYAW_VEH
        pduTr_V_VEH_A_FlexRay_pduPort_EPS_A_FlexRay_IN_7d601c47_052bff33: PduLength=5, SysTPduToFrameMappingRef=sn_2891826c350d482582f167e1fc0f401f_10_af83ce37179a45aca7ac57646532416b_18  # V_VEH
        pduTr_dummy16bstatic_A_FlexRay_pduPort_EPS_A_FlexRay_OUT_7d601c47_052bff33: PduLength=16, SysTPduToFrameMappingRef=sn_d6c051138a624b7197665ea502ed9c68_3_9779c0f9609648bfa4441a0865c580a6_3  # dummy16bstatic
        pduTr_dummy32bmaster_A_FlexRay_pduPort_EPS_A_FlexRay_IN_7d601c47_052bff33: PduLength=32, SysTPduToFrameMappingRef=sn_6acd24342b914dee85c6ec4bb84bea56_4_2e91d703d77a465ba5c92f45777cf2d1_4  # dummy32bmaster
        pduTr_dummy32bslave_A_FlexRay_pduPort_EPS_A_FlexRay_OUT_7d601c47_052bff33: PduLength=32, SysTPduToFrameMappingRef=sn_2ed003fa08904453b0dfb985d50da316_4_039aef2810e44f2c9248813621a8312e_4  # dummy32bslave
        pduTr_xcpdynamic254_1_A_FlexRay_pduPort_EPS_A_FlexRay_OUT_7d601c47_052bff33: PduLength=254, SysTPduToFrameMappingRef=sn_fdeafba7ae254e1e80d60b106053d532_1_7d44d6d889bf437cb0ff888debf8555c_1  # xcpdynamic254_1
        pduTr_xcpdynamic254_2_A_FlexRay_pduPort_EPS_A_FlexRay_OUT_7d601c47_052bff33: PduLength=254, SysTPduToFrameMappingRef=sn_ED55AF29C91C2294E0402EA019874515_1_ED55B6DAA560EF99E0402EA019870214_1  # xcpdynamic254_2
        pduTr_xcpdynamic254_3_A_FlexRay_pduPort_EPS_A_FlexRay_OUT_7d601c47_052bff33: PduLength=254, SysTPduToFrameMappingRef=sn_ED55AF29C91F2294E0402EA019874515_1_ED55CA2D406A1E52E0402EA01987021E_1  # xcpdynamic254_3
        pduTr_xcpdynamic254_4_A_FlexRay_pduPort_EPS_A_FlexRay_OUT_7d601c47_052bff33: PduLength=254, SysTPduToFrameMappingRef=sn_ED55D3C388349965E0402EA019872AD5_1_ED55AF29C92D2294E0402EA019874515_1  # xcpdynamic254_4
        pduTr_xcpdynamic254_5_A_FlexRay_pduPort_EPS_A_FlexRay_OUT_7d601c47_052bff33: PduLength=254, SysTPduToFrameMappingRef=sn_ED55AF29C9332294E0402EA019874515_1_ED55D568B7B1E932E0402EA019874AD0_1  # xcpdynamic254_5
        pduTr_xcpdynamic254_6_A_FlexRay_pduPort_EPS_A_FlexRay_OUT_7d601c47_052bff33: PduLength=254, SysTPduToFrameMappingRef=sn_ED55D568B7B7E932E0402EA019874AD0_1_ED55DDBF3F3F1652E0402EA01987662B_1  # xcpdynamic254_6
        pduTr_xcpdynamic254_7_A_FlexRay_pduPort_EPS_A_FlexRay_OUT_7d601c47_052bff33: PduLength=254, SysTPduToFrameMappingRef=sn_ED55EE5E9A7A36A4E0402EA019872B37_1_ED55EF63738BA24EE0402EA019872B3F_1  # xcpdynamic254_7
        pduTr_xcpdynamic254_8_A_FlexRay_pduPort_EPS_A_FlexRay_OUT_7d601c47_052bff33: PduLength=254, SysTPduToFrameMappingRef=sn_ED55EE5E9A8836A4E0402EA019872B37_1_ED55FD352928D633E0402EA019872B44_1  # xcpdynamic254_8
  module config Fr
    FrGeneral
    FrMultipleConfiguration
      contr_EPS_A_FlexRay (FrController):
        FrPAllowHaltDueToClock = true
        FrPAllowPassiveToActive = 0
        FrPChannels = FR_CHANNEL_A
        FrPClusterDriftDamping = 2
        FrPDecodingCorrection = 48
        FrPDelayCompensationA = 1
        FrPDelayCompensationB = 1
        FrPKeySlotId = 0
        FrPKeySlotOnlyEnabled = false
        FrPKeySlotUsedForStartup = false
        FrPKeySlotUsedForSync = false
        FrPLatestTx = 269
        FrPMacroInitialOffsetA = 3
        FrPMacroInitialOffsetB = 3
        FrPMicroInitialOffsetA = 6
        FrPMicroInitialOffsetB = 6
        FrPMicroPerCycle = 200000
        FrPOffsetCorrectionOut = 126
        FrPOffsetCorrectionStart = 3632
        FrPPayloadLengthDynMax = 60
        FrPRateCorrectionOut = 121
        FrPSamplesPerMicrotick = N2SAMPLES
        FrPWakeupChannel = FR_CHANNEL_A
        FrPWakeupPattern = 33
        FrPdAcceptedStartupRange = 212
        FrPdListenTimeout = 400242
        FrPdMicrotick = T25NS
  module config FrIf
    FrIfConfig
      A_FlexRay (FrIfCluster):
        FrIfDetectNITError = false
        FrIfGChannels = FR_CHANNEL_A
        FrIfGColdStartAttempts = 8
        FrIfGCycleCountMax = 63
        FrIfGListenNoise = 2
        FrIfGMacroPerCycle = 3636
        FrIfGMaxWithoutClockCorrectFatal = 2
        FrIfGMaxWithoutClockCorrectPassive = 2
        FrIfGNetworkManagementVectorLength = 0
        FrIfGNumberOfMinislots = 289
        FrIfGNumberOfStaticSlots = 91
        FrIfGPayloadLengthStatic = 8
        FrIfGSyncFrameIDCountMax = 15
        FrIfGdActionPointOffset = 2
        FrIfGdBit = T100NS
        FrIfGdCasRxLowMax = 79
        FrIfGdCycle = 0.005
        FrIfGdDynamicSlotIdlePhase = 1
        FrIfGdIgnoreAfterTx = 0
        FrIfGdMacrotick = 0.000001375
        FrIfGdMiniSlotActionPointOffset = 2
        FrIfGdMinislot = 5
        FrIfGdNit = 7
        FrIfGdSampleClockPeriod = T12_5NS
        FrIfGdStaticSlot = 24
        FrIfGdSymbolWindow = 0
        FrIfGdSymbolWindowActionPointOffset = 2
        FrIfGdTSSTransmitter = 9
        FrIfGdWakeupRxIdle = 59
        FrIfGdWakeupRxLow = 50
        FrIfGdWakeupRxWindow = 301
        FrIfGdWakeupTxActive = 60
        FrIfGdWakeupTxIdle = 180
        FrIfSafetyMargin = 100
        contr_EPS_A_FlexRay (FrIfController): FrIfCtrlIdx=0, FrIfFrCtrlRef=FrMultipleConfiguration/contr_EPS_A_FlexRay
          69 x FrIfFrameTriggering, all with FrIfAllowDynamicLSduLength=false, FrIfChannel=FRIF_CHANNEL_A, FrIfPayloadPreamble=false:
            frTrig_FR_3a54c8219f12452dafc00b243d0703e0_1001_A_FlexRay_S_10_B_0_R_1_ChA_OUT: FrIfBaseCycle=0, FrIfCycleRepetition=1, FrIfLSduLength=16, FrIfSlotId=10, FrIfFrameStructureRef=FrStr_xcpstatic_7ff9780c_Out
            frTrig_FR_3a54c8219f12452dafc00b243d0703e0_10401_A_FlexRay_S_104_B_0_R_1_ChA_IN: FrIfBaseCycle=0, FrIfCycleRepetition=1, FrIfLSduLength=2, FrIfSlotId=104, FrIfFrameStructureRef=FrStr_ERRM_BN_U
            frTrig_FR_3a54c8219f12452dafc00b243d0703e0_10701_A_FlexRay_S_107_B_0_R_1_ChA_IN: FrIfBaseCycle=0, FrIfCycleRepetition=1, FrIfLSduLength=5, FrIfSlotId=107, FrIfFrameStructureRef=FrStr_OFFS_QUAD_EPS
            frTrig_FR_3a54c8219f12452dafc00b243d0703e0_10802_A_FlexRay_S_108_B_0_R_2_ChA_IN: FrIfBaseCycle=0, FrIfCycleRepetition=2, FrIfLSduLength=8, FrIfSlotId=108, FrIfFrameStructureRef=FrStr_STEA_OFFS
            frTrig_FR_3a54c8219f12452dafc00b243d0703e0_1101_A_FlexRay_S_11_B_0_R_1_ChA_OUT: FrIfBaseCycle=0, FrIfCycleRepetition=1, FrIfLSduLength=16, FrIfSlotId=11, FrIfFrameStructureRef=FrStr_xcpstatic_a26fa189_Out
            frTrig_FR_3a54c8219f12452dafc00b243d0703e0_11702_A_FlexRay_S_117_B_0_R_2_ChA_IN: FrIfBaseCycle=0, FrIfCycleRepetition=2, FrIfLSduLength=8, FrIfSlotId=117, FrIfFrameStructureRef=FrStr_ST_CENG
            frTrig_FR_3a54c8219f12452dafc00b243d0703e0_11912_A_FlexRay_S_119_B_1_R_2_ChA_IN: FrIfBaseCycle=1, FrIfCycleRepetition=2, FrIfLSduLength=8, FrIfSlotId=119, FrIfFrameStructureRef=FrStr_ENSU_SFY
            frTrig_FR_3a54c8219f12452dafc00b243d0703e0_1201_A_FlexRay_S_12_B_0_R_1_ChA_OUT: FrIfBaseCycle=0, FrIfCycleRepetition=1, FrIfLSduLength=16, FrIfSlotId=12, FrIfFrameStructureRef=FrStr_xcpstatic_1fa5cd47_Out
            frTrig_FR_3a54c8219f12452dafc00b243d0703e0_12112_A_FlexRay_S_121_B_1_R_2_ChA_IN: FrIfBaseCycle=1, FrIfCycleRepetition=2, FrIfLSduLength=8, FrIfSlotId=121, FrIfFrameStructureRef=FrStr_CON_VEH
            frTrig_FR_3a54c8219f12452dafc00b243d0703e0_14701_A_FlexRay_S_147_B_0_R_1_ChA_IN: FrIfBaseCycle=0, FrIfCycleRepetition=1, FrIfLSduLength=254, FrIfSlotId=147, FrIfFrameStructureRef=FrStr_TL_MST_GW_TRNSM_FR_254
            frTrig_FR_3a54c8219f12452dafc00b243d0703e0_18301_A_FlexRay_S_183_B_0_R_1_ChA_OUT: FrIfBaseCycle=0, FrIfCycleRepetition=1, FrIfLSduLength=32, FrIfSlotId=183, FrIfFrameStructureRef=FrStr_TL_ECU_TRNSM_FR_32
            frTrig_FR_3a54c8219f12452dafc00b243d0703e0_20901_A_FlexRay_S_209_B_0_R_1_ChA_IN: FrIfBaseCycle=0, FrIfCycleRepetition=1, FrIfLSduLength=32, FrIfSlotId=209, FrIfFrameStructureRef=FrStr_TL_BRC_FR_32_7c67e8dd_In
            frTrig_FR_3a54c8219f12452dafc00b243d0703e0_21001_A_FlexRay_S_210_B_0_R_1_ChA_IN: FrIfBaseCycle=0, FrIfCycleRepetition=1, FrIfLSduLength=32, FrIfSlotId=210, FrIfFrameStructureRef=FrStr_TL_BRC_FR_32_66fd0343_In
            frTrig_FR_3a54c8219f12452dafc00b243d0703e0_21101_A_FlexRay_S_211_B_0_R_1_ChA_IN: FrIfBaseCycle=0, FrIfCycleRepetition=1, FrIfLSduLength=32, FrIfSlotId=211, FrIfFrameStructureRef=FrStr_TL_BRC_FR_32_bb6bdac6_In
            frTrig_FR_3a54c8219f12452dafc00b243d0703e0_21201_A_FlexRay_S_212_B_0_R_1_ChA_IN: FrIfBaseCycle=0, FrIfCycleRepetition=1, FrIfLSduLength=32, FrIfSlotId=212, FrIfFrameStructureRef=FrStr_TL_BRC_FR_32_06a1b608_In
            frTrig_FR_3a54c8219f12452dafc00b243d0703e0_21301_A_FlexRay_S_213_B_0_R_1_ChA_IN: FrIfBaseCycle=0, FrIfCycleRepetition=1, FrIfLSduLength=32, FrIfSlotId=213, FrIfFrameStructureRef=FrStr_TL_BRC_FR_32_db376f8d_In
            frTrig_FR_3a54c8219f12452dafc00b243d0703e0_21434_A_FlexRay_S_214_B_3_R_4_ChA_IN: FrIfBaseCycle=3, FrIfCycleRepetition=4, FrIfLSduLength=8, FrIfSlotId=214, FrIfFrameStructureRef=FrStr_SVC_a08d1767_In
            frTrig_FR_3a54c8219f12452dafc00b243d0703e0_2151016_A_FlexRay_S_215_B_10_R_16_ChA_IN: FrIfBaseCycle=10, FrIfCycleRepetition=16, FrIfLSduLength=8, FrIfSlotId=215, FrIfFrameStructureRef=FrStr_SVC_30e65b47_In
            frTrig_FR_3a54c8219f12452dafc00b243d0703e0_215216_A_FlexRay_S_215_B_2_R_16_ChA_IN: FrIfBaseCycle=2, FrIfCycleRepetition=16, FrIfLSduLength=8, FrIfSlotId=215, FrIfFrameStructureRef=FrStr_SVC_5a9452fc_In
            frTrig_FR_3a54c8219f12452dafc00b243d0703e0_215516_A_FlexRay_S_215_B_5_R_16_ChA_IN: FrIfBaseCycle=5, FrIfCycleRepetition=16, FrIfLSduLength=8, FrIfSlotId=215, FrIfFrameStructureRef=FrStr_SVC_27e754a4_In
            frTrig_FR_3a54c8219f12452dafc00b243d0703e0_215616_A_FlexRay_S_215_B_6_R_16_ChA_IN: FrIfBaseCycle=6, FrIfCycleRepetition=16, FrIfLSduLength=8, FrIfSlotId=215, FrIfFrameStructureRef=FrStr_SVC_9a2d386a_In
            frTrig_FR_3a54c8219f12452dafc00b243d0703e0_215916_A_FlexRay_S_215_B_9_R_16_ChA_IN: FrIfBaseCycle=9, FrIfCycleRepetition=16, FrIfLSduLength=8, FrIfSlotId=215, FrIfFrameStructureRef=FrStr_SVC_bd5ded5f_In
            frTrig_FR_3a54c8219f12452dafc00b243d0703e0_2161016_A_FlexRay_S_216_B_10_R_16_ChA_IN: FrIfBaseCycle=10, FrIfCycleRepetition=16, FrIfLSduLength=8, FrIfSlotId=216, FrIfFrameStructureRef=FrStr_SVC_219b313e_In
            frTrig_FR_3a54c8219f12452dafc00b243d0703e0_2161216_A_FlexRay_S_216_B_12_R_16_ChA_IN: FrIfBaseCycle=12, FrIfCycleRepetition=16, FrIfLSduLength=8, FrIfSlotId=216, FrIfFrameStructureRef=FrStr_SVC_41c78475_In
            frTrig_FR_3a54c8219f12452dafc00b243d0703e0_2161316_A_FlexRay_S_216_B_13_R_16_ChA_IN: FrIfBaseCycle=13, FrIfCycleRepetition=16, FrIfLSduLength=8, FrIfSlotId=216, FrIfFrameStructureRef=FrStr_SVC_9c515df0_In
            frTrig_FR_3a54c8219f12452dafc00b243d0703e0_2161416_A_FlexRay_S_216_B_14_R_16_ChA_IN: FrIfBaseCycle=14, FrIfCycleRepetition=16, FrIfLSduLength=8, FrIfSlotId=216, FrIfFrameStructureRef=FrStr_SVC_e1225ba8_In
            frTrig_FR_3a54c8219f12452dafc00b243d0703e0_2161516_A_FlexRay_S_216_B_15_R_16_ChA_IN: FrIfBaseCycle=15, FrIfCycleRepetition=16, FrIfLSduLength=8, FrIfSlotId=216, FrIfFrameStructureRef=FrStr_SVC_3cb4822d_In
            frTrig_FR_3a54c8219f12452dafc00b243d0703e0_216616_A_FlexRay_S_216_B_6_R_16_ChA_IN: FrIfBaseCycle=6, FrIfCycleRepetition=16, FrIfLSduLength=8, FrIfSlotId=216, FrIfFrameStructureRef=FrStr_SVC_e64c1db1_In
            frTrig_FR_3a54c8219f12452dafc00b243d0703e0_216716_A_FlexRay_S_216_B_7_R_16_ChA_IN: FrIfBaseCycle=7, FrIfCycleRepetition=16, FrIfLSduLength=8, FrIfSlotId=216, FrIfFrameStructureRef=FrStr_SVC_3bdac434_In
            frTrig_FR_3a54c8219f12452dafc00b243d0703e0_216916_A_FlexRay_S_216_B_9_R_16_ChA_OUT: FrIfBaseCycle=9, FrIfCycleRepetition=16, FrIfLSduLength=8, FrIfSlotId=216, FrIfFrameStructureRef=FrStr_SVC_c13cc884_Out
            frTrig_FR_3a54c8219f12452dafc00b243d0703e0_21901_A_FlexRay_S_219_B_0_R_1_ChA_IN: FrIfBaseCycle=0, FrIfCycleRepetition=1, FrIfLSduLength=32, FrIfSlotId=219, FrIfFrameStructureRef=FrStr_xcpmaster
            frTrig_FR_3a54c8219f12452dafc00b243d0703e0_22001_A_FlexRay_S_220_B_0_R_1_ChA_OUT: FrIfBaseCycle=0, FrIfCycleRepetition=1, FrIfLSduLength=32, FrIfSlotId=220, FrIfFrameStructureRef=FrStr_xcpslave
            frTrig_FR_3a54c8219f12452dafc00b243d0703e0_23212_A_FlexRay_S_232_B_1_R_2_ChA_IN: FrIfBaseCycle=1, FrIfCycleRepetition=2, FrIfLSduLength=8, FrIfSlotId=232, FrIfFrameStructureRef=FrStr_ST_ENERG_GEN
            frTrig_FR_3a54c8219f12452dafc00b243d0703e0_23412_A_FlexRay_S_234_B_1_R_2_ChA_OUT: FrIfBaseCycle=1, FrIfCycleRepetition=2, FrIfLSduLength=5, FrIfSlotId=234, FrIfFrameStructureRef=FrStr_ST_EST
            frTrig_FR_3a54c8219f12452dafc00b243d0703e0_24404_A_FlexRay_S_244_B_0_R_4_ChA_IN: FrIfBaseCycle=0, FrIfCycleRepetition=4, FrIfLSduLength=8, FrIfSlotId=244, FrIfFrameStructureRef=FrStr_SECU_FAHRGESTELLNUMMER
            frTrig_FR_3a54c8219f12452dafc00b243d0703e0_24702_A_FlexRay_S_247_B_0_R_2_ChA_IN: FrIfBaseCycle=0, FrIfCycleRepetition=2, FrIfLSduLength=2, FrIfSlotId=247, FrIfFrameStructureRef=FrStr_CTR_DIAG_OBD_DRDY
            frTrig_FR_3a54c8219f12452dafc00b243d0703e0_24712_A_FlexRay_S_247_B_1_R_2_ChA_IN: FrIfBaseCycle=1, FrIfCycleRepetition=2, FrIfLSduLength=7, FrIfSlotId=247, FrIfFrameStructureRef=FrStr_DIAG_OBD_ENG
            frTrig_FR_3a54c8219f12452dafc00b243d0703e0_2481032_A_FlexRay_S_248_B_10_R_32_ChA_OUT: FrIfBaseCycle=10, FrIfCycleRepetition=32, FrIfLSduLength=8, FrIfSlotId=248, FrIfFrameStructureRef=FrStr_ST_DIAG_OBD_3_DRDY
            frTrig_FR_3a54c8219f12452dafc00b243d0703e0_25214_A_FlexRay_S_252_B_1_R_4_ChA_IN: FrIfBaseCycle=1, FrIfCycleRepetition=4, FrIfLSduLength=2, FrIfSlotId=252, FrIfFrameStructureRef=FrStr_A_TEMP
            frTrig_FR_3a54c8219f12452dafc00b243d0703e0_26924_A_FlexRay_S_269_B_2_R_4_ChA_IN: FrIfBaseCycle=2, FrIfCycleRepetition=4, FrIfLSduLength=16, FrIfSlotId=269, FrIfFrameStructureRef=FrStr_CTR_VIB_STW_DISP_EXMI_SP2015_FDBK_VIB_STW_DISP_EXMI
            frTrig_FR_3a54c8219f12452dafc00b243d0703e0_27408_A_FlexRay_S_274_B_0_R_8_ChA_OUT: FrIfBaseCycle=0, FrIfCycleRepetition=8, FrIfLSduLength=8, FrIfSlotId=274, FrIfFrameStructureRef=FrStr_SU_EPS
            frTrig_FR_3a54c8219f12452dafc00b243d0703e0_27424_A_FlexRay_S_274_B_2_R_4_ChA_OUT: FrIfBaseCycle=2, FrIfCycleRepetition=4, FrIfLSduLength=5, FrIfSlotId=274, FrIfFrameStructureRef=FrStr_DISP_CC_EPS
            frTrig_FR_3a54c8219f12452dafc00b243d0703e0_27518_A_FlexRay_S_275_B_1_R_8_ChA_IN: FrIfBaseCycle=1, FrIfCycleRepetition=8, FrIfLSduLength=8, FrIfSlotId=275, FrIfFrameStructureRef=FrStr_FZZSTD
            frTrig_FR_3a54c8219f12452dafc00b243d0703e0_27578_A_FlexRay_S_275_B_7_R_8_ChA_IN: FrIfBaseCycle=7, FrIfCycleRepetition=8, FrIfLSduLength=7, FrIfSlotId=275, FrIfFrameStructureRef=FrStr_FAHRGESTELLNUMMER
            frTrig_FR_3a54c8219f12452dafc00b243d0703e0_27628_A_FlexRay_S_276_B_2_R_8_ChA_IN: FrIfBaseCycle=2, FrIfCycleRepetition=8, FrIfLSduLength=6, FrIfSlotId=276, FrIfFrameStructureRef=FrStr_RELATIVZEIT
            frTrig_FR_3a54c8219f12452dafc00b243d0703e0_27648_A_FlexRay_S_276_B_4_R_8_ChA_IN: FrIfBaseCycle=4, FrIfCycleRepetition=8, FrIfLSduLength=8, FrIfSlotId=276, FrIfFrameStructureRef=FrStr_KILOMETERSTAND
            frTrig_FR_3a54c8219f12452dafc00b243d0703e0_29401_A_FlexRay_S_294_B_0_R_1_ChA_OUT: FrIfBaseCycle=0, FrIfCycleRepetition=1, FrIfLSduLength=254, FrIfSlotId=294, FrIfFrameStructureRef=FrStr_xcpdynamic254_1
            frTrig_FR_3a54c8219f12452dafc00b243d0703e0_29501_A_FlexRay_S_295_B_0_R_1_ChA_OUT: FrIfBaseCycle=0, FrIfCycleRepetition=1, FrIfLSduLength=254, FrIfSlotId=295, FrIfFrameStructureRef=FrStr_xcpdynamic254_2
            frTrig_FR_3a54c8219f12452dafc00b243d0703e0_29601_A_FlexRay_S_296_B_0_R_1_ChA_OUT: FrIfBaseCycle=0, FrIfCycleRepetition=1, FrIfLSduLength=254, FrIfSlotId=296, FrIfFrameStructureRef=FrStr_xcpdynamic254_3
            frTrig_FR_3a54c8219f12452dafc00b243d0703e0_29701_A_FlexRay_S_297_B_0_R_1_ChA_OUT: FrIfBaseCycle=0, FrIfCycleRepetition=1, FrIfLSduLength=254, FrIfSlotId=297, FrIfFrameStructureRef=FrStr_xcpdynamic254_4
            frTrig_FR_3a54c8219f12452dafc00b243d0703e0_29801_A_FlexRay_S_298_B_0_R_1_ChA_OUT: FrIfBaseCycle=0, FrIfCycleRepetition=1, FrIfLSduLength=254, FrIfSlotId=298, FrIfFrameStructureRef=FrStr_xcpdynamic254_5
            frTrig_FR_3a54c8219f12452dafc00b243d0703e0_29901_A_FlexRay_S_299_B_0_R_1_ChA_OUT: FrIfBaseCycle=0, FrIfCycleRepetition=1, FrIfLSduLength=254, FrIfSlotId=299, FrIfFrameStructureRef=FrStr_xcpdynamic254_6
            frTrig_FR_3a54c8219f12452dafc00b243d0703e0_30001_A_FlexRay_S_300_B_0_R_1_ChA_OUT: FrIfBaseCycle=0, FrIfCycleRepetition=1, FrIfLSduLength=254, FrIfSlotId=300, FrIfFrameStructureRef=FrStr_xcpdynamic254_7
            frTrig_FR_3a54c8219f12452dafc00b243d0703e0_30101_A_FlexRay_S_301_B_0_R_1_ChA_OUT: FrIfBaseCycle=0, FrIfCycleRepetition=1, FrIfLSduLength=254, FrIfSlotId=301, FrIfFrameStructureRef=FrStr_xcpdynamic254_8
            frTrig_FR_3a54c8219f12452dafc00b243d0703e0_31501_A_FlexRay_S_315_B_0_R_1_ChA_OUT: FrIfBaseCycle=0, FrIfCycleRepetition=1, FrIfLSduLength=58, FrIfSlotId=315, FrIfFrameStructureRef=FrStr_FR_DBG_EPS
            frTrig_FR_3a54c8219f12452dafc00b243d0703e0_4601_A_FlexRay_S_46_B_0_R_1_ChA_IN: FrIfBaseCycle=0, FrIfCycleRepetition=1, FrIfLSduLength=12, FrIfSlotId=46, FrIfFrameStructureRef=FrStr_AVL_RPM_WHL
            frTrig_FR_3a54c8219f12452dafc00b243d0703e0_4712_A_FlexRay_S_47_B_1_R_2_ChA_IN: FrIfBaseCycle=1, FrIfCycleRepetition=2, FrIfLSduLength=16, FrIfSlotId=47, FrIfFrameStructureRef=FrStr_ST_STAB_DSC_ST_STAB_DSC_2
            frTrig_FR_3a54c8219f12452dafc00b243d0703e0_4902_A_FlexRay_S_49_B_0_R_2_ChA_OUT: FrIfBaseCycle=0, FrIfCycleRepetition=2, FrIfLSduLength=16, FrIfSlotId=49, FrIfFrameStructureRef=FrStr_AVL_STMOM_DV_ACT_AVL_FORC_GRD
            frTrig_FR_3a54c8219f12452dafc00b243d0703e0_4912_A_FlexRay_S_49_B_1_R_2_ChA_OUT: FrIfBaseCycle=1, FrIfCycleRepetition=2, FrIfLSduLength=16, FrIfSlotId=49, FrIfFrameStructureRef=FrStr_DT_EST
            frTrig_FR_3a54c8219f12452dafc00b243d0703e0_5102_A_FlexRay_S_51_B_0_R_2_ChA_OUT: FrIfBaseCycle=0, FrIfCycleRepetition=2, FrIfLSduLength=16, FrIfSlotId=51, FrIfFrameStructureRef=FrStr_AVL_PO_EPS_ENGTORQ_EPS
            frTrig_FR_3a54c8219f12452dafc00b243d0703e0_5338_A_FlexRay_S_53_B_3_R_8_ChA_IN: FrIfBaseCycle=3, FrIfCycleRepetition=8, FrIfLSduLength=16, FrIfSlotId=53, FrIfFrameStructureRef=FrStr_SU_CLE_DRDY_DXP_SPEC_ADPT_MOD_DXP_ST_IDLV_COOD_DBE_DXP
            frTrig_FR_3a54c8219f12452dafc00b243d0703e0_5502_A_FlexRay_S_55_B_0_R_2_ChA_IN: FrIfBaseCycle=0, FrIfCycleRepetition=2, FrIfLSduLength=14, FrIfSlotId=55, FrIfFrameStructureRef=FrStr_ACLNX_MASSCNTR_ACLNY_MASSCNTR
            frTrig_FR_3a54c8219f12452dafc00b243d0703e0_5534_A_FlexRay_S_55_B_3_R_4_ChA_IN: FrIfBaseCycle=3, FrIfCycleRepetition=4, FrIfLSduLength=16, FrIfSlotId=55, FrIfFrameStructureRef=FrStr_V_VEH_V_VEH_2
            frTrig_FR_3a54c8219f12452dafc00b243d0703e0_5602_A_FlexRay_S_56_B_0_R_2_ChA_IN: FrIfBaseCycle=0, FrIfCycleRepetition=2, FrIfLSduLength=14, FrIfSlotId=56, FrIfFrameStructureRef=FrStr_DT_DRDYSEN_EXT_VYAW_VEH
            frTrig_FR_3a54c8219f12452dafc00b243d0703e0_6512_A_FlexRay_S_65_B_1_R_2_ChA_IN: FrIfBaseCycle=1, FrIfCycleRepetition=2, FrIfLSduLength=8, FrIfSlotId=65, FrIfFrameStructureRef=FrStr_TAR_ESTP_VIRT_FTAX
            frTrig_FR_3a54c8219f12452dafc00b243d0703e0_6802_A_FlexRay_S_68_B_0_R_2_ChA_IN: FrIfBaseCycle=0, FrIfCycleRepetition=2, FrIfLSduLength=16, FrIfSlotId=68, FrIfFrameStructureRef=FrStr_TAR_QTA_STRMOM_DV_TAR_STMOM_DV_ACT
            frTrig_FR_3a54c8219f12452dafc00b243d0703e0_6812_A_FlexRay_S_68_B_1_R_2_ChA_IN: FrIfBaseCycle=1, FrIfCycleRepetition=2, FrIfLSduLength=8, FrIfSlotId=68, FrIfFrameStructureRef=FrStr_ENERG_DGR_DRDY
            frTrig_FR_3a54c8219f12452dafc00b243d0703e0_801_A_FlexRay_S_8_B_0_R_1_ChA_OUT: FrIfBaseCycle=0, FrIfCycleRepetition=1, FrIfLSduLength=16, FrIfSlotId=8, FrIfFrameStructureRef=FrStr_xcpstatic_31d6b02c_Out
            frTrig_FR_3a54c8219f12452dafc00b243d0703e0_901_A_FlexRay_S_9_B_0_R_1_ChA_OUT: FrIfBaseCycle=0, FrIfCycleRepetition=1, FrIfLSduLength=16, FrIfSlotId=9, FrIfFrameStructureRef=FrStr_xcpstatic_ec4069a9_Out
          69 x FrIfLPdu:
            LPdu_frTrig_FR_3a54c8219f12452dafc00b243d0703e0_1001_A_FlexRay_S_10_B_0_R_1_ChA_OUT: FrIfVBTriggeringRef=frTrig_FR_3a54c8219f12452dafc00b243d0703e0_1001_A_FlexRay_S_10_B_0_R_1_ChA_OUT  # frTrig_FR_3a54c8219f12452dafc00b243d0703e0_1001_A_FlexRay
            LPdu_frTrig_FR_3a54c8219f12452dafc00b243d0703e0_10401_A_FlexRay_S_104_B_0_R_1_ChA_IN: FrIfVBTriggeringRef=frTrig_FR_3a54c8219f12452dafc00b243d0703e0_10401_A_FlexRay_S_104_B_0_R_1_ChA_IN  # frTrig_FR_3a54c8219f12452dafc00b243d0703e0_10401_A_FlexRay
            LPdu_frTrig_FR_3a54c8219f12452dafc00b243d0703e0_10701_A_FlexRay_S_107_B_0_R_1_ChA_IN: FrIfVBTriggeringRef=frTrig_FR_3a54c8219f12452dafc00b243d0703e0_10701_A_FlexRay_S_107_B_0_R_1_ChA_IN  # frTrig_FR_3a54c8219f12452dafc00b243d0703e0_10701_A_FlexRay
            LPdu_frTrig_FR_3a54c8219f12452dafc00b243d0703e0_10802_A_FlexRay_S_108_B_0_R_2_ChA_IN: FrIfVBTriggeringRef=frTrig_FR_3a54c8219f12452dafc00b243d0703e0_10802_A_FlexRay_S_108_B_0_R_2_ChA_IN  # frTrig_FR_3a54c8219f12452dafc00b243d0703e0_10802_A_FlexRay
            LPdu_frTrig_FR_3a54c8219f12452dafc00b243d0703e0_1101_A_FlexRay_S_11_B_0_R_1_ChA_OUT: FrIfVBTriggeringRef=frTrig_FR_3a54c8219f12452dafc00b243d0703e0_1101_A_FlexRay_S_11_B_0_R_1_ChA_OUT  # frTrig_FR_3a54c8219f12452dafc00b243d0703e0_1101_A_FlexRay
            LPdu_frTrig_FR_3a54c8219f12452dafc00b243d0703e0_11702_A_FlexRay_S_117_B_0_R_2_ChA_IN: FrIfVBTriggeringRef=frTrig_FR_3a54c8219f12452dafc00b243d0703e0_11702_A_FlexRay_S_117_B_0_R_2_ChA_IN  # frTrig_FR_3a54c8219f12452dafc00b243d0703e0_11702_A_FlexRay
            LPdu_frTrig_FR_3a54c8219f12452dafc00b243d0703e0_11912_A_FlexRay_S_119_B_1_R_2_ChA_IN: FrIfVBTriggeringRef=frTrig_FR_3a54c8219f12452dafc00b243d0703e0_11912_A_FlexRay_S_119_B_1_R_2_ChA_IN  # frTrig_FR_3a54c8219f12452dafc00b243d0703e0_11912_A_FlexRay
            LPdu_frTrig_FR_3a54c8219f12452dafc00b243d0703e0_1201_A_FlexRay_S_12_B_0_R_1_ChA_OUT: FrIfVBTriggeringRef=frTrig_FR_3a54c8219f12452dafc00b243d0703e0_1201_A_FlexRay_S_12_B_0_R_1_ChA_OUT  # frTrig_FR_3a54c8219f12452dafc00b243d0703e0_1201_A_FlexRay
            LPdu_frTrig_FR_3a54c8219f12452dafc00b243d0703e0_12112_A_FlexRay_S_121_B_1_R_2_ChA_IN: FrIfVBTriggeringRef=frTrig_FR_3a54c8219f12452dafc00b243d0703e0_12112_A_FlexRay_S_121_B_1_R_2_ChA_IN  # frTrig_FR_3a54c8219f12452dafc00b243d0703e0_12112_A_FlexRay
            LPdu_frTrig_FR_3a54c8219f12452dafc00b243d0703e0_14701_A_FlexRay_S_147_B_0_R_1_ChA_IN: FrIfVBTriggeringRef=frTrig_FR_3a54c8219f12452dafc00b243d0703e0_14701_A_FlexRay_S_147_B_0_R_1_ChA_IN  # frTrig_FR_3a54c8219f12452dafc00b243d0703e0_14701_A_FlexRay
            LPdu_frTrig_FR_3a54c8219f12452dafc00b243d0703e0_18301_A_FlexRay_S_183_B_0_R_1_ChA_OUT: FrIfVBTriggeringRef=frTrig_FR_3a54c8219f12452dafc00b243d0703e0_18301_A_FlexRay_S_183_B_0_R_1_ChA_OUT  # frTrig_FR_3a54c8219f12452dafc00b243d0703e0_18301_A_FlexRay
            LPdu_frTrig_FR_3a54c8219f12452dafc00b243d0703e0_20901_A_FlexRay_S_209_B_0_R_1_ChA_IN: FrIfVBTriggeringRef=frTrig_FR_3a54c8219f12452dafc00b243d0703e0_20901_A_FlexRay_S_209_B_0_R_1_ChA_IN  # frTrig_FR_3a54c8219f12452dafc00b243d0703e0_20901_A_FlexRay
            LPdu_frTrig_FR_3a54c8219f12452dafc00b243d0703e0_21001_A_FlexRay_S_210_B_0_R_1_ChA_IN: FrIfVBTriggeringRef=frTrig_FR_3a54c8219f12452dafc00b243d0703e0_21001_A_FlexRay_S_210_B_0_R_1_ChA_IN  # frTrig_FR_3a54c8219f12452dafc00b243d0703e0_21001_A_FlexRay
            LPdu_frTrig_FR_3a54c8219f12452dafc00b243d0703e0_21101_A_FlexRay_S_211_B_0_R_1_ChA_IN: FrIfVBTriggeringRef=frTrig_FR_3a54c8219f12452dafc00b243d0703e0_21101_A_FlexRay_S_211_B_0_R_1_ChA_IN  # frTrig_FR_3a54c8219f12452dafc00b243d0703e0_21101_A_FlexRay
            LPdu_frTrig_FR_3a54c8219f12452dafc00b243d0703e0_21201_A_FlexRay_S_212_B_0_R_1_ChA_IN: FrIfVBTriggeringRef=frTrig_FR_3a54c8219f12452dafc00b243d0703e0_21201_A_FlexRay_S_212_B_0_R_1_ChA_IN  # frTrig_FR_3a54c8219f12452dafc00b243d0703e0_21201_A_FlexRay
            LPdu_frTrig_FR_3a54c8219f12452dafc00b243d0703e0_21301_A_FlexRay_S_213_B_0_R_1_ChA_IN: FrIfVBTriggeringRef=frTrig_FR_3a54c8219f12452dafc00b243d0703e0_21301_A_FlexRay_S_213_B_0_R_1_ChA_IN  # frTrig_FR_3a54c8219f12452dafc00b243d0703e0_21301_A_FlexRay
            LPdu_frTrig_FR_3a54c8219f12452dafc00b243d0703e0_21434_A_FlexRay_S_214_B_3_R_4_ChA_IN: FrIfVBTriggeringRef=frTrig_FR_3a54c8219f12452dafc00b243d0703e0_21434_A_FlexRay_S_214_B_3_R_4_ChA_IN  # frTrig_FR_3a54c8219f12452dafc00b243d0703e0_21434_A_FlexRay
            LPdu_frTrig_FR_3a54c8219f12452dafc00b243d0703e0_2151016_A_FlexRay_S_215_B_10_R_16_ChA_IN: FrIfVBTriggeringRef=frTrig_FR_3a54c8219f12452dafc00b243d0703e0_2151016_A_FlexRay_S_215_B_10_R_16_ChA_IN  # frTrig_FR_3a54c8219f12452dafc00b243d0703e0_2151016_A_FlexRay
            LPdu_frTrig_FR_3a54c8219f12452dafc00b243d0703e0_215216_A_FlexRay_S_215_B_2_R_16_ChA_IN: FrIfVBTriggeringRef=frTrig_FR_3a54c8219f12452dafc00b243d0703e0_215216_A_FlexRay_S_215_B_2_R_16_ChA_IN  # frTrig_FR_3a54c8219f12452dafc00b243d0703e0_215216_A_FlexRay
            LPdu_frTrig_FR_3a54c8219f12452dafc00b243d0703e0_215516_A_FlexRay_S_215_B_5_R_16_ChA_IN: FrIfVBTriggeringRef=frTrig_FR_3a54c8219f12452dafc00b243d0703e0_215516_A_FlexRay_S_215_B_5_R_16_ChA_IN  # frTrig_FR_3a54c8219f12452dafc00b243d0703e0_215516_A_FlexRay
            LPdu_frTrig_FR_3a54c8219f12452dafc00b243d0703e0_215616_A_FlexRay_S_215_B_6_R_16_ChA_IN: FrIfVBTriggeringRef=frTrig_FR_3a54c8219f12452dafc00b243d0703e0_215616_A_FlexRay_S_215_B_6_R_16_ChA_IN  # frTrig_FR_3a54c8219f12452dafc00b243d0703e0_215616_A_FlexRay
            LPdu_frTrig_FR_3a54c8219f12452dafc00b243d0703e0_215916_A_FlexRay_S_215_B_9_R_16_ChA_IN: FrIfVBTriggeringRef=frTrig_FR_3a54c8219f12452dafc00b243d0703e0_215916_A_FlexRay_S_215_B_9_R_16_ChA_IN  # frTrig_FR_3a54c8219f12452dafc00b243d0703e0_215916_A_FlexRay
            LPdu_frTrig_FR_3a54c8219f12452dafc00b243d0703e0_2161016_A_FlexRay_S_216_B_10_R_16_ChA_IN: FrIfVBTriggeringRef=frTrig_FR_3a54c8219f12452dafc00b243d0703e0_2161016_A_FlexRay_S_216_B_10_R_16_ChA_IN  # frTrig_FR_3a54c8219f12452dafc00b243d0703e0_2161016_A_FlexRay
            LPdu_frTrig_FR_3a54c8219f12452dafc00b243d0703e0_2161216_A_FlexRay_S_216_B_12_R_16_ChA_IN: FrIfVBTriggeringRef=frTrig_FR_3a54c8219f12452dafc00b243d0703e0_2161216_A_FlexRay_S_216_B_12_R_16_ChA_IN  # frTrig_FR_3a54c8219f12452dafc00b243d0703e0_2161216_A_FlexRay
            LPdu_frTrig_FR_3a54c8219f12452dafc00b243d0703e0_2161316_A_FlexRay_S_216_B_13_R_16_ChA_IN: FrIfVBTriggeringRef=frTrig_FR_3a54c8219f12452dafc00b243d0703e0_2161316_A_FlexRay_S_216_B_13_R_16_ChA_IN  # frTrig_FR_3a54c8219f12452dafc00b243d0703e0_2161316_A_FlexRay
            LPdu_frTrig_FR_3a54c8219f12452dafc00b243d0703e0_2161416_A_FlexRay_S_216_B_14_R_16_ChA_IN: FrIfVBTriggeringRef=frTrig_FR_3a54c8219f12452dafc00b243d0703e0_2161416_A_FlexRay_S_216_B_14_R_16_ChA_IN  # frTrig_FR_3a54c8219f12452dafc00b243d0703e0_2161416_A_FlexRay
            LPdu_frTrig_FR_3a54c8219f12452dafc00b243d0703e0_2161516_A_FlexRay_S_216_B_15_R_16_ChA_IN: FrIfVBTriggeringRef=frTrig_FR_3a54c8219f12452dafc00b243d0703e0_2161516_A_FlexRay_S_216_B_15_R_16_ChA_IN  # frTrig_FR_3a54c8219f12452dafc00b243d0703e0_2161516_A_FlexRay
            LPdu_frTrig_FR_3a54c8219f12452dafc00b243d0703e0_216616_A_FlexRay_S_216_B_6_R_16_ChA_IN: FrIfVBTriggeringRef=frTrig_FR_3a54c8219f12452dafc00b243d0703e0_216616_A_FlexRay_S_216_B_6_R_16_ChA_IN  # frTrig_FR_3a54c8219f12452dafc00b243d0703e0_216616_A_FlexRay
            LPdu_frTrig_FR_3a54c8219f12452dafc00b243d0703e0_216716_A_FlexRay_S_216_B_7_R_16_ChA_IN: FrIfVBTriggeringRef=frTrig_FR_3a54c8219f12452dafc00b243d0703e0_216716_A_FlexRay_S_216_B_7_R_16_ChA_IN  # frTrig_FR_3a54c8219f12452dafc00b243d0703e0_216716_A_FlexRay
            LPdu_frTrig_FR_3a54c8219f12452dafc00b243d0703e0_216916_A_FlexRay_S_216_B_9_R_16_ChA_OUT: FrIfVBTriggeringRef=frTrig_FR_3a54c8219f12452dafc00b243d0703e0_216916_A_FlexRay_S_216_B_9_R_16_ChA_OUT  # frTrig_FR_3a54c8219f12452dafc00b243d0703e0_216916_A_FlexRay
            LPdu_frTrig_FR_3a54c8219f12452dafc00b243d0703e0_21901_A_FlexRay_S_219_B_0_R_1_ChA_IN: FrIfVBTriggeringRef=frTrig_FR_3a54c8219f12452dafc00b243d0703e0_21901_A_FlexRay_S_219_B_0_R_1_ChA_IN  # frTrig_FR_3a54c8219f12452dafc00b243d0703e0_21901_A_FlexRay
            LPdu_frTrig_FR_3a54c8219f12452dafc00b243d0703e0_22001_A_FlexRay_S_220_B_0_R_1_ChA_OUT: FrIfVBTriggeringRef=frTrig_FR_3a54c8219f12452dafc00b243d0703e0_22001_A_FlexRay_S_220_B_0_R_1_ChA_OUT  # frTrig_FR_3a54c8219f12452dafc00b243d0703e0_22001_A_FlexRay
            LPdu_frTrig_FR_3a54c8219f12452dafc00b243d0703e0_23212_A_FlexRay_S_232_B_1_R_2_ChA_IN: FrIfVBTriggeringRef=frTrig_FR_3a54c8219f12452dafc00b243d0703e0_23212_A_FlexRay_S_232_B_1_R_2_ChA_IN  # frTrig_FR_3a54c8219f12452dafc00b243d0703e0_23212_A_FlexRay
            LPdu_frTrig_FR_3a54c8219f12452dafc00b243d0703e0_23412_A_FlexRay_S_234_B_1_R_2_ChA_OUT: FrIfVBTriggeringRef=frTrig_FR_3a54c8219f12452dafc00b243d0703e0_23412_A_FlexRay_S_234_B_1_R_2_ChA_OUT  # frTrig_FR_3a54c8219f12452dafc00b243d0703e0_23412_A_FlexRay
            LPdu_frTrig_FR_3a54c8219f12452dafc00b243d0703e0_24404_A_FlexRay_S_244_B_0_R_4_ChA_IN: FrIfVBTriggeringRef=frTrig_FR_3a54c8219f12452dafc00b243d0703e0_24404_A_FlexRay_S_244_B_0_R_4_ChA_IN  # frTrig_FR_3a54c8219f12452dafc00b243d0703e0_24404_A_FlexRay
            LPdu_frTrig_FR_3a54c8219f12452dafc00b243d0703e0_24702_A_FlexRay_S_247_B_0_R_2_ChA_IN: FrIfVBTriggeringRef=frTrig_FR_3a54c8219f12452dafc00b243d0703e0_24702_A_FlexRay_S_247_B_0_R_2_ChA_IN  # frTrig_FR_3a54c8219f12452dafc00b243d0703e0_24702_A_FlexRay
            LPdu_frTrig_FR_3a54c8219f12452dafc00b243d0703e0_24712_A_FlexRay_S_247_B_1_R_2_ChA_IN: FrIfVBTriggeringRef=frTrig_FR_3a54c8219f12452dafc00b243d0703e0_24712_A_FlexRay_S_247_B_1_R_2_ChA_IN  # frTrig_FR_3a54c8219f12452dafc00b243d0703e0_24712_A_FlexRay
            LPdu_frTrig_FR_3a54c8219f12452dafc00b243d0703e0_2481032_A_FlexRay_S_248_B_10_R_32_ChA_OUT: FrIfVBTriggeringRef=frTrig_FR_3a54c8219f12452dafc00b243d0703e0_2481032_A_FlexRay_S_248_B_10_R_32_ChA_OUT  # frTrig_FR_3a54c8219f12452dafc00b243d0703e0_2481032_A_FlexRay
            LPdu_frTrig_FR_3a54c8219f12452dafc00b243d0703e0_25214_A_FlexRay_S_252_B_1_R_4_ChA_IN: FrIfVBTriggeringRef=frTrig_FR_3a54c8219f12452dafc00b243d0703e0_25214_A_FlexRay_S_252_B_1_R_4_ChA_IN  # frTrig_FR_3a54c8219f12452dafc00b243d0703e0_25214_A_FlexRay
            LPdu_frTrig_FR_3a54c8219f12452dafc00b243d0703e0_26924_A_FlexRay_S_269_B_2_R_4_ChA_IN: FrIfVBTriggeringRef=frTrig_FR_3a54c8219f12452dafc00b243d0703e0_26924_A_FlexRay_S_269_B_2_R_4_ChA_IN  # frTrig_FR_3a54c8219f12452dafc00b243d0703e0_26924_A_FlexRay
            LPdu_frTrig_FR_3a54c8219f12452dafc00b243d0703e0_27408_A_FlexRay_S_274_B_0_R_8_ChA_OUT: FrIfVBTriggeringRef=frTrig_FR_3a54c8219f12452dafc00b243d0703e0_27408_A_FlexRay_S_274_B_0_R_8_ChA_OUT  # frTrig_FR_3a54c8219f12452dafc00b243d0703e0_27408_A_FlexRay
            LPdu_frTrig_FR_3a54c8219f12452dafc00b243d0703e0_27424_A_FlexRay_S_274_B_2_R_4_ChA_OUT: FrIfVBTriggeringRef=frTrig_FR_3a54c8219f12452dafc00b243d0703e0_27424_A_FlexRay_S_274_B_2_R_4_ChA_OUT  # frTrig_FR_3a54c8219f12452dafc00b243d0703e0_27424_A_FlexRay
            LPdu_frTrig_FR_3a54c8219f12452dafc00b243d0703e0_27518_A_FlexRay_S_275_B_1_R_8_ChA_IN: FrIfVBTriggeringRef=frTrig_FR_3a54c8219f12452dafc00b243d0703e0_27518_A_FlexRay_S_275_B_1_R_8_ChA_IN  # frTrig_FR_3a54c8219f12452dafc00b243d0703e0_27518_A_FlexRay
            LPdu_frTrig_FR_3a54c8219f12452dafc00b243d0703e0_27578_A_FlexRay_S_275_B_7_R_8_ChA_IN: FrIfVBTriggeringRef=frTrig_FR_3a54c8219f12452dafc00b243d0703e0_27578_A_FlexRay_S_275_B_7_R_8_ChA_IN  # frTrig_FR_3a54c8219f12452dafc00b243d0703e0_27578_A_FlexRay
            LPdu_frTrig_FR_3a54c8219f12452dafc00b243d0703e0_27628_A_FlexRay_S_276_B_2_R_8_ChA_IN: FrIfVBTriggeringRef=frTrig_FR_3a54c8219f12452dafc00b243d0703e0_27628_A_FlexRay_S_276_B_2_R_8_ChA_IN  # frTrig_FR_3a54c8219f12452dafc00b243d0703e0_27628_A_FlexRay
            LPdu_frTrig_FR_3a54c8219f12452dafc00b243d0703e0_27648_A_FlexRay_S_276_B_4_R_8_ChA_IN: FrIfVBTriggeringRef=frTrig_FR_3a54c8219f12452dafc00b243d0703e0_27648_A_FlexRay_S_276_B_4_R_8_ChA_IN  # frTrig_FR_3a54c8219f12452dafc00b243d0703e0_27648_A_FlexRay
            LPdu_frTrig_FR_3a54c8219f12452dafc00b243d0703e0_29401_A_FlexRay_S_294_B_0_R_1_ChA_OUT: FrIfVBTriggeringRef=frTrig_FR_3a54c8219f12452dafc00b243d0703e0_29401_A_FlexRay_S_294_B_0_R_1_ChA_OUT  # frTrig_FR_3a54c8219f12452dafc00b243d0703e0_29401_A_FlexRay
            LPdu_frTrig_FR_3a54c8219f12452dafc00b243d0703e0_29501_A_FlexRay_S_295_B_0_R_1_ChA_OUT: FrIfVBTriggeringRef=frTrig_FR_3a54c8219f12452dafc00b243d0703e0_29501_A_FlexRay_S_295_B_0_R_1_ChA_OUT  # frTrig_FR_3a54c8219f12452dafc00b243d0703e0_29501_A_FlexRay
            LPdu_frTrig_FR_3a54c8219f12452dafc00b243d0703e0_29601_A_FlexRay_S_296_B_0_R_1_ChA_OUT: FrIfVBTriggeringRef=frTrig_FR_3a54c8219f12452dafc00b243d0703e0_29601_A_FlexRay_S_296_B_0_R_1_ChA_OUT  # frTrig_FR_3a54c8219f12452dafc00b243d0703e0_29601_A_FlexRay
            LPdu_frTrig_FR_3a54c8219f12452dafc00b243d0703e0_29701_A_FlexRay_S_297_B_0_R_1_ChA_OUT: FrIfVBTriggeringRef=frTrig_FR_3a54c8219f12452dafc00b243d0703e0_29701_A_FlexRay_S_297_B_0_R_1_ChA_OUT  # frTrig_FR_3a54c8219f12452dafc00b243d0703e0_29701_A_FlexRay
            LPdu_frTrig_FR_3a54c8219f12452dafc00b243d0703e0_29801_A_FlexRay_S_298_B_0_R_1_ChA_OUT: FrIfVBTriggeringRef=frTrig_FR_3a54c8219f12452dafc00b243d0703e0_29801_A_FlexRay_S_298_B_0_R_1_ChA_OUT  # frTrig_FR_3a54c8219f12452dafc00b243d0703e0_29801_A_FlexRay
            LPdu_frTrig_FR_3a54c8219f12452dafc00b243d0703e0_29901_A_FlexRay_S_299_B_0_R_1_ChA_OUT: FrIfVBTriggeringRef=frTrig_FR_3a54c8219f12452dafc00b243d0703e0_29901_A_FlexRay_S_299_B_0_R_1_ChA_OUT  # frTrig_FR_3a54c8219f12452dafc00b243d0703e0_29901_A_FlexRay
            LPdu_frTrig_FR_3a54c8219f12452dafc00b243d0703e0_30001_A_FlexRay_S_300_B_0_R_1_ChA_OUT: FrIfVBTriggeringRef=frTrig_FR_3a54c8219f12452dafc00b243d0703e0_30001_A_FlexRay_S_300_B_0_R_1_ChA_OUT  # frTrig_FR_3a54c8219f12452dafc00b243d0703e0_30001_A_FlexRay
            LPdu_frTrig_FR_3a54c8219f12452dafc00b243d0703e0_30101_A_FlexRay_S_301_B_0_R_1_ChA_OUT: FrIfVBTriggeringRef=frTrig_FR_3a54c8219f12452dafc00b243d0703e0_30101_A_FlexRay_S_301_B_0_R_1_ChA_OUT  # frTrig_FR_3a54c8219f12452dafc00b243d0703e0_30101_A_FlexRay
            LPdu_frTrig_FR_3a54c8219f12452dafc00b243d0703e0_31501_A_FlexRay_S_315_B_0_R_1_ChA_OUT: FrIfVBTriggeringRef=frTrig_FR_3a54c8219f12452dafc00b243d0703e0_31501_A_FlexRay_S_315_B_0_R_1_ChA_OUT  # frTrig_FR_3a54c8219f12452dafc00b243d0703e0_31501_A_FlexRay
            LPdu_frTrig_FR_3a54c8219f12452dafc00b243d0703e0_4601_A_FlexRay_S_46_B_0_R_1_ChA_IN: FrIfVBTriggeringRef=frTrig_FR_3a54c8219f12452dafc00b243d0703e0_4601_A_FlexRay_S_46_B_0_R_1_ChA_IN  # frTrig_FR_3a54c8219f12452dafc00b243d0703e0_4601_A_FlexRay
            LPdu_frTrig_FR_3a54c8219f12452dafc00b243d0703e0_4712_A_FlexRay_S_47_B_1_R_2_ChA_IN: FrIfVBTriggeringRef=frTrig_FR_3a54c8219f12452dafc00b243d0703e0_4712_A_FlexRay_S_47_B_1_R_2_ChA_IN  # frTrig_FR_3a54c8219f12452dafc00b243d0703e0_4712_A_FlexRay
            LPdu_frTrig_FR_3a54c8219f12452dafc00b243d0703e0_4902_A_FlexRay_S_49_B_0_R_2_ChA_OUT: FrIfVBTriggeringRef=frTrig_FR_3a54c8219f12452dafc00b243d0703e0_4902_A_FlexRay_S_49_B_0_R_2_ChA_OUT  # frTrig_FR_3a54c8219f12452dafc00b243d0703e0_4902_A_FlexRay
            LPdu_frTrig_FR_3a54c8219f12452dafc00b243d0703e0_4912_A_FlexRay_S_49_B_1_R_2_ChA_OUT: FrIfVBTriggeringRef=frTrig_FR_3a54c8219f12452dafc00b243d0703e0_4912_A_FlexRay_S_49_B_1_R_2_ChA_OUT  # frTrig_FR_3a54c8219f12452dafc00b243d0703e0_4912_A_FlexRay
            LPdu_frTrig_FR_3a54c8219f12452dafc00b243d0703e0_5102_A_FlexRay_S_51_B_0_R_2_ChA_OUT: FrIfVBTriggeringRef=frTrig_FR_3a54c8219f12452dafc00b243d0703e0_5102_A_FlexRay_S_51_B_0_R_2_ChA_OUT  # frTrig_FR_3a54c8219f12452dafc00b243d0703e0_5102_A_FlexRay
            LPdu_frTrig_FR_3a54c8219f12452dafc00b243d0703e0_5338_A_FlexRay_S_53_B_3_R_8_ChA_IN: FrIfVBTriggeringRef=frTrig_FR_3a54c8219f12452dafc00b243d0703e0_5338_A_FlexRay_S_53_B_3_R_8_ChA_IN  # frTrig_FR_3a54c8219f12452dafc00b243d0703e0_5338_A_FlexRay
            LPdu_frTrig_FR_3a54c8219f12452dafc00b243d0703e0_5502_A_FlexRay_S_55_B_0_R_2_ChA_IN: FrIfVBTriggeringRef=frTrig_FR_3a54c8219f12452dafc00b243d0703e0_5502_A_FlexRay_S_55_B_0_R_2_ChA_IN  # frTrig_FR_3a54c8219f12452dafc00b243d0703e0_5502_A_FlexRay
            LPdu_frTrig_FR_3a54c8219f12452dafc00b243d0703e0_5534_A_FlexRay_S_55_B_3_R_4_ChA_IN: FrIfVBTriggeringRef=frTrig_FR_3a54c8219f12452dafc00b243d0703e0_5534_A_FlexRay_S_55_B_3_R_4_ChA_IN  # frTrig_FR_3a54c8219f12452dafc00b243d0703e0_5534_A_FlexRay
            LPdu_frTrig_FR_3a54c8219f12452dafc00b243d0703e0_5602_A_FlexRay_S_56_B_0_R_2_ChA_IN: FrIfVBTriggeringRef=frTrig_FR_3a54c8219f12452dafc00b243d0703e0_5602_A_FlexRay_S_56_B_0_R_2_ChA_IN  # frTrig_FR_3a54c8219f12452dafc00b243d0703e0_5602_A_FlexRay
            LPdu_frTrig_FR_3a54c8219f12452dafc00b243d0703e0_6512_A_FlexRay_S_65_B_1_R_2_ChA_IN: FrIfVBTriggeringRef=frTrig_FR_3a54c8219f12452dafc00b243d0703e0_6512_A_FlexRay_S_65_B_1_R_2_ChA_IN  # frTrig_FR_3a54c8219f12452dafc00b243d0703e0_6512_A_FlexRay
            LPdu_frTrig_FR_3a54c8219f12452dafc00b243d0703e0_6802_A_FlexRay_S_68_B_0_R_2_ChA_IN: FrIfVBTriggeringRef=frTrig_FR_3a54c8219f12452dafc00b243d0703e0_6802_A_FlexRay_S_68_B_0_R_2_ChA_IN  # frTrig_FR_3a54c8219f12452dafc00b243d0703e0_6802_A_FlexRay
            LPdu_frTrig_FR_3a54c8219f12452dafc00b243d0703e0_6812_A_FlexRay_S_68_B_1_R_2_ChA_IN: FrIfVBTriggeringRef=frTrig_FR_3a54c8219f12452dafc00b243d0703e0_6812_A_FlexRay_S_68_B_1_R_2_ChA_IN  # frTrig_FR_3a54c8219f12452dafc00b243d0703e0_6812_A_FlexRay
            LPdu_frTrig_FR_3a54c8219f12452dafc00b243d0703e0_801_A_FlexRay_S_8_B_0_R_1_ChA_OUT: FrIfVBTriggeringRef=frTrig_FR_3a54c8219f12452dafc00b243d0703e0_801_A_FlexRay_S_8_B_0_R_1_ChA_OUT  # frTrig_FR_3a54c8219f12452dafc00b243d0703e0_801_A_FlexRay
            LPdu_frTrig_FR_3a54c8219f12452dafc00b243d0703e0_901_A_FlexRay_S_9_B_0_R_1_ChA_OUT: FrIfVBTriggeringRef=frTrig_FR_3a54c8219f12452dafc00b243d0703e0_901_A_FlexRay_S_9_B_0_R_1_ChA_OUT  # frTrig_FR_3a54c8219f12452dafc00b243d0703e0_901_A_FlexRay
      69 x FrIfFrameStructure, all with FrIfByteOrder=LITTLE_ENDIAN:
        FrStr_ACLNX_MASSCNTR_ACLNY_MASSCNTR  # ACLNX_MASSCNTR_ACLNY_MASSCNTR
          sn_5d864f4a266e40639fe6abc57cceb758_17_060886cf9e88403f9df14c319aa0ae95_20 (FrIfPdusInFrame): FrIfPduOffset=8, FrIfPduRef=ACLNY_MASSCNTR
        FrStr_AVL_PO_EPS_ENGTORQ_EPS  # AVL_PO_EPS_ENGTORQ_EPS
          sn_0b01e810a8bf4aa3b3ead1e4c09f2b68_4_0c0ed9ed2c324b648cea19ccfdcf4017_2 (FrIfPdusInFrame): FrIfPduOffset=8, FrIfPduRef=ENGTORQ_EPS
          sn_0b01e810a8bf4aa3b3ead1e4c09f2b68_4_e0f63d36315c4773ba837e73d6faaadd_15 (FrIfPdusInFrame): FrIfPduOffset=0, FrIfPduRef=AVL_PO_EPS
        FrStr_AVL_RPM_WHL  # AVL_RPM_WHL
          sn_708b545e63774a48974a2e012c342c56_18_ca307c7178fd4cb8b1f0845b9598b7e4_18 (FrIfPdusInFrame): FrIfPduOffset=0, FrIfPduRef=AVL_RPM_WHL
        FrStr_AVL_STMOM_DV_ACT_AVL_FORC_GRD  # AVL_STMOM_DV_ACT_AVL_FORC_GRD
          sn_742c7ae2ecf94fc080e798e25ca70247_16_09e4bde6148d45f99746b23c44ef9b67_14 (FrIfPdusInFrame): FrIfPduOffset=8, FrIfPduRef=AVL_FORC_GRD
          sn_742c7ae2ecf94fc080e798e25ca70247_16_1edf400c871b41dab29d318a6fc3ec64_13 (FrIfPdusInFrame): FrIfPduOffset=0, FrIfPduRef=AVL_STMOM_DV_ACT
        FrStr_A_TEMP  # A_TEMP
          sn_ffb3893c37a446b6bb48321cc292082f_18_d0ea1fc2c1ca4e2295bae82b1e156e9a_18 (FrIfPdusInFrame): FrIfPduOffset=0, FrIfPduRef=A_TEMP
        FrStr_CON_VEH  # CON_VEH
          sn_a07de7dfbad342e18d0517336a8ccb12_11_f39dc9b4f18c4462a3ca3222d270f882_11 (FrIfPdusInFrame): FrIfPduOffset=0, FrIfPduRef=CON_VEH
        FrStr_CTR_DIAG_OBD_DRDY  # CTR_DIAG_OBD_DRDY
          sn_62b9b444be3144e4afdbe2e8f65ae37b_4_eb2aaf9fde954786857e30879fbebab8_4 (FrIfPdusInFrame): FrIfPduOffset=0, FrIfPduRef=CTR_DIAG_OBD_DRDY
        FrStr_CTR_VIB_STW_DISP_EXMI_SP2015_FDBK_VIB_STW_DISP_EXMI  # CTR_VIB_STW_DISP_EXMI_SP2015_FDBK_VIB_STW_DISP_EXMI
          sn_6d8a461ff30049dfbb2df9138651c35b_3_8e1fc510f7a3427998068160382540c0_4 (FrIfPdusInFrame): FrIfPduOffset=0, FrIfPduRef=CTR_VIB_STW_DISP_EXMI_SP2015
        FrStr_DIAG_OBD_ENG  # DIAG_OBD_ENG
          sn_f26c29b5554146b48da2e76fdc87f59b_13_d8833aa6063240d791b5384f59f75d9a_13 (FrIfPdusInFrame): FrIfPduOffset=0, FrIfPduRef=DIAG_OBD_ENG
        FrStr_DISP_CC_EPS  # DISP_CC_EPS
          sn_bbacfb13291a4ee286c905592a1bb973_2_39a2ac19c7164f0385b879ca14e85e7b_2 (FrIfPdusInFrame): FrIfPduOffset=0, FrIfPduRef=DISP_CC_EPS
        FrStr_DT_DRDYSEN_EXT_VYAW_VEH  # DT_DRDYSEN_EXT_VYAW_VEH
          sn_1a6c54ef470342899c8af77346d5f01c_20_27f7c756a0e24349b8e230b415458184_21 (FrIfPdusInFrame): FrIfPduOffset=8, FrIfPduRef=VYAW_VEH
        FrStr_DT_EST  # DT_EST
          sn_47f7335f9e884cfebf3cf85a43b03f09_9_f1c2ea448b5742e6a930415b5321c120_9 (FrIfPdusInFrame): FrIfPduOffset=0, FrIfPduRef=DT_EST
        FrStr_ENERG_DGR_DRDY  # ENERG_DGR_DRDY
          sn_a8f1d204f2ad40669d1acf24a5cd893e_8_39c3f0eb640a4f78a081a30d189b0df4_8 (FrIfPdusInFrame): FrIfPduOffset=0, FrIfPduRef=ENERG_DGR_DRDY
        FrStr_ENSU_SFY  # ENSU_SFY
          sn_34b57a760af141aaa6b7f792f94a53b8_2_4145eaff72594a8e9989935517b189e9_2 (FrIfPdusInFrame): FrIfPduOffset=0, FrIfPduRef=ENSU_SFY
        FrStr_ERRM_BN_U  # ERRM_BN_U
          sn_8e8d5ba824d24f699ca284a4f92ea5fd_4_677e18af96434b57a7947ca5849af5e4_4 (FrIfPdusInFrame): FrIfPduOffset=0, FrIfPduRef=ERRM_BN_U
        FrStr_FAHRGESTELLNUMMER  # FAHRGESTELLNUMMER
          sn_1e39d529353949ad94ad72cd99e0239e_13_9007d271e9154737bbd9f3c54ab3098b_12 (FrIfPdusInFrame): FrIfPduOffset=0, FrIfPduRef=FAHRGESTELLNUMMER
        FrStr_FR_DBG_EPS  # FR_DBG_EPS
          sn_6b68fdbc63d54758bff55913fcd344ba_5_43f7a9daf64d4ee7b94a0fd106743903_5 (FrIfPdusInFrame): FrIfPduOffset=0, FrIfPduRef=FR_DBG_EPS
        FrStr_FZZSTD  # FZZSTD
          sn_e5dc33323d8e4047bef88bdbfc641fb1_12_47c848be64324d52af177d4eda36b369_12 (FrIfPdusInFrame): FrIfPduOffset=0, FrIfPduRef=FZZSTD
        FrStr_KILOMETERSTAND  # KILOMETERSTAND
          sn_23b23ec8e79d4821a4fd4f71addacbb8_10_209e4b614ee044c4bbf1020e8ad2a6e0_10 (FrIfPdusInFrame): FrIfPduOffset=0, FrIfPduRef=KILOMETERSTAND
        FrStr_OFFS_QUAD_EPS  # OFFS_QUAD_EPS
          sn_4b75d7aade684404a40181123f5e091e_13_2538d099b88d4657ae03c10c9544a047_14 (FrIfPdusInFrame): FrIfPduOffset=0, FrIfPduRef=OFFS_QUAD_EPS
        FrStr_RELATIVZEIT  # RELATIVZEIT
          sn_ccc09e8b2c1e432a8f2a272e558c8566_3_acb3c9a426bf4887ba724efd428ad5a4_3 (FrIfPdusInFrame): FrIfPduOffset=0, FrIfPduRef=RELATIVZEIT
        FrStr_SECU_FAHRGESTELLNUMMER  # SECU_FAHRGESTELLNUMMER
          sn_45fe7c1444bb44a182e3c698da50983a_3_ff5ad01b69a64f2fa3482d8ab369f18a_3 (FrIfPdusInFrame): FrIfPduOffset=0, FrIfPduRef=SECU_FAHRGESTELLNUMMER
        FrStr_STEA_OFFS  # STEA_OFFS
          sn_58cceca224fe40fc80675725acb2e3e1_11_55e086fa3cb3405c9e0849033f661450_11 (FrIfPdusInFrame): FrIfPduOffset=0, FrIfPduRef=STEA_OFFS
        FrStr_ST_CENG  # ST_CENG
          sn_cf4a41801d9a44e3ad6339c69f3c4e8c_9_6e55c14d93c64aaa86e33b57aac2ae43_9 (FrIfPdusInFrame): FrIfPduOffset=0, FrIfPduRef=ST_CENG
        FrStr_ST_DIAG_OBD_3_DRDY  # ST_DIAG_OBD_3_DRDY
          sn_f1b37dec817945749ac7e14f80df159d_4_95dff1578f214757b23c8394af12aa48_4 (FrIfPdusInFrame): FrIfPduOffset=0, FrIfPduRef=ST_DIAG_OBD_3_DRDY
        FrStr_ST_ENERG_GEN  # ST_ENERG_GEN
          sn_efdccab807464c4ab076173048647d90_15_085b67cff4b142a59fb46d892b9938f0_15 (FrIfPdusInFrame): FrIfPduOffset=0, FrIfPduRef=ST_ENERG_GEN
        FrStr_ST_EST  # ST_EST
          sn_2f3b1c2990d8434f9d60c8bc0223380a_14_0d521c7c53964f869478fa5c12f4ec50_14 (FrIfPdusInFrame): FrIfPduOffset=0, FrIfPduRef=ST_EST
        FrStr_ST_STAB_DSC_ST_STAB_DSC_2  # ST_STAB_DSC_ST_STAB_DSC_2
          sn_2c6859f532c740fd851c07438c6639fd_20_3e35ac63fc494d0fb399c763aeb7057b_24 (FrIfPdusInFrame): FrIfPduOffset=0, FrIfPduRef=ST_STAB_DSC
        FrStr_SU_CLE_DRDY_DXP_SPEC_ADPT_MOD_DXP_ST_IDLV_COOD_DBE_DXP  # SU_CLE_DRDY_DXP_SPEC_ADPT_MOD_DXP_ST_IDLV_COOD_DBE_DXP
          sn_642c67ac547c477491d482d6f4297c8a_10_04b89dc3c26d4ca08465c4eec950ef56_8 (FrIfPdusInFrame): FrIfPduOffset=0, FrIfPduRef=SU_CLE_DRDY_DXP
        FrStr_SU_EPS  # SU_EPS
          sn_c217e50a54da493a879e8e4514e8c562_4_ecced8165aea4835a2a17dc224344598_4 (FrIfPdusInFrame): FrIfPduOffset=0, FrIfPduRef=SU_EPS
        FrStr_SVC_219b313e_In  # SVC
          sn_9dd8c6cee627483a83c881709979081d_77_017541877cab44569267610f7b9dbbd6_78 (FrIfPdusInFrame): FrIfPduOffset=0, FrIfPduRef=SVC_In
        FrStr_SVC_27e754a4_In  # SVC
          sn_9dd8c6cee627483a83c881709979081d_77_017541877cab44569267610f7b9dbbd6_78 (FrIfPdusInFrame): FrIfPduOffset=0, FrIfPduRef=SVC_In
        FrStr_SVC_30e65b47_In  # SVC
          sn_9dd8c6cee627483a83c881709979081d_77_017541877cab44569267610f7b9dbbd6_78 (FrIfPdusInFrame): FrIfPduOffset=0, FrIfPduRef=SVC_In
        FrStr_SVC_3bdac434_In  # SVC
          sn_9dd8c6cee627483a83c881709979081d_77_017541877cab44569267610f7b9dbbd6_78 (FrIfPdusInFrame): FrIfPduOffset=0, FrIfPduRef=SVC_In
        FrStr_SVC_3cb4822d_In  # SVC
          sn_9dd8c6cee627483a83c881709979081d_77_017541877cab44569267610f7b9dbbd6_78 (FrIfPdusInFrame): FrIfPduOffset=0, FrIfPduRef=SVC_In
        FrStr_SVC_41c78475_In  # SVC
          sn_9dd8c6cee627483a83c881709979081d_77_017541877cab44569267610f7b9dbbd6_78 (FrIfPdusInFrame): FrIfPduOffset=0, FrIfPduRef=SVC_In
        FrStr_SVC_5a9452fc_In  # SVC
          sn_9dd8c6cee627483a83c881709979081d_77_017541877cab44569267610f7b9dbbd6_78 (FrIfPdusInFrame): FrIfPduOffset=0, FrIfPduRef=SVC_In
        FrStr_SVC_9a2d386a_In  # SVC
          sn_9dd8c6cee627483a83c881709979081d_77_017541877cab44569267610f7b9dbbd6_78 (FrIfPdusInFrame): FrIfPduOffset=0, FrIfPduRef=SVC_In
        FrStr_SVC_9c515df0_In  # SVC
          sn_9dd8c6cee627483a83c881709979081d_77_017541877cab44569267610f7b9dbbd6_78 (FrIfPdusInFrame): FrIfPduOffset=0, FrIfPduRef=SVC_In
        FrStr_SVC_a08d1767_In  # SVC
          sn_9dd8c6cee627483a83c881709979081d_77_017541877cab44569267610f7b9dbbd6_78 (FrIfPdusInFrame): FrIfPduOffset=0, FrIfPduRef=SVC_In
        FrStr_SVC_bd5ded5f_In  # SVC
          sn_9dd8c6cee627483a83c881709979081d_77_017541877cab44569267610f7b9dbbd6_78 (FrIfPdusInFrame): FrIfPduOffset=0, FrIfPduRef=SVC_In
        FrStr_SVC_c13cc884_Out  # SVC
          sn_9dd8c6cee627483a83c881709979081d_77_017541877cab44569267610f7b9dbbd6_78 (FrIfPdusInFrame): FrIfPduOffset=0, FrIfPduRef=SVC_Out
        FrStr_SVC_e1225ba8_In  # SVC
          sn_9dd8c6cee627483a83c881709979081d_77_017541877cab44569267610f7b9dbbd6_78 (FrIfPdusInFrame): FrIfPduOffset=0, FrIfPduRef=SVC_In
        FrStr_SVC_e64c1db1_In  # SVC
          sn_9dd8c6cee627483a83c881709979081d_77_017541877cab44569267610f7b9dbbd6_78 (FrIfPdusInFrame): FrIfPduOffset=0, FrIfPduRef=SVC_In
        FrStr_TAR_ESTP_VIRT_FTAX  # TAR_ESTP_VIRT_FTAX
          sn_d9f1ff037ed147f1bcd2f969afda82c4_5_12963b5f55914150b9f8aacada47bf44_5 (FrIfPdusInFrame): FrIfPduOffset=0, FrIfPduRef=TAR_ESTP_VIRT_FTAX
        FrStr_TAR_QTA_STRMOM_DV_TAR_STMOM_DV_ACT  # TAR_QTA_STRMOM_DV_TAR_STMOM_DV_ACT
          sn_13aa1571427746dfa4ddec6f8fe46d9d_12_2b4b9cfb3a644a13aeec78e06779be78_9 (FrIfPdusInFrame): FrIfPduOffset=0, FrIfPduRef=TAR_QTA_STRMOM_DV
          sn_13aa1571427746dfa4ddec6f8fe46d9d_12_d81fd7307a29409f9d9a2c110d5f1a3d_9 (FrIfPdusInFrame): FrIfPduOffset=8, FrIfPduRef=TAR_STMOM_DV_ACT
        FrStr_TL_BRC_FR_32_06a1b608_In  # TL_BRC_FR_32
          sn_b89d750f03b54dc591beef3d97af79e1_6_99b35db8d0034c95bddada0c4e168dbd_5 (FrIfPdusInFrame): FrIfPduOffset=0, FrIfPduRef=TL_BRC_FR_32
        FrStr_TL_BRC_FR_32_66fd0343_In  # TL_BRC_FR_32
          sn_b89d750f03b54dc591beef3d97af79e1_6_99b35db8d0034c95bddada0c4e168dbd_5 (FrIfPdusInFrame): FrIfPduOffset=0, FrIfPduRef=TL_BRC_FR_32
        FrStr_TL_BRC_FR_32_7c67e8dd_In  # TL_BRC_FR_32
          sn_b89d750f03b54dc591beef3d97af79e1_6_99b35db8d0034c95bddada0c4e168dbd_5 (FrIfPdusInFrame): FrIfPduOffset=0, FrIfPduRef=TL_BRC_FR_32
        FrStr_TL_BRC_FR_32_bb6bdac6_In  # TL_BRC_FR_32
          sn_b89d750f03b54dc591beef3d97af79e1_6_99b35db8d0034c95bddada0c4e168dbd_5 (FrIfPdusInFrame): FrIfPduOffset=0, FrIfPduRef=TL_BRC_FR_32
        FrStr_TL_BRC_FR_32_db376f8d_In  # TL_BRC_FR_32
          sn_b89d750f03b54dc591beef3d97af79e1_6_99b35db8d0034c95bddada0c4e168dbd_5 (FrIfPdusInFrame): FrIfPduOffset=0, FrIfPduRef=TL_BRC_FR_32
        FrStr_TL_ECU_TRNSM_FR_32  # TL_ECU_TRNSM_FR_32
          sn_ada9591f59be44a18409d95fca100f53_5_c623861e6a0749cc9d81d43585ea7f81_4 (FrIfPdusInFrame): FrIfPduOffset=0, FrIfPduRef=TL_ECU_TRNSM_FR_32
        FrStr_TL_MST_GW_TRNSM_FR_254  # TL_MST_GW_TRNSM_FR_254
          sn_d187a29661e448debbfa1c1db2495add_2_161ebe01a13246f5bc130ce6f196d980_1 (FrIfPdusInFrame): FrIfPduOffset=0, FrIfPduRef=TL_MST_GW_TRNSM_FR_254
        FrStr_V_VEH_V_VEH_2  # V_VEH_V_VEH_2
          sn_2891826c350d482582f167e1fc0f401f_10_af83ce37179a45aca7ac57646532416b_18 (FrIfPdusInFrame): FrIfPduOffset=0, FrIfPduRef=V_VEH
        FrStr_xcpdynamic254_1  # xcpdynamic254_1
          sn_fdeafba7ae254e1e80d60b106053d532_1_7d44d6d889bf437cb0ff888debf8555c_1 (FrIfPdusInFrame): FrIfPduOffset=0, FrIfPduRef=xcpdynamic254_1
        FrStr_xcpdynamic254_2  # xcpdynamic254_2
          sn_ED55AF29C91C2294E0402EA019874515_1_ED55B6DAA560EF99E0402EA019870214_1 (FrIfPdusInFrame): FrIfPduOffset=0, FrIfPduRef=xcpdynamic254_2
        FrStr_xcpdynamic254_3  # xcpdynamic254_3
          sn_ED55AF29C91F2294E0402EA019874515_1_ED55CA2D406A1E52E0402EA01987021E_1 (FrIfPdusInFrame): FrIfPduOffset=0, FrIfPduRef=xcpdynamic254_3
        FrStr_xcpdynamic254_4  # xcpdynamic254_4
          sn_ED55D3C388349965E0402EA019872AD5_1_ED55AF29C92D2294E0402EA019874515_1 (FrIfPdusInFrame): FrIfPduOffset=0, FrIfPduRef=xcpdynamic254_4
        FrStr_xcpdynamic254_5  # xcpdynamic254_5
          sn_ED55AF29C9332294E0402EA019874515_1_ED55D568B7B1E932E0402EA019874AD0_1 (FrIfPdusInFrame): FrIfPduOffset=0, FrIfPduRef=xcpdynamic254_5
        FrStr_xcpdynamic254_6  # xcpdynamic254_6
          sn_ED55D568B7B7E932E0402EA019874AD0_1_ED55DDBF3F3F1652E0402EA01987662B_1 (FrIfPdusInFrame): FrIfPduOffset=0, FrIfPduRef=xcpdynamic254_6
        FrStr_xcpdynamic254_7  # xcpdynamic254_7
          sn_ED55EE5E9A7A36A4E0402EA019872B37_1_ED55EF63738BA24EE0402EA019872B3F_1 (FrIfPdusInFrame): FrIfPduOffset=0, FrIfPduRef=xcpdynamic254_7
        FrStr_xcpdynamic254_8  # xcpdynamic254_8
          sn_ED55EE5E9A8836A4E0402EA019872B37_1_ED55FD352928D633E0402EA019872B44_1 (FrIfPdusInFrame): FrIfPduOffset=0, FrIfPduRef=xcpdynamic254_8
        FrStr_xcpmaster  # xcpmaster
          sn_6acd24342b914dee85c6ec4bb84bea56_4_2e91d703d77a465ba5c92f45777cf2d1_4 (FrIfPdusInFrame): FrIfPduOffset=0, FrIfPduRef=dummy32bmaster
        FrStr_xcpslave  # xcpslave
          sn_2ed003fa08904453b0dfb985d50da316_4_039aef2810e44f2c9248813621a8312e_4 (FrIfPdusInFrame): FrIfPduOffset=0, FrIfPduRef=dummy32bslave
        FrStr_xcpstatic_1fa5cd47_Out  # xcpstatic
          sn_d6c051138a624b7197665ea502ed9c68_3_9779c0f9609648bfa4441a0865c580a6_3 (FrIfPdusInFrame): FrIfPduOffset=0, FrIfPduRef=dummy16bstatic
        FrStr_xcpstatic_31d6b02c_Out  # xcpstatic
          sn_d6c051138a624b7197665ea502ed9c68_3_9779c0f9609648bfa4441a0865c580a6_3 (FrIfPdusInFrame): FrIfPduOffset=0, FrIfPduRef=dummy16bstatic
        FrStr_xcpstatic_7ff9780c_Out  # xcpstatic
          sn_d6c051138a624b7197665ea502ed9c68_3_9779c0f9609648bfa4441a0865c580a6_3 (FrIfPdusInFrame): FrIfPduOffset=0, FrIfPduRef=dummy16bstatic
        FrStr_xcpstatic_a26fa189_Out  # xcpstatic
          sn_d6c051138a624b7197665ea502ed9c68_3_9779c0f9609648bfa4441a0865c580a6_3 (FrIfPdusInFrame): FrIfPduOffset=0, FrIfPduRef=dummy16bstatic
        FrStr_xcpstatic_ec4069a9_Out  # xcpstatic
          sn_d6c051138a624b7197665ea502ed9c68_3_9779c0f9609648bfa4441a0865c580a6_3 (FrIfPdusInFrame): FrIfPduOffset=0, FrIfPduRef=dummy16bstatic
      52 x FrIfPdu:
        ACLNY_MASSCNTR
          FrIfPduDirection
            FrIfRxPdu_ACLNY_MASSCNTR (FrIfRxPdu): FrIfUserRxIndicationUL=PDUR, FrIfRxPduRef=pduTr_ACLNY_MASSCNTR_A_FlexRay_pduPort_EPS_A_FlexRay_IN_7d601c47_052bff33  # ACLNY_MASSCNTR
        AVL_FORC_GRD
          FrIfPduDirection
            FrIfTxPdu_AVL_FORC_GRD (FrIfTxPdu): FrIfUserTxUL=PDUR, FrIfTxPduRef=pduTr_AVL_FORC_GRD_A_FlexRay_pduPort_EPS_A_FlexRay_OUT_7d601c47_052bff33  # AVL_FORC_GRD
        AVL_PO_EPS
          FrIfPduDirection
            FrIfTxPdu_AVL_PO_EPS (FrIfTxPdu): FrIfUserTxUL=PDUR, FrIfTxPduRef=pduTr_AVL_PO_EPS_A_FlexRay_pduPort_EPS_A_FlexRay_OUT_7d601c47_052bff33  # AVL_PO_EPS
        AVL_RPM_WHL
          FrIfPduDirection
            FrIfRxPdu_AVL_RPM_WHL (FrIfRxPdu): FrIfUserRxIndicationUL=PDUR, FrIfRxPduRef=pduTr_AVL_RPM_WHL_A_FlexRay_pduPort_EPS_A_FlexRay_IN_7d601c47_052bff33  # AVL_RPM_WHL
        AVL_STMOM_DV_ACT
          FrIfPduDirection
            FrIfTxPdu_AVL_STMOM_DV_ACT (FrIfTxPdu): FrIfUserTxUL=PDUR, FrIfTxPduRef=pduTr_AVL_STMOM_DV_ACT_A_FlexRay_pduPort_EPS_A_FlexRay_OUT_7d601c47_052bff33  # AVL_STMOM_DV_ACT
        A_TEMP
          FrIfPduDirection
            FrIfRxPdu_A_TEMP (FrIfRxPdu): FrIfUserRxIndicationUL=PDUR, FrIfRxPduRef=pduTr_A_TEMP_A_FlexRay_pduPort_EPS_A_FlexRay_IN_7d601c47_052bff33  # A_TEMP
        CON_VEH
          FrIfPduDirection
            FrIfRxPdu_CON_VEH (FrIfRxPdu): FrIfUserRxIndicationUL=PDUR, FrIfRxPduRef=pduTr_CON_VEH_A_FlexRay_pduPort_EPS_A_FlexRay_IN_7d601c47_052bff33  # CON_VEH
        CTR_DIAG_OBD_DRDY
          FrIfPduDirection
            FrIfRxPdu_CTR_DIAG_OBD_DRDY (FrIfRxPdu): FrIfUserRxIndicationUL=PDUR, FrIfRxPduRef=pduTr_CTR_DIAG_OBD_DRDY_A_FlexRay_pduPort_EPS_A_FlexRay_IN_7d601c47_052bff33  # CTR_DIAG_OBD_DRDY
        CTR_VIB_STW_DISP_EXMI_SP2015
          FrIfPduDirection
            FrIfRxPdu_CTR_VIB_STW_DISP_EXMI_SP2015 (FrIfRxPdu): FrIfUserRxIndicationUL=PDUR, FrIfRxPduRef=pduTr_CTR_VIB_STW_DISP_EXMI_SP2015_A_FlexRay_pduPort_EPS_A_FlexRay_IN_7d601c47_052bff33  # CTR_VIB_STW_DISP_EXMI_SP2015
        DIAG_OBD_ENG
          FrIfPduDirection
            FrIfRxPdu_DIAG_OBD_ENG (FrIfRxPdu): FrIfUserRxIndicationUL=PDUR, FrIfRxPduRef=pduTr_DIAG_OBD_ENG_A_FlexRay_pduPort_EPS_A_FlexRay_IN_7d601c47_052bff33  # DIAG_OBD_ENG
        DISP_CC_EPS
          FrIfPduDirection
            FrIfTxPdu_DISP_CC_EPS (FrIfTxPdu): FrIfUserTxUL=PDUR, FrIfTxPduRef=pduTr_DISP_CC_EPS_A_FlexRay_pduPort_EPS_A_FlexRay_OUT_7d601c47_052bff33  # DISP_CC_EPS
        DT_EST
          FrIfPduDirection
            FrIfTxPdu_DT_EST (FrIfTxPdu): FrIfUserTxUL=PDUR, FrIfTxPduRef=pduTr_DT_EST_A_FlexRay_pduPort_EPS_A_FlexRay_OUT_7d601c47_052bff33  # DT_EST
        ENERG_DGR_DRDY
          FrIfPduDirection
            FrIfRxPdu_ENERG_DGR_DRDY (FrIfRxPdu): FrIfUserRxIndicationUL=PDUR, FrIfRxPduRef=pduTr_ENERG_DGR_DRDY_A_FlexRay_pduPort_EPS_A_FlexRay_IN_7d601c47_052bff33  # ENERG_DGR_DRDY
        ENGTORQ_EPS
          FrIfPduDirection
            FrIfTxPdu_ENGTORQ_EPS (FrIfTxPdu): FrIfUserTxUL=PDUR, FrIfTxPduRef=pduTr_ENGTORQ_EPS_A_FlexRay_pduPort_EPS_A_FlexRay_OUT_7d601c47_052bff33  # ENGTORQ_EPS
        ENSU_SFY
          FrIfPduDirection
            FrIfRxPdu_ENSU_SFY (FrIfRxPdu): FrIfUserRxIndicationUL=PDUR, FrIfRxPduRef=pduTr_ENSU_SFY_A_FlexRay_pduPort_EPS_A_FlexRay_IN_7d601c47_052bff33  # ENSU_SFY
        ERRM_BN_U
          FrIfPduDirection
            FrIfRxPdu_ERRM_BN_U (FrIfRxPdu): FrIfUserRxIndicationUL=PDUR, FrIfRxPduRef=pduTr_ERRM_BN_U_A_FlexRay_pduPort_EPS_A_FlexRay_IN_7d601c47_052bff33  # ERRM_BN_U
        FAHRGESTELLNUMMER
          FrIfPduDirection
            FrIfRxPdu_FAHRGESTELLNUMMER (FrIfRxPdu): FrIfUserRxIndicationUL=PDUR, FrIfRxPduRef=pduTr_FAHRGESTELLNUMMER_A_FlexRay_pduPort_EPS_A_FlexRay_IN_7d601c47_052bff33  # FAHRGESTELLNUMMER
        FR_DBG_EPS
          FrIfPduDirection
            FrIfTxPdu_FR_DBG_EPS (FrIfTxPdu): FrIfUserTxUL=PDUR, FrIfTxPduRef=pduTr_FR_DBG_EPS_A_FlexRay_pduPort_EPS_A_FlexRay_OUT_7d601c47_052bff33  # FR_DBG_EPS
        FZZSTD
          FrIfPduDirection
            FrIfRxPdu_FZZSTD (FrIfRxPdu): FrIfUserRxIndicationUL=PDUR, FrIfRxPduRef=pduTr_FZZSTD_A_FlexRay_pduPort_EPS_A_FlexRay_IN_7d601c47_052bff33  # FZZSTD
        KILOMETERSTAND
          FrIfPduDirection
            FrIfRxPdu_KILOMETERSTAND (FrIfRxPdu): FrIfUserRxIndicationUL=PDUR, FrIfRxPduRef=pduTr_KILOMETERSTAND_A_FlexRay_pduPort_EPS_A_FlexRay_IN_7d601c47_052bff33  # KILOMETERSTAND
        OFFS_QUAD_EPS
          FrIfPduDirection
            FrIfRxPdu_OFFS_QUAD_EPS (FrIfRxPdu): FrIfUserRxIndicationUL=PDUR, FrIfRxPduRef=pduTr_OFFS_QUAD_EPS_A_FlexRay_pduPort_EPS_A_FlexRay_IN_7d601c47_052bff33  # OFFS_QUAD_EPS
        RELATIVZEIT
          FrIfPduDirection
            FrIfRxPdu_RELATIVZEIT (FrIfRxPdu): FrIfUserRxIndicationUL=PDUR, FrIfRxPduRef=pduTr_RELATIVZEIT_A_FlexRay_pduPort_EPS_A_FlexRay_IN_7d601c47_052bff33  # RELATIVZEIT
        SECU_FAHRGESTELLNUMMER
          FrIfPduDirection
            FrIfRxPdu_SECU_FAHRGESTELLNUMMER (FrIfRxPdu): FrIfUserRxIndicationUL=PDUR, FrIfRxPduRef=pduTr_SECU_FAHRGESTELLNUMMER_A_FlexRay_pduPort_EPS_A_FlexRay_IN_7d601c47_052bff33  # SECU_FAHRGESTELLNUMMER
        STEA_OFFS
          FrIfPduDirection
            FrIfRxPdu_STEA_OFFS (FrIfRxPdu): FrIfUserRxIndicationUL=PDUR, FrIfRxPduRef=pduTr_STEA_OFFS_A_FlexRay_pduPort_EPS_A_FlexRay_IN_7d601c47_052bff33  # STEA_OFFS
        ST_CENG
          FrIfPduDirection
            FrIfRxPdu_ST_CENG (FrIfRxPdu): FrIfUserRxIndicationUL=PDUR, FrIfRxPduRef=pduTr_ST_CENG_A_FlexRay_pduPort_EPS_A_FlexRay_IN_7d601c47_052bff33  # ST_CENG
        ST_DIAG_OBD_3_DRDY
          FrIfPduDirection
            FrIfTxPdu_ST_DIAG_OBD_3_DRDY (FrIfTxPdu): FrIfUserTxUL=PDUR, FrIfTxPduRef=pduTr_ST_DIAG_OBD_3_DRDY_A_FlexRay_pduPort_EPS_A_FlexRay_OUT_7d601c47_052bff33  # ST_DIAG_OBD_3_DRDY
        ST_ENERG_GEN
          FrIfPduDirection
            FrIfRxPdu_ST_ENERG_GEN (FrIfRxPdu): FrIfUserRxIndicationUL=PDUR, FrIfRxPduRef=pduTr_ST_ENERG_GEN_A_FlexRay_pduPort_EPS_A_FlexRay_IN_7d601c47_052bff33  # ST_ENERG_GEN
        ST_EST
          FrIfPduDirection
            FrIfTxPdu_ST_EST (FrIfTxPdu): FrIfUserTxUL=PDUR, FrIfTxPduRef=pduTr_ST_EST_A_FlexRay_pduPort_EPS_A_FlexRay_OUT_7d601c47_052bff33  # ST_EST
        ST_STAB_DSC
          FrIfPduDirection
            FrIfRxPdu_ST_STAB_DSC (FrIfRxPdu): FrIfUserRxIndicationUL=PDUR, FrIfRxPduRef=pduTr_ST_STAB_DSC_A_FlexRay_pduPort_EPS_A_FlexRay_IN_7d601c47_052bff33  # ST_STAB_DSC
        SU_CLE_DRDY_DXP
          FrIfPduDirection
            FrIfRxPdu_SU_CLE_DRDY_DXP (FrIfRxPdu): FrIfUserRxIndicationUL=PDUR, FrIfRxPduRef=pduTr_SU_CLE_DRDY_DXP_A_FlexRay_pduPort_EPS_A_FlexRay_IN_7d601c47_052bff33  # SU_CLE_DRDY_DXP
        SU_EPS
          FrIfPduDirection
            FrIfTxPdu_SU_EPS (FrIfTxPdu): FrIfUserTxUL=PDUR, FrIfTxPduRef=pduTr_SU_EPS_A_FlexRay_pduPort_EPS_A_FlexRay_OUT_7d601c47_052bff33  # SU_EPS
        SVC_In
          FrIfPduDirection
            FrIfRxPdu_SVC (FrIfRxPdu): FrIfUserRxIndicationUL=CDD, FrIfRxPduRef=EcucPduCollection/SVC_434514f6_In  # SVC
        SVC_Out
          FrIfPduDirection
            FrIfTxPdu_SVC (FrIfTxPdu): FrIfUserTxUL=CDD, FrIfTxPduRef=EcucPduCollection/SVC_434514f6_Out  # SVC
        TAR_ESTP_VIRT_FTAX
          FrIfPduDirection
            FrIfRxPdu_TAR_ESTP_VIRT_FTAX (FrIfRxPdu): FrIfUserRxIndicationUL=PDUR, FrIfRxPduRef=pduTr_TAR_ESTP_VIRT_FTAX_A_FlexRay_pduPort_EPS_A_FlexRay_IN_7d601c47_052bff33  # TAR_ESTP_VIRT_FTAX
        TAR_QTA_STRMOM_DV
          FrIfPduDirection
            FrIfRxPdu_TAR_QTA_STRMOM_DV (FrIfRxPdu): FrIfUserRxIndicationUL=PDUR, FrIfRxPduRef=pduTr_TAR_QTA_STRMOM_DV_A_FlexRay_pduPort_EPS_A_FlexRay_IN_7d601c47_052bff33  # TAR_QTA_STRMOM_DV
        TAR_STMOM_DV_ACT
          FrIfPduDirection
            FrIfRxPdu_TAR_STMOM_DV_ACT (FrIfRxPdu): FrIfUserRxIndicationUL=PDUR, FrIfRxPduRef=pduTr_TAR_STMOM_DV_ACT_A_FlexRay_pduPort_EPS_A_FlexRay_IN_7d601c47_052bff33  # TAR_STMOM_DV_ACT
        TL_BRC_FR_32
          FrIfPduDirection
            FrIfRxPdu_TL_BRC_FR_32 (FrIfRxPdu): FrIfUserRxIndicationUL=CDD, FrIfRxPduRef=pduTr_TL_BRC_FR_32_A_FlexRay_pduPort_EPS_A_FlexRay_IN_7d601c47_052bff33  # TL_BRC_FR_32
        TL_ECU_TRNSM_FR_32
          FrIfPduDirection
            FrIfTxPdu_TL_ECU_TRNSM_FR_32 (FrIfTxPdu): FrIfUserTxUL=CDD, FrIfTxPduRef=pduTr_TL_ECU_TRNSM_FR_32_A_FlexRay_pduPort_EPS_A_FlexRay_OUT_7d601c47_052bff33  # TL_ECU_TRNSM_FR_32
        TL_MST_GW_TRNSM_FR_254
          FrIfPduDirection
            FrIfRxPdu_TL_MST_GW_TRNSM_FR_254 (FrIfRxPdu): FrIfUserRxIndicationUL=CDD, FrIfRxPduRef=pduTr_TL_MST_GW_TRNSM_FR_254_A_FlexRay_pduPort_EPS_A_FlexRay_IN_7d601c47_052bff33  # TL_MST_GW_TRNSM_FR_254
        VYAW_VEH
          FrIfPduDirection
            FrIfRxPdu_VYAW_VEH (FrIfRxPdu): FrIfUserRxIndicationUL=PDUR, FrIfRxPduRef=pduTr_VYAW_VEH_A_FlexRay_pduPort_EPS_A_FlexRay_IN_7d601c47_052bff33  # VYAW_VEH
        V_VEH
          FrIfPduDirection
            FrIfRxPdu_V_VEH (FrIfRxPdu): FrIfUserRxIndicationUL=PDUR, FrIfRxPduRef=pduTr_V_VEH_A_FlexRay_pduPort_EPS_A_FlexRay_IN_7d601c47_052bff33  # V_VEH
        dummy16bstatic
          FrIfPduDirection
            FrIfTxPdu_dummy16bstatic (FrIfTxPdu): FrIfUserTxUL=XCP, FrIfTxPduRef=pduTr_dummy16bstatic_A_FlexRay_pduPort_EPS_A_FlexRay_OUT_7d601c47_052bff33  # dummy16bstatic
        dummy32bmaster
          FrIfPduDirection
            FrIfRxPdu_dummy32bmaster (FrIfRxPdu): FrIfUserRxIndicationUL=XCP, FrIfRxPduRef=pduTr_dummy32bmaster_A_FlexRay_pduPort_EPS_A_FlexRay_IN_7d601c47_052bff33  # dummy32bmaster
        dummy32bslave
          FrIfPduDirection
            FrIfTxPdu_dummy32bslave (FrIfTxPdu): FrIfUserTxUL=XCP, FrIfTxPduRef=pduTr_dummy32bslave_A_FlexRay_pduPort_EPS_A_FlexRay_OUT_7d601c47_052bff33  # dummy32bslave
        xcpdynamic254_1
          FrIfPduDirection
            FrIfTxPdu_xcpdynamic254_1 (FrIfTxPdu): FrIfUserTxUL=XCP, FrIfTxPduRef=pduTr_xcpdynamic254_1_A_FlexRay_pduPort_EPS_A_FlexRay_OUT_7d601c47_052bff33  # xcpdynamic254_1
        xcpdynamic254_2
          FrIfPduDirection
            FrIfTxPdu_xcpdynamic254_2 (FrIfTxPdu): FrIfUserTxUL=XCP, FrIfTxPduRef=pduTr_xcpdynamic254_2_A_FlexRay_pduPort_EPS_A_FlexRay_OUT_7d601c47_052bff33  # xcpdynamic254_2
        xcpdynamic254_3
          FrIfPduDirection
            FrIfTxPdu_xcpdynamic254_3 (FrIfTxPdu): FrIfUserTxUL=XCP, FrIfTxPduRef=pduTr_xcpdynamic254_3_A_FlexRay_pduPort_EPS_A_FlexRay_OUT_7d601c47_052bff33  # xcpdynamic254_3
        xcpdynamic254_4
          FrIfPduDirection
            FrIfTxPdu_xcpdynamic254_4 (FrIfTxPdu): FrIfUserTxUL=XCP, FrIfTxPduRef=pduTr_xcpdynamic254_4_A_FlexRay_pduPort_EPS_A_FlexRay_OUT_7d601c47_052bff33  # xcpdynamic254_4
        xcpdynamic254_5
          FrIfPduDirection
            FrIfTxPdu_xcpdynamic254_5 (FrIfTxPdu): FrIfUserTxUL=XCP, FrIfTxPduRef=pduTr_xcpdynamic254_5_A_FlexRay_pduPort_EPS_A_FlexRay_OUT_7d601c47_052bff33  # xcpdynamic254_5
        xcpdynamic254_6
          FrIfPduDirection
            FrIfTxPdu_xcpdynamic254_6 (FrIfTxPdu): FrIfUserTxUL=XCP, FrIfTxPduRef=pduTr_xcpdynamic254_6_A_FlexRay_pduPort_EPS_A_FlexRay_OUT_7d601c47_052bff33  # xcpdynamic254_6
        xcpdynamic254_7
          FrIfPduDirection
            FrIfTxPdu_xcpdynamic254_7 (FrIfTxPdu): FrIfUserTxUL=XCP, FrIfTxPduRef=pduTr_xcpdynamic254_7_A_FlexRay_pduPort_EPS_A_FlexRay_OUT_7d601c47_052bff33  # xcpdynamic254_7
        xcpdynamic254_8
          FrIfPduDirection
            FrIfTxPdu_xcpdynamic254_8 (FrIfTxPdu): FrIfUserTxUL=XCP, FrIfTxPduRef=pduTr_xcpdynamic254_8_A_FlexRay_pduPort_EPS_A_FlexRay_OUT_7d601c47_052bff33  # xcpdynamic254_8
    FrIfGeneral
  module config FrSM
    FrSMConfig
      A_FlexRay_5b5a9ac2 (FrSMCluster): FrSMComMNetworkHandleRef=ComMConfigSet/A_FlexRay_5b5a9ac2, FrSMFrIfClusterRef=A_FlexRay
  module config IpduM
    IpduMConfig
      pduTr_SVC_A_FlexRay_434514f6_In (IpduMRxPathway)  # SVC
        pduTr_SVC_A_FlexRay_434514f6_In (IpduMRxIndication): IpduMByteOrder=LITTLE_ENDIAN, IpduMRxIndicationPduRef=EcucPduCollection/SVC_434514f6_In
          ANFRAGE_23008def (IpduMRxDynamicPart): IpduMRxSelectorValue=1, IpduMOutgoingDynamicPduRef=EcucPduCollection/ANFRAGE_434514f6_In
            SegmentPosition_0 (IpduMSegment): IpduMSegmentLength=64, IpduMSegmentPosition=0
          SECU_RESP_23008def (IpduMRxDynamicPart): IpduMRxSelectorValue=247, IpduMOutgoingDynamicPduRef=pduTr_SECU_RESP_A_FlexRay_pduPort_EPS_A_FlexRay_IN_7d601c47_052bff33
            SegmentPosition_0 (IpduMSegment): IpduMSegmentLength=64, IpduMSegmentPosition=0
          IpduMSelectorFieldPosition: IpduMSelectorFieldLength=8, IpduMSelectorFieldPosition=0
      pduTr_FR_DBG_EPS_A_FlexRay_7d601c47 (IpduMTxPathway)  # FR_DBG_EPS
        pduTr_FR_DBG_EPS_A_FlexRay_7d601c47 (IpduMTxRequest):
          IpduMByteOrder = LITTLE_ENDIAN
          IpduMTxTriggerMode = DYNAMIC_PART_TRIGGER
          IpduMInitialDynamicPart = pduTr_FR_DBG_EPS_A_FlexRay_7d601c47/DBG_EPS_BS_MOD_58_BYTE_23008def
          IpduMOutgoingPduRef = pduTr_FR_DBG_EPS_A_FlexRay_pduPort_EPS_A_FlexRay_OUT_7d601c47_052bff33
          IpduMSelectorFieldPosition: IpduMSelectorFieldLength=8, IpduMSelectorFieldPosition=0
          DBG_EPS_BS_MOD_58_BYTE_23008def (IpduMTxDynamicPart): IpduMTxDynamicPduRef=pduTr_DBG_EPS_BS_MOD_58_BYTE_A_FlexRay_pduPort_EPS_A_FlexRay_OUT_7d601c47_052bff33
            SegmentPosition_0 (IpduMSegment): IpduMSegmentLength=464, IpduMSegmentPosition=0
          DBG_EPS_MOD_EXT_120_BYTE_23008def (IpduMTxDynamicPart): IpduMTxDynamicPduRef=pduTr_DBG_EPS_MOD_EXT_120_BYTE_A_FlexRay_pduPort_EPS_A_FlexRay_OUT_7d601c47_052bff33
            SegmentPosition_0 (IpduMSegment): IpduMSegmentLength=464, IpduMSegmentPosition=0
      pduTr_SVC_A_FlexRay_434514f6_Out (IpduMTxPathway)  # SVC
        pduTr_SVC_A_FlexRay_434514f6_Out (IpduMTxRequest):
          IpduMByteOrder = LITTLE_ENDIAN
          IpduMTxTriggerMode = DYNAMIC_PART_TRIGGER
          IpduMInitialDynamicPart = pduTr_SVC_A_FlexRay_434514f6_Out/ANFRAGE_23008def
          IpduMOutgoingPduRef = EcucPduCollection/SVC_434514f6_Out
          IpduMSelectorFieldPosition: IpduMSelectorFieldLength=8, IpduMSelectorFieldPosition=0
          3 x IpduMTxDynamicPart:
            ANFRAGE_23008def: IpduMTxDynamicPduRef=EcucPduCollection/ANFRAGE_434514f6_Out
              SegmentPosition_0 (IpduMSegment): IpduMSegmentLength=64, IpduMSegmentPosition=0
            RQ_STG_EFAN_23008def: IpduMTxDynamicPduRef=pduTr_RQ_STG_EFAN_A_FlexRay_pduPort_EPS_A_FlexRay_OUT_7d601c47_052bff33
              SegmentPosition_0 (IpduMSegment): IpduMSegmentLength=64, IpduMSegmentPosition=0
            SECU_CHAL_23008def: IpduMTxDynamicPduRef=pduTr_SECU_CHAL_A_FlexRay_pduPort_EPS_A_FlexRay_OUT_7d601c47_052bff33
              SegmentPosition_0 (IpduMSegment): IpduMSegmentLength=64, IpduMSegmentPosition=0
    IPduMGeneral (IpduMGeneral): IpduMStaticPartExists=false
  module config PduR
    PduRGeneral
    PduRRoutingTables
      PduRRoutingTable
        45 x PduRRoutingPath:
          ANFRAGE_434514f6_In
            DST_ANFRAGE_434514f6_In (PduRDestPdu): PduRDestPduRef=EcucPduCollection/ANFRAGE_434514f6_In
            SRC_ANFRAGE_434514f6_In (PduRSrcPdu): PduRSrcPduRef=EcucPduCollection/ANFRAGE_434514f6_In
          ANFRAGE_434514f6_Out
            DST_ANFRAGE_434514f6_Out (PduRDestPdu): PduRDestPduRef=EcucPduCollection/ANFRAGE_434514f6_Out
            SRC_ANFRAGE_434514f6_Out (PduRSrcPdu): PduRSrcPduRef=EcucPduCollection/ANFRAGE_434514f6_Out
          Fr_pduTr_ACLNY_MASSCNTR_A_FlexRay_7d601c47  # ACLNY_MASSCNTR
            DST_Fr_pduTr_ACLNY_MASSCNTR_A_FlexRay_7d601c47 (PduRDestPdu): PduRDestPduRef=pduTr_ACLNY_MASSCNTR_A_FlexRay_pduPort_EPS_A_FlexRay_IN_7d601c47_052bff33
            SRC_Fr_pduTr_ACLNY_MASSCNTR_A_FlexRay_7d601c47 (PduRSrcPdu): PduRSrcPduRef=pduTr_ACLNY_MASSCNTR_A_FlexRay_pduPort_EPS_A_FlexRay_IN_7d601c47_052bff33
          Fr_pduTr_AVL_FORC_GRD_A_FlexRay_7d601c47  # AVL_FORC_GRD
            DST_Fr_pduTr_AVL_FORC_GRD_A_FlexRay_7d601c47 (PduRDestPdu): PduRDestPduRef=pduTr_AVL_FORC_GRD_A_FlexRay_pduPort_EPS_A_FlexRay_OUT_7d601c47_052bff33
            SRC_Fr_pduTr_AVL_FORC_GRD_A_FlexRay_7d601c47 (PduRSrcPdu): PduRSrcPduRef=pduTr_AVL_FORC_GRD_A_FlexRay_pduPort_EPS_A_FlexRay_OUT_7d601c47_052bff33
          Fr_pduTr_AVL_PO_EPS_A_FlexRay_7d601c47  # AVL_PO_EPS
            DST_Fr_pduTr_AVL_PO_EPS_A_FlexRay_7d601c47 (PduRDestPdu): PduRDestPduRef=pduTr_AVL_PO_EPS_A_FlexRay_pduPort_EPS_A_FlexRay_OUT_7d601c47_052bff33
            SRC_Fr_pduTr_AVL_PO_EPS_A_FlexRay_7d601c47 (PduRSrcPdu): PduRSrcPduRef=pduTr_AVL_PO_EPS_A_FlexRay_pduPort_EPS_A_FlexRay_OUT_7d601c47_052bff33
          Fr_pduTr_AVL_RPM_WHL_A_FlexRay_7d601c47  # AVL_RPM_WHL
            DST_Fr_pduTr_AVL_RPM_WHL_A_FlexRay_7d601c47 (PduRDestPdu): PduRDestPduRef=pduTr_AVL_RPM_WHL_A_FlexRay_pduPort_EPS_A_FlexRay_IN_7d601c47_052bff33
            SRC_Fr_pduTr_AVL_RPM_WHL_A_FlexRay_7d601c47 (PduRSrcPdu): PduRSrcPduRef=pduTr_AVL_RPM_WHL_A_FlexRay_pduPort_EPS_A_FlexRay_IN_7d601c47_052bff33
          Fr_pduTr_AVL_STMOM_DV_ACT_A_FlexRay_7d601c47  # AVL_STMOM_DV_ACT
            DST_Fr_pduTr_AVL_STMOM_DV_ACT_A_FlexRay_7d601c47 (PduRDestPdu): PduRDestPduRef=pduTr_AVL_STMOM_DV_ACT_A_FlexRay_pduPort_EPS_A_FlexRay_OUT_7d601c47_052bff33
            SRC_Fr_pduTr_AVL_STMOM_DV_ACT_A_FlexRay_7d601c47 (PduRSrcPdu): PduRSrcPduRef=pduTr_AVL_STMOM_DV_ACT_A_FlexRay_pduPort_EPS_A_FlexRay_OUT_7d601c47_052bff33
          Fr_pduTr_A_TEMP_A_FlexRay_7d601c47  # A_TEMP
            DST_Fr_pduTr_A_TEMP_A_FlexRay_7d601c47 (PduRDestPdu): PduRDestPduRef=pduTr_A_TEMP_A_FlexRay_pduPort_EPS_A_FlexRay_IN_7d601c47_052bff33
            SRC_Fr_pduTr_A_TEMP_A_FlexRay_7d601c47 (PduRSrcPdu): PduRSrcPduRef=pduTr_A_TEMP_A_FlexRay_pduPort_EPS_A_FlexRay_IN_7d601c47_052bff33
          Fr_pduTr_CON_VEH_A_FlexRay_7d601c47  # CON_VEH
            DST_Fr_pduTr_CON_VEH_A_FlexRay_7d601c47 (PduRDestPdu): PduRDestPduRef=pduTr_CON_VEH_A_FlexRay_pduPort_EPS_A_FlexRay_IN_7d601c47_052bff33
            SRC_Fr_pduTr_CON_VEH_A_FlexRay_7d601c47 (PduRSrcPdu): PduRSrcPduRef=pduTr_CON_VEH_A_FlexRay_pduPort_EPS_A_FlexRay_IN_7d601c47_052bff33
          Fr_pduTr_CTR_DIAG_OBD_DRDY_A_FlexRay_7d601c47  # CTR_DIAG_OBD_DRDY
            DST_Fr_pduTr_CTR_DIAG_OBD_DRDY_A_FlexRay_7d601c47 (PduRDestPdu): PduRDestPduRef=pduTr_CTR_DIAG_OBD_DRDY_A_FlexRay_pduPort_EPS_A_FlexRay_IN_7d601c47_052bff33
            SRC_Fr_pduTr_CTR_DIAG_OBD_DRDY_A_FlexRay_7d601c47 (PduRSrcPdu): PduRSrcPduRef=pduTr_CTR_DIAG_OBD_DRDY_A_FlexRay_pduPort_EPS_A_FlexRay_IN_7d601c47_052bff33
          Fr_pduTr_CTR_VIB_STW_DISP_EXMI_SP2015_A_FlexRay_7d601c47  # CTR_VIB_STW_DISP_EXMI_SP2015
            DST_Fr_pduTr_CTR_VIB_STW_DISP_EXMI_SP2015_A_FlexRay_7d601c47 (PduRDestPdu): PduRDestPduRef=pduTr_CTR_VIB_STW_DISP_EXMI_SP2015_A_FlexRay_pduPort_EPS_A_FlexRay_IN_7d601c47_052bff33
            SRC_Fr_pduTr_CTR_VIB_STW_DISP_EXMI_SP2015_A_FlexRay_7d601c47 (PduRSrcPdu): PduRSrcPduRef=pduTr_CTR_VIB_STW_DISP_EXMI_SP2015_A_FlexRay_pduPort_EPS_A_FlexRay_IN_7d601c47_052bff33
          Fr_pduTr_DBG_EPS_BS_MOD_58_BYTE_A_FlexRay_7d601c47  # DBG_EPS_BS_MOD_58_BYTE
            DST_Fr_pduTr_DBG_EPS_BS_MOD_58_BYTE_A_FlexRay_7d601c47 (PduRDestPdu): PduRDestPduRef=pduTr_DBG_EPS_BS_MOD_58_BYTE_A_FlexRay_pduPort_EPS_A_FlexRay_OUT_7d601c47_052bff33
            SRC_Fr_pduTr_DBG_EPS_BS_MOD_58_BYTE_A_FlexRay_7d601c47 (PduRSrcPdu): PduRSrcPduRef=pduTr_DBG_EPS_BS_MOD_58_BYTE_A_FlexRay_pduPort_EPS_A_FlexRay_OUT_7d601c47_052bff33
          Fr_pduTr_DBG_EPS_MOD_EXT_120_BYTE_A_FlexRay_7d601c47  # DBG_EPS_MOD_EXT_120_BYTE
            DST_Fr_pduTr_DBG_EPS_MOD_EXT_120_BYTE_A_FlexRay_7d601c47 (PduRDestPdu): PduRDestPduRef=pduTr_DBG_EPS_MOD_EXT_120_BYTE_A_FlexRay_pduPort_EPS_A_FlexRay_OUT_7d601c47_052bff33
            SRC_Fr_pduTr_DBG_EPS_MOD_EXT_120_BYTE_A_FlexRay_7d601c47 (PduRSrcPdu): PduRSrcPduRef=pduTr_DBG_EPS_MOD_EXT_120_BYTE_A_FlexRay_pduPort_EPS_A_FlexRay_OUT_7d601c47_052bff33
          Fr_pduTr_DIAG_OBD_ENG_A_FlexRay_7d601c47  # DIAG_OBD_ENG
            DST_Fr_pduTr_DIAG_OBD_ENG_A_FlexRay_7d601c47 (PduRDestPdu): PduRDestPduRef=pduTr_DIAG_OBD_ENG_A_FlexRay_pduPort_EPS_A_FlexRay_IN_7d601c47_052bff33
            SRC_Fr_pduTr_DIAG_OBD_ENG_A_FlexRay_7d601c47 (PduRSrcPdu): PduRSrcPduRef=pduTr_DIAG_OBD_ENG_A_FlexRay_pduPort_EPS_A_FlexRay_IN_7d601c47_052bff33
          Fr_pduTr_DISP_CC_EPS_A_FlexRay_7d601c47  # DISP_CC_EPS
            DST_Fr_pduTr_DISP_CC_EPS_A_FlexRay_7d601c47 (PduRDestPdu): PduRDestPduRef=pduTr_DISP_CC_EPS_A_FlexRay_pduPort_EPS_A_FlexRay_OUT_7d601c47_052bff33
            SRC_Fr_pduTr_DISP_CC_EPS_A_FlexRay_7d601c47 (PduRSrcPdu): PduRSrcPduRef=pduTr_DISP_CC_EPS_A_FlexRay_pduPort_EPS_A_FlexRay_OUT_7d601c47_052bff33
          Fr_pduTr_DT_EST_A_FlexRay_7d601c47  # DT_EST
            DST_Fr_pduTr_DT_EST_A_FlexRay_7d601c47 (PduRDestPdu): PduRDestPduRef=pduTr_DT_EST_A_FlexRay_pduPort_EPS_A_FlexRay_OUT_7d601c47_052bff33
            SRC_Fr_pduTr_DT_EST_A_FlexRay_7d601c47 (PduRSrcPdu): PduRSrcPduRef=pduTr_DT_EST_A_FlexRay_pduPort_EPS_A_FlexRay_OUT_7d601c47_052bff33
          Fr_pduTr_ENERG_DGR_DRDY_A_FlexRay_7d601c47  # ENERG_DGR_DRDY
            DST_Fr_pduTr_ENERG_DGR_DRDY_A_FlexRay_7d601c47 (PduRDestPdu): PduRDestPduRef=pduTr_ENERG_DGR_DRDY_A_FlexRay_pduPort_EPS_A_FlexRay_IN_7d601c47_052bff33
            SRC_Fr_pduTr_ENERG_DGR_DRDY_A_FlexRay_7d601c47 (PduRSrcPdu): PduRSrcPduRef=pduTr_ENERG_DGR_DRDY_A_FlexRay_pduPort_EPS_A_FlexRay_IN_7d601c47_052bff33
          Fr_pduTr_ENGTORQ_EPS_A_FlexRay_7d601c47  # ENGTORQ_EPS
            DST_Fr_pduTr_ENGTORQ_EPS_A_FlexRay_7d601c47 (PduRDestPdu): PduRDestPduRef=pduTr_ENGTORQ_EPS_A_FlexRay_pduPort_EPS_A_FlexRay_OUT_7d601c47_052bff33
            SRC_Fr_pduTr_ENGTORQ_EPS_A_FlexRay_7d601c47 (PduRSrcPdu): PduRSrcPduRef=pduTr_ENGTORQ_EPS_A_FlexRay_pduPort_EPS_A_FlexRay_OUT_7d601c47_052bff33
          Fr_pduTr_ENSU_SFY_A_FlexRay_7d601c47  # ENSU_SFY
            DST_Fr_pduTr_ENSU_SFY_A_FlexRay_7d601c47 (PduRDestPdu): PduRDestPduRef=pduTr_ENSU_SFY_A_FlexRay_pduPort_EPS_A_FlexRay_IN_7d601c47_052bff33
            SRC_Fr_pduTr_ENSU_SFY_A_FlexRay_7d601c47 (PduRSrcPdu): PduRSrcPduRef=pduTr_ENSU_SFY_A_FlexRay_pduPort_EPS_A_FlexRay_IN_7d601c47_052bff33
          Fr_pduTr_ERRM_BN_U_A_FlexRay_7d601c47  # ERRM_BN_U
            DST_Fr_pduTr_ERRM_BN_U_A_FlexRay_7d601c47 (PduRDestPdu): PduRDestPduRef=pduTr_ERRM_BN_U_A_FlexRay_pduPort_EPS_A_FlexRay_IN_7d601c47_052bff33
            SRC_Fr_pduTr_ERRM_BN_U_A_FlexRay_7d601c47 (PduRSrcPdu): PduRSrcPduRef=pduTr_ERRM_BN_U_A_FlexRay_pduPort_EPS_A_FlexRay_IN_7d601c47_052bff33
          Fr_pduTr_FAHRGESTELLNUMMER_A_FlexRay_7d601c47  # FAHRGESTELLNUMMER
            DST_Fr_pduTr_FAHRGESTELLNUMMER_A_FlexRay_7d601c47 (PduRDestPdu): PduRDestPduRef=pduTr_FAHRGESTELLNUMMER_A_FlexRay_pduPort_EPS_A_FlexRay_IN_7d601c47_052bff33
            SRC_Fr_pduTr_FAHRGESTELLNUMMER_A_FlexRay_7d601c47 (PduRSrcPdu): PduRSrcPduRef=pduTr_FAHRGESTELLNUMMER_A_FlexRay_pduPort_EPS_A_FlexRay_IN_7d601c47_052bff33
          Fr_pduTr_FR_DBG_EPS_A_FlexRay_7d601c47  # FR_DBG_EPS
            DST_Fr_pduTr_FR_DBG_EPS_A_FlexRay_7d601c47 (PduRDestPdu): PduRDestPduRef=pduTr_FR_DBG_EPS_A_FlexRay_pduPort_EPS_A_FlexRay_OUT_7d601c47_052bff33
            SRC_Fr_pduTr_FR_DBG_EPS_A_FlexRay_7d601c47 (PduRSrcPdu): PduRSrcPduRef=pduTr_FR_DBG_EPS_A_FlexRay_pduPort_EPS_A_FlexRay_OUT_7d601c47_052bff33
          Fr_pduTr_FZZSTD_A_FlexRay_7d601c47  # FZZSTD
            DST_Fr_pduTr_FZZSTD_A_FlexRay_7d601c47 (PduRDestPdu): PduRDestPduRef=pduTr_FZZSTD_A_FlexRay_pduPort_EPS_A_FlexRay_IN_7d601c47_052bff33
            SRC_Fr_pduTr_FZZSTD_A_FlexRay_7d601c47 (PduRSrcPdu): PduRSrcPduRef=pduTr_FZZSTD_A_FlexRay_pduPort_EPS_A_FlexRay_IN_7d601c47_052bff33
          Fr_pduTr_KILOMETERSTAND_A_FlexRay_7d601c47  # KILOMETERSTAND
            DST_Fr_pduTr_KILOMETERSTAND_A_FlexRay_7d601c47 (PduRDestPdu): PduRDestPduRef=pduTr_KILOMETERSTAND_A_FlexRay_pduPort_EPS_A_FlexRay_IN_7d601c47_052bff33
            SRC_Fr_pduTr_KILOMETERSTAND_A_FlexRay_7d601c47 (PduRSrcPdu): PduRSrcPduRef=pduTr_KILOMETERSTAND_A_FlexRay_pduPort_EPS_A_FlexRay_IN_7d601c47_052bff33
          Fr_pduTr_OFFS_QUAD_EPS_A_FlexRay_7d601c47  # OFFS_QUAD_EPS
            DST_Fr_pduTr_OFFS_QUAD_EPS_A_FlexRay_7d601c47 (PduRDestPdu): PduRDestPduRef=pduTr_OFFS_QUAD_EPS_A_FlexRay_pduPort_EPS_A_FlexRay_IN_7d601c47_052bff33
            SRC_Fr_pduTr_OFFS_QUAD_EPS_A_FlexRay_7d601c47 (PduRSrcPdu): PduRSrcPduRef=pduTr_OFFS_QUAD_EPS_A_FlexRay_pduPort_EPS_A_FlexRay_IN_7d601c47_052bff33
          Fr_pduTr_RELATIVZEIT_A_FlexRay_7d601c47  # RELATIVZEIT
            DST_Fr_pduTr_RELATIVZEIT_A_FlexRay_7d601c47 (PduRDestPdu): PduRDestPduRef=pduTr_RELATIVZEIT_A_FlexRay_pduPort_EPS_A_FlexRay_IN_7d601c47_052bff33
            SRC_Fr_pduTr_RELATIVZEIT_A_FlexRay_7d601c47 (PduRSrcPdu): PduRSrcPduRef=pduTr_RELATIVZEIT_A_FlexRay_pduPort_EPS_A_FlexRay_IN_7d601c47_052bff33
          Fr_pduTr_RQ_STG_EFAN_A_FlexRay_7d601c47  # RQ_STG_EFAN
            DST_Fr_pduTr_RQ_STG_EFAN_A_FlexRay_7d601c47 (PduRDestPdu): PduRDestPduRef=pduTr_RQ_STG_EFAN_A_FlexRay_pduPort_EPS_A_FlexRay_OUT_7d601c47_052bff33
            SRC_Fr_pduTr_RQ_STG_EFAN_A_FlexRay_7d601c47 (PduRSrcPdu): PduRSrcPduRef=pduTr_RQ_STG_EFAN_A_FlexRay_pduPort_EPS_A_FlexRay_OUT_7d601c47_052bff33
          Fr_pduTr_SECU_CHAL_A_FlexRay_7d601c47  # SECU_CHAL
            DST_Fr_pduTr_SECU_CHAL_A_FlexRay_7d601c47 (PduRDestPdu): PduRDestPduRef=pduTr_SECU_CHAL_A_FlexRay_pduPort_EPS_A_FlexRay_OUT_7d601c47_052bff33
            SRC_Fr_pduTr_SECU_CHAL_A_FlexRay_7d601c47 (PduRSrcPdu): PduRSrcPduRef=pduTr_SECU_CHAL_A_FlexRay_pduPort_EPS_A_FlexRay_OUT_7d601c47_052bff33
          Fr_pduTr_SECU_FAHRGESTELLNUMMER_A_FlexRay_7d601c47  # SECU_FAHRGESTELLNUMMER
            DST_Fr_pduTr_SECU_FAHRGESTELLNUMMER_A_FlexRay_7d601c47 (PduRDestPdu): PduRDestPduRef=pduTr_SECU_FAHRGESTELLNUMMER_A_FlexRay_pduPort_EPS_A_FlexRay_IN_7d601c47_052bff33
            SRC_Fr_pduTr_SECU_FAHRGESTELLNUMMER_A_FlexRay_7d601c47 (PduRSrcPdu): PduRSrcPduRef=pduTr_SECU_FAHRGESTELLNUMMER_A_FlexRay_pduPort_EPS_A_FlexRay_IN_7d601c47_052bff33
          Fr_pduTr_SECU_RESP_A_FlexRay_7d601c47  # SECU_RESP
            DST_Fr_pduTr_SECU_RESP_A_FlexRay_7d601c47 (PduRDestPdu): PduRDestPduRef=pduTr_SECU_RESP_A_FlexRay_pduPort_EPS_A_FlexRay_IN_7d601c47_052bff33
            SRC_Fr_pduTr_SECU_RESP_A_FlexRay_7d601c47 (PduRSrcPdu): PduRSrcPduRef=pduTr_SECU_RESP_A_FlexRay_pduPort_EPS_A_FlexRay_IN_7d601c47_052bff33
          Fr_pduTr_STEA_OFFS_A_FlexRay_7d601c47  # STEA_OFFS
            DST_Fr_pduTr_STEA_OFFS_A_FlexRay_7d601c47 (PduRDestPdu): PduRDestPduRef=pduTr_STEA_OFFS_A_FlexRay_pduPort_EPS_A_FlexRay_IN_7d601c47_052bff33
            SRC_Fr_pduTr_STEA_OFFS_A_FlexRay_7d601c47 (PduRSrcPdu): PduRSrcPduRef=pduTr_STEA_OFFS_A_FlexRay_pduPort_EPS_A_FlexRay_IN_7d601c47_052bff33
          Fr_pduTr_ST_CENG_A_FlexRay_7d601c47  # ST_CENG
            DST_Fr_pduTr_ST_CENG_A_FlexRay_7d601c47 (PduRDestPdu): PduRDestPduRef=pduTr_ST_CENG_A_FlexRay_pduPort_EPS_A_FlexRay_IN_7d601c47_052bff33
            SRC_Fr_pduTr_ST_CENG_A_FlexRay_7d601c47 (PduRSrcPdu): PduRSrcPduRef=pduTr_ST_CENG_A_FlexRay_pduPort_EPS_A_FlexRay_IN_7d601c47_052bff33
          Fr_pduTr_ST_DIAG_OBD_3_DRDY_A_FlexRay_7d601c47  # ST_DIAG_OBD_3_DRDY
            DST_Fr_pduTr_ST_DIAG_OBD_3_DRDY_A_FlexRay_7d601c47 (PduRDestPdu): PduRDestPduRef=pduTr_ST_DIAG_OBD_3_DRDY_A_FlexRay_pduPort_EPS_A_FlexRay_OUT_7d601c47_052bff33
            SRC_Fr_pduTr_ST_DIAG_OBD_3_DRDY_A_FlexRay_7d601c47 (PduRSrcPdu): PduRSrcPduRef=pduTr_ST_DIAG_OBD_3_DRDY_A_FlexRay_pduPort_EPS_A_FlexRay_OUT_7d601c47_052bff33
          Fr_pduTr_ST_ENERG_GEN_A_FlexRay_7d601c47  # ST_ENERG_GEN
            DST_Fr_pduTr_ST_ENERG_GEN_A_FlexRay_7d601c47 (PduRDestPdu): PduRDestPduRef=pduTr_ST_ENERG_GEN_A_FlexRay_pduPort_EPS_A_FlexRay_IN_7d601c47_052bff33
            SRC_Fr_pduTr_ST_ENERG_GEN_A_FlexRay_7d601c47 (PduRSrcPdu): PduRSrcPduRef=pduTr_ST_ENERG_GEN_A_FlexRay_pduPort_EPS_A_FlexRay_IN_7d601c47_052bff33
          Fr_pduTr_ST_EST_A_FlexRay_7d601c47  # ST_EST
            DST_Fr_pduTr_ST_EST_A_FlexRay_7d601c47 (PduRDestPdu): PduRDestPduRef=pduTr_ST_EST_A_FlexRay_pduPort_EPS_A_FlexRay_OUT_7d601c47_052bff33
            SRC_Fr_pduTr_ST_EST_A_FlexRay_7d601c47 (PduRSrcPdu): PduRSrcPduRef=pduTr_ST_EST_A_FlexRay_pduPort_EPS_A_FlexRay_OUT_7d601c47_052bff33
          Fr_pduTr_ST_STAB_DSC_A_FlexRay_7d601c47  # ST_STAB_DSC
            DST_Fr_pduTr_ST_STAB_DSC_A_FlexRay_7d601c47 (PduRDestPdu): PduRDestPduRef=pduTr_ST_STAB_DSC_A_FlexRay_pduPort_EPS_A_FlexRay_IN_7d601c47_052bff33
            SRC_Fr_pduTr_ST_STAB_DSC_A_FlexRay_7d601c47 (PduRSrcPdu): PduRSrcPduRef=pduTr_ST_STAB_DSC_A_FlexRay_pduPort_EPS_A_FlexRay_IN_7d601c47_052bff33
          Fr_pduTr_SU_CLE_DRDY_DXP_A_FlexRay_7d601c47  # SU_CLE_DRDY_DXP
            DST_Fr_pduTr_SU_CLE_DRDY_DXP_A_FlexRay_7d601c47 (PduRDestPdu): PduRDestPduRef=pduTr_SU_CLE_DRDY_DXP_A_FlexRay_pduPort_EPS_A_FlexRay_IN_7d601c47_052bff33
            SRC_Fr_pduTr_SU_CLE_DRDY_DXP_A_FlexRay_7d601c47 (PduRSrcPdu): PduRSrcPduRef=pduTr_SU_CLE_DRDY_DXP_A_FlexRay_pduPort_EPS_A_FlexRay_IN_7d601c47_052bff33
          Fr_pduTr_SU_EPS_A_FlexRay_7d601c47  # SU_EPS
            DST_Fr_pduTr_SU_EPS_A_FlexRay_7d601c47 (PduRDestPdu): PduRDestPduRef=pduTr_SU_EPS_A_FlexRay_pduPort_EPS_A_FlexRay_OUT_7d601c47_052bff33
            SRC_Fr_pduTr_SU_EPS_A_FlexRay_7d601c47 (PduRSrcPdu): PduRSrcPduRef=pduTr_SU_EPS_A_FlexRay_pduPort_EPS_A_FlexRay_OUT_7d601c47_052bff33
          Fr_pduTr_TAR_ESTP_VIRT_FTAX_A_FlexRay_7d601c47  # TAR_ESTP_VIRT_FTAX
            DST_Fr_pduTr_TAR_ESTP_VIRT_FTAX_A_FlexRay_7d601c47 (PduRDestPdu): PduRDestPduRef=pduTr_TAR_ESTP_VIRT_FTAX_A_FlexRay_pduPort_EPS_A_FlexRay_IN_7d601c47_052bff33
            SRC_Fr_pduTr_TAR_ESTP_VIRT_FTAX_A_FlexRay_7d601c47 (PduRSrcPdu): PduRSrcPduRef=pduTr_TAR_ESTP_VIRT_FTAX_A_FlexRay_pduPort_EPS_A_FlexRay_IN_7d601c47_052bff33
          Fr_pduTr_TAR_QTA_STRMOM_DV_A_FlexRay_7d601c47  # TAR_QTA_STRMOM_DV
            DST_Fr_pduTr_TAR_QTA_STRMOM_DV_A_FlexRay_7d601c47 (PduRDestPdu): PduRDestPduRef=pduTr_TAR_QTA_STRMOM_DV_A_FlexRay_pduPort_EPS_A_FlexRay_IN_7d601c47_052bff33
            SRC_Fr_pduTr_TAR_QTA_STRMOM_DV_A_FlexRay_7d601c47 (PduRSrcPdu): PduRSrcPduRef=pduTr_TAR_QTA_STRMOM_DV_A_FlexRay_pduPort_EPS_A_FlexRay_IN_7d601c47_052bff33
          Fr_pduTr_TAR_STMOM_DV_ACT_A_FlexRay_7d601c47  # TAR_STMOM_DV_ACT
            DST_Fr_pduTr_TAR_STMOM_DV_ACT_A_FlexRay_7d601c47 (PduRDestPdu): PduRDestPduRef=pduTr_TAR_STMOM_DV_ACT_A_FlexRay_pduPort_EPS_A_FlexRay_IN_7d601c47_052bff33
            SRC_Fr_pduTr_TAR_STMOM_DV_ACT_A_FlexRay_7d601c47 (PduRSrcPdu): PduRSrcPduRef=pduTr_TAR_STMOM_DV_ACT_A_FlexRay_pduPort_EPS_A_FlexRay_IN_7d601c47_052bff33
          Fr_pduTr_VYAW_VEH_A_FlexRay_7d601c47  # VYAW_VEH
            DST_Fr_pduTr_VYAW_VEH_A_FlexRay_7d601c47 (PduRDestPdu): PduRDestPduRef=pduTr_VYAW_VEH_A_FlexRay_pduPort_EPS_A_FlexRay_IN_7d601c47_052bff33
            SRC_Fr_pduTr_VYAW_VEH_A_FlexRay_7d601c47 (PduRSrcPdu): PduRSrcPduRef=pduTr_VYAW_VEH_A_FlexRay_pduPort_EPS_A_FlexRay_IN_7d601c47_052bff33
          Fr_pduTr_V_VEH_A_FlexRay_7d601c47  # V_VEH
            DST_Fr_pduTr_V_VEH_A_FlexRay_7d601c47 (PduRDestPdu): PduRDestPduRef=pduTr_V_VEH_A_FlexRay_pduPort_EPS_A_FlexRay_IN_7d601c47_052bff33
            SRC_Fr_pduTr_V_VEH_A_FlexRay_7d601c47 (PduRSrcPdu): PduRSrcPduRef=pduTr_V_VEH_A_FlexRay_pduPort_EPS_A_FlexRay_IN_7d601c47_052bff33
          SVC_434514f6_In
            DST_SVC_434514f6_In (PduRDestPdu): PduRDestPduRef=EcucPduCollection/SVC_434514f6_In
            SRC_SVC_434514f6_In (PduRSrcPdu): PduRSrcPduRef=EcucPduCollection/SVC_434514f6_In
          SVC_434514f6_Out
            DST_SVC_434514f6_Out (PduRDestPdu): PduRDestPduRef=EcucPduCollection/SVC_434514f6_Out
            SRC_SVC_434514f6_Out (PduRSrcPdu): PduRSrcPduRef=EcucPduCollection/SVC_434514f6_Out
  module config Xcp
    XcpConfig
      11 x XcpPdu:
        dummy16bstatic_23008def
          dummy16bstatic_23008def (XcpTxPdu): XcpTxPduRef=pduTr_dummy16bstatic_A_FlexRay_pduPort_EPS_A_FlexRay_OUT_7d601c47_052bff33
        dummy32bmaster_23008def
          dummy32bmaster_23008def (XcpRxPdu): XcpRxPduRef=pduTr_dummy32bmaster_A_FlexRay_pduPort_EPS_A_FlexRay_IN_7d601c47_052bff33
        dummy32bslave_23008def
          dummy32bslave_23008def (XcpTxPdu): XcpTxPduRef=pduTr_dummy32bslave_A_FlexRay_pduPort_EPS_A_FlexRay_OUT_7d601c47_052bff33
        xcpdynamic254_1_23008def
          xcpdynamic254_1_23008def (XcpTxPdu): XcpTxPduRef=pduTr_xcpdynamic254_1_A_FlexRay_pduPort_EPS_A_FlexRay_OUT_7d601c47_052bff33
        xcpdynamic254_2_23008def
          xcpdynamic254_2_23008def (XcpTxPdu): XcpTxPduRef=pduTr_xcpdynamic254_2_A_FlexRay_pduPort_EPS_A_FlexRay_OUT_7d601c47_052bff33
        xcpdynamic254_3_23008def
          xcpdynamic254_3_23008def (XcpTxPdu): XcpTxPduRef=pduTr_xcpdynamic254_3_A_FlexRay_pduPort_EPS_A_FlexRay_OUT_7d601c47_052bff33
        xcpdynamic254_4_23008def
          xcpdynamic254_4_23008def (XcpTxPdu): XcpTxPduRef=pduTr_xcpdynamic254_4_A_FlexRay_pduPort_EPS_A_FlexRay_OUT_7d601c47_052bff33
        xcpdynamic254_5_23008def
          xcpdynamic254_5_23008def (XcpTxPdu): XcpTxPduRef=pduTr_xcpdynamic254_5_A_FlexRay_pduPort_EPS_A_FlexRay_OUT_7d601c47_052bff33
        xcpdynamic254_6_23008def
          xcpdynamic254_6_23008def (XcpTxPdu): XcpTxPduRef=pduTr_xcpdynamic254_6_A_FlexRay_pduPort_EPS_A_FlexRay_OUT_7d601c47_052bff33
        xcpdynamic254_7_23008def
          xcpdynamic254_7_23008def (XcpTxPdu): XcpTxPduRef=pduTr_xcpdynamic254_7_A_FlexRay_pduPort_EPS_A_FlexRay_OUT_7d601c47_052bff33
        xcpdynamic254_8_23008def
          xcpdynamic254_8_23008def (XcpTxPdu): XcpTxPduRef=pduTr_xcpdynamic254_8_A_FlexRay_pduPort_EPS_A_FlexRay_OUT_7d601c47_052bff33
    XcpGeneral: XcpOnFlexRayEnabled=true
