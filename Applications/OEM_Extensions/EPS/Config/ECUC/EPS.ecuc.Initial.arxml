[part 2 of 3: package /InitialEcuC]
AUTOSAR XML (schema 4-3-0)
package /InitialEcuC  (continued)
  module config Dcm
    DcmConfigSet  # Project Standard Configuration
      DcmDsd  # Project Standard Configuration
        DcmDsdServiceTable  # Project Standard Configuration
          6 x DcmDsdService, all with DcmDsdSidTabSessionLevelRef=DcmDspSessionRow_EXTENDED_DIAGNOSTIC_SESSION:
            DcmDsdService_CLEAR_DIAGNOSTIC_INFORMATION: DcmDsdSidTabServiceId=20, DcmDsdSidTabSubfuncAvail=false, DcmDsdSidTabSessionLevelRef=DcmDspSessionRow_DEFAULT_SESSION  # Project Standard Configuration
            DcmDsdService_READ_DATA_BY_IDENTIFIER: DcmDsdSidTabServiceId=34, DcmDsdSidTabSubfuncAvail=false, DcmDsdSidTabSessionLevelRef=DcmDspSessionRow_CODING_SESSION, DcmDsdSidTabSessionLevelRef=DcmDspSessionRow_DEFAULT_SESSION, DcmDsdSidTabSessionLevelRef=DcmDspSessionRow_HDD_DOWNLOAD_SESSION  # Project Standard Configuration
            DcmDsdService_REQUEST_UPLOAD: DcmDsdSidTabServiceId=53, DcmDsdSidTabSubfuncAvail=false  # Project Standard Configuration
            DcmDsdService_ROUTINE_CONTROL: DcmDsdSidTabServiceId=49, DcmDsdSidTabSubfuncAvail=true, DcmDsdSidTabSessionLevelRef=DcmDspSessionRow_CODING_SESSION, DcmDsdSidTabSessionLevelRef=DcmDspSessionRow_DEFAULT_SESSION, DcmDsdSidTabSessionLevelRef=DcmDspSessionRow_HDD_DOWNLOAD_SESSION, DcmDsdSidTabSessionLevelRef=DcmDspSessionRow_SWT_SESSION  # Project Standard Configuration
            DcmDsdService_SECURITY_ACCESS: DcmDsdSidTabServiceId=39, DcmDsdSidTabSubfuncAvail=true  # Project Standard Configuration
              DcmDsdSubService_0x3 (DcmDsdSubService): DcmDsdSubServiceId=3, DcmDsdSubServiceSessionLevelRef=DcmDspSessionRow_EXTENDED_DIAGNOSTIC_SESSION  # Project Standard Configuration
              DcmDsdSubService_0x4 (DcmDsdSubService): DcmDsdSubServiceId=4, DcmDsdSubServiceSessionLevelRef=DcmDspSessionRow_EXTENDED_DIAGNOSTIC_SESSION  # Project Standard Configuration
            DcmDsdService_WRITE_DATA_BY_IDENTIFIER: DcmDsdSidTabServiceId=46, DcmDsdSidTabSubfuncAvail=false, DcmDsdSidTabSessionLevelRef=DcmDspSessionRow_CODING_SESSION, DcmDsdSidTabSessionLevelRef=DcmDspSessionRow_DEFAULT_SESSION  # Project Standard Configuration
      DcmDsl  # Project Standard Configuration
        DcmDslDiagResp: DcmDslDiagRespMaxNumRespPend=2, DcmDslDiagRespOnSecondDeclinedRequest=true  # Project Standard Configuration
        DcmDslProtocol  # Project Standard Configuration
          DcmDslProtocolRow_DCM_UDS_ON_FLEXRAY (DcmDslProtocolRow): DcmDslProtocolID=DCM_UDS_ON_FLEXRAY, DcmDslProtocolTransType=TYPE1, DcmSendRespPendOnTransToBoot=true  # Project Standard Configuration
            14 x DcmDslConnection:
              DcmDslConnection_0xF0  # Project Standard Configuration
                DcmDslMainConnection: DcmDslProtocolRxTesterSourceAddr=240  # Project Standard Configuration
                  DcmDslProtocolRx_0xF0_fu (DcmDslProtocolRx): DcmDslProtocolRxAddrType=DCM_FUNCTIONAL_TYPE  # Project Standard Configuration
                  DcmDslProtocolRx_0xF0_ph (DcmDslProtocolRx): DcmDslProtocolRxAddrType=DCM_PHYSICAL_TYPE  # Project Standard Configuration
                  DcmDslProtocolTx_0xF0 (DcmDslProtocolTx)  # Project Standard Configuration
              DcmDslConnection_0xF1  # Project Standard Configuration
                DcmDslMainConnection: DcmDslProtocolRxTesterSourceAddr=241  # Project Standard Configuration
                  DcmDslProtocolRx_0xF1_fu (DcmDslProtocolRx): DcmDslProtocolRxAddrType=DCM_FUNCTIONAL_TYPE  # Project Standard Configuration
                  DcmDslProtocolRx_0xF1_ph (DcmDslProtocolRx): DcmDslProtocolRxAddrType=DCM_PHYSICAL_TYPE  # Project Standard Configuration
                  DcmDslProtocolTx_0xF1 (DcmDslProtocolTx)  # Project Standard Configuration
              DcmDslConnection_0xF2  # Project Standard Configuration
                DcmDslMainConnection: DcmDslProtocolRxTesterSourceAddr=242  # Project Standard Configuration
                  DcmDslProtocolRx_0xF2_fu (DcmDslProtocolRx): DcmDslProtocolRxAddrType=DCM_FUNCTIONAL_TYPE  # Project Standard Configuration
                  DcmDslProtocolRx_0xF2_ph (DcmDslProtocolRx): DcmDslProtocolRxAddrType=DCM_PHYSICAL_TYPE  # Project Standard Configuration
                  DcmDslProtocolTx_0xF2 (DcmDslProtocolTx)  # Project Standard Configuration
              DcmDslConnection_0xF3  # Project Standard Configuration
                DcmDslMainConnection: DcmDslProtocolRxTesterSourceAddr=243  # Project Standard Configuration
                  DcmDslProtocolRx_0xF3_fu (DcmDslProtocolRx): DcmDslProtocolRxAddrType=DCM_FUNCTIONAL_TYPE  # Project Standard Configuration
                  DcmDslProtocolRx_0xF3_ph (DcmDslProtocolRx): DcmDslProtocolRxAddrType=DCM_PHYSICAL_TYPE  # Project Standard Configuration
                  DcmDslProtocolTx_0xF3 (DcmDslProtocolTx)  # Project Standard Configuration
              DcmDslConnection_0xF4  # Project Standard Configuration
                DcmDslMainConnection: DcmDslProtocolRxTesterSourceAddr=244  # Project Standard Configuration
                  DcmDslProtocolRx_0xF4_fu (DcmDslProtocolRx): DcmDslProtocolRxAddrType=DCM_FUNCTIONAL_TYPE  # Project Standard Configuration
                  DcmDslProtocolRx_0xF4_ph (DcmDslProtocolRx): DcmDslProtocolRxAddrType=DCM_PHYSICAL_TYPE  # Project Standard Configuration
                  DcmDslProtocolTx_0xF4 (DcmDslProtocolTx)  # Project Standard Configuration
              DcmDslConnection_0xF5  # Project Standard Configuration
                DcmDslMainConnection: DcmDslProtocolRxTesterSourceAddr=245  # Project Standard Configuration
                  DcmDslProtocolRx_0xF5_fu (DcmDslProtocolRx): DcmDslProtocolRxAddrType=DCM_FUNCTIONAL_TYPE  # Project Standard Configuration
                  DcmDslProtocolRx_0xF5_ph (DcmDslProtocolRx): DcmDslProtocolRxAddrType=DCM_PHYSICAL_TYPE  # Project Standard Configuration
                  DcmDslProtocolTx_0xF5 (DcmDslProtocolTx)  # Project Standard Configuration
              DcmDslConnection_0xF6  # Project Standard Configuration
                DcmDslMainConnection: DcmDslProtocolRxTesterSourceAddr=246  # Project Standard Configuration
                  DcmDslProtocolRx_0xF6_fu (DcmDslProtocolRx): DcmDslProtocolRxAddrType=DCM_FUNCTIONAL_TYPE  # Project Standard Configuration
                  DcmDslProtocolRx_0xF6_ph (DcmDslProtocolRx): DcmDslProtocolRxAddrType=DCM_PHYSICAL_TYPE  # Project Standard Configuration
                  DcmDslProtocolTx_0xF6 (DcmDslProtocolTx)  # Project Standard Configuration
              DcmDslConnection_0xF7  # Project Standard Configuration
                DcmDslMainConnection: DcmDslProtocolRxTesterSourceAddr=247  # Project Standard Configuration
                  DcmDslProtocolRx_0xF7_fu (DcmDslProtocolRx): DcmDslProtocolRxAddrType=DCM_FUNCTIONAL_TYPE  # Project Standard Configuration
                  DcmDslProtocolRx_0xF7_ph (DcmDslProtocolRx): DcmDslProtocolRxAddrType=DCM_PHYSICAL_TYPE  # Project Standard Configuration
                  DcmDslProtocolTx_0xF7 (DcmDslProtocolTx)  # Project Standard Configuration
              DcmDslConnection_0xF8  # Project Standard Configuration
                DcmDslMainConnection: DcmDslProtocolRxTesterSourceAddr=248  # Project Standard Configuration
                  DcmDslProtocolRx_0xF8_fu (DcmDslProtocolRx): DcmDslProtocolRxAddrType=DCM_FUNCTIONAL_TYPE  # Project Standard Configuration
                  DcmDslProtocolRx_0xF8_ph (DcmDslProtocolRx): DcmDslProtocolRxAddrType=DCM_PHYSICAL_TYPE  # Project Standard Configuration
                  DcmDslProtocolTx_0xF8 (DcmDslProtocolTx)  # Project Standard Configuration
              DcmDslConnection_0xF9  # Project Standard Configuration
                DcmDslMainConnection: DcmDslProtocolRxTesterSourceAddr=249  # Project Standard Configuration
                  DcmDslProtocolRx_0xF9_fu (DcmDslProtocolRx): DcmDslProtocolRxAddrType=DCM_FUNCTIONAL_TYPE  # Project Standard Configuration
                  DcmDslProtocolRx_0xF9_ph (DcmDslProtocolRx): DcmDslProtocolRxAddrType=DCM_PHYSICAL_TYPE  # Project Standard Configuration
                  DcmDslProtocolTx_0xF9 (DcmDslProtocolTx)  # Project Standard Configuration
              DcmDslConnection_0xFA  # Project Standard Configuration
                DcmDslMainConnection: DcmDslProtocolRxTesterSourceAddr=250  # Project Standard Configuration
                  DcmDslProtocolRx_0xFA_fu (DcmDslProtocolRx): DcmDslProtocolRxAddrType=DCM_FUNCTIONAL_TYPE  # Project Standard Configuration
                  DcmDslProtocolRx_0xFA_ph (DcmDslProtocolRx): DcmDslProtocolRxAddrType=DCM_PHYSICAL_TYPE  # Project Standard Configuration
                  DcmDslProtocolTx_0xFA (DcmDslProtocolTx)  # Project Standard Configuration
              DcmDslConnection_0xFB  # Project Standard Configuration
                DcmDslMainConnection: DcmDslProtocolRxTesterSourceAddr=251  # Project Standard Configuration
                  DcmDslProtocolRx_0xFB_fu (DcmDslProtocolRx): DcmDslProtocolRxAddrType=DCM_FUNCTIONAL_TYPE  # Project Standard Configuration
                  DcmDslProtocolRx_0xFB_ph (DcmDslProtocolRx): DcmDslProtocolRxAddrType=DCM_PHYSICAL_TYPE  # Project Standard Configuration
                  DcmDslProtocolTx_0xFB (DcmDslProtocolTx)  # Project Standard Configuration
              DcmDslConnection_0xFC  # Project Standard Configuration
                DcmDslMainConnection: DcmDslProtocolRxTesterSourceAddr=252  # Project Standard Configuration
                  DcmDslProtocolRx_0xFC_fu (DcmDslProtocolRx): DcmDslProtocolRxAddrType=DCM_FUNCTIONAL_TYPE  # Project Standard Configuration
                  DcmDslProtocolRx_0xFC_ph (DcmDslProtocolRx): DcmDslProtocolRxAddrType=DCM_PHYSICAL_TYPE  # Project Standard Configuration
                  DcmDslProtocolTx_0xFC (DcmDslProtocolTx)  # Project Standard Configuration
              DcmDslConnection_0xFD  # Project Standard Configuration
                DcmDslMainConnection: DcmDslProtocolRxTesterSourceAddr=253  # Project Standard Configuration
                  DcmDslProtocolRx_0xFD_fu (DcmDslProtocolRx): DcmDslProtocolRxAddrType=DCM_FUNCTIONAL_TYPE  # Project Standard Configuration
                  DcmDslProtocolRx_0xFD_ph (DcmDslProtocolRx): DcmDslProtocolRxAddrType=DCM_PHYSICAL_TYPE  # Project Standard Configuration
                  DcmDslProtocolTx_0xFD (DcmDslProtocolTx)  # Project Standard Configuration
        4 x DcmDslServiceRequestManufacturerNotification:
          Coding  # Project Standard Configuration
          Darh  # Project Standard Configuration
          StdDiag  # Project Standard Configuration
          Swt  # Project Standard Configuration
      DcmDsp: DcmDspMaxDidToRead=1  # Project Standard Configuration
        107 x DcmDspData, all with DcmDspDataType=UINT8:
          DcmDspData_ActiveDiagnosticSession: DcmDspDataConditionCheckReadFncUsed=true, DcmDspDataSize=8, DcmDspDataUsePort=USE_DATA_SYNCH_CLIENT_SERVER  # Project Standard Configuration
          DcmDspData_DmDtcAktiveMeldung: DcmDspDataConditionCheckReadFncUsed=true, DcmDspDataSize=168, DcmDspDataUsePort=USE_DATA_SYNCH_CLIENT_SERVER, DcmDspDataInfoRef=DcmDspDataInfo_bY4y4  # Project Standard Configuration
          DcmDspData_DmIsDtcActiveResponse: DcmDspDataConditionCheckReadFncUsed=true, DcmDspDataUsePort=USE_DATA_SYNCH_CLIENT_SERVER, DcmDspDataInfoRef=DcmDspDataInfo_GCft1  # Project Standard Configuration
          DcmDspData_EcuSerialNumber: DcmDspDataConditionCheckReadFncUsed=false, DcmDspDataSize=80, DcmDspDataUsePort=USE_DATA_SYNCH_CLIENT_SERVER  # Project Standard Configuration
          DcmDspData_EnergySavingState: DcmDspDataConditionCheckReadFncUsed=true, DcmDspDataSize=8, DcmDspDataUsePort=USE_DATA_SYNCH_CLIENT_SERVER  # Project Standard Configuration
          DcmDspData_EthGetNumberOfPorts: DcmDspDataSize=8  # Project Standard Configuration
          DcmDspData_EthPhyLinkState: DcmDspDataSize=24  # Project Standard Configuration
          DcmDspData_EthSignalQuality  # Project Standard Configuration
          DcmDspData_ExtendedEnergySavingState: DcmDspDataConditionCheckReadFncUsed=true, DcmDspDataSize=8, DcmDspDataUsePort=USE_DATA_SYNCH_CLIENT_SERVER  # Project Standard Configuration
          DcmDspData_FlashTimingParameter: DcmDspDataConditionCheckReadFncUsed=false, DcmDspDataSize=96, DcmDspDataUsePort=USE_DATA_SYNCH_CLIENT_SERVER  # Project Standard Configuration
          DcmDspData_HddDownloadStatus  # Project Standard Configuration
          DcmDspData_HddDownloadTimeToCompletion: DcmDspDataSize=32  # Project Standard Configuration
          DcmDspData_Herstelldatum: DcmDspDataConditionCheckReadFncUsed=false, DcmDspDataSize=24, DcmDspDataUsePort=USE_DATA_SYNCH_CLIENT_SERVER  # Project Standard Configuration
          DcmDspData_IndivDataTable: DcmDspDataConditionCheckReadFncUsed=false, DcmDspDataUsePort=USE_DATA_SYNCH_CLIENT_SERVER  # Project Standard Configuration
          DcmDspData_IpConfiguration: DcmDspDataConditionCheckReadFnc=EthDiagMM_CheckConditionReadDataIpConfig, DcmDspDataConditionCheckReadFncUsed=true, DcmDspDataReadFnc=EthDiagMM_ReadDataIpConfig, DcmDspDataSize=104, DcmDspDataUsePort=USE_DATA_SYNCH_FNC  # Project Standard Configuration
          DcmDspData_ListManipulationApplicationData  # Project Standard Configuration
          DcmDspData_ListManipulationGeneral  # Project Standard Configuration
          DcmDspData_ListManipulationSecureBoot  # Project Standard Configuration
          DcmDspData_ListManipulationSecurityArtifact  # Project Standard Configuration
          DcmDspData_ListManipulationSw  # Project Standard Configuration
          DcmDspData_MileKmEeprom: DcmDspDataSize=24  # Project Standard Configuration
          DcmDspData_PiaProfile0: DcmDspDataConditionCheckReadFncUsed=true, DcmDspDataUsePort=USE_DATA_ASYNCH_CLIENT_SERVER, DcmDspDataInfoRef=DcmDspData_PiaProfile0_1ZT4CR  # Project Standard Configuration
          DcmDspData_PiaProfile1: DcmDspDataConditionCheckReadFncUsed=true, DcmDspDataUsePort=USE_DATA_ASYNCH_CLIENT_SERVER, DcmDspDataInfoRef=DcmDspData_PiaProfile1_1ZT4CS  # Project Standard Configuration
          DcmDspData_PiaProfile2: DcmDspDataConditionCheckReadFncUsed=true, DcmDspDataUsePort=USE_DATA_ASYNCH_CLIENT_SERVER, DcmDspDataInfoRef=DcmDspData_PiaProfile2_1ZT4CT  # Project Standard Configuration
          DcmDspData_PiaProfileA: DcmDspDataConditionCheckReadFncUsed=true, DcmDspDataUsePort=USE_DATA_ASYNCH_CLIENT_SERVER, DcmDspDataInfoRef=DcmDspData_PiaProfileA_1ZT4D9  # Project Standard Configuration
          DcmDspData_ProgrammingCounter: DcmDspDataConditionCheckReadFncUsed=false, DcmDspDataSize=32, DcmDspDataUsePort=USE_DATA_SYNCH_CLIENT_SERVER  # Project Standard Configuration
          DcmDspData_ProgrammingCounterMaxValue: DcmDspDataConditionCheckReadFncUsed=false, DcmDspDataSize=16, DcmDspDataUsePort=USE_DATA_SYNCH_CLIENT_SERVER  # Project Standard Configuration
          DcmDspData_Pruefstempel: DcmDspDataSize=24  # Project Standard Configuration
          DcmDspData_ReadActiveSession: DcmDspDataConditionCheckReadFncUsed=true, DcmDspDataSize=8, DcmDspDataUsePort=USE_DATA_SYNCH_CLIENT_SERVER  # Project Standard Configuration
          DcmDspData_ReadActiveSessionState: DcmDspDataConditionCheckReadFncUsed=true, DcmDspDataSize=8, DcmDspDataUsePort=USE_DATA_SYNCH_CLIENT_SERVER  # Project Standard Configuration
          DcmDspData_ReadOpMode: DcmDspDataConditionCheckReadFncUsed=true, DcmDspDataSize=8, DcmDspDataUsePort=USE_DATA_SYNCH_CLIENT_SERVER  # Project Standard Configuration
          DcmDspData_ReadRoeState: DcmDspDataConditionCheckReadFncUsed=true, DcmDspDataSize=8, DcmDspDataUsePort=USE_DATA_SYNCH_CLIENT_SERVER  # Project Standard Configuration
          DcmDspData_Readhwmodificationindex: DcmDspDataSize=16  # Project Standard Configuration
          DcmDspData_Sekundaererfehlerspeicher  # Project Standard Configuration
          DcmDspData_SensorenAnzahlLesen: DcmDspDataSize=8  # Project Standard Configuration
          DcmDspData_SgbdIdx: DcmDspDataConditionCheckReadFncUsed=false, DcmDspDataSize=24, DcmDspDataUsePort=USE_DATA_SYNCH_CLIENT_SERVER  # Project Standard Configuration
          DcmDspData_StatusDmFssMaster: DcmDspDataSize=16  # Project Standard Configuration
          DcmDspData_StatusSystime: DcmDspDataSize=32  # Project Standard Configuration
          DcmDspData_SvkAktuell: DcmDspDataConditionCheckReadFncUsed=true, DcmDspDataUsePort=USE_DATA_ASYNCH_CLIENT_SERVER, DcmDspDataInfoRef=DcmDspData_SvkAktuell_57zZ9W  # Project Standard Configuration
          DcmDspData_SvkBackup{01..03}: DcmDspDataConditionCheckReadFncUsed=true, DcmDspDataUsePort=USE_DATA_ASYNCH_CLIENT_SERVER  # Project Standard Configuration
          DcmDspData_SvkBackup{04..61}  # Project Standard Configuration
          DcmDspData_SvkSysSupplier: DcmDspDataConditionCheckReadFncUsed=true, DcmDspDataUsePort=USE_DATA_ASYNCH_CLIENT_SERVER  # Project Standard Configuration
          DcmDspData_SvkWerk: DcmDspDataConditionCheckReadFncUsed=true, DcmDspDataUsePort=USE_DATA_ASYNCH_CLIENT_SERVER  # Project Standard Configuration
          DcmDspData_SwfkDeleteSupported: DcmDspDataConditionCheckReadFncUsed=false, DcmDspDataSize=8, DcmDspDataUsePort=USE_DATA_SYNCH_CLIENT_SERVER  # Project Standard Configuration
          DcmDspData_SystemSupplierIdentifier: DcmDspDataSize=24  # Project Standard Configuration
          DcmDspData_Systemzeit: DcmDspDataConditionCheckReadFncUsed=false, DcmDspDataSize=32, DcmDspDataUsePort=USE_DATA_SYNCH_CLIENT_SERVER  # Project Standard Configuration
          DcmDspData_Vin: DcmDspDataConditionCheckReadFncUsed=true, DcmDspDataSize=136, DcmDspDataUsePort=USE_DATA_ASYNCH_CLIENT_SERVER  # Project Standard Configuration
          DcmDspData_ZgwZertifikat  # Project Standard Configuration
        104 x DcmDspDid, all with DcmDspDidUsed=true:
          DcmDspDid_ActiveDiagnosticSession: DcmDspDidIdentifier=61830, DcmDspDidInfoRef=DcmDspDidInfo_ActiveDiagnosticSession  # Project Standard Configuration
            DcmDspDidSignal_ActiveDiagnosticSession (DcmDspDidSignal): DcmDspDidDataPos=0, DcmDspDidDataRef=DcmDspData_ActiveDiagnosticSession  # Project Standard Configuration
          DcmDspDid_DmDtcAktiveMeldung: DcmDspDidIdentifier=5892, DcmDspDidInfoRef=DcmDspDidInfo_DmDtcAktiveMeldung  # Project Standard Configuration
            DcmDspDidSignal_DmDtcAktiveMeldung (DcmDspDidSignal): DcmDspDidDataPos=0, DcmDspDidDataRef=DcmDspData_DmDtcAktiveMeldung  # Project Standard Configuration
          DcmDspDid_DmIsDtcActiveResponse: DcmDspDidIdentifier=5923, DcmDspDidInfoRef=DcmDspDidInfo_DmIsDtcActiveResponse  # Project Standard Configuration
            DcmDspDidSignal_DmIsDtcActiveResponse (DcmDspDidSignal): DcmDspDidDataPos=0, DcmDspDidDataRef=DcmDspData_DmIsDtcActiveResponse  # Project Standard Configuration
          DcmDspDid_EcuSerialNumber: DcmDspDidIdentifier=61836, DcmDspDidInfoRef=DcmDspDidInfo_EcuSerialNumber  # Project Standard Configuration
            DcmDspDidSignal_EcuSerialNumber (DcmDspDidSignal): DcmDspDidDataPos=0, DcmDspDidDataRef=DcmDspData_EcuSerialNumber  # Project Standard Configuration
          DcmDspDid_EnergySavingState: DcmDspDidIdentifier=4106, DcmDspDidInfoRef=DcmDspDidInfo_EnergySavingState  # Project Standard Configuration
            DcmDspDidSignal_EnergySavingState (DcmDspDidSignal): DcmDspDidDataPos=0, DcmDspDidDataRef=DcmDspData_EnergySavingState  # Project Standard Configuration
          DcmDspDid_EthGetNumberOfPorts: DcmDspDidIdentifier=6144, DcmDspDidInfoRef=DcmDspDidInfo_EthGetNumberOfPorts  # Project Standard Configuration
            DcmDspDidSignal_EthGetNumberOfPorts (DcmDspDidSignal): DcmDspDidDataPos=0, DcmDspDidDataRef=DcmDspData_EthGetNumberOfPorts  # Project Standard Configuration
          DcmDspDid_EthPhyLinkState: DcmDspDidIdentifier=6146, DcmDspDidInfoRef=DcmDspDidInfo_EthPhyLinkState  # Project Standard Configuration
            DcmDspDidSignal_EthPhyLinkState (DcmDspDidSignal): DcmDspDidDataPos=0, DcmDspDidDataRef=DcmDspData_EthPhyLinkState  # Project Standard Configuration
          DcmDspDid_EthSignalQuality: DcmDspDidIdentifier=6145, DcmDspDidInfoRef=DcmDspDidInfo_EthSignalQuality  # Project Standard Configuration
            DcmDspDidSignal_EthSignalQuality (DcmDspDidSignal): DcmDspDidDataPos=0, DcmDspDidDataRef=DcmDspData_EthSignalQuality  # Project Standard Configuration
          DcmDspDid_ExtendedEnergySavingState: DcmDspDidIdentifier=4110, DcmDspDidInfoRef=DcmDspDidInfo_ExtendedEnergySavingState  # Project Standard Configuration
            DcmDspDidSignal_ExtendedEnergySavingState (DcmDspDidSignal): DcmDspDidDataPos=0, DcmDspDidDataRef=DcmDspData_ExtendedEnergySavingState  # Project Standard Configuration
          DcmDspDid_FlashTimingParameter: DcmDspDidIdentifier=9476, DcmDspDidInfoRef=DcmDspDidInfo_FlashTimingParameter  # Project Standard Configuration
            DcmDspDidSignal_FlashTimingParameter (DcmDspDidSignal): DcmDspDidDataPos=0, DcmDspDidDataRef=DcmDspData_FlashTimingParameter  # Project Standard Configuration
          DcmDspDid_HddDownloadStatus: DcmDspDidIdentifier=9488, DcmDspDidInfoRef=DcmDspDidInfo_HddDownloadStatus  # Project Standard Configuration
            DcmDspDidSignal_HddDownloadStatus (DcmDspDidSignal): DcmDspDidDataPos=0, DcmDspDidDataRef=DcmDspData_HddDownloadStatus  # Project Standard Configuration
          DcmDspDid_HddDownloadTimeToCompletion: DcmDspDidIdentifier=9489, DcmDspDidInfoRef=DcmDspDidInfo_HddDownloadTimeToCompletion  # Project Standard Configuration
            DcmDspDidSignal_HddDownloadTimeToCompletion (DcmDspDidSignal): DcmDspDidDataPos=0, DcmDspDidDataRef=DcmDspData_HddDownloadTimeToCompletion  # Project Standard Configuration
          DcmDspDid_Herstelldatum: DcmDspDidIdentifier=61835, DcmDspDidInfoRef=DcmDspDidInfo_Herstelldatum  # Project Standard Configuration
            DcmDspDidSignal_Herstelldatum (DcmDspDidSignal): DcmDspDidDataPos=0, DcmDspDidDataRef=DcmDspData_Herstelldatum  # Project Standard Configuration
          DcmDspDid_IndivDataTable: DcmDspDidIdentifier=5940, DcmDspDidInfoRef=DcmDspDidInfo_IndivDataTable  # Project Standard Configuration
            DcmDspDidSignal_IndivDataTable (DcmDspDidSignal): DcmDspDidDataPos=0, DcmDspDidDataRef=DcmDspData_IndivDataTable  # Project Standard Configuration
          DcmDspDid_IpConfiguration: DcmDspDidIdentifier=5930, DcmDspDidInfoRef=DcmDspDidInfo_IpConfiguration  # Project Standard Configuration
            DcmDspDidSignal_IpConfiguration (DcmDspDidSignal): DcmDspDidDataPos=0, DcmDspDidDataRef=DcmDspData_IpConfiguration  # Project Standard Configuration
          DcmDspDid_ListManipulationApplicationData: DcmDspDidIdentifier=9618, DcmDspDidInfoRef=DcmDspDidInfo_ListManipulationApplicationData  # Project Standard Configuration
            DcmDspDidSignal_ListManipulationApplicationData (DcmDspDidSignal): DcmDspDidDataPos=0, DcmDspDidDataRef=DcmDspData_ListManipulationApplicationData  # Project Standard Configuration
          DcmDspDid_ListManipulationGeneral: DcmDspDidIdentifier=9620, DcmDspDidInfoRef=DcmDspDidInfo_ListManipulationGeneral  # Project Standard Configuration
            DcmDspDidSignal_ListManipulationGeneral (DcmDspDidSignal): DcmDspDidDataPos=0, DcmDspDidDataRef=DcmDspData_ListManipulationGeneral  # Project Standard Configuration
          DcmDspDid_ListManipulationSecureBoot: DcmDspDidIdentifier=9619, DcmDspDidInfoRef=DcmDspDidInfo_ListManipulationSecureBoot  # Project Standard Configuration
            DcmDspDidSignal_ListManipulationSecureBoot (DcmDspDidSignal): DcmDspDidDataPos=0, DcmDspDidDataRef=DcmDspData_ListManipulationSecureBoot  # Project Standard Configuration
          DcmDspDid_ListManipulationSecurityArtifact: DcmDspDidIdentifier=9616, DcmDspDidInfoRef=DcmDspDidInfo_ListManipulationSecurityArtifact  # Project Standard Configuration
            DcmDspDidSignal_ListManipulationSecurityArtifact (DcmDspDidSignal): DcmDspDidDataPos=0, DcmDspDidDataRef=DcmDspData_ListManipulationSecurityArtifact  # Project Standard Configuration
          DcmDspDid_ListManipulationSw: DcmDspDidIdentifier=9617, DcmDspDidInfoRef=DcmDspDidInfo_ListManipulationSw  # Project Standard Configuration
            DcmDspDidSignal_ListManipulationSw (DcmDspDidSignal): DcmDspDidDataPos=0, DcmDspDidDataRef=DcmDspData_ListManipulationSw  # Project Standard Configuration
          DcmDspDid_MileKmEeprom: DcmDspDidIdentifier=9536, DcmDspDidInfoRef=DcmDspDidInfo_MileKmEeprom  # Project Standard Configuration
            DcmDspDidSignal_MileKmEeprom (DcmDspDidSignal): DcmDspDidDataPos=0, DcmDspDidDataRef=DcmDspData_MileKmEeprom  # Project Standard Configuration
          DcmDspDid_PiaProfile0: DcmDspDidIdentifier=9568, DcmDspDidInfoRef=DcmDspDidInfo_PiaProfile0  # Project Standard Configuration
            DcmDspDidSignal_PiaProfile0 (DcmDspDidSignal): DcmDspDidDataPos=0, DcmDspDidDataRef=DcmDspData_PiaProfile0  # Project Standard Configuration
          DcmDspDid_PiaProfile1: DcmDspDidIdentifier=9569, DcmDspDidInfoRef=DcmDspDidInfo_PiaProfile1  # Project Standard Configuration
            DcmDspDidSignal_PiaProfile1 (DcmDspDidSignal): DcmDspDidDataPos=0, DcmDspDidDataRef=DcmDspData_PiaProfile1  # Project Standard Configuration
          DcmDspDid_PiaProfile2: DcmDspDidIdentifier=9570, DcmDspDidInfoRef=DcmDspDidInfo_PiaProfile2  # Project Standard Configuration
            DcmDspDidSignal_PiaProfile2 (DcmDspDidSignal): DcmDspDidDataPos=0, DcmDspDidDataRef=DcmDspData_PiaProfile2  # Project Standard Configuration
          DcmDspDid_PiaProfileA: DcmDspDidIdentifier=9571, DcmDspDidInfoRef=DcmDspDidInfo_PiaProfileA  # Project Standard Configuration
            DcmDspDidSignal_PiaProfileA (DcmDspDidSignal): DcmDspDidDataPos=0, DcmDspDidDataRef=DcmDspData_PiaProfileA  # Project Standard Configuration
          DcmDspDid_ProgrammingCounter: DcmDspDidIdentifier=9474, DcmDspDidInfoRef=DcmDspDidInfo_ProgrammingCounter  # Project Standard Configuration
            DcmDspDidSignal_ProgrammingCounter (DcmDspDidSignal): DcmDspDidDataPos=0, DcmDspDidDataRef=DcmDspData_ProgrammingCounter  # Project Standard Configuration
          DcmDspDid_ProgrammingCounterMaxValue: DcmDspDidIdentifier=9475, DcmDspDidInfoRef=DcmDspDidInfo_ProgrammingCounterMaxValue  # Project Standard Configuration
            DcmDspDidSignal_ProgrammingCounterMaxValue (DcmDspDidSignal): DcmDspDidDataPos=0, DcmDspDidDataRef=DcmDspData_ProgrammingCounterMaxValue  # Project Standard Configuration
          DcmDspDid_Pruefstempel: DcmDspDidIdentifier=4096, DcmDspDidInfoRef=DcmDspDidInfo_Pruefstempel  # Project Standard Configuration
            DcmDspDidSignal_Pruefstempel (DcmDspDidSignal): DcmDspDidDataPos=0, DcmDspDidDataRef=DcmDspData_Pruefstempel  # Project Standard Configuration
          DcmDspDid_ReadActiveSessionState: DcmDspDidIdentifier=61696, DcmDspDidInfoRef=DcmDspDidInfo_ReadActiveSessionState  # Project Standard Configuration
            4 x DcmDspDidSignal:
              DcmDspDidSignal_ReadActiveSession: DcmDspDidDataPos=0, DcmDspDidDataRef=DcmDspData_ReadActiveSession  # Project Standard Configuration
              DcmDspDidSignal_ReadActiveSessionState: DcmDspDidDataPos=8, DcmDspDidDataRef=DcmDspData_ReadActiveSessionState  # Project Standard Configuration
              DcmDspDidSignal_ReadOpMode: DcmDspDidDataPos=16, DcmDspDidDataRef=DcmDspData_ReadOpMode  # Project Standard Configuration
              DcmDspDidSignal_ReadRoeState: DcmDspDidDataPos=24, DcmDspDidDataRef=DcmDspData_ReadRoeState  # Project Standard Configuration
          DcmDspDid_Readhwmodificationindex: DcmDspDidIdentifier=61778, DcmDspDidInfoRef=DcmDspDidInfo_Readhwmodificationindex  # Project Standard Configuration
            DcmDspDidSignal_Readhwmodificationindex (DcmDspDidSignal): DcmDspDidDataPos=0, DcmDspDidDataRef=DcmDspData_Readhwmodificationindex  # Project Standard Configuration
          DcmDspDid_Sekundaererfehlerspeicher: DcmDspDidIdentifier=8192, DcmDspDidInfoRef=DcmDspDidInfo_Sekundaererfehlerspeicher  # Project Standard Configuration
            DcmDspDidSignal_Sekundaererfehlerspeicher (DcmDspDidSignal): DcmDspDidDataPos=0, DcmDspDidDataRef=DcmDspData_Sekundaererfehlerspeicher  # Project Standard Configuration
          DcmDspDid_SensorenAnzahlLesen: DcmDspDidIdentifier=5632, DcmDspDidInfoRef=DcmDspDidInfo_SensorenAnzahlLesen  # Project Standard Configuration
            DcmDspDidSignal_SensorenAnzahlLesen (DcmDspDidSignal): DcmDspDidDataPos=0, DcmDspDidDataRef=DcmDspData_SensorenAnzahlLesen  # Project Standard Configuration
          DcmDspDid_SgbdIdx: DcmDspDidIdentifier=61776, DcmDspDidInfoRef=DcmDspDidInfo_SgbdIdx  # Project Standard Configuration
            DcmDspDidSignal_SgbdIdx (DcmDspDidSignal): DcmDspDidDataPos=0, DcmDspDidDataRef=DcmDspData_SgbdIdx  # Project Standard Configuration
          DcmDspDid_StatusDmFssMaster: DcmDspDidIdentifier=5904, DcmDspDidInfoRef=DcmDspDidInfo_StatusDmFssMaster  # Project Standard Configuration
            DcmDspDidSignal_StatusDmFssMaster (DcmDspDidSignal): DcmDspDidDataPos=0, DcmDspDidDataRef=DcmDspData_StatusDmFssMaster  # Project Standard Configuration
          DcmDspDid_StatusSystime: DcmDspDidIdentifier=5925, DcmDspDidInfoRef=DcmDspDidInfo_StatusSystime  # Project Standard Configuration
            DcmDspDidSignal_StatusSystime (DcmDspDidSignal): DcmDspDidDataPos=0, DcmDspDidDataRef=DcmDspData_StatusSystime  # Project Standard Configuration
          DcmDspDid_SvkAktuell: DcmDspDidIdentifier=61697, DcmDspDidInfoRef=DcmDspDidInfo_SvkAktuell  # Project Standard Configuration
            DcmDspDidSignal_SvkAktuell (DcmDspDidSignal): DcmDspDidDataPos=0, DcmDspDidDataRef=DcmDspData_SvkAktuell  # Project Standard Configuration
          DcmDspDid_SvkBackup01: DcmDspDidIdentifier=61700, DcmDspDidInfoRef=DcmDspDidInfo_SvkBackup01  # Project Standard Configuration
            DcmDspDidSignal_SvkBackup01 (DcmDspDidSignal): DcmDspDidDataPos=0, DcmDspDidDataRef=DcmDspData_SvkBackup01  # Project Standard Configuration
          DcmDspDid_SvkBackup02: DcmDspDidIdentifier=61701, DcmDspDidInfoRef=DcmDspDidInfo_SvkBackup02  # Project Standard Configuration
            DcmDspDidSignal_SvkBackup02 (DcmDspDidSignal): DcmDspDidDataPos=0, DcmDspDidDataRef=DcmDspData_SvkBackup02  # Project Standard Configuration
          DcmDspDid_SvkBackup03: DcmDspDidIdentifier=61702, DcmDspDidInfoRef=DcmDspDidInfo_SvkBackup03  # Project Standard Configuration
            DcmDspDidSignal_SvkBackup03 (DcmDspDidSignal): DcmDspDidDataPos=0, DcmDspDidDataRef=DcmDspData_SvkBackup03  # Project Standard Configuration
          DcmDspDid_SvkBackup04: DcmDspDidIdentifier=61703, DcmDspDidInfoRef=DcmDspDidInfo_SvkBackup04  # Project Standard Configuration
            DcmDspDidSignal_SvkBackup04 (DcmDspDidSignal): DcmDspDidDataPos=0, DcmDspDidDataRef=DcmDspData_SvkBackup04  # Project Standard Configuration
          DcmDspDid_SvkBackup05: DcmDspDidIdentifier=61704, DcmDspDidInfoRef=DcmDspDidInfo_SvkBackup05  # Project Standard Configuration
            DcmDspDidSignal_SvkBackup05 (DcmDspDidSignal): DcmDspDidDataPos=0, DcmDspDidDataRef=DcmDspData_SvkBackup05  # Project Standard Configuration
          DcmDspDid_SvkBackup06: DcmDspDidIdentifier=61705, DcmDspDidInfoRef=DcmDspDidInfo_SvkBackup06  # Project Standard Configuration
            DcmDspDidSignal_SvkBackup06 (DcmDspDidSignal): DcmDspDidDataPos=0, DcmDspDidDataRef=DcmDspData_SvkBackup06  # Project Standard Configuration
          DcmDspDid_SvkBackup07: DcmDspDidIdentifier=61706, DcmDspDidInfoRef=DcmDspDidInfo_SvkBackup07  # Project Standard Configuration
            DcmDspDidSignal_SvkBackup07 (DcmDspDidSignal): DcmDspDidDataPos=0, DcmDspDidDataRef=DcmDspData_SvkBackup07  # Project Standard Configuration
          DcmDspDid_SvkBackup08: DcmDspDidIdentifier=61707, DcmDspDidInfoRef=DcmDspDidInfo_SvkBackup08  # Project Standard Configuration
            DcmDspDidSignal_SvkBackup08 (DcmDspDidSignal): DcmDspDidDataPos=0, DcmDspDidDataRef=DcmDspData_SvkBackup08  # Project Standard Configuration
          DcmDspDid_SvkBackup09: DcmDspDidIdentifier=61708, DcmDspDidInfoRef=DcmDspDidInfo_SvkBackup09  # Project Standard Configuration
            DcmDspDidSignal_SvkBackup09 (DcmDspDidSignal): DcmDspDidDataPos=0, DcmDspDidDataRef=DcmDspData_SvkBackup09  # Project Standard Configuration
          DcmDspDid_SvkBackup10: DcmDspDidIdentifier=61709, DcmDspDidInfoRef=DcmDspDidInfo_SvkBackup10  # Project Standard Configuration
            DcmDspDidSignal_SvkBackup10 (DcmDspDidSignal): DcmDspDidDataPos=0, DcmDspDidDataRef=DcmDspData_SvkBackup10  # Project Standard Configuration
          DcmDspDid_SvkBackup11: DcmDspDidIdentifier=61710, DcmDspDidInfoRef=DcmDspDidInfo_SvkBackup11  # Project Standard Configuration
            DcmDspDidSignal_SvkBackup11 (DcmDspDidSignal): DcmDspDidDataPos=0, DcmDspDidDataRef=DcmDspData_SvkBackup11  # Project Standard Configuration
          DcmDspDid_SvkBackup12: DcmDspDidIdentifier=61711, DcmDspDidInfoRef=DcmDspDidInfo_SvkBackup12  # Project Standard Configuration
            DcmDspDidSignal_SvkBackup12 (DcmDspDidSignal): DcmDspDidDataPos=0, DcmDspDidDataRef=DcmDspData_SvkBackup12  # Project Standard Configuration
          DcmDspDid_SvkBackup13: DcmDspDidIdentifier=61712, DcmDspDidInfoRef=DcmDspDidInfo_SvkBackup13  # Project Standard Configuration
            DcmDspDidSignal_SvkBackup13 (DcmDspDidSignal): DcmDspDidDataPos=0, DcmDspDidDataRef=DcmDspData_SvkBackup13  # Project Standard Configuration
          DcmDspDid_SvkBackup14: DcmDspDidIdentifier=61713, DcmDspDidInfoRef=DcmDspDidInfo_SvkBackup14  # Project Standard Configuration
            DcmDspDidSignal_SvkBackup14 (DcmDspDidSignal): DcmDspDidDataPos=0, DcmDspDidDataRef=DcmDspData_SvkBackup14  # Project Standard Configuration
          DcmDspDid_SvkBackup15: DcmDspDidIdentifier=61714, DcmDspDidInfoRef=DcmDspDidInfo_SvkBackup15  # Project Standard Configuration
            DcmDspDidSignal_SvkBackup15 (DcmDspDidSignal): DcmDspDidDataPos=0, DcmDspDidDataRef=DcmDspData_SvkBackup15  # Project Standard Configuration
          DcmDspDid_SvkBackup16: DcmDspDidIdentifier=61715, DcmDspDidInfoRef=DcmDspDidInfo_SvkBackup16  # Project Standard Configuration
            DcmDspDidSignal_SvkBackup16 (DcmDspDidSignal): DcmDspDidDataPos=0, DcmDspDidDataRef=DcmDspData_SvkBackup16  # Project Standard Configuration
          DcmDspDid_SvkBackup17: DcmDspDidIdentifier=61716, DcmDspDidInfoRef=DcmDspDidInfo_SvkBackup17  # Project Standard Configuration
            DcmDspDidSignal_SvkBackup17 (DcmDspDidSignal): DcmDspDidDataPos=0, DcmDspDidDataRef=DcmDspData_SvkBackup17  # Project Standard Configuration
          DcmDspDid_SvkBackup18: DcmDspDidIdentifier=61717, DcmDspDidInfoRef=DcmDspDidInfo_SvkBackup18  # Project Standard Configuration
            DcmDspDidSignal_SvkBackup18 (DcmDspDidSignal): DcmDspDidDataPos=0, DcmDspDidDataRef=DcmDspData_SvkBackup18  # Project Standard Configuration
          DcmDspDid_SvkBackup19: DcmDspDidIdentifier=61718, DcmDspDidInfoRef=DcmDspDidInfo_SvkBackup19  # Project Standard Configuration
            DcmDspDidSignal_SvkBackup19 (DcmDspDidSignal): DcmDspDidDataPos=0, DcmDspDidDataRef=DcmDspData_SvkBackup19  # Project Standard Configuration
          DcmDspDid_SvkBackup20: DcmDspDidIdentifier=61719, DcmDspDidInfoRef=DcmDspDidInfo_SvkBackup20  # Project Standard Configuration
            DcmDspDidSignal_SvkBackup20 (DcmDspDidSignal): DcmDspDidDataPos=0, DcmDspDidDataRef=DcmDspData_SvkBackup20  # Project Standard Configuration
          DcmDspDid_SvkBackup21: DcmDspDidIdentifier=61720, DcmDspDidInfoRef=DcmDspDidInfo_SvkBackup21  # Project Standard Configuration
            DcmDspDidSignal_SvkBackup21 (DcmDspDidSignal): DcmDspDidDataPos=0, DcmDspDidDataRef=DcmDspData_SvkBackup21  # Project Standard Configuration
          DcmDspDid_SvkBackup22: DcmDspDidIdentifier=61721, DcmDspDidInfoRef=DcmDspDidInfo_SvkBackup22  # Project Standard Configuration
            DcmDspDidSignal_SvkBackup22 (DcmDspDidSignal): DcmDspDidDataPos=0, DcmDspDidDataRef=DcmDspData_SvkBackup22  # Project Standard Configuration
          DcmDspDid_SvkBackup23: DcmDspDidIdentifier=61722, DcmDspDidInfoRef=DcmDspDidInfo_SvkBackup23  # Project Standard Configuration
            DcmDspDidSignal_SvkBackup23 (DcmDspDidSignal): DcmDspDidDataPos=0, DcmDspDidDataRef=DcmDspData_SvkBackup23  # Project Standard Configuration
          DcmDspDid_SvkBackup24: DcmDspDidIdentifier=61723, DcmDspDidInfoRef=DcmDspDidInfo_SvkBackup24  # Project Standard Configuration
            DcmDspDidSignal_SvkBackup24 (DcmDspDidSignal): DcmDspDidDataPos=0, DcmDspDidDataRef=DcmDspData_SvkBackup24  # Project Standard Configuration
          DcmDspDid_SvkBackup25: DcmDspDidIdentifier=61724, DcmDspDidInfoRef=DcmDspDidInfo_SvkBackup25  # Project Standard Configuration
            DcmDspDidSignal_SvkBackup25 (DcmDspDidSignal): DcmDspDidDataPos=0, DcmDspDidDataRef=DcmDspData_SvkBackup25  # Project Standard Configuration
          DcmDspDid_SvkBackup26: DcmDspDidIdentifier=61725, DcmDspDidInfoRef=DcmDspDidInfo_SvkBackup26  # Project Standard Configuration
            DcmDspDidSignal_SvkBackup26 (DcmDspDidSignal): DcmDspDidDataPos=0, DcmDspDidDataRef=DcmDspData_SvkBackup26  # Project Standard Configuration
          DcmDspDid_SvkBackup27: DcmDspDidIdentifier=61726, DcmDspDidInfoRef=DcmDspDidInfo_SvkBackup27  # Project Standard Configuration
            DcmDspDidSignal_SvkBackup27 (DcmDspDidSignal): DcmDspDidDataPos=0, DcmDspDidDataRef=DcmDspData_SvkBackup27  # Project Standard Configuration
          DcmDspDid_SvkBackup28: DcmDspDidIdentifier=61727, DcmDspDidInfoRef=DcmDspDidInfo_SvkBackup28  # Project Standard Configuration
            DcmDspDidSignal_SvkBackup28 (DcmDspDidSignal): DcmDspDidDataPos=0, DcmDspDidDataRef=DcmDspData_SvkBackup28  # Project Standard Configuration
          DcmDspDid_SvkBackup29: DcmDspDidIdentifier=61728, DcmDspDidInfoRef=DcmDspDidInfo_SvkBackup29  # Project Standard Configuration
            DcmDspDidSignal_SvkBackup29 (DcmDspDidSignal): DcmDspDidDataPos=0, DcmDspDidDataRef=DcmDspData_SvkBackup29  # Project Standard Configuration
          DcmDspDid_SvkBackup30: DcmDspDidIdentifier=61729, DcmDspDidInfoRef=DcmDspDidInfo_SvkBackup30  # Project Standard Configuration
            DcmDspDidSignal_SvkBackup30 (DcmDspDidSignal): DcmDspDidDataPos=0, DcmDspDidDataRef=DcmDspData_SvkBackup30  # Project Standard Configuration
          DcmDspDid_SvkBackup31: DcmDspDidIdentifier=61730, DcmDspDidInfoRef=DcmDspDidInfo_SvkBackup31  # Project Standard Configuration
            DcmDspDidSignal_SvkBackup31 (DcmDspDidSignal): DcmDspDidDataPos=0, DcmDspDidDataRef=DcmDspData_SvkBackup31  # Project Standard Configuration
          DcmDspDid_SvkBackup32: DcmDspDidIdentifier=61731, DcmDspDidInfoRef=DcmDspDidInfo_SvkBackup32  # Project Standard Configuration
            DcmDspDidSignal_SvkBackup32 (DcmDspDidSignal): DcmDspDidDataPos=0, DcmDspDidDataRef=DcmDspData_SvkBackup32  # Project Standard Configuration
          DcmDspDid_SvkBackup33: DcmDspDidIdentifier=61732, DcmDspDidInfoRef=DcmDspDidInfo_SvkBackup33  # Project Standard Configuration
            DcmDspDidSignal_SvkBackup33 (DcmDspDidSignal): DcmDspDidDataPos=0, DcmDspDidDataRef=DcmDspData_SvkBackup33  # Project Standard Configuration
          DcmDspDid_SvkBackup34: DcmDspDidIdentifier=61733, DcmDspDidInfoRef=DcmDspDidInfo_SvkBackup34  # Project Standard Configuration
            DcmDspDidSignal_SvkBackup34 (DcmDspDidSignal): DcmDspDidDataPos=0, DcmDspDidDataRef=DcmDspData_SvkBackup34  # Project Standard Configuration
          DcmDspDid_SvkBackup35: DcmDspDidIdentifier=61734, DcmDspDidInfoRef=DcmDspDidInfo_SvkBackup35  # Project Standard Configuration
            DcmDspDidSignal_SvkBackup35 (DcmDspDidSignal): DcmDspDidDataPos=0, DcmDspDidDataRef=DcmDspData_SvkBackup35  # Project Standard Configuration
          DcmDspDid_SvkBackup36: DcmDspDidIdentifier=61735, DcmDspDidInfoRef=DcmDspDidInfo_SvkBackup36  # Project Standard Configuration
            DcmDspDidSignal_SvkBackup36 (DcmDspDidSignal): DcmDspDidDataPos=0, DcmDspDidDataRef=DcmDspData_SvkBackup36  # Project Standard Configuration
          DcmDspDid_SvkBackup37: DcmDspDidIdentifier=61736, DcmDspDidInfoRef=DcmDspDidInfo_SvkBackup37  # Project Standard Configuration
            DcmDspDidSignal_SvkBackup37 (DcmDspDidSignal): DcmDspDidDataPos=0, DcmDspDidDataRef=DcmDspData_SvkBackup37  # Project Standard Configuration
          DcmDspDid_SvkBackup38: DcmDspDidIdentifier=61737, DcmDspDidInfoRef=DcmDspDidInfo_SvkBackup38  # Project Standard Configuration
            DcmDspDidSignal_SvkBackup38 (DcmDspDidSignal): DcmDspDidDataPos=0, DcmDspDidDataRef=DcmDspData_SvkBackup38  # Project Standard Configuration
          DcmDspDid_SvkBackup39: DcmDspDidIdentifier=61738, DcmDspDidInfoRef=DcmDspDidInfo_SvkBackup39  # Project Standard Configuration
            DcmDspDidSignal_SvkBackup39 (DcmDspDidSignal): DcmDspDidDataPos=0, DcmDspDidDataRef=DcmDspData_SvkBackup39  # Project Standard Configuration
          DcmDspDid_SvkBackup40: DcmDspDidIdentifier=61739, DcmDspDidInfoRef=DcmDspDidInfo_SvkBackup40  # Project Standard Configuration
            DcmDspDidSignal_SvkBackup40 (DcmDspDidSignal): DcmDspDidDataPos=0, DcmDspDidDataRef=DcmDspData_SvkBackup40  # Project Standard Configuration
          DcmDspDid_SvkBackup41: DcmDspDidIdentifier=61740, DcmDspDidInfoRef=DcmDspDidInfo_SvkBackup41  # Project Standard Configuration
            DcmDspDidSignal_SvkBackup41 (DcmDspDidSignal): DcmDspDidDataPos=0, DcmDspDidDataRef=DcmDspData_SvkBackup41  # Project Standard Configuration
          DcmDspDid_SvkBackup42: DcmDspDidIdentifier=61741, DcmDspDidInfoRef=DcmDspDidInfo_SvkBackup42  # Project Standard Configuration
            DcmDspDidSignal_SvkBackup42 (DcmDspDidSignal): DcmDspDidDataPos=0, DcmDspDidDataRef=DcmDspData_SvkBackup42  # Project Standard Configuration
          DcmDspDid_SvkBackup43: DcmDspDidIdentifier=61742, DcmDspDidInfoRef=DcmDspDidInfo_SvkBackup43  # Project Standard Configuration
            DcmDspDidSignal_SvkBackup43 (DcmDspDidSignal): DcmDspDidDataPos=0, DcmDspDidDataRef=DcmDspData_SvkBackup43  # Project Standard Configuration
          DcmDspDid_SvkBackup44: DcmDspDidIdentifier=61743, DcmDspDidInfoRef=DcmDspDidInfo_SvkBackup44  # Project Standard Configuration
            DcmDspDidSignal_SvkBackup44 (DcmDspDidSignal): DcmDspDidDataPos=0, DcmDspDidDataRef=DcmDspData_SvkBackup44  # Project Standard Configuration
          DcmDspDid_SvkBackup45: DcmDspDidIdentifier=61744, DcmDspDidInfoRef=DcmDspDidInfo_SvkBackup45  # Project Standard Configuration
            DcmDspDidSignal_SvkBackup45 (DcmDspDidSignal): DcmDspDidDataPos=0, DcmDspDidDataRef=DcmDspData_SvkBackup45  # Project Standard Configuration
          DcmDspDid_SvkBackup46: DcmDspDidIdentifier=61745, DcmDspDidInfoRef=DcmDspDidInfo_SvkBackup46  # Project Standard Configuration
            DcmDspDidSignal_SvkBackup46 (DcmDspDidSignal): DcmDspDidDataPos=0, DcmDspDidDataRef=DcmDspData_SvkBackup46  # Project Standard Configuration
          DcmDspDid_SvkBackup47: DcmDspDidIdentifier=61746, DcmDspDidInfoRef=DcmDspDidInfo_SvkBackup47  # Project Standard Configuration
            DcmDspDidSignal_SvkBackup47 (DcmDspDidSignal): DcmDspDidDataPos=0, DcmDspDidDataRef=DcmDspData_SvkBackup47  # Project Standard Configuration
          DcmDspDid_SvkBackup48: DcmDspDidIdentifier=61747, DcmDspDidInfoRef=DcmDspDidInfo_SvkBackup48  # Project Standard Configuration
            DcmDspDidSignal_SvkBackup48 (DcmDspDidSignal): DcmDspDidDataPos=0, DcmDspDidDataRef=DcmDspData_SvkBackup48  # Project Standard Configuration
          DcmDspDid_SvkBackup49: DcmDspDidIdentifier=61748, DcmDspDidInfoRef=DcmDspDidInfo_SvkBackup49  # Project Standard Configuration
            DcmDspDidSignal_SvkBackup49 (DcmDspDidSignal): DcmDspDidDataPos=0, DcmDspDidDataRef=DcmDspData_SvkBackup49  # Project Standard Configuration
          DcmDspDid_SvkBackup50: DcmDspDidIdentifier=61749, DcmDspDidInfoRef=DcmDspDidInfo_SvkBackup50  # Project Standard Configuration
            DcmDspDidSignal_SvkBackup50 (DcmDspDidSignal): DcmDspDidDataPos=0, DcmDspDidDataRef=DcmDspData_SvkBackup50  # Project Standard Configuration
          DcmDspDid_SvkBackup51: DcmDspDidIdentifier=61750, DcmDspDidInfoRef=DcmDspDidInfo_SvkBackup51  # Project Standard Configuration
            DcmDspDidSignal_SvkBackup51 (DcmDspDidSignal): DcmDspDidDataPos=0, DcmDspDidDataRef=DcmDspData_SvkBackup51  # Project Standard Configuration
          DcmDspDid_SvkBackup52: DcmDspDidIdentifier=61751, DcmDspDidInfoRef=DcmDspDidInfo_SvkBackup52  # Project Standard Configuration
            DcmDspDidSignal_SvkBackup52 (DcmDspDidSignal): DcmDspDidDataPos=0, DcmDspDidDataRef=DcmDspData_SvkBackup52  # Project Standard Configuration
          DcmDspDid_SvkBackup53: DcmDspDidIdentifier=61752, DcmDspDidInfoRef=DcmDspDidInfo_SvkBackup53  # Project Standard Configuration
            DcmDspDidSignal_SvkBackup53 (DcmDspDidSignal): DcmDspDidDataPos=0, DcmDspDidDataRef=DcmDspData_SvkBackup53  # Project Standard Configuration
          DcmDspDid_SvkBackup54: DcmDspDidIdentifier=61753, DcmDspDidInfoRef=DcmDspDidInfo_SvkBackup54  # Project Standard Configuration
            DcmDspDidSignal_SvkBackup54 (DcmDspDidSignal): DcmDspDidDataPos=0, DcmDspDidDataRef=DcmDspData_SvkBackup54  # Project Standard Configuration
          DcmDspDid_SvkBackup55: DcmDspDidIdentifier=61754, DcmDspDidInfoRef=DcmDspDidInfo_SvkBackup55  # Project Standard Configuration
            DcmDspDidSignal_SvkBackup55 (DcmDspDidSignal): DcmDspDidDataPos=0, DcmDspDidDataRef=DcmDspData_SvkBackup55  # Project Standard Configuration
          DcmDspDid_SvkBackup56: DcmDspDidIdentifier=61755, DcmDspDidInfoRef=DcmDspDidInfo_SvkBackup56  # Project Standard Configuration
            DcmDspDidSignal_SvkBackup56 (DcmDspDidSignal): DcmDspDidDataPos=0, DcmDspDidDataRef=DcmDspData_SvkBackup56  # Project Standard Configuration
          DcmDspDid_SvkBackup57: DcmDspDidIdentifier=61756, DcmDspDidInfoRef=DcmDspDidInfo_SvkBackup57  # Project Standard Configuration
            DcmDspDidSignal_SvkBackup57 (DcmDspDidSignal): DcmDspDidDataPos=0, DcmDspDidDataRef=DcmDspData_SvkBackup57  # Project Standard Configuration
          DcmDspDid_SvkBackup58: DcmDspDidIdentifier=61757, DcmDspDidInfoRef=DcmDspDidInfo_SvkBackup58  # Project Standard Configuration
            DcmDspDidSignal_SvkBackup58 (DcmDspDidSignal): DcmDspDidDataPos=0, DcmDspDidDataRef=DcmDspData_SvkBackup58  # Project Standard Configuration
          DcmDspDid_SvkBackup59: DcmDspDidIdentifier=61758, DcmDspDidInfoRef=DcmDspDidInfo_SvkBackup59  # Project Standard Configuration
            DcmDspDidSignal_SvkBackup59 (DcmDspDidSignal): DcmDspDidDataPos=0, DcmDspDidDataRef=DcmDspData_SvkBackup59  # Project Standard Configuration
          DcmDspDid_SvkBackup60: DcmDspDidIdentifier=61759, DcmDspDidInfoRef=DcmDspDidInfo_SvkBackup60  # Project Standard Configuration
            DcmDspDidSignal_SvkBackup60 (DcmDspDidSignal): DcmDspDidDataPos=0, DcmDspDidDataRef=DcmDspData_SvkBackup60  # Project Standard Configuration
          DcmDspDid_SvkBackup61: DcmDspDidIdentifier=61760, DcmDspDidInfoRef=DcmDspDidInfo_SvkBackup61  # Project Standard Configuration
            DcmDspDidSignal_SvkBackup61 (DcmDspDidSignal): DcmDspDidDataPos=0, DcmDspDidDataRef=DcmDspData_SvkBackup61  # Project Standard Configuration
          DcmDspDid_SvkSysSupplier: DcmDspDidIdentifier=61698, DcmDspDidInfoRef=DcmDspDidInfo_SvkSysSupplier  # Project Standard Configuration
            DcmDspDidSignal_SvkSysSupplier (DcmDspDidSignal): DcmDspDidDataPos=0, DcmDspDidDataRef=DcmDspData_SvkSysSupplier  # Project Standard Configuration
          DcmDspDid_SvkWerk: DcmDspDidIdentifier=61699, DcmDspDidInfoRef=DcmDspDidInfo_SvkWerk  # Project Standard Configuration
            DcmDspDidSignal_SvkWerk (DcmDspDidSignal): DcmDspDidDataPos=0, DcmDspDidDataRef=DcmDspData_SvkWerk  # Project Standard Configuration
          DcmDspDid_SwfkDeleteSupported: DcmDspDidIdentifier=9479, DcmDspDidInfoRef=DcmDspDidInfo_SwfkDeleteSupported  # Project Standard Configuration
            DcmDspDidSignal_SwfkDeleteSupported (DcmDspDidSignal): DcmDspDidDataPos=0, DcmDspDidDataRef=DcmDspData_SwfkDeleteSupported  # Project Standard Configuration
          DcmDspDid_SystemSupplierIdentifier: DcmDspDidIdentifier=61834, DcmDspDidInfoRef=DcmDspDidInfo_SystemSupplierIdentifier  # Project Standard Configuration
            DcmDspDidSignal_SystemSupplierIdentifier (DcmDspDidSignal): DcmDspDidDataPos=0, DcmDspDidDataRef=DcmDspData_SystemSupplierIdentifier  # Project Standard Configuration
          DcmDspDid_Systemzeit: DcmDspDidIdentifier=5889, DcmDspDidInfoRef=DcmDspDidInfo_Systemzeit  # Project Standard Configuration
            DcmDspDidSignal_Systemzeit (DcmDspDidSignal): DcmDspDidDataPos=0, DcmDspDidDataRef=DcmDspData_Systemzeit  # Project Standard Configuration
          DcmDspDid_Vin: DcmDspDidIdentifier=61840, DcmDspDidInfoRef=DcmDspDidInfo_Vin  # Project Standard Configuration
            DcmDspDidSignal_Vin (DcmDspDidSignal): DcmDspDidDataPos=0, DcmDspDidDataRef=DcmDspData_Vin  # Project Standard Configuration
          DcmDspDid_ZgwZertifikat: DcmDspDidIdentifier=5919, DcmDspDidInfoRef=DcmDspDidInfo_ZgwZertifikat  # Project Standard Configuration
            DcmDspDidSignal_ZgwZertifikat (DcmDspDidSignal): DcmDspDidDataPos=0, DcmDspDidDataRef=DcmDspData_ZgwZertifikat  # Project Standard Configuration
        105 x DcmDspDidInfo, all with DcmDspDidDynamicallyDefined=false:
          DcmDspDidInfo_ActiveDiagnosticSession  # Project Standard Configuration
            DcmDspDidAccess  # Project Standard Configuration
              DcmDspDidRead: DcmDspDidReadSessionRef=DcmDspSessionRow_EXTENDED_DIAGNOSTIC_SESSION, DcmDspDidReadSessionRef=DcmDspSessionRow_DEFAULT_SESSION  # Project Standard Configuration
          DcmDspDidInfo_Cps  # Project Standard Configuration
            DcmDspDidAccess  # Project Standard Configuration
              DcmDspDidRead:  # Project Standard Configuration
                DcmDspDidReadSessionRef = DcmDspSessionRow_DEFAULT_SESSION
                DcmDspDidReadSessionRef = DcmDspSessionRow_EXTENDED_DIAGNOSTIC_SESSION
                DcmDspDidReadSessionRef = DcmDspSessionRow_CODING_SESSION
              DcmDspDidWrite: DcmDspDidWriteSecurityLevelRef=DcmDspSecurityRow_Coding, DcmDspDidWriteSessionRef=DcmDspSessionRow_CODING_SESSION  # Project Standard Configuration
          DcmDspDidInfo_DmDtcAktiveMeldung  # Project Standard Configuration
            DcmDspDidAccess  # Project Standard Configuration
              DcmDspDidRead: DcmDspDidReadSessionRef=DcmDspSessionRow_DEFAULT_SESSION, DcmDspDidReadSessionRef=DcmDspSessionRow_EXTENDED_DIAGNOSTIC_SESSION  # Project Standard Configuration
          DcmDspDidInfo_DmIsDtcActiveResponse  # Project Standard Configuration
            DcmDspDidAccess  # Project Standard Configuration
              DcmDspDidRead: DcmDspDidReadSessionRef=DcmDspSessionRow_DEFAULT_SESSION, DcmDspDidReadSessionRef=DcmDspSessionRow_EXTENDED_DIAGNOSTIC_SESSION  # Project Standard Configuration
          DcmDspDidInfo_EcuSerialNumber  # Project Standard Configuration
            DcmDspDidAccess  # Project Standard Configuration
              DcmDspDidRead: DcmDspDidReadSessionRef=DcmDspSessionRow_EXTENDED_DIAGNOSTIC_SESSION, DcmDspDidReadSessionRef=DcmDspSessionRow_DEFAULT_SESSION  # Project Standard Configuration
          DcmDspDidInfo_EnergySavingState  # Project Standard Configuration
            DcmDspDidAccess  # Project Standard Configuration
              DcmDspDidRead: DcmDspDidReadSessionRef=DcmDspSessionRow_DEFAULT_SESSION, DcmDspDidReadSessionRef=DcmDspSessionRow_EXTENDED_DIAGNOSTIC_SESSION  # Project Standard Configuration
          DcmDspDidInfo_EthGetNumberOfPorts  # Project Standard Configuration
            DcmDspDidAccess  # Project Standard Configuration
              DcmDspDidRead: DcmDspDidReadSessionRef=DcmDspSessionRow_DEFAULT_SESSION, DcmDspDidReadSessionRef=DcmDspSessionRow_EXTENDED_DIAGNOSTIC_SESSION  # Project Standard Configuration
          DcmDspDidInfo_EthPhyLinkState  # Project Standard Configuration
            DcmDspDidAccess  # Project Standard Configuration
              DcmDspDidRead: DcmDspDidReadSessionRef=DcmDspSessionRow_DEFAULT_SESSION, DcmDspDidReadSessionRef=DcmDspSessionRow_EXTENDED_DIAGNOSTIC_SESSION  # Project Standard Configuration
          DcmDspDidInfo_EthSignalQuality  # Project Standard Configuration
            DcmDspDidAccess  # Project Standard Configuration
              DcmDspDidRead: DcmDspDidReadSessionRef=DcmDspSessionRow_DEFAULT_SESSION, DcmDspDidReadSessionRef=DcmDspSessionRow_EXTENDED_DIAGNOSTIC_SESSION  # Project Standard Configuration
          DcmDspDidInfo_ExtendedEnergySavingState  # Project Standard Configuration
            DcmDspDidAccess  # Project Standard Configuration
              DcmDspDidRead: DcmDspDidReadSessionRef=DcmDspSessionRow_DEFAULT_SESSION, DcmDspDidReadSessionRef=DcmDspSessionRow_EXTENDED_DIAGNOSTIC_SESSION  # Project Standard Configuration
          DcmDspDidInfo_FlashTimingParameter  # Project Standard Configuration
            DcmDspDidAccess  # Project Standard Configuration
              DcmDspDidRead: DcmDspDidReadSessionRef=DcmDspSessionRow_DEFAULT_SESSION, DcmDspDidReadSessionRef=DcmDspSessionRow_EXTENDED_DIAGNOSTIC_SESSION  # Project Standard Configuration
          DcmDspDidInfo_HddDownloadStatus  # Project Standard Configuration
            DcmDspDidAccess  # Project Standard Configuration
              DcmDspDidRead: DcmDspDidReadSessionRef=DcmDspSessionRow_HDD_DOWNLOAD_SESSION  # Project Standard Configuration
          DcmDspDidInfo_HddDownloadTimeToCompletion  # Project Standard Configuration
            DcmDspDidAccess  # Project Standard Configuration
              DcmDspDidRead: DcmDspDidReadSessionRef=DcmDspSessionRow_HDD_DOWNLOAD_SESSION  # Project Standard Configuration
          DcmDspDidInfo_Herstelldatum  # Project Standard Configuration
            DcmDspDidAccess  # Project Standard Configuration
              DcmDspDidRead: DcmDspDidReadSessionRef=DcmDspSessionRow_DEFAULT_SESSION, DcmDspDidReadSessionRef=DcmDspSessionRow_EXTENDED_DIAGNOSTIC_SESSION  # Project Standard Configuration
          DcmDspDidInfo_IndivDataTable  # Project Standard Configuration
            DcmDspDidAccess  # Project Standard Configuration
              DcmDspDidRead: DcmDspDidReadSessionRef=DcmDspSessionRow_EXTENDED_DIAGNOSTIC_SESSION  # Project Standard Configuration
          DcmDspDidInfo_IpConfiguration  # Project Standard Configuration
            DcmDspDidAccess  # Project Standard Configuration
              DcmDspDidRead: DcmDspDidReadSessionRef=DcmDspSessionRow_DEFAULT_SESSION, DcmDspDidReadSessionRef=DcmDspSessionRow_EXTENDED_DIAGNOSTIC_SESSION  # Project Standard Configuration
          DcmDspDidInfo_ListManipulationApplicationData  # Project Standard Configuration
            DcmDspDidAccess  # Project Standard Configuration
              DcmDspDidRead: DcmDspDidReadSessionRef=DcmDspSessionRow_EXTENDED_DIAGNOSTIC_SESSION, DcmDspDidReadSessionRef=DcmDspSessionRow_DEFAULT_SESSION  # Project Standard Configuration
          DcmDspDidInfo_ListManipulationGeneral  # Project Standard Configuration
            DcmDspDidAccess  # Project Standard Configuration
              DcmDspDidRead: DcmDspDidReadSessionRef=DcmDspSessionRow_DEFAULT_SESSION, DcmDspDidReadSessionRef=DcmDspSessionRow_EXTENDED_DIAGNOSTIC_SESSION  # Project Standard Configuration
          DcmDspDidInfo_ListManipulationSecureBoot  # Project Standard Configuration
            DcmDspDidAccess  # Project Standard Configuration
              DcmDspDidRead: DcmDspDidReadSessionRef=DcmDspSessionRow_EXTENDED_DIAGNOSTIC_SESSION, DcmDspDidReadSessionRef=DcmDspSessionRow_DEFAULT_SESSION  # Project Standard Configuration
          DcmDspDidInfo_ListManipulationSecurityArtifact  # Project Standard Configuration
            DcmDspDidAccess  # Project Standard Configuration
              DcmDspDidRead: DcmDspDidReadSessionRef=DcmDspSessionRow_DEFAULT_SESSION, DcmDspDidReadSessionRef=DcmDspSessionRow_EXTENDED_DIAGNOSTIC_SESSION  # Project Standard Configuration
          DcmDspDidInfo_ListManipulationSw  # Project Standard Configuration
            DcmDspDidAccess  # Project Standard Configuration
              DcmDspDidRead: DcmDspDidReadSessionRef=DcmDspSessionRow_DEFAULT_SESSION, DcmDspDidReadSessionRef=DcmDspSessionRow_EXTENDED_DIAGNOSTIC_SESSION  # Project Standard Configuration
          DcmDspDidInfo_MileKmEeprom  # Project Standard Configuration
            DcmDspDidAccess  # Project Standard Configuration
              DcmDspDidRead: DcmDspDidReadSessionRef=DcmDspSessionRow_EXTENDED_DIAGNOSTIC_SESSION, DcmDspDidReadSessionRef=DcmDspSessionRow_DEFAULT_SESSION  # Project Standard Configuration
          DcmDspDidInfo_PiaProfile0  # Project Standard Configuration
            DcmDspDidAccess  # Project Standard Configuration
              DcmDspDidRead: DcmDspDidReadSessionRef=DcmDspSessionRow_EXTENDED_DIAGNOSTIC_SESSION  # Project Standard Configuration
              DcmDspDidWrite: DcmDspDidWriteSessionRef=DcmDspSessionRow_EXTENDED_DIAGNOSTIC_SESSION  # Project Standard Configuration
          DcmDspDidInfo_PiaProfile1  # Project Standard Configuration
            DcmDspDidAccess  # Project Standard Configuration
              DcmDspDidRead: DcmDspDidReadSessionRef=DcmDspSessionRow_EXTENDED_DIAGNOSTIC_SESSION  # Project Standard Configuration
              DcmDspDidWrite: DcmDspDidWriteSessionRef=DcmDspSessionRow_EXTENDED_DIAGNOSTIC_SESSION  # Project Standard Configuration
          DcmDspDidInfo_PiaProfile2  # Project Standard Configuration
            DcmDspDidAccess  # Project Standard Configuration
              DcmDspDidRead: DcmDspDidReadSessionRef=DcmDspSessionRow_EXTENDED_DIAGNOSTIC_SESSION  # Project Standard Configuration
              DcmDspDidWrite: DcmDspDidWriteSessionRef=DcmDspSessionRow_EXTENDED_DIAGNOSTIC_SESSION  # Project Standard Configuration
          DcmDspDidInfo_PiaProfileA  # Project Standard Configuration
            DcmDspDidAccess  # Project Standard Configuration
              DcmDspDidRead: DcmDspDidReadSessionRef=DcmDspSessionRow_EXTENDED_DIAGNOSTIC_SESSION  # Project Standard Configuration
              DcmDspDidWrite: DcmDspDidWriteSessionRef=DcmDspSessionRow_EXTENDED_DIAGNOSTIC_SESSION  # Project Standard Configuration
          DcmDspDidInfo_ProgrammingCounter  # Project Standard Configuration
            DcmDspDidAccess  # Project Standard Configuration
              DcmDspDidRead: DcmDspDidReadSessionRef=DcmDspSessionRow_EXTENDED_DIAGNOSTIC_SESSION, DcmDspDidReadSessionRef=DcmDspSessionRow_DEFAULT_SESSION  # Project Standard Configuration
          DcmDspDidInfo_ProgrammingCounterMaxValue  # Project Standard Configuration
            DcmDspDidAccess  # Project Standard Configuration
              DcmDspDidRead: DcmDspDidReadSessionRef=DcmDspSessionRow_EXTENDED_DIAGNOSTIC_SESSION, DcmDspDidReadSessionRef=DcmDspSessionRow_DEFAULT_SESSION  # Project Standard Configuration
          DcmDspDidInfo_Pruefstempel  # Project Standard Configuration
            DcmDspDidAccess  # Project Standard Configuration
              DcmDspDidRead: DcmDspDidReadSessionRef=DcmDspSessionRow_EXTENDED_DIAGNOSTIC_SESSION, DcmDspDidReadSessionRef=DcmDspSessionRow_DEFAULT_SESSION  # Project Standard Configuration
              DcmDspDidWrite: DcmDspDidWriteSessionRef=DcmDspSessionRow_EXTENDED_DIAGNOSTIC_SESSION, DcmDspDidWriteSessionRef=DcmDspSessionRow_DEFAULT_SESSION  # Project Standard Configuration
          DcmDspDidInfo_ReadActiveSessionState  # Project Standard Configuration
            DcmDspDidAccess  # Project Standard Configuration
              DcmDspDidRead: DcmDspDidReadSessionRef=DcmDspSessionRow_EXTENDED_DIAGNOSTIC_SESSION, DcmDspDidReadSessionRef=DcmDspSessionRow_DEFAULT_SESSION  # Project Standard Configuration
          DcmDspDidInfo_Readhwmodificationindex  # Project Standard Configuration
            DcmDspDidAccess  # Project Standard Configuration
              DcmDspDidRead: DcmDspDidReadSessionRef=DcmDspSessionRow_EXTENDED_DIAGNOSTIC_SESSION, DcmDspDidReadSessionRef=DcmDspSessionRow_DEFAULT_SESSION  # Project Standard Configuration
          DcmDspDidInfo_Sekundaererfehlerspeicher  # Project Standard Configuration
            DcmDspDidAccess  # Project Standard Configuration
              DcmDspDidRead: DcmDspDidReadSessionRef=DcmDspSessionRow_DEFAULT_SESSION, DcmDspDidReadSessionRef=DcmDspSessionRow_EXTENDED_DIAGNOSTIC_SESSION  # Project Standard Configuration
          DcmDspDidInfo_SensorenAnzahlLesen  # Project Standard Configuration
            DcmDspDidAccess  # Project Standard Configuration
              DcmDspDidRead: DcmDspDidReadSessionRef=DcmDspSessionRow_EXTENDED_DIAGNOSTIC_SESSION, DcmDspDidReadSessionRef=DcmDspSessionRow_DEFAULT_SESSION  # Project Standard Configuration
          DcmDspDidInfo_SgbdIdx  # Project Standard Configuration
            DcmDspDidAccess  # Project Standard Configuration
              DcmDspDidRead: DcmDspDidReadSessionRef=DcmDspSessionRow_EXTENDED_DIAGNOSTIC_SESSION, DcmDspDidReadSessionRef=DcmDspSessionRow_DEFAULT_SESSION  # Project Standard Configuration
          DcmDspDidInfo_StatusDmFssMaster  # Project Standard Configuration
            DcmDspDidAccess  # Project Standard Configuration
              DcmDspDidRead: DcmDspDidReadSessionRef=DcmDspSessionRow_DEFAULT_SESSION, DcmDspDidReadSessionRef=DcmDspSessionRow_EXTENDED_DIAGNOSTIC_SESSION  # Project Standard Configuration
          DcmDspDidInfo_StatusSystime  # Project Standard Configuration
            DcmDspDidAccess  # Project Standard Configuration
              DcmDspDidRead: DcmDspDidReadSessionRef=DcmDspSessionRow_DEFAULT_SESSION, DcmDspDidReadSessionRef=DcmDspSessionRow_EXTENDED_DIAGNOSTIC_SESSION  # Project Standard Configuration
          DcmDspDidInfo_SvkAktuell  # Project Standard Configuration
            DcmDspDidAccess  # Project Standard Configuration
              DcmDspDidRead: DcmDspDidReadSessionRef=DcmDspSessionRow_EXTENDED_DIAGNOSTIC_SESSION, DcmDspDidReadSessionRef=DcmDspSessionRow_DEFAULT_SESSION  # Project Standard Configuration
          DcmDspDidInfo_SvkBackup01  # Project Standard Configuration
            DcmDspDidAccess  # Project Standard Configuration
              DcmDspDidRead: DcmDspDidReadSessionRef=DcmDspSessionRow_EXTENDED_DIAGNOSTIC_SESSION, DcmDspDidReadSessionRef=DcmDspSessionRow_DEFAULT_SESSION  # Project Standard Configuration
          DcmDspDidInfo_SvkBackup02  # Project Standard Configuration
            DcmDspDidAccess  # Project Standard Configuration
              DcmDspDidRead: DcmDspDidReadSessionRef=DcmDspSessionRow_EXTENDED_DIAGNOSTIC_SESSION, DcmDspDidReadSessionRef=DcmDspSessionRow_DEFAULT_SESSION  # Project Standard Configuration
          DcmDspDidInfo_SvkBackup03  # Project Standard Configuration
            DcmDspDidAccess  # Project Standard Configuration
              DcmDspDidRead: DcmDspDidReadSessionRef=DcmDspSessionRow_DEFAULT_SESSION, DcmDspDidReadSessionRef=DcmDspSessionRow_EXTENDED_DIAGNOSTIC_SESSION  # Project Standard Configuration
          DcmDspDidInfo_SvkBackup04  # Project Standard Configuration
            DcmDspDidAccess  # Project Standard Configuration
              DcmDspDidRead: DcmDspDidReadSessionRef=DcmDspSessionRow_EXTENDED_DIAGNOSTIC_SESSION, DcmDspDidReadSessionRef=DcmDspSessionRow_DEFAULT_SESSION  # Project Standard Configuration
          DcmDspDidInfo_SvkBackup05  # Project Standard Configuration
            DcmDspDidAccess  # Project Standard Configuration
              DcmDspDidRead: DcmDspDidReadSessionRef=DcmDspSessionRow_EXTENDED_DIAGNOSTIC_SESSION, DcmDspDidReadSessionRef=DcmDspSessionRow_DEFAULT_SESSION  # Project Standard Configuration
          DcmDspDidInfo_SvkBackup06  # Project Standard Configuration
            DcmDspDidAccess  # Project Standard Configuration
              DcmDspDidRead: DcmDspDidReadSessionRef=DcmDspSessionRow_DEFAULT_SESSION, DcmDspDidReadSessionRef=DcmDspSessionRow_EXTENDED_DIAGNOSTIC_SESSION  # Project Standard Configuration
          DcmDspDidInfo_SvkBackup07  # Project Standard Configuration
            DcmDspDidAccess  # Project Standard Configuration
              DcmDspDidRead: DcmDspDidReadSessionRef=DcmDspSessionRow_DEFAULT_SESSION, DcmDspDidReadSessionRef=DcmDspSessionRow_EXTENDED_DIAGNOSTIC_SESSION  # Project Standard Configuration
          DcmDspDidInfo_SvkBackup08  # Project Standard Configuration
            DcmDspDidAccess  # Project Standard Configuration
              DcmDspDidRead: DcmDspDidReadSessionRef=DcmDspSessionRow_DEFAULT_SESSION, DcmDspDidReadSessionRef=DcmDspSessionRow_EXTENDED_DIAGNOSTIC_SESSION  # Project Standard Configuration
          DcmDspDidInfo_SvkBackup09  # Project Standard Configuration
            DcmDspDidAccess  # Project Standard Configuration
              DcmDspDidRead: DcmDspDidReadSessionRef=DcmDspSessionRow_DEFAULT_SESSION, DcmDspDidReadSessionRef=DcmDspSessionRow_EXTENDED_DIAGNOSTIC_SESSION  # Project Standard Configuration
          DcmDspDidInfo_SvkBackup10  # Project Standard Configuration
            DcmDspDidAccess  # Project Standard Configuration
              DcmDspDidRead: DcmDspDidReadSessionRef=DcmDspSessionRow_DEFAULT_SESSION, DcmDspDidReadSessionRef=DcmDspSessionRow_EXTENDED_DIAGNOSTIC_SESSION  # Project Standard Configuration
          DcmDspDidInfo_SvkBackup11  # Project Standard Configuration
            DcmDspDidAccess  # Project Standard Configuration
              DcmDspDidRead: DcmDspDidReadSessionRef=DcmDspSessionRow_EXTENDED_DIAGNOSTIC_SESSION, DcmDspDidReadSessionRef=DcmDspSessionRow_DEFAULT_SESSION  # Project Standard Configuration
          DcmDspDidInfo_SvkBackup12  # Project Standard Configuration
            DcmDspDidAccess  # Project Standard Configuration
              DcmDspDidRead: DcmDspDidReadSessionRef=DcmDspSessionRow_DEFAULT_SESSION, DcmDspDidReadSessionRef=DcmDspSessionRow_EXTENDED_DIAGNOSTIC_SESSION  # Project Standard Configuration
          DcmDspDidInfo_SvkBackup13  # Project Standard Configuration
            DcmDspDidAccess  # Project Standard Configuration
              DcmDspDidRead: DcmDspDidReadSessionRef=DcmDspSessionRow_DEFAULT_SESSION, DcmDspDidReadSessionRef=DcmDspSessionRow_EXTENDED_DIAGNOSTIC_SESSION  # Project Standard Configuration
          DcmDspDidInfo_SvkBackup14  # Project Standard Configuration
            DcmDspDidAccess  # Project Standard Configuration
              DcmDspDidRead: DcmDspDidReadSessionRef=DcmDspSessionRow_EXTENDED_DIAGNOSTIC_SESSION, DcmDspDidReadSessionRef=DcmDspSessionRow_DEFAULT_SESSION  # Project Standard Configuration
          DcmDspDidInfo_SvkBackup15  # Project Standard Configuration
            DcmDspDidAccess  # Project Standard Configuration
              DcmDspDidRead: DcmDspDidReadSessionRef=DcmDspSessionRow_EXTENDED_DIAGNOSTIC_SESSION, DcmDspDidReadSessionRef=DcmDspSessionRow_DEFAULT_SESSION  # Project Standard Configuration
          DcmDspDidInfo_SvkBackup16  # Project Standard Configuration
            DcmDspDidAccess  # Project Standard Configuration
              DcmDspDidRead: DcmDspDidReadSessionRef=DcmDspSessionRow_EXTENDED_DIAGNOSTIC_SESSION, DcmDspDidReadSessionRef=DcmDspSessionRow_DEFAULT_SESSION  # Project Standard Configuration
          DcmDspDidInfo_SvkBackup17  # Project Standard Configuration
            DcmDspDidAccess  # Project Standard Configuration
              DcmDspDidRead: DcmDspDidReadSessionRef=DcmDspSessionRow_DEFAULT_SESSION, DcmDspDidReadSessionRef=DcmDspSessionRow_EXTENDED_DIAGNOSTIC_SESSION  # Project Standard Configuration
          DcmDspDidInfo_SvkBackup18  # Project Standard Configuration
            DcmDspDidAccess  # Project Standard Configuration
              DcmDspDidRead: DcmDspDidReadSessionRef=DcmDspSessionRow_EXTENDED_DIAGNOSTIC_SESSION, DcmDspDidReadSessionRef=DcmDspSessionRow_DEFAULT_SESSION  # Project Standard Configuration
          DcmDspDidInfo_SvkBackup19  # Project Standard Configuration
            DcmDspDidAccess  # Project Standard Configuration
              DcmDspDidRead: DcmDspDidReadSessionRef=DcmDspSessionRow_EXTENDED_DIAGNOSTIC_SESSION, DcmDspDidReadSessionRef=DcmDspSessionRow_DEFAULT_SESSION  # Project Standard Configuration
          DcmDspDidInfo_SvkBackup20  # Project Standard Configuration
            DcmDspDidAccess  # Project Standard Configuration
              DcmDspDidRead: DcmDspDidReadSessionRef=DcmDspSessionRow_EXTENDED_DIAGNOSTIC_SESSION, DcmDspDidReadSessionRef=DcmDspSessionRow_DEFAULT_SESSION  # Project Standard Configuration
          DcmDspDidInfo_SvkBackup21  # Project Standard Configuration
            DcmDspDidAccess  # Project Standard Configuration
              DcmDspDidRead: DcmDspDidReadSessionRef=DcmDspSessionRow_EXTENDED_DIAGNOSTIC_SESSION, DcmDspDidReadSessionRef=DcmDspSessionRow_DEFAULT_SESSION  # Project Standard Configuration
          DcmDspDidInfo_SvkBackup22  # Project Standard Configuration
            DcmDspDidAccess  # Project Standard Configuration
              DcmDspDidRead: DcmDspDidReadSessionRef=DcmDspSessionRow_EXTENDED_DIAGNOSTIC_SESSION, DcmDspDidReadSessionRef=DcmDspSessionRow_DEFAULT_SESSION  # Project Standard Configuration
          DcmDspDidInfo_SvkBackup23  # Project Standard Configuration
            DcmDspDidAccess  # Project Standard Configuration
              DcmDspDidRead: DcmDspDidReadSessionRef=DcmDspSessionRow_EXTENDED_DIAGNOSTIC_SESSION, DcmDspDidReadSessionRef=DcmDspSessionRow_DEFAULT_SESSION  # Project Standard Configuration
          DcmDspDidInfo_SvkBackup24  # Project Standard Configuration
            DcmDspDidAccess  # Project Standard Configuration
              DcmDspDidRead: DcmDspDidReadSessionRef=DcmDspSessionRow_DEFAULT_SESSION, DcmDspDidReadSessionRef=DcmDspSessionRow_EXTENDED_DIAGNOSTIC_SESSION  # Project Standard Configuration
          DcmDspDidInfo_SvkBackup25  # Project Standard Configuration
            DcmDspDidAccess  # Project Standard Configuration
              DcmDspDidRead: DcmDspDidReadSessionRef=DcmDspSessionRow_EXTENDED_DIAGNOSTIC_SESSION, DcmDspDidReadSessionRef=DcmDspSessionRow_DEFAULT_SESSION  # Project Standard Configuration
          DcmDspDidInfo_SvkBackup26  # Project Standard Configuration
            DcmDspDidAccess  # Project Standard Configuration
              DcmDspDidRead: DcmDspDidReadSessionRef=DcmDspSessionRow_DEFAULT_SESSION, DcmDspDidReadSessionRef=DcmDspSessionRow_EXTENDED_DIAGNOSTIC_SESSION  # Project Standard Configuration
          DcmDspDidInfo_SvkBackup27  # Project Standard Configuration
            DcmDspDidAccess  # Project Standard Configuration
              DcmDspDidRead: DcmDspDidReadSessionRef=DcmDspSessionRow_DEFAULT_SESSION, DcmDspDidReadSessionRef=DcmDspSessionRow_EXTENDED_DIAGNOSTIC_SESSION  # Project Standard Configuration
          DcmDspDidInfo_SvkBackup28  # Project Standard Configuration
            DcmDspDidAccess  # Project Standard Configuration
              DcmDspDidRead: DcmDspDidReadSessionRef=DcmDspSessionRow_EXTENDED_DIAGNOSTIC_SESSION, DcmDspDidReadSessionRef=DcmDspSessionRow_DEFAULT_SESSION  # Project Standard Configuration
          DcmDspDidInfo_SvkBackup29  # Project Standard Configuration
            DcmDspDidAccess  # Project Standard Configuration
              DcmDspDidRead: DcmDspDidReadSessionRef=DcmDspSessionRow_EXTENDED_DIAGNOSTIC_SESSION, DcmDspDidReadSessionRef=DcmDspSessionRow_DEFAULT_SESSION  # Project Standard Configuration
          DcmDspDidInfo_SvkBackup30  # Project Standard Configuration
            DcmDspDidAccess  # Project Standard Configuration
              DcmDspDidRead: DcmDspDidReadSessionRef=DcmDspSessionRow_DEFAULT_SESSION, DcmDspDidReadSessionRef=DcmDspSessionRow_EXTENDED_DIAGNOSTIC_SESSION  # Project Standard Configuration
          DcmDspDidInfo_SvkBackup31  # Project Standard Configuration
            DcmDspDidAccess  # Project Standard Configuration
              DcmDspDidRead: DcmDspDidReadSessionRef=DcmDspSessionRow_DEFAULT_SESSION, DcmDspDidReadSessionRef=DcmDspSessionRow_EXTENDED_DIAGNOSTIC_SESSION  # Project Standard Configuration
          DcmDspDidInfo_SvkBackup32  # Project Standard Configuration
            DcmDspDidAccess  # Project Standard Configuration
              DcmDspDidRead: DcmDspDidReadSessionRef=DcmDspSessionRow_DEFAULT_SESSION, DcmDspDidReadSessionRef=DcmDspSessionRow_EXTENDED_DIAGNOSTIC_SESSION  # Project Standard Configuration
          DcmDspDidInfo_SvkBackup33  # Project Standard Configuration
            DcmDspDidAccess  # Project Standard Configuration
              DcmDspDidRead: DcmDspDidReadSessionRef=DcmDspSessionRow_DEFAULT_SESSION, DcmDspDidReadSessionRef=DcmDspSessionRow_EXTENDED_DIAGNOSTIC_SESSION  # Project Standard Configuration
          DcmDspDidInfo_SvkBackup34  # Project Standard Configuration
            DcmDspDidAccess  # Project Standard Configuration
              DcmDspDidRead: DcmDspDidReadSessionRef=DcmDspSessionRow_EXTENDED_DIAGNOSTIC_SESSION, DcmDspDidReadSessionRef=DcmDspSessionRow_DEFAULT_SESSION  # Project Standard Configuration
          DcmDspDidInfo_SvkBackup35  # Project Standard Configuration
            DcmDspDidAccess  # Project Standard Configuration
              DcmDspDidRead: DcmDspDidReadSessionRef=DcmDspSessionRow_DEFAULT_SESSION, DcmDspDidReadSessionRef=DcmDspSessionRow_EXTENDED_DIAGNOSTIC_SESSION  # Project Standard Configuration
          DcmDspDidInfo_SvkBackup36  # Project Standard Configuration
            DcmDspDidAccess  # Project Standard Configuration
              DcmDspDidRead: DcmDspDidReadSessionRef=DcmDspSessionRow_EXTENDED_DIAGNOSTIC_SESSION, DcmDspDidReadSessionRef=DcmDspSessionRow_DEFAULT_SESSION  # Project Standard Configuration
          DcmDspDidInfo_SvkBackup37  # Project Standard Configuration
            DcmDspDidAccess  # Project Standard Configuration
              DcmDspDidRead: DcmDspDidReadSessionRef=DcmDspSessionRow_DEFAULT_SESSION, DcmDspDidReadSessionRef=DcmDspSessionRow_EXTENDED_DIAGNOSTIC_SESSION  # Project Standard Configuration
          DcmDspDidInfo_SvkBackup38  # Project Standard Configuration
            DcmDspDidAccess  # Project Standard Configuration
              DcmDspDidRead: DcmDspDidReadSessionRef=DcmDspSessionRow_DEFAULT_SESSION, DcmDspDidReadSessionRef=DcmDspSessionRow_EXTENDED_DIAGNOSTIC_SESSION  # Project Standard Configuration
          DcmDspDidInfo_SvkBackup39  # Project Standard Configuration
            DcmDspDidAccess  # Project Standard Configuration
              DcmDspDidRead: DcmDspDidReadSessionRef=DcmDspSessionRow_DEFAULT_SESSION, DcmDspDidReadSessionRef=DcmDspSessionRow_EXTENDED_DIAGNOSTIC_SESSION  # Project Standard Configuration
          DcmDspDidInfo_SvkBackup40  # Project Standard Configuration
            DcmDspDidAccess  # Project Standard Configuration
              DcmDspDidRead: DcmDspDidReadSessionRef=DcmDspSessionRow_EXTENDED_DIAGNOSTIC_SESSION, DcmDspDidReadSessionRef=DcmDspSessionRow_DEFAULT_SESSION  # Project Standard Configuration
          DcmDspDidInfo_SvkBackup41  # Project Standard Configuration
            DcmDspDidAccess  # Project Standard Configuration
              DcmDspDidRead: DcmDspDidReadSessionRef=DcmDspSessionRow_DEFAULT_SESSION, DcmDspDidReadSessionRef=DcmDspSessionRow_EXTENDED_DIAGNOSTIC_SESSION  # Project Standard Configuration
          DcmDspDidInfo_SvkBackup42  # Project Standard Configuration
            DcmDspDidAccess  # Project Standard Configuration
              DcmDspDidRead: DcmDspDidReadSessionRef=DcmDspSessionRow_EXTENDED_DIAGNOSTIC_SESSION, DcmDspDidReadSessionRef=DcmDspSessionRow_DEFAULT_SESSION  # Project Standard Configuration
          DcmDspDidInfo_SvkBackup43  # Project Standard Configuration
            DcmDspDidAccess  # Project Standard Configuration
              DcmDspDidRead: DcmDspDidReadSessionRef=DcmDspSessionRow_EXTENDED_DIAGNOSTIC_SESSION, DcmDspDidReadSessionRef=DcmDspSessionRow_DEFAULT_SESSION  # Project Standard Configuration
          DcmDspDidInfo_SvkBackup44  # Project Standard Configuration
            DcmDspDidAccess  # Project Standard Configuration
              DcmDspDidRead: DcmDspDidReadSessionRef=DcmDspSessionRow_DEFAULT_SESSION, DcmDspDidReadSessionRef=DcmDspSessionRow_EXTENDED_DIAGNOSTIC_SESSION  # Project Standard Configuration
          DcmDspDidInfo_SvkBackup45  # Project Standard Configuration
            DcmDspDidAccess  # Project Standard Configuration
              DcmDspDidRead: DcmDspDidReadSessionRef=DcmDspSessionRow_EXTENDED_DIAGNOSTIC_SESSION, DcmDspDidReadSessionRef=DcmDspSessionRow_DEFAULT_SESSION  # Project Standard Configuration
          DcmDspDidInfo_SvkBackup46  # Project Standard Configuration
            DcmDspDidAccess  # Project Standard Configuration
              DcmDspDidRead: DcmDspDidReadSessionRef=DcmDspSessionRow_EXTENDED_DIAGNOSTIC_SESSION, DcmDspDidReadSessionRef=DcmDspSessionRow_DEFAULT_SESSION  # Project Standard Configuration
          DcmDspDidInfo_SvkBackup47  # Project Standard Configuration
            DcmDspDidAccess  # Project Standard Configuration
              DcmDspDidRead: DcmDspDidReadSessionRef=DcmDspSessionRow_EXTENDED_DIAGNOSTIC_SESSION, DcmDspDidReadSessionRef=DcmDspSessionRow_DEFAULT_SESSION  # Project Standard Configuration
          DcmDspDidInfo_SvkBackup48  # Project Standard Configuration
            DcmDspDidAccess  # Project Standard Configuration
              DcmDspDidRead: DcmDspDidReadSessionRef=DcmDspSessionRow_DEFAULT_SESSION, DcmDspDidReadSessionRef=DcmDspSessionRow_EXTENDED_DIAGNOSTIC_SESSION  # Project Standard Configuration
          DcmDspDidInfo_SvkBackup49  # Project Standard Configuration
            DcmDspDidAccess  # Project Standard Configuration
              DcmDspDidRead: DcmDspDidReadSessionRef=DcmDspSessionRow_DEFAULT_SESSION, DcmDspDidReadSessionRef=DcmDspSessionRow_EXTENDED_DIAGNOSTIC_SESSION  # Project Standard Configuration
          DcmDspDidInfo_SvkBackup50  # Project Standard Configuration
            DcmDspDidAccess  # Project Standard Configuration
              DcmDspDidRead: DcmDspDidReadSessionRef=DcmDspSessionRow_DEFAULT_SESSION, DcmDspDidReadSessionRef=DcmDspSessionRow_EXTENDED_DIAGNOSTIC_SESSION  # Project Standard Configuration
          DcmDspDidInfo_SvkBackup51  # Project Standard Configuration
            DcmDspDidAccess  # Project Standard Configuration
              DcmDspDidRead: DcmDspDidReadSessionRef=DcmDspSessionRow_DEFAULT_SESSION, DcmDspDidReadSessionRef=DcmDspSessionRow_EXTENDED_DIAGNOSTIC_SESSION  # Project Standard Configuration
          DcmDspDidInfo_SvkBackup52  # Project Standard Configuration
            DcmDspDidAccess  # Project Standard Configuration
              DcmDspDidRead: DcmDspDidReadSessionRef=DcmDspSessionRow_EXTENDED_DIAGNOSTIC_SESSION, DcmDspDidReadSessionRef=DcmDspSessionRow_DEFAULT_SESSION  # Project Standard Configuration
          DcmDspDidInfo_SvkBackup53  # Project Standard Configuration
            DcmDspDidAccess  # Project Standard Configuration
              DcmDspDidRead: DcmDspDidReadSessionRef=DcmDspSessionRow_EXTENDED_DIAGNOSTIC_SESSION, DcmDspDidReadSessionRef=DcmDspSessionRow_DEFAULT_SESSION  # Project Standard Configuration
          DcmDspDidInfo_SvkBackup54  # Project Standard Configuration
            DcmDspDidAccess  # Project Standard Configuration
              DcmDspDidRead: DcmDspDidReadSessionRef=DcmDspSessionRow_DEFAULT_SESSION, DcmDspDidReadSessionRef=DcmDspSessionRow_EXTENDED_DIAGNOSTIC_SESSION  # Project Standard Configuration
          DcmDspDidInfo_SvkBackup55  # Project Standard Configuration
            DcmDspDidAccess  # Project Standard Configuration
              DcmDspDidRead: DcmDspDidReadSessionRef=DcmDspSessionRow_EXTENDED_DIAGNOSTIC_SESSION, DcmDspDidReadSessionRef=DcmDspSessionRow_DEFAULT_SESSION  # Project Standard Configuration
          DcmDspDidInfo_SvkBackup56  # Project Standard Configuration
            DcmDspDidAccess  # Project Standard Configuration
              DcmDspDidRead: DcmDspDidReadSessionRef=DcmDspSessionRow_DEFAULT_SESSION, DcmDspDidReadSessionRef=DcmDspSessionRow_EXTENDED_DIAGNOSTIC_SESSION  # Project Standard Configuration
          DcmDspDidInfo_SvkBackup57  # Project Standard Configuration
            DcmDspDidAccess  # Project Standard Configuration
              DcmDspDidRead: DcmDspDidReadSessionRef=DcmDspSessionRow_DEFAULT_SESSION, DcmDspDidReadSessionRef=DcmDspSessionRow_EXTENDED_DIAGNOSTIC_SESSION  # Project Standard Configuration
          DcmDspDidInfo_SvkBackup58  # Project Standard Configuration
            DcmDspDidAccess  # Project Standard Configuration
              DcmDspDidRead: DcmDspDidReadSessionRef=DcmDspSessionRow_EXTENDED_DIAGNOSTIC_SESSION, DcmDspDidReadSessionRef=DcmDspSessionRow_DEFAULT_SESSION  # Project Standard Configuration
          DcmDspDidInfo_SvkBackup59  # Project Standard Configuration
            DcmDspDidAccess  # Project Standard Configuration
              DcmDspDidRead: DcmDspDidReadSessionRef=DcmDspSessionRow_DEFAULT_SESSION, DcmDspDidReadSessionRef=DcmDspSessionRow_EXTENDED_DIAGNOSTIC_SESSION  # Project Standard Configuration
          DcmDspDidInfo_SvkBackup60  # Project Standard Configuration
            DcmDspDidAccess  # Project Standard Configuration
              DcmDspDidRead: DcmDspDidReadSessionRef=DcmDspSessionRow_EXTENDED_DIAGNOSTIC_SESSION, DcmDspDidReadSessionRef=DcmDspSessionRow_DEFAULT_SESSION  # Project Standard Configuration
          DcmDspDidInfo_SvkBackup61  # Project Standard Configuration
            DcmDspDidAccess  # Project Standard Configuration
              DcmDspDidRead: DcmDspDidReadSessionRef=DcmDspSessionRow_DEFAULT_SESSION, DcmDspDidReadSessionRef=DcmDspSessionRow_EXTENDED_DIAGNOSTIC_SESSION  # Project Standard Configuration
          DcmDspDidInfo_SvkSysSupplier  # Project Standard Configuration
            DcmDspDidAccess  # Project Standard Configuration
              DcmDspDidRead: DcmDspDidReadSessionRef=DcmDspSessionRow_EXTENDED_DIAGNOSTIC_SESSION, DcmDspDidReadSessionRef=DcmDspSessionRow_DEFAULT_SESSION  # Project Standard Configuration
          DcmDspDidInfo_SvkWerk  # Project Standard Configuration
            DcmDspDidAccess  # Project Standard Configuration
              DcmDspDidRead: DcmDspDidReadSessionRef=DcmDspSessionRow_DEFAULT_SESSION, DcmDspDidReadSessionRef=DcmDspSessionRow_EXTENDED_DIAGNOSTIC_SESSION  # Project Standard Configuration
          DcmDspDidInfo_SwfkDeleteSupported  # Project Standard Configuration
            DcmDspDidAccess  # Project Standard Configuration
              DcmDspDidRead: DcmDspDidReadSessionRef=DcmDspSessionRow_DEFAULT_SESSION, DcmDspDidReadSessionRef=DcmDspSessionRow_EXTENDED_DIAGNOSTIC_SESSION  # Project Standard Configuration
          DcmDspDidInfo_SystemSupplierIdentifier  # Project Standard Configuration
            DcmDspDidAccess  # Project Standard Configuration
              DcmDspDidRead: DcmDspDidReadSessionRef=DcmDspSessionRow_EXTENDED_DIAGNOSTIC_SESSION, DcmDspDidReadSessionRef=DcmDspSessionRow_DEFAULT_SESSION  # Project Standard Configuration
          DcmDspDidInfo_Systemzeit  # Project Standard Configuration
            DcmDspDidAccess  # Project Standard Configuration
              DcmDspDidRead: DcmDspDidReadSessionRef=DcmDspSessionRow_EXTENDED_DIAGNOSTIC_SESSION, DcmDspDidReadSessionRef=DcmDspSessionRow_DEFAULT_SESSION  # Project Standard Configuration
          DcmDspDidInfo_Vin  # Project Standard Configuration
            DcmDspDidAccess  # Project Standard Configuration
              DcmDspDidRead: DcmDspDidReadSessionRef=DcmDspSessionRow_EXTENDED_DIAGNOSTIC_SESSION, DcmDspDidReadSessionRef=DcmDspSessionRow_DEFAULT_SESSION  # Project Standard Configuration
          DcmDspDidInfo_ZgwZertifikat  # Project Standard Configuration
            DcmDspDidAccess  # Project Standard Configuration
              DcmDspDidRead: DcmDspDidReadSessionRef=DcmDspSessionRow_EXTENDED_DIAGNOSTIC_SESSION, DcmDspDidReadSessionRef=DcmDspSessionRow_DEFAULT_SESSION  # Project Standard Configuration
        DcmDspDidRange_Coding (DcmDspDidRange):  # Project Standard Configuration
          DcmDspDidRangeHasGaps = true
          DcmDspDidRangeIdentifierLowerLimit = 12288
          DcmDspDidRangeIdentifierUpperLimit = 14334
          DcmDspDidRangeMaxDataLength = 0
          DcmDspDidRangeUsePort = true
          DcmDspDidRangeInfoRef = DcmDspDidInfo_Cps
        DcmDspRoe  # Project Standard Configuration
          DcmDspRoeEvent  # Project Standard Configuration
          DcmDspRoeEventWindowTime: DcmDspRoeEventWindowTime=DCM_ROE_EVENT_WINDOW_INFINITE, DcmDspRoeStorageState=true  # Project Standard Configuration
        58 x DcmDspRoutine:
          DcmDspRoutine_AblageSystemkontext: DcmDspRoutineIdentifier=16384, DcmDspRoutineUsePort=true, DcmDspRoutineUsed=true, DcmDspRequestResultsRoutineSupported=false, DcmDspStopRoutineSupported=false, DcmDspRoutineInfoRef=DcmDspRoutineInfo_4sZdNY  # Project Standard Configuration
          DcmDspRoutine_ActivateZgwApplicationmode: DcmDspRoutineIdentifier=4111, DcmDspRoutineUsePort=false, DcmDspRoutineUsed=true, DcmDspRequestResultsRoutineSupported=false, DcmDspStopRoutineSupported=false, DcmDspRoutineInfoRef=DcmDspRoutineInfo_4v65x9  # Project Standard Configuration
          DcmDspRoutine_ActivateZgwCodingmode: DcmDspRoutineIdentifier=4109, DcmDspRoutineUsePort=true, DcmDspRoutineUsed=true, DcmDspRequestResultsRoutineSupported=false, DcmDspStopRoutineSupported=false, DcmDspRoutineInfoRef=DcmDspRoutineInfo_2X67zg  # Project Standard Configuration
          DcmDspRoutine_ActivateZgwFlashmode: DcmDspRoutineIdentifier=4110, DcmDspRoutineUsePort=false, DcmDspRoutineUsed=true, DcmDspRequestResultsRoutineSupported=false, DcmDspStopRoutineSupported=false, DcmDspRoutineInfoRef=DcmDspRoutineInfo_4fCQ3y  # Project Standard Configuration
          DcmDspRoutine_CheckCodingSignature: DcmDspRoutineIdentifier=3841, DcmDspRoutineUsePort=true, DcmDspRoutineUsed=true, DcmDspRequestResultsRoutineSupported=false, DcmDspStopRoutineSupported=false, DcmDspRoutineInfoRef=DcmDspRoutineInfo_w6CZ  # Project Standard Configuration
          DcmDspRoutine_CheckHttpConnection: DcmDspRoutineIdentifier=4130, DcmDspRoutineUsePort=true, DcmDspRoutineUsed=true, DcmDspRequestResultsRoutineSupported=false, DcmDspStopRoutineSupported=false, DcmDspRoutineInfoRef=DcmDspRoutineInfo_3Gfcyc  # Project Standard Configuration
          DcmDspRoutine_ControlExtendedEnergySavingState: DcmDspRoutineIdentifier=4099, DcmDspRoutineUsePort=true, DcmDspRoutineUsed=true, DcmDspRequestResultsRoutineSupported=false, DcmDspStopRoutineSupported=false, DcmDspRoutineInfoRef=DcmDspRoutineInfo_3sP0FB  # Project Standard Configuration
          DcmDspRoutine_DiagCommLoopback: DcmDspRoutineIdentifier=771, DcmDspRoutineUsePort=true, DcmDspRoutineUsed=true, DcmDspRequestResultsRoutineSupported=false, DcmDspStopRoutineSupported=false, DcmDspRoutineInfoRef=DcmDspRoutineInfo_14zl3n  # Project Standard Configuration
          DcmDspRoutine_DmClientTriggerDtcEntry: DcmDspRoutineIdentifier=772, DcmDspRoutineUsePort=true, DcmDspRoutineUsed=true, DcmDspRequestResultsRoutineSupported=false, DcmDspStopRoutineSupported=false, DcmDspRoutineInfoRef=DcmDspRoutineInfo_15K4rM  # Project Standard Configuration
          DcmDspRoutine_Energiesparmode: DcmDspRoutineIdentifier=3852, DcmDspRoutineUsePort=true, DcmDspRoutineUsed=true, DcmDspRequestResultsRoutineSupported=false, DcmDspStopRoutineSupported=false, DcmDspRoutineInfoRef=DcmDspRoutineInfo_1T6bNw  # Project Standard Configuration
          DcmDspRoutine_EraseIdrData: DcmDspRoutineIdentifier=4122, DcmDspRoutineUsePort=true, DcmDspRoutineUsed=true, DcmDspRequestResultsRoutineSupported=false, DcmDspStopRoutineSupported=false, DcmDspRoutineInfoRef=DcmDspRoutineInfo_4ctJmy  # Project Standard Configuration
          DcmDspRoutine_EthArlTable: DcmDspRoutineIdentifier=4162, DcmDspRoutineUsePort=true, DcmDspRoutineUsed=true, DcmDspRequestResultsRoutineSupported=false, DcmDspStopRoutineSupported=false, DcmDspRoutineInfoRef=DcmDspRoutineInfo_1SGY3D  # Project Standard Configuration
          DcmDspRoutine_EthArpTable: DcmDspRoutineIdentifier=4163, DcmDspRoutineUsePort=true, DcmDspRoutineUsed=true, DcmDspRequestResultsRoutineSupported=false, DcmDspStopRoutineSupported=false, DcmDspRoutineInfoRef=DcmDspRoutineInfo_29lnT1  # Project Standard Configuration
          DcmDspRoutine_EthEnableTestMode: DcmDspRoutineIdentifier=4172, DcmDspRoutineUsePort=true, DcmDspRoutineUsed=true, DcmDspRequestResultsRoutineSupported=false, DcmDspStopRoutineSupported=false, DcmDspRoutineInfoRef=DcmDspRoutineInfo_2w2P9V  # Project Standard Configuration
          DcmDspRoutine_EthExtendedArlTable: DcmDspRoutineIdentifier=4174, DcmDspRoutineUsePort=true, DcmDspRoutineUsed=true, DcmDspRequestResultsRoutineSupported=false, DcmDspStopRoutineSupported=false, DcmDspRoutineInfoRef=DcmDspRoutineInfo_10R48r  # Project Standard Configuration
          DcmDspRoutine_EthGetDhcpStatus: DcmDspRoutineIdentifier=4175, DcmDspRoutineUsePort=true, DcmDspRoutineUsed=true, DcmDspRequestResultsRoutineSupported=false, DcmDspStopRoutineSupported=false, DcmDspRoutineInfoRef=DcmDspRoutineInfo_5dM0r2  # Project Standard Configuration
          DcmDspRoutine_EthGetEthernetSwitches: DcmDspRoutineIdentifier=4176, DcmDspRoutineUsePort=true, DcmDspRoutineUsed=true, DcmDspRequestResultsRoutineSupported=false, DcmDspStopRoutineSupported=false, DcmDspRoutineInfoRef=DcmDspRoutineInfo_1HDxyB  # Project Standard Configuration
          DcmDspRoutine_EthGetPortTxRxStats: DcmDspRoutineIdentifier=4169, DcmDspRoutineUsePort=true, DcmDspRoutineUsed=true, DcmDspRequestResultsRoutineSupported=false, DcmDspStopRoutineSupported=false, DcmDspRoutineInfoRef=DcmDspRoutineInfo_1n4WLx  # Project Standard Configuration
          DcmDspRoutine_EthGetSwitchVlanConfiguration: DcmDspRoutineIdentifier=4177, DcmDspRoutineUsePort=true, DcmDspRoutineUsed=true, DcmDspRequestResultsRoutineSupported=false, DcmDspStopRoutineSupported=false, DcmDspRoutineInfoRef=DcmDspRoutineInfo_1YcVW4  # Project Standard Configuration
          DcmDspRoutine_EthIpConfiguration: DcmDspRoutineIdentifier=4165, DcmDspRoutineUsePort=true, DcmDspRoutineUsed=true, DcmDspRequestResultsRoutineSupported=false, DcmDspStopRoutineSupported=false, DcmDspRoutineInfoRef=DcmDspRoutineInfo_d9xzR  # Project Standard Configuration
          DcmDspRoutine_EthPhyIdentifier: DcmDspRoutineIdentifier=4167, DcmDspRoutineUsePort=true, DcmDspRoutineUsed=true, DcmDspRequestResultsRoutineSupported=false, DcmDspStopRoutineSupported=false, DcmDspRoutineInfoRef=DcmDspRoutineInfo_4JGv5v  # Project Standard Configuration
          DcmDspRoutine_EthPhySwitchEngineReset: DcmDspRoutineIdentifier=4164, DcmDspRoutineUsePort=true, DcmDspRoutineUsed=true, DcmDspRequestResultsRoutineSupported=false, DcmDspStopRoutineSupported=false, DcmDspRoutineInfoRef=DcmDspRoutineInfo_yqjYv  # Project Standard Configuration
          DcmDspRoutine_EthReadPhyRegister: DcmDspRoutineIdentifier=4161, DcmDspRoutineUsePort=true, DcmDspRoutineUsed=true, DcmDspRequestResultsRoutineSupported=false, DcmDspStopRoutineSupported=false, DcmDspRoutineInfoRef=DcmDspRoutineInfo_4LZ7vb  # Project Standard Configuration
          DcmDspRoutine_EthResetPortTxRxStats: DcmDspRoutineIdentifier=4171, DcmDspRoutineUsePort=true, DcmDspRoutineUsed=true, DcmDspRequestResultsRoutineSupported=false, DcmDspStopRoutineSupported=false, DcmDspRoutineInfoRef=DcmDspRoutineInfo_PCxzr  # Project Standard Configuration
          DcmDspRoutine_EthWritePhyRegister: DcmDspRoutineIdentifier=4173, DcmDspRoutineUsePort=true, DcmDspRoutineUsed=true, DcmDspRequestResultsRoutineSupported=false, DcmDspStopRoutineSupported=false, DcmDspRoutineInfoRef=DcmDspRoutineInfo_4KQsRC  # Project Standard Configuration
          DcmDspRoutine_ExternalHsfz: DcmDspRoutineIdentifier=4131, DcmDspRoutineUsePort=false, DcmDspRoutineUsed=true, DcmDspRequestResultsRoutineSupported=false, DcmDspStopRoutineSupported=false, DcmDspRoutineInfoRef=DcmDspRoutineInfo_3ctCrQ  # Project Standard Configuration
          DcmDspRoutine_FehlerspeicherEndeWerksablauf: DcmDspRoutineIdentifier=4193, DcmDspRoutineUsePort=true, DcmDspRoutineUsed=true, DcmDspRequestResultsRoutineSupported=true, DcmDspStopRoutineSupported=false, DcmDspRoutineInfoRef=DcmDspRoutineInfo_SyJZQ  # Project Standard Configuration
          DcmDspRoutine_FsMsmN101AbfrageFzgsec: DcmDspRoutineIdentifier=532, DcmDspRoutineUsePort=true, DcmDspRoutineUsed=true, DcmDspRequestResultsRoutineSupported=false, DcmDspStopRoutineSupported=false, DcmDspRoutineInfoRef=DcmDspRoutineInfo_10gc40  # Project Standard Configuration
          DcmDspRoutine_FsMsmN102: DcmDspRoutineIdentifier=560, DcmDspRoutineUsePort=true, DcmDspRoutineUsed=true, DcmDspRequestResultsRoutineSupported=false, DcmDspStopRoutineSupported=false, DcmDspRoutineInfoRef=DcmDspRoutine_FsMsmN102_1XQM0  # Project Standard Configuration
          DcmDspRoutine_FsMsmN111: DcmDspRoutineIdentifier=533, DcmDspRoutineUsePort=true, DcmDspRoutineUsed=true, DcmDspRequestResultsRoutineSupported=false, DcmDspStopRoutineSupported=false, DcmDspRoutineInfoRef=DcmDspRoutine_FsMsmN111_1XQMz  # Project Standard Configuration
          DcmDspRoutine_FsMsmN220X: DcmDspRoutineIdentifier=529, DcmDspRoutineUsePort=true, DcmDspRoutineUsed=true, DcmDspRequestResultsRoutineSupported=false, DcmDspStopRoutineSupported=false, DcmDspRoutineInfoRef=DcmDspRoutine_FsMsmN220X_18JjzX  # Project Standard Configuration
          DcmDspRoutine_FsMsmN300XTeleservice: DcmDspRoutineIdentifier=528, DcmDspRoutineUsePort=true, DcmDspRoutineUsed=true, DcmDspRequestResultsRoutineSupported=true, DcmDspStopRoutineSupported=false, DcmDspRoutineInfoRef=DcmDspRoutineInfo_43dZYd  # Project Standard Configuration
          DcmDspRoutine_FsN251: DcmDspRoutineIdentifier=564, DcmDspRoutineUsePort=true, DcmDspRoutineUsed=true, DcmDspRequestResultsRoutineSupported=false, DcmDspStopRoutineSupported=false, DcmDspRoutineInfoRef=DcmDspRoutine_FsN251_YxHYY  # Project Standard Configuration
          DcmDspRoutine_FsN252: DcmDspRoutineIdentifier=565, DcmDspRoutineUsePort=true, DcmDspRoutineUsed=true, DcmDspRequestResultsRoutineSupported=false, DcmDspStopRoutineSupported=false, DcmDspRoutineInfoRef=DcmDspRoutine_FsN252_YxHYZ  # Project Standard Configuration
          DcmDspRoutine_FsN30X: DcmDspRoutineIdentifier=524, DcmDspRoutineUsePort=true, DcmDspRoutineUsed=true, DcmDspRequestResultsRoutineSupported=true, DcmDspStopRoutineSupported=false, DcmDspRoutineInfoRef=DcmDspRoutine_FsN30X_YxJhc  # Project Standard Configuration
          DcmDspRoutine_FsN31034: DcmDspRoutineIdentifier=530, DcmDspRoutineUsePort=true, DcmDspRoutineUsed=true, DcmDspRequestResultsRoutineSupported=false, DcmDspStopRoutineSupported=false, DcmDspRoutineInfoRef=DcmDspRoutine_FsN31034_2gPlQH  # Project Standard Configuration
          DcmDspRoutine_FsN5005: DcmDspRoutineIdentifier=531, DcmDspRoutineUsePort=true, DcmDspRoutineUsed=true, DcmDspRequestResultsRoutineSupported=true, DcmDspStopRoutineSupported=false, DcmDspRoutineInfoRef=DcmDspRoutine_FsN5005_1TzqYQ  # Project Standard Configuration
          DcmDspRoutine_FsN5012: DcmDspRoutineIdentifier=568, DcmDspRoutineUsePort=true, DcmDspRoutineUsed=true, DcmDspRequestResultsRoutineSupported=true, DcmDspStopRoutineSupported=false, DcmDspRoutineInfoRef=DcmDspRoutine_FsN5012_1TzqZm  # Project Standard Configuration
          DcmDspRoutine_FsN5034: DcmDspRoutineIdentifier=569, DcmDspRoutineUsePort=true, DcmDspRoutineUsed=true, DcmDspRequestResultsRoutineSupported=true, DcmDspStopRoutineSupported=false, DcmDspRoutineInfoRef=DcmDspRoutine_FsN5034_1Tzr0B  # Project Standard Configuration
          DcmDspRoutine_FsN70X: DcmDspRoutineIdentifier=527, DcmDspRoutineUsePort=true, DcmDspRoutineUsed=true, DcmDspRequestResultsRoutineSupported=true, DcmDspStopRoutineSupported=false, DcmDspRoutineInfoRef=DcmDspRoutine_FsN70X_YxKJ7  # Project Standard Configuration
          DcmDspRoutine_FsN7112: DcmDspRoutineIdentifier=534, DcmDspRoutineUsePort=true, DcmDspRoutineUsed=true, DcmDspRequestResultsRoutineSupported=true, DcmDspStopRoutineSupported=false, DcmDspRoutineInfoRef=DcmDspRoutine_FsN7112_1TzSmF  # Project Standard Configuration
          DcmDspRoutine_GetActualConfig: DcmDspRoutineIdentifier=4113, DcmDspRoutineUsePort=false, DcmDspRoutineUsed=true, DcmDspRequestResultsRoutineSupported=false, DcmDspStopRoutineSupported=false, DcmDspRoutineInfoRef=DcmDspRoutineInfo_pCCkH  # Project Standard Configuration
          DcmDspRoutine_IndividualDatenRettung: DcmDspRoutineIdentifier=4098, DcmDspRoutineUsePort=true, DcmDspRoutineUsed=true, DcmDspRequestResultsRoutineSupported=false, DcmDspStopRoutineSupported=false, DcmDspRoutineInfoRef=DcmDspRoutineInfo_2sK1ff  # Project Standard Configuration
          DcmDspRoutine_InitLinBus: DcmDspRoutineIdentifier=16387, DcmDspRoutineUsePort=true, DcmDspRoutineUsed=true, DcmDspRequestResultsRoutineSupported=false, DcmDspStopRoutineSupported=false, DcmDspRoutineInfoRef=DcmDspRoutine_InitLinBus_4NDgMR  # Project Standard Configuration
          DcmDspRoutine_InitLinSlave: DcmDspRoutineIdentifier=4128, DcmDspRoutineUsePort=true, DcmDspRoutineUsed=true, DcmDspRequestResultsRoutineSupported=false, DcmDspStopRoutineSupported=false, DcmDspRoutineInfoRef=DcmDspRoutineInfo_4C5wFQ  # Project Standard Configuration
          DcmDspRoutine_IsLoeschen: DcmDspRoutineIdentifier=3846, DcmDspRoutineUsePort=true, DcmDspRoutineUsed=true, DcmDspRequestResultsRoutineSupported=false, DcmDspStopRoutineSupported=false, DcmDspRoutineInfoRef=DcmDspRoutine_IsLoeschen_26SwJG  # Project Standard Configuration
          DcmDspRoutine_RamDatenSchreiben: DcmDspRoutineIdentifier=16390, DcmDspRoutineUsePort=true, DcmDspRoutineUsed=true, DcmDspRequestResultsRoutineSupported=true, DcmDspStopRoutineSupported=false, DcmDspRoutineInfoRef=DcmDspRoutineInfo_3MGry8  # Project Standard Configuration
          DcmDspRoutine_RcCpp: DcmDspRoutineIdentifier=518, DcmDspRoutineUsePort=true, DcmDspRoutineUsed=true, DcmDspRequestResultsRoutineSupported=false, DcmDspStopRoutineSupported=false, DcmDspRoutineInfoRef=DcmDspRoutine_RcCpp_q1vmL  # Project Standard Configuration
          DcmDspRoutine_RcCppc: DcmDspRoutineIdentifier=515, DcmDspRoutineUsePort=true, DcmDspRoutineUsed=true, DcmDspRequestResultsRoutineSupported=false, DcmDspStopRoutineSupported=false, DcmDspRoutineInfoRef=DcmDspRoutine_RcCppc_1Qt2kP  # Project Standard Configuration
          DcmDspRoutine_RcHdddRi4002: DcmDspRequestResultsRoutineSupported=false, DcmDspStopRoutineSupported=false, DcmDspRoutineInfoRef=DcmDspRoutineInfo_x6nJQ  # Project Standard Configuration
          DcmDspRoutine_RcPad: DcmDspRoutineIdentifier=28672, DcmDspRoutineUsePort=true, DcmDspRoutineUsed=true, DcmDspRequestResultsRoutineSupported=false, DcmDspStopRoutineSupported=false, DcmDspRoutineInfoRef=DcmDspRoutine_RcPad_q1zPQ  # Project Standard Configuration
          DcmDspRoutine_RcRswedi: DcmDspRoutineIdentifier=517, DcmDspRoutineUsePort=true, DcmDspRoutineUsed=true, DcmDspRequestResultsRoutineSupported=false, DcmDspStopRoutineSupported=false, DcmDspRoutineInfoRef=DcmDspRoutine_RcRswedi_3rXcSz  # Project Standard Configuration
          DcmDspRoutine_RequestPreferredProtocol: DcmDspRoutineIdentifier=4129, DcmDspRoutineUsePort=true, DcmDspRoutineUsed=true, DcmDspRequestResultsRoutineSupported=false, DcmDspStopRoutineSupported=false, DcmDspRoutineInfoRef=DcmDspRoutineInfo_1VGBKh  # Project Standard Configuration
          DcmDspRoutine_ResetAktivierungsleitung: DcmDspRoutineIdentifier=4132, DcmDspRoutineUsePort=true, DcmDspRoutineUsed=true, DcmDspRequestResultsRoutineSupported=false, DcmDspStopRoutineSupported=false, DcmDspRoutineInfoRef=DcmDspRoutineInfo_4HTyTy  # Project Standard Configuration
          DcmDspRoutine_SetDefaultBus: DcmDspRoutineIdentifier=4112, DcmDspRoutineUsePort=false, DcmDspRoutineUsed=true, DcmDspRequestResultsRoutineSupported=false, DcmDspStopRoutineSupported=false, DcmDspRoutineInfoRef=DcmDspRoutineInfo_1gWdmq  # Project Standard Configuration
          DcmDspRoutine_StartSystime: DcmDspRoutineIdentifier=4101, DcmDspRoutineUsePort=true, DcmDspRoutineUsed=true, DcmDspRequestResultsRoutineSupported=false, DcmDspStopRoutineSupported=false, DcmDspRoutineInfoRef=DcmDspRoutineInfo_1X4xzf  # Project Standard Configuration
          DcmDspRoutine_SteuernDmFssMaster: DcmDspRoutineIdentifier=773, DcmDspRoutineUsePort=true, DcmDspRoutineUsed=true, DcmDspRequestResultsRoutineSupported=false, DcmDspStopRoutineSupported=true, DcmDspRoutineInfoRef=DcmDspRoutineInfo_3yymQj  # Project Standard Configuration
          DcmDspRoutine_Swt: DcmDspRoutineIdentifier=3871, DcmDspRoutineUsePort=true, DcmDspRoutineUsed=true, DcmDspRequestResultsRoutineSupported=false, DcmDspStopRoutineSupported=false, DcmDspRoutineInfoRef=DcmDspRoutine_Swt_3DPx9T  # Project Standard Configuration
        DcmDspSecurity  # Project Standard Configuration
          3 x DcmDspSecurityRow, all with DcmDspSecurityADRSize=4, DcmDspSecurityAttemptCounterEnabled=false, DcmDspSecurityDelayTime=0, DcmDspSecurityDelayTimeOnBoot=0, DcmDspSecuritySeedSize=8, DcmDspSecurityUsePort=USE_ASYNCH_CLIENT_SERVER:
            DcmDspSecurityRow_Coding: DcmDspSecurityLevel=1  # Project Standard Configuration
            DcmDspSecurityRow_Programming_HDD: DcmDspSecurityLevel=9  # Project Standard Configuration
            DcmDspSecurityRow_Swt: DcmDspSecurityLevel=10  # Project Standard Configuration
        DcmDspSession  # Project Standard Configuration
          6 x DcmDspSessionRow, all with DcmDspSessionForBoot=DCM_NO_BOOT:
            DcmDspSessionRow_CODING_SESSION: DcmDspSessionLevel=65, DcmDspSessionP2StarServerMax=5  # Project Standard Configuration
            DcmDspSessionRow_DEFAULT_SESSION: DcmDspSessionLevel=1, DcmDspSessionP2ServerMax=0.05, DcmDspSessionP2StarServerMax=5  # Project Standard Configuration
            DcmDspSessionRow_EXTENDED_DIAGNOSTIC_SESSION: DcmDspSessionLevel=3, DcmDspSessionP2StarServerMax=5  # Project Standard Configuration
            DcmDspSessionRow_HDD_DOWNLOAD_SESSION: DcmDspSessionLevel=67, DcmDspSessionP2StarServerMax=5  # Project Standard Configuration
            DcmDspSessionRow_PROGRAMMING_SESSION: DcmDspSessionLevel=2  # Project Standard Configuration
            DcmDspSessionRow_SWT_SESSION: DcmDspSessionLevel=66  # Project Standard Configuration
        58 x DcmDspRoutineInfo:
          DcmDspRoutineInfo_4sZdNY  # Project Standard Configuration
            DcmDspRoutineAuthorization: DcmDspRoutineSessionRef=DcmDspSessionRow_DEFAULT_SESSION, DcmDspRoutineSessionRef=DcmDspSessionRow_EXTENDED_DIAGNOSTIC_SESSION  # Project Standard Configuration
            DcmDspStartRoutineIn_START_AblageSystemkontext (DcmDspStartRoutineIn)  # Project Standard Configuration
              DcmDspStartRoutineInSignal_Function (DcmDspStartRoutineInSignal): DcmDspRoutineSignalEndianness=BIG_ENDIAN, DcmDspRoutineSignalLength=8, DcmDspRoutineSignalPos=0, DcmDspRoutineSignalType=UINT8  # Project Standard Configuration
            DcmDspStartRoutineOut_START_AblageSystemkontext (DcmDspStartRoutineOut)  # Project Standard Configuration
              DcmDspStartRoutineOutSignal_StatDmLockState (DcmDspStartRoutineOutSignal): DcmDspRoutineSignalEndianness=BIG_ENDIAN, DcmDspRoutineSignalLength=8, DcmDspRoutineSignalPos=8, DcmDspRoutineSignalType=UINT8  # Project Standard Configuration
              DcmDspStartRoutineOutSignal_StatFunction (DcmDspStartRoutineOutSignal): DcmDspRoutineSignalEndianness=BIG_ENDIAN, DcmDspRoutineSignalLength=8, DcmDspRoutineSignalPos=0, DcmDspRoutineSignalType=UINT8  # Project Standard Configuration
          DcmDspRoutineInfo_4v65x9  # Project Standard Configuration
            DcmDspRoutineAuthorization: DcmDspRoutineSessionRef=DcmDspSessionRow_EXTENDED_DIAGNOSTIC_SESSION  # Project Standard Configuration
          DcmDspRoutineInfo_2X67zg  # Project Standard Configuration
            DcmDspRoutineAuthorization: DcmDspRoutineSessionRef=DcmDspSessionRow_CODING_SESSION  # Project Standard Configuration
          DcmDspRoutineInfo_4fCQ3y  # Project Standard Configuration
            DcmDspRoutineAuthorization: DcmDspRoutineSessionRef=DcmDspSessionRow_EXTENDED_DIAGNOSTIC_SESSION  # Project Standard Configuration
          DcmDspRoutineInfo_w6CZ  # Project Standard Configuration
            DcmDspRoutineAuthorization: DcmDspRoutineSecurityLevelRef=DcmDspSecurityRow_Coding, DcmDspRoutineSessionRef=DcmDspSessionRow_CODING_SESSION  # Project Standard Configuration
            DcmDspStartRoutineOut_START_CheckCodingSignature (DcmDspStartRoutineOut)  # Project Standard Configuration
              DcmDspStartRoutineOutSignal_DataOutX (DcmDspStartRoutineOutSignal): DcmDspRoutineSignalLength=8, DcmDspRoutineSignalPos=0, DcmDspRoutineSignalType=UINT8  # Project Standard Configuration
          DcmDspRoutineInfo_3Gfcyc  # Project Standard Configuration
            DcmDspRoutineAuthorization: DcmDspRoutineSessionRef=DcmDspSessionRow_DEFAULT_SESSION, DcmDspRoutineSessionRef=DcmDspSessionRow_EXTENDED_DIAGNOSTIC_SESSION  # Project Standard Configuration
            DcmDspStartRoutineIn_START_CheckHttpConnection (DcmDspStartRoutineIn)  # Project Standard Configuration
              DcmDspStartRoutineInSignal_ServerUrl (DcmDspStartRoutineInSignal): DcmDspRoutineSignalPos=32  # Project Standard Configuration
              DcmDspStartRoutineInSignal_TimeOutTime (DcmDspStartRoutineInSignal): DcmDspRoutineSignalEndianness=BIG_ENDIAN, DcmDspRoutineSignalLength=32, DcmDspRoutineSignalPos=0, DcmDspRoutineSignalType=UINT32  # Project Standard Configuration
            DcmDspStartRoutineOut_START_CheckHttpConnection (DcmDspStartRoutineOut)  # Project Standard Configuration
              DcmDspStartRoutineOutSignal_HttpConnectionStatus (DcmDspStartRoutineOutSignal): DcmDspRoutineSignalEndianness=BIG_ENDIAN, DcmDspRoutineSignalLength=8, DcmDspRoutineSignalPos=0, DcmDspRoutineSignalType=UINT8  # Project Standard Configuration
              DcmDspStartRoutineOutSignal_HttpResponseCode (DcmDspStartRoutineOutSignal): DcmDspRoutineSignalEndianness=BIG_ENDIAN, DcmDspRoutineSignalLength=16, DcmDspRoutineSignalPos=8, DcmDspRoutineSignalType=UINT16  # Project Standard Configuration
          DcmDspRoutineInfo_3sP0FB  # Project Standard Configuration
            DcmDspRoutineAuthorization: DcmDspRoutineSessionRef=DcmDspSessionRow_DEFAULT_SESSION, DcmDspRoutineSessionRef=DcmDspSessionRow_EXTENDED_DIAGNOSTIC_SESSION  # Project Standard Configuration
            DcmDspStartRoutineIn_START_ControlExtendedEnergySavingState (DcmDspStartRoutineIn)  # Project Standard Configuration
              DcmDspStartRoutineInSignal_ExtendedOperatingMode (DcmDspStartRoutineInSignal): DcmDspRoutineSignalLength=8, DcmDspRoutineSignalPos=0, DcmDspRoutineSignalType=UINT8  # Project Standard Configuration
          DcmDspRoutineInfo_14zl3n  # Project Standard Configuration
            DcmDspRoutineAuthorization: DcmDspRoutineSessionRef=DcmDspSessionRow_DEFAULT_SESSION, DcmDspRoutineSessionRef=DcmDspSessionRow_EXTENDED_DIAGNOSTIC_SESSION  # Project Standard Configuration
            DcmDspStartRoutineIn_START_DiagCommLoopback (DcmDspStartRoutineIn)  # Project Standard Configuration
              DcmDspStartRoutineInSignal_dataIn (DcmDspStartRoutineInSignal): DcmDspRoutineSignalPos=0, DcmDspRoutineSignalType=VARIABLE_LENGTH  # Project Standard Configuration
            DcmDspStartRoutineOut_START_DiagCommLoopback (DcmDspStartRoutineOut)  # Project Standard Configuration
              DcmDspStartRoutineOutSignal_dataOut (DcmDspStartRoutineOutSignal): DcmDspRoutineSignalPos=0, DcmDspRoutineSignalType=VARIABLE_LENGTH  # Project Standard Configuration
          DcmDspRoutineInfo_15K4rM  # Project Standard Configuration
            DcmDspRoutineAuthorization: DcmDspRoutineSessionRef=DcmDspSessionRow_DEFAULT_SESSION, DcmDspRoutineSessionRef=DcmDspSessionRow_EXTENDED_DIAGNOSTIC_SESSION  # Project Standard Configuration
            DcmDspStartRoutineIn_START_DmClientTriggerDtcEntry (DcmDspStartRoutineIn)  # Project Standard Configuration
              DcmDspStartRoutineInSignal_DTCType (DcmDspStartRoutineInSignal): DcmDspRoutineSignalLength=8, DcmDspRoutineSignalPos=0, DcmDspRoutineSignalType=UINT8  # Project Standard Configuration
            DcmDspStartRoutineOut_START_DmClientTriggerDtcEntry (DcmDspStartRoutineOut)  # Project Standard Configuration
              4 x DcmDspStartRoutineOutSignal, all with DcmDspRoutineSignalLength=8, DcmDspRoutineSignalType=UINT8:
                DcmDspStartRoutineOutSignal_DTCByte1: DcmDspRoutineSignalPos=8  # Project Standard Configuration
                DcmDspStartRoutineOutSignal_DTCByte2: DcmDspRoutineSignalPos=16  # Project Standard Configuration
                DcmDspStartRoutineOutSignal_DTCByte3: DcmDspRoutineSignalPos=24  # Project Standard Configuration
                DcmDspStartRoutineOutSignal_DTCTypeOut: DcmDspRoutineSignalPos=0  # Project Standard Configuration
          DcmDspRoutineInfo_1T6bNw  # Project Standard Configuration
            DcmDspRoutineAuthorization: DcmDspRoutineSessionRef=DcmDspSessionRow_DEFAULT_SESSION, DcmDspRoutineSessionRef=DcmDspSessionRow_EXTENDED_DIAGNOSTIC_SESSION  # Project Standard Configuration
            DcmDspStartRoutineIn_START_Energiesparmode (DcmDspStartRoutineIn)  # Project Standard Configuration
              DcmDspStartRoutineInSignal_OperatingMode (DcmDspStartRoutineInSignal): DcmDspRoutineSignalLength=8, DcmDspRoutineSignalPos=0, DcmDspRoutineSignalType=UINT8  # Project Standard Configuration
          DcmDspRoutineInfo_4ctJmy  # Project Standard Configuration
            DcmDspRoutineAuthorization: DcmDspRoutineSessionRef=DcmDspSessionRow_EXTENDED_DIAGNOSTIC_SESSION  # Project Standard Configuration
            DcmDspStartRoutineOut_START_EraseIdrData (DcmDspStartRoutineOut)  # Project Standard Configuration
              DcmDspStartRoutineOutSignal_routineResult (DcmDspStartRoutineOutSignal): DcmDspRoutineSignalLength=8, DcmDspRoutineSignalPos=0, DcmDspRoutineSignalType=UINT8  # Project Standard Configuration
          DcmDspRoutineInfo_1SGY3D  # Project Standard Configuration
            DcmDspRoutineAuthorization: DcmDspRoutineSessionRef=DcmDspSessionRow_DEFAULT_SESSION, DcmDspRoutineSessionRef=DcmDspSessionRow_EXTENDED_DIAGNOSTIC_SESSION  # Project Standard Configuration
            DcmDspStartRoutineIn_START_EthArlTable (DcmDspStartRoutineIn)  # Project Standard Configuration
              DcmDspStartRoutineInSignal_PortIndex (DcmDspStartRoutineInSignal): DcmDspRoutineSignalEndianness=BIG_ENDIAN, DcmDspRoutineSignalLength=8, DcmDspRoutineSignalPos=0, DcmDspRoutineSignalType=UINT8  # Project Standard Configuration
            DcmDspStartRoutineOut_START_EthArlTable (DcmDspStartRoutineOut)  # Project Standard Configuration
              DcmDspStartRoutineOutSignal_StatArlVlanIdEntries (DcmDspStartRoutineOutSignal): DcmDspRoutineSignalPos=8  # Project Standard Configuration
              DcmDspStartRoutineOutSignal_StatNumArlVlanIdEntriesWert (DcmDspStartRoutineOutSignal): DcmDspRoutineSignalEndianness=BIG_ENDIAN, DcmDspRoutineSignalLength=8, DcmDspRoutineSignalPos=0, DcmDspRoutineSignalType=UINT8  # Project Standard Configuration
          DcmDspRoutineInfo_29lnT1  # Project Standard Configuration
            DcmDspRoutineAuthorization: DcmDspRoutineSessionRef=DcmDspSessionRow_DEFAULT_SESSION, DcmDspRoutineSessionRef=DcmDspSessionRow_EXTENDED_DIAGNOSTIC_SESSION  # Project Standard Configuration
            DcmDspStartRoutineIn_START_EthArpTable (DcmDspStartRoutineIn)  # Project Standard Configuration
              DcmDspStartRoutineInSignal_ArpTableForIpAddress (DcmDspStartRoutineInSignal): DcmDspRoutineSignalPos=8  # Project Standard Configuration
              DcmDspStartRoutineInSignal_IpVersion (DcmDspStartRoutineInSignal): DcmDspRoutineSignalEndianness=BIG_ENDIAN, DcmDspRoutineSignalLength=8, DcmDspRoutineSignalPos=0, DcmDspRoutineSignalType=UINT8  # Project Standard Configuration
            DcmDspStartRoutineOut_START_EthArpTable (DcmDspStartRoutineOut)  # Project Standard Configuration
              DcmDspStartRoutineOutSignal_StatArpIpMacEntries (DcmDspStartRoutineOutSignal): DcmDspRoutineSignalPos=8  # Project Standard Configuration
              DcmDspStartRoutineOutSignal_StatNumArpEntriesWert (DcmDspStartRoutineOutSignal): DcmDspRoutineSignalEndianness=BIG_ENDIAN, DcmDspRoutineSignalLength=8, DcmDspRoutineSignalPos=0, DcmDspRoutineSignalType=UINT8  # Project Standard Configuration
          DcmDspRoutineInfo_2w2P9V  # Project Standard Configuration
            DcmDspRoutineAuthorization: DcmDspRoutineSessionRef=DcmDspSessionRow_EXTENDED_DIAGNOSTIC_SESSION  # Project Standard Configuration
            DcmDspStartRoutineIn_START_EthEnableTestMode (DcmDspStartRoutineIn)  # Project Standard Configuration
              3 x DcmDspStartRoutineInSignal, all with DcmDspRoutineSignalEndianness=BIG_ENDIAN, DcmDspRoutineSignalLength=8, DcmDspRoutineSignalType=UINT8:
                DcmDspStartRoutineInSignal_PortIndex: DcmDspRoutineSignalPos=0  # Project Standard Configuration
                DcmDspStartRoutineInSignal_TestDuration: DcmDspRoutineSignalPos=8  # Project Standard Configuration
                DcmDspStartRoutineInSignal_TestModeId: DcmDspRoutineSignalPos=16  # Project Standard Configuration
            DcmDspStartRoutineOut_START_EthEnableTestMode (DcmDspStartRoutineOut)  # Project Standard Configuration
              DcmDspStartRoutineOutSignal_StatPhyTestMode (DcmDspStartRoutineOutSignal): DcmDspRoutineSignalEndianness=BIG_ENDIAN, DcmDspRoutineSignalLength=8, DcmDspRoutineSignalPos=0, DcmDspRoutineSignalType=UINT8  # Project Standard Configuration
          DcmDspRoutineInfo_10R48r  # Project Standard Configuration
            DcmDspRoutineAuthorization: DcmDspRoutineSessionRef=DcmDspSessionRow_DEFAULT_SESSION, DcmDspRoutineSessionRef=DcmDspSessionRow_EXTENDED_DIAGNOSTIC_SESSION  # Project Standard Configuration
            DcmDspStartRoutineOut_START_EthExtendedArlTable (DcmDspStartRoutineOut)  # Project Standard Configuration
              DcmDspStartRoutineOutSignal_StatExtendedArlVlanIdEntries (DcmDspStartRoutineOutSignal): DcmDspRoutineSignalPos=8  # Project Standard Configuration
              DcmDspStartRoutineOutSignal_StatNumArlVlanIdEntriesWert (DcmDspStartRoutineOutSignal): DcmDspRoutineSignalEndianness=BIG_ENDIAN, DcmDspRoutineSignalLength=8, DcmDspRoutineSignalPos=0, DcmDspRoutineSignalType=UINT8  # Project Standard Configuration
          DcmDspRoutineInfo_5dM0r2  # Project Standard Configuration
            DcmDspRoutineAuthorization:  # Project Standard Configuration
              DcmDspRoutineSessionRef = DcmDspSessionRow_CODING_SESSION
              DcmDspRoutineSessionRef = DcmDspSessionRow_DEFAULT_SESSION
              DcmDspRoutineSessionRef = DcmDspSessionRow_EXTENDED_DIAGNOSTIC_SESSION
            DcmDspStartRoutineIn_START_EthGetDhcpStatus (DcmDspStartRoutineIn)  # Project Standard Configuration
              DcmDspStartRoutineInSignal_NwInterfaceIndex (DcmDspStartRoutineInSignal): DcmDspRoutineSignalEndianness=BIG_ENDIAN, DcmDspRoutineSignalLength=8, DcmDspRoutineSignalPos=0, DcmDspRoutineSignalType=UINT8  # Project Standard Configuration
            DcmDspStartRoutineOut_START_EthGetDhcpStatus (DcmDspStartRoutineOut)  # Project Standard Configuration
              DcmDspStartRoutineOutSignal_StatDhcpClientState (DcmDspStartRoutineOutSignal): DcmDspRoutineSignalEndianness=BIG_ENDIAN, DcmDspRoutineSignalLength=8, DcmDspRoutineSignalPos=0, DcmDspRoutineSignalType=UINT8  # Project Standard Configuration
          DcmDspRoutineInfo_1HDxyB  # Project Standard Configuration
            DcmDspRoutineAuthorization:  # Project Standard Configuration
              DcmDspRoutineSessionRef = DcmDspSessionRow_CODING_SESSION
              DcmDspRoutineSessionRef = DcmDspSessionRow_DEFAULT_SESSION
              DcmDspRoutineSessionRef = DcmDspSessionRow_EXTENDED_DIAGNOSTIC_SESSION
            DcmDspStartRoutineOut_START_EthGetEthernetSwitches (DcmDspStartRoutineOut)  # Project Standard Configuration
              DcmDspStartRoutineOutSignal_StatEthSwitchEntries (DcmDspStartRoutineOutSignal): DcmDspRoutineSignalPos=8  # Project Standard Configuration
              DcmDspStartRoutineOutSignal_StatNumEthSwitchEntriesWert (DcmDspStartRoutineOutSignal): DcmDspRoutineSignalEndianness=BIG_ENDIAN, DcmDspRoutineSignalLength=8, DcmDspRoutineSignalPos=0, DcmDspRoutineSignalType=UINT8  # Project Standard Configuration
          DcmDspRoutineInfo_1n4WLx  # Project Standard Configuration
            DcmDspRoutineAuthorization: DcmDspRoutineSessionRef=DcmDspSessionRow_DEFAULT_SESSION, DcmDspRoutineSessionRef=DcmDspSessionRow_EXTENDED_DIAGNOSTIC_SESSION  # Project Standard Configuration
            DcmDspStartRoutineIn_START_EthGetPortTxRxStats (DcmDspStartRoutineIn)  # Project Standard Configuration
              DcmDspStartRoutineInSignal_PortIndex (DcmDspStartRoutineInSignal): DcmDspRoutineSignalEndianness=BIG_ENDIAN, DcmDspRoutineSignalLength=8, DcmDspRoutineSignalPos=0, DcmDspRoutineSignalType=UINT8  # Project Standard Configuration
            DcmDspStartRoutineOut_START_EthGetPortTxRxStats (DcmDspStartRoutineOut)  # Project Standard Configuration
              6 x DcmDspStartRoutineOutSignal, all with DcmDspRoutineSignalEndianness=BIG_ENDIAN, DcmDspRoutineSignalLength=32, DcmDspRoutineSignalType=UINT32:
                DcmDspStartRoutineOutSignal_StatBytesSentWert: DcmDspRoutineSignalPos=32  # Project Standard Configuration
                DcmDspStartRoutineOutSignal_StatNumberOfDroppedRxPacketsWert: DcmDspRoutineSignalPos=160  # Project Standard Configuration
                DcmDspStartRoutineOutSignal_StatNumberOfDroppedTxPacketsWert: DcmDspRoutineSignalPos=64  # Project Standard Configuration
                DcmDspStartRoutineOutSignal_StatNumberOfReceivedPacketsWert: DcmDspRoutineSignalPos=96  # Project Standard Configuration
                DcmDspStartRoutineOutSignal_StatNumberOfTransmittedPacketsWert: DcmDspRoutineSignalPos=0  # Project Standard Configuration
                DcmDspStartRoutineOutSignal_StatStatBytesReceivedWert: DcmDspRoutineSignalPos=128  # Project Standard Configuration
          DcmDspRoutineInfo_1YcVW4  # Project Standard Configuration
            DcmDspRoutineAuthorization:  # Project Standard Configuration
              DcmDspRoutineSessionRef = DcmDspSessionRow_CODING_SESSION
              DcmDspRoutineSessionRef = DcmDspSessionRow_DEFAULT_SESSION
              DcmDspRoutineSessionRef = DcmDspSessionRow_EXTENDED_DIAGNOSTIC_SESSION
            DcmDspStartRoutineIn_START_EthGetSwitchVlanConfiguration (DcmDspStartRoutineIn)  # Project Standard Configuration
              DcmDspStartRoutineInSignal_SwitchIndex (DcmDspStartRoutineInSignal): DcmDspRoutineSignalEndianness=BIG_ENDIAN, DcmDspRoutineSignalLength=8, DcmDspRoutineSignalPos=0, DcmDspRoutineSignalType=UINT8  # Project Standard Configuration
            DcmDspStartRoutineOut_START_EthGetSwitchVlanConfiguration (DcmDspStartRoutineOut)  # Project Standard Configuration
              DcmDspStartRoutineOutSignal_StatNumVlanConfigurationEntriesWert (DcmDspStartRoutineOutSignal): DcmDspRoutineSignalEndianness=BIG_ENDIAN, DcmDspRoutineSignalLength=8, DcmDspRoutineSignalPos=0, DcmDspRoutineSignalType=UINT8  # Project Standard Configuration
              DcmDspStartRoutineOutSignal_StatVlanConfigEntries (DcmDspStartRoutineOutSignal): DcmDspRoutineSignalPos=8  # Project Standard Configuration
          DcmDspRoutineInfo_d9xzR  # Project Standard Configuration
            DcmDspRoutineAuthorization: DcmDspRoutineSessionRef=DcmDspSessionRow_DEFAULT_SESSION, DcmDspRoutineSessionRef=DcmDspSessionRow_EXTENDED_DIAGNOSTIC_SESSION  # Project Standard Configuration
            DcmDspStartRoutineIn_START_EthIpConfiguration (DcmDspStartRoutineIn)  # Project Standard Configuration
              DcmDspStartRoutineInSignal_InternalExternalAddress (DcmDspStartRoutineInSignal): DcmDspRoutineSignalEndianness=BIG_ENDIAN, DcmDspRoutineSignalLength=8, DcmDspRoutineSignalPos=0, DcmDspRoutineSignalType=UINT8  # Project Standard Configuration
              DcmDspStartRoutineInSignal_TriggerGratuitousArp (DcmDspStartRoutineInSignal): DcmDspRoutineSignalEndianness=BIG_ENDIAN, DcmDspRoutineSignalLength=8, DcmDspRoutineSignalPos=8, DcmDspRoutineSignalType=UINT8  # Project Standard Configuration
            DcmDspStartRoutineOut_START_EthIpConfiguration (DcmDspStartRoutineOut)  # Project Standard Configuration
              DcmDspStartRoutineOutSignal_EcuType (DcmDspStartRoutineOutSignal): DcmDspRoutineSignalEndianness=BIG_ENDIAN, DcmDspRoutineSignalLength=8, DcmDspRoutineSignalPos=0, DcmDspRoutineSignalType=UINT8  # Project Standard Configuration
              DcmDspStartRoutineOutSignal_StatEthIpConfiguration (DcmDspStartRoutineOutSignal): DcmDspRoutineSignalPos=8  # Project Standard Configuration
          DcmDspRoutineInfo_4JGv5v  # Project Standard Configuration
            DcmDspRoutineAuthorization: DcmDspRoutineSessionRef=DcmDspSessionRow_DEFAULT_SESSION, DcmDspRoutineSessionRef=DcmDspSessionRow_EXTENDED_DIAGNOSTIC_SESSION  # Project Standard Configuration
            DcmDspStartRoutineIn_START_EthPhyIdentifier (DcmDspStartRoutineIn)  # Project Standard Configuration
              DcmDspStartRoutineInSignal_PortIndex (DcmDspStartRoutineInSignal): DcmDspRoutineSignalEndianness=BIG_ENDIAN, DcmDspRoutineSignalLength=8, DcmDspRoutineSignalPos=0, DcmDspRoutineSignalType=UINT8  # Project Standard Configuration
            DcmDspStartRoutineOut_START_EthPhyIdentifier (DcmDspStartRoutineOut)  # Project Standard Configuration
              DcmDspStartRoutineOutSignal_StatOuiData (DcmDspStartRoutineOutSignal): DcmDspRoutineSignalEndianness=BIG_ENDIAN, DcmDspRoutineSignalLength=48, DcmDspRoutineSignalPos=0, DcmDspRoutineSignalType=VARIABLE_LENGTH  # Project Standard Configuration
          DcmDspRoutineInfo_yqjYv  # Project Standard Configuration
            DcmDspRoutineAuthorization: DcmDspRoutineSessionRef=DcmDspSessionRow_EXTENDED_DIAGNOSTIC_SESSION  # Project Standard Configuration
            DcmDspStartRoutineIn_START_EthPhySwitchEngineReset (DcmDspStartRoutineIn)  # Project Standard Configuration
              DcmDspStartRoutineInSignal_PortIndex (DcmDspStartRoutineInSignal): DcmDspRoutineSignalEndianness=BIG_ENDIAN, DcmDspRoutineSignalLength=8, DcmDspRoutineSignalPos=0, DcmDspRoutineSignalType=UINT8  # Project Standard Configuration
              DcmDspStartRoutineInSignal_StopPhyForT (DcmDspStartRoutineInSignal): DcmDspRoutineSignalEndianness=BIG_ENDIAN, DcmDspRoutineSignalLength=8, DcmDspRoutineSignalPos=8, DcmDspRoutineSignalType=UINT8  # Project Standard Configuration
            DcmDspStartRoutineOut_START_EthPhySwitchEngineReset (DcmDspStartRoutineOut)  # Project Standard Configuration
              DcmDspStartRoutineOutSignal_StatPhyReset (DcmDspStartRoutineOutSignal): DcmDspRoutineSignalEndianness=BIG_ENDIAN, DcmDspRoutineSignalLength=8, DcmDspRoutineSignalPos=0, DcmDspRoutineSignalType=UINT8  # Project Standard Configuration
          DcmDspRoutineInfo_4LZ7vb  # Project Standard Configuration
            DcmDspRoutineAuthorization: DcmDspRoutineSessionRef=DcmDspSessionRow_DEFAULT_SESSION, DcmDspRoutineSessionRef=DcmDspSessionRow_EXTENDED_DIAGNOSTIC_SESSION  # Project Standard Configuration
            DcmDspStartRoutineIn_START_EthReadPhyRegister (DcmDspStartRoutineIn)  # Project Standard Configuration
              DcmDspStartRoutineInSignal_Data (DcmDspStartRoutineInSignal): DcmDspRoutineSignalPos=8  # Project Standard Configuration
              DcmDspStartRoutineInSignal_RegReadRange (DcmDspStartRoutineInSignal): DcmDspRoutineSignalEndianness=BIG_ENDIAN, DcmDspRoutineSignalLength=8, DcmDspRoutineSignalPos=0, DcmDspRoutineSignalType=UINT8  # Project Standard Configuration
            DcmDspStartRoutineOut_START_EthReadPhyRegister (DcmDspStartRoutineOut)  # Project Standard Configuration
              DcmDspStartRoutineOutSignal_StatRegReadData (DcmDspStartRoutineOutSignal): DcmDspRoutineSignalPos=8  # Project Standard Configuration
              DcmDspStartRoutineOutSignal_StatRegReadOk (DcmDspStartRoutineOutSignal): DcmDspRoutineSignalEndianness=BIG_ENDIAN, DcmDspRoutineSignalLength=8, DcmDspRoutineSignalPos=0, DcmDspRoutineSignalType=UINT8  # Project Standard Configuration
          DcmDspRoutineInfo_PCxzr  # Project Standard Configuration
            DcmDspRoutineAuthorization: DcmDspRoutineSessionRef=DcmDspSessionRow_DEFAULT_SESSION, DcmDspRoutineSessionRef=DcmDspSessionRow_EXTENDED_DIAGNOSTIC_SESSION  # Project Standard Configuration
          DcmDspRoutineInfo_4KQsRC  # Project Standard Configuration
            DcmDspRoutineAuthorization: DcmDspRoutineSessionRef=DcmDspSessionRow_EXTENDED_DIAGNOSTIC_SESSION  # Project Standard Configuration
            DcmDspStartRoutineIn_START_EthWritePhyRegister (DcmDspStartRoutineIn)  # Project Standard Configuration
              DcmDspStartRoutineInSignal_Data (DcmDspStartRoutineInSignal): DcmDspRoutineSignalPos=8  # Project Standard Configuration
              DcmDspStartRoutineInSignal_RegWriteProtect (DcmDspStartRoutineInSignal): DcmDspRoutineSignalEndianness=BIG_ENDIAN, DcmDspRoutineSignalLength=8, DcmDspRoutineSignalPos=0, DcmDspRoutineSignalType=UINT8  # Project Standard Configuration
            DcmDspStartRoutineOut_START_EthWritePhyRegister (DcmDspStartRoutineOut)  # Project Standard Configuration
              DcmDspStartRoutineOutSignal_StatRegWriteOk (DcmDspStartRoutineOutSignal): DcmDspRoutineSignalEndianness=BIG_ENDIAN, DcmDspRoutineSignalLength=8, DcmDspRoutineSignalPos=0, DcmDspRoutineSignalType=UINT8  # Project Standard Configuration
          DcmDspRoutineInfo_3ctCrQ  # Project Standard Configuration
            DcmDspRoutineAuthorization: DcmDspRoutineSessionRef=DcmDspSessionRow_DEFAULT_SESSION, DcmDspRoutineSessionRef=DcmDspSessionRow_EXTENDED_DIAGNOSTIC_SESSION  # Project Standard Configuration
            DcmDspStartRoutineIn_START_ExternalHsfz (DcmDspStartRoutineIn)  # Project Standard Configuration
              DcmDspStartRoutineInSignal_Activation (DcmDspStartRoutineInSignal): DcmDspRoutineSignalLength=8, DcmDspRoutineSignalPos=0, DcmDspRoutineSignalType=UINT8  # Project Standard Configuration
          DcmDspRoutineInfo_SyJZQ  # Project Standard Configuration
            DcmDspRoutineAuthorization: DcmDspRoutineSessionRef=DcmDspSessionRow_DEFAULT_SESSION, DcmDspRoutineSessionRef=DcmDspSessionRow_EXTENDED_DIAGNOSTIC_SESSION  # Project Standard Configuration
            RESULT_FehlerspeicherEndeWerksablauf_OUT (DcmDspRoutineRequestResOut)  # Project Standard Configuration
              DcmDspRequestRoutineResultsOutSignal_StatFsEndeWabl (DcmDspRoutineRequestResOutSignal): DcmDspRoutineSignalEndianness=BIG_ENDIAN, DcmDspRoutineSignalLength=8, DcmDspRoutineSignalPos=0, DcmDspRoutineSignalType=UINT8  # Project Standard Configuration
          DcmDspRoutineInfo_10gc40  # Project Standard Configuration
            DcmDspRoutineAuthorization: DcmDspRoutineSessionRef=DcmDspSessionRow_EXTENDED_DIAGNOSTIC_SESSION  # Project Standard Configuration
            DcmDspStartRoutineIn_START_FsMsmN101AbfrageFzgsec (DcmDspStartRoutineIn)  # Project Standard Configuration
              DcmDspStartRoutineInSignal_FunktionsId (DcmDspStartRoutineInSignal): DcmDspRoutineSignalEndianness=BIG_ENDIAN, DcmDspRoutineSignalLength=8, DcmDspRoutineSignalPos=0, DcmDspRoutineSignalType=UINT8  # Project Standard Configuration
            DcmDspStartRoutineOut_START_FsMsmN101AbfrageFzgsec (DcmDspStartRoutineOut)  # Project Standard Configuration
              3 x DcmDspStartRoutineOutSignal, all with DcmDspRoutineSignalEndianness=BIG_ENDIAN, DcmDspRoutineSignalLength=8, DcmDspRoutineSignalType=UINT8:
                DcmDspStartRoutineOutSignal_Res1: DcmDspRoutineSignalPos=0  # Project Standard Configuration
                DcmDspStartRoutineOutSignal_Res2: DcmDspRoutineSignalPos=8  # Project Standard Configuration
                DcmDspStartRoutineOutSignal_State: DcmDspRoutineSignalPos=16  # Project Standard Configuration
          DcmDspRoutine_FsMsmN102_1XQM0  # Project Standard Configuration
            DcmDspRoutineAuthorization: DcmDspRoutineSessionRef=DcmDspSessionRow_EXTENDED_DIAGNOSTIC_SESSION  # Project Standard Configuration
            DcmDspStartRoutineIn_START_FsMsmN102 (DcmDspStartRoutineIn)  # Project Standard Configuration
              DcmDspStartRoutineInSignal_FunktionsId (DcmDspStartRoutineInSignal): DcmDspRoutineSignalEndianness=BIG_ENDIAN, DcmDspRoutineSignalLength=8, DcmDspRoutineSignalPos=0, DcmDspRoutineSignalType=UINT8  # Project Standard Configuration
            DcmDspStartRoutineOut_START_FsMsmN102 (DcmDspStartRoutineOut)  # Project Standard Configuration
              3 x DcmDspStartRoutineOutSignal, all with DcmDspRoutineSignalEndianness=BIG_ENDIAN, DcmDspRoutineSignalLength=8, DcmDspRoutineSignalType=UINT8:
                DcmDspStartRoutineOutSignal_Res1: DcmDspRoutineSignalPos=0  # Project Standard Configuration
                DcmDspStartRoutineOutSignal_Res2: DcmDspRoutineSignalPos=8  # Project Standard Configuration
                DcmDspStartRoutineOutSignal_State: DcmDspRoutineSignalPos=16  # Project Standard Configuration
          DcmDspRoutine_FsMsmN111_1XQMz  # Project Standard Configuration
            DcmDspRoutineAuthorization: DcmDspRoutineSessionRef=DcmDspSessionRow_DEFAULT_SESSION, DcmDspRoutineSessionRef=DcmDspSessionRow_EXTENDED_DIAGNOSTIC_SESSION  # Project Standard Configuration
            DcmDspStartRoutineIn_START_FsMsmN111 (DcmDspStartRoutineIn)  # Project Standard Configuration
              DcmDspStartRoutineInSignal_FscsmId (DcmDspStartRoutineInSignal): DcmDspRoutineSignalEndianness=BIG_ENDIAN, DcmDspRoutineSignalLength=8, DcmDspRoutineSignalPos=8, DcmDspRoutineSignalType=UINT8  # Project Standard Configuration
              DcmDspStartRoutineInSignal_ParameterId (DcmDspStartRoutineInSignal): DcmDspRoutineSignalEndianness=BIG_ENDIAN, DcmDspRoutineSignalLength=8, DcmDspRoutineSignalPos=0, DcmDspRoutineSignalType=UINT8  # Project Standard Configuration
            DcmDspStartRoutineOut_START_FsMsmN111 (DcmDspStartRoutineOut)  # Project Standard Configuration
              4 x DcmDspStartRoutineOutSignal:
                DcmDspStartRoutineOutSignal_Data: DcmDspRoutineSignalPos=24  # Project Standard Configuration
                DcmDspStartRoutineOutSignal_Len: DcmDspRoutineSignalEndianness=BIG_ENDIAN, DcmDspRoutineSignalLength=8, DcmDspRoutineSignalPos=16, DcmDspRoutineSignalType=UINT8  # Project Standard Configuration
                DcmDspStartRoutineOutSignal_Res1: DcmDspRoutineSignalEndianness=BIG_ENDIAN, DcmDspRoutineSignalLength=8, DcmDspRoutineSignalPos=0, DcmDspRoutineSignalType=UINT8  # Project Standard Configuration
                DcmDspStartRoutineOutSignal_Res2: DcmDspRoutineSignalEndianness=BIG_ENDIAN, DcmDspRoutineSignalLength=8, DcmDspRoutineSignalPos=8, DcmDspRoutineSignalType=UINT8  # Project Standard Configuration
          DcmDspRoutine_FsMsmN220X_18JjzX  # Project Standard Configuration
            DcmDspRoutineAuthorization: DcmDspRoutineSessionRef=DcmDspSessionRow_EXTENDED_DIAGNOSTIC_SESSION  # Project Standard Configuration
            DcmDspStartRoutineIn_START_FsMsmN220X (DcmDspStartRoutineIn)  # Project Standard Configuration
              DcmDspStartRoutineInSignal_Par3Req (DcmDspStartRoutineInSignal): DcmDspRoutineSignalEndianness=BIG_ENDIAN, DcmDspRoutineSignalLength=8, DcmDspRoutineSignalPos=0, DcmDspRoutineSignalType=UINT8  # Project Standard Configuration
              DcmDspStartRoutineInSignal_Par4Req (DcmDspStartRoutineInSignal): DcmDspRoutineSignalEndianness=BIG_ENDIAN, DcmDspRoutineSignalLength=8, DcmDspRoutineSignalPos=8, DcmDspRoutineSignalType=UINT8  # Project Standard Configuration
            DcmDspStartRoutineOut_START_FsMsmN220X (DcmDspStartRoutineOut)  # Project Standard Configuration
              DcmDspStartRoutineOutSignal_Par3Resp (DcmDspStartRoutineOutSignal): DcmDspRoutineSignalEndianness=BIG_ENDIAN, DcmDspRoutineSignalLength=8, DcmDspRoutineSignalPos=0, DcmDspRoutineSignalType=UINT8  # Project Standard Configuration
              DcmDspStartRoutineOutSignal_Par4Resp (DcmDspStartRoutineOutSignal): DcmDspRoutineSignalEndianness=BIG_ENDIAN, DcmDspRoutineSignalLength=8, DcmDspRoutineSignalPos=8, DcmDspRoutineSignalType=UINT8  # Project Standard Configuration
          DcmDspRoutineInfo_43dZYd  # Project Standard Configuration
            DcmDspRoutineAuthorization: DcmDspRoutineSessionRef=DcmDspSessionRow_DEFAULT_SESSION, DcmDspRoutineSessionRef=DcmDspSessionRow_EXTENDED_DIAGNOSTIC_SESSION  # Project Standard Configuration
            DcmDspStartRoutineIn_START_FsMsmN300XTeleservice (DcmDspStartRoutineIn)  # Project Standard Configuration
              5 x DcmDspStartRoutineInSignal, all with DcmDspRoutineSignalEndianness=BIG_ENDIAN, DcmDspRoutineSignalLength=8, DcmDspRoutineSignalType=UINT8:
                DcmDspStartRoutineInSignal_Id: DcmDspRoutineSignalPos=8  # Project Standard Configuration
                DcmDspStartRoutineInSignal_Par4Req: DcmDspRoutineSignalPos=0  # Project Standard Configuration
                DcmDspStartRoutineInSignal_Par6Req: DcmDspRoutineSignalPos=16  # Project Standard Configuration
                DcmDspStartRoutineInSignal_Par7Req: DcmDspRoutineSignalPos=24  # Project Standard Configuration
                DcmDspStartRoutineInSignal_Par8Req: DcmDspRoutineSignalPos=32  # Project Standard Configuration
            DcmDspStartRoutineOut_START_FsMsmN300XTeleservice (DcmDspStartRoutineOut)  # Project Standard Configuration
              DcmDspStartRoutineOutSignal_Par4Resp (DcmDspStartRoutineOutSignal): DcmDspRoutineSignalEndianness=BIG_ENDIAN, DcmDspRoutineSignalLength=8, DcmDspRoutineSignalPos=0, DcmDspRoutineSignalType=UINT8  # Project Standard Configuration
            RESULT_FsMsmN300XTeleservice_OUT (DcmDspRoutineRequestResOut)  # Project Standard Configuration
              5 x DcmDspRoutineRequestResOutSignal, all with DcmDspRoutineSignalEndianness=BIG_ENDIAN:
                DcmDspRequestRoutineResultsOutSignal_IdResp: DcmDspRoutineSignalLength=8, DcmDspRoutineSignalPos=8, DcmDspRoutineSignalType=UINT8  # Project Standard Configuration
                DcmDspRequestRoutineResultsOutSignal_Len: DcmDspRoutineSignalLength=16, DcmDspRoutineSignalPos=24, DcmDspRoutineSignalType=UINT16  # Project Standard Configuration
                DcmDspRequestRoutineResultsOutSignal_Par4Resp: DcmDspRoutineSignalLength=8, DcmDspRoutineSignalPos=0, DcmDspRoutineSignalType=UINT8  # Project Standard Configuration
                DcmDspRequestRoutineResultsOutSignal_Par6Resp: DcmDspRoutineSignalLength=8, DcmDspRoutineSignalPos=16, DcmDspRoutineSignalType=UINT8  # Project Standard Configuration
                DcmDspRequestRoutineResultsOutSignal_Zufallszahl: DcmDspRoutineSignalLength=160, DcmDspRoutineSignalPos=40, DcmDspRoutineSignalType=VARIABLE_LENGTH  # Project Standard Configuration
          DcmDspRoutine_FsN251_YxHYY  # Project Standard Configuration
            DcmDspRoutineAuthorization: DcmDspRoutineSessionRef=DcmDspSessionRow_DEFAULT_SESSION, DcmDspRoutineSessionRef=DcmDspSessionRow_EXTENDED_DIAGNOSTIC_SESSION  # Project Standard Configuration
            DcmDspStartRoutineIn_START_FsN251 (DcmDspStartRoutineIn)  # Project Standard Configuration
              DcmDspStartRoutineInSignal_Adr (DcmDspStartRoutineInSignal): DcmDspRoutineSignalPos=8  # Project Standard Configuration
              DcmDspStartRoutineInSignal_Len (DcmDspStartRoutineInSignal): DcmDspRoutineSignalEndianness=BIG_ENDIAN, DcmDspRoutineSignalLength=8, DcmDspRoutineSignalPos=0, DcmDspRoutineSignalType=UINT8  # Project Standard Configuration
            DcmDspStartRoutineOut_START_FsN251 (DcmDspStartRoutineOut)  # Project Standard Configuration
              DcmDspStartRoutineOutSignal_Res1 (DcmDspStartRoutineOutSignal): DcmDspRoutineSignalEndianness=BIG_ENDIAN, DcmDspRoutineSignalLength=8, DcmDspRoutineSignalPos=0, DcmDspRoutineSignalType=UINT8  # Project Standard Configuration
              DcmDspStartRoutineOutSignal_Res2 (DcmDspStartRoutineOutSignal): DcmDspRoutineSignalEndianness=BIG_ENDIAN, DcmDspRoutineSignalLength=8, DcmDspRoutineSignalPos=8, DcmDspRoutineSignalType=UINT8  # Project Standard Configuration
          DcmDspRoutine_FsN252_YxHYZ  # Project Standard Configuration
            DcmDspRoutineAuthorization: DcmDspRoutineSessionRef=DcmDspSessionRow_DEFAULT_SESSION, DcmDspRoutineSessionRef=DcmDspSessionRow_EXTENDED_DIAGNOSTIC_SESSION  # Project Standard Configuration
            DcmDspStartRoutineIn_START_FsN252 (DcmDspStartRoutineIn)  # Project Standard Configuration
              DcmDspStartRoutineInSignal_DataToCompare (DcmDspStartRoutineInSignal): DcmDspRoutineSignalLength=128, DcmDspRoutineSignalPos=0, DcmDspRoutineSignalType=VARIABLE_LENGTH  # Project Standard Configuration
            DcmDspStartRoutineOut_START_FsN252 (DcmDspStartRoutineOut)  # Project Standard Configuration
              DcmDspStartRoutineOutSignal_Result1 (DcmDspStartRoutineOutSignal): DcmDspRoutineSignalLength=8, DcmDspRoutineSignalPos=0, DcmDspRoutineSignalType=UINT8  # Project Standard Configuration
              DcmDspStartRoutineOutSignal_Result2 (DcmDspStartRoutineOutSignal): DcmDspRoutineSignalLength=8, DcmDspRoutineSignalPos=8, DcmDspRoutineSignalType=UINT8  # Project Standard Configuration
          DcmDspRoutine_FsN30X_YxJhc  # Project Standard Configuration
            DcmDspRoutineAuthorization: DcmDspRoutineSessionRef=DcmDspSessionRow_DEFAULT_SESSION, DcmDspRoutineSessionRef=DcmDspSessionRow_EXTENDED_DIAGNOSTIC_SESSION  # Project Standard Configuration
            DcmDspStartRoutineIn_START_FsN30X (DcmDspStartRoutineIn)  # Project Standard Configuration
              5 x DcmDspStartRoutineInSignal:
                DcmDspStartRoutineInSignal_Enc: DcmDspRoutineSignalPos=40  # Project Standard Configuration
                DcmDspStartRoutineInSignal_Id: DcmDspRoutineSignalEndianness=BIG_ENDIAN, DcmDspRoutineSignalLength=8, DcmDspRoutineSignalPos=8, DcmDspRoutineSignalType=UINT8  # Project Standard Configuration
                DcmDspStartRoutineInSignal_Len: DcmDspRoutineSignalEndianness=BIG_ENDIAN, DcmDspRoutineSignalLength=16, DcmDspRoutineSignalPos=24, DcmDspRoutineSignalType=UINT16  # Project Standard Configuration
                DcmDspStartRoutineInSignal_Par4Req: DcmDspRoutineSignalEndianness=BIG_ENDIAN, DcmDspRoutineSignalLength=8, DcmDspRoutineSignalPos=0, DcmDspRoutineSignalType=UINT8  # Project Standard Configuration
                DcmDspStartRoutineInSignal_Par6Req: DcmDspRoutineSignalEndianness=BIG_ENDIAN, DcmDspRoutineSignalLength=8, DcmDspRoutineSignalPos=16, DcmDspRoutineSignalType=UINT8  # Project Standard Configuration
            DcmDspStartRoutineOut_START_FsN30X (DcmDspStartRoutineOut)  # Project Standard Configuration
              DcmDspStartRoutineOutSignal_Par4Resp (DcmDspStartRoutineOutSignal): DcmDspRoutineSignalEndianness=BIG_ENDIAN, DcmDspRoutineSignalLength=8, DcmDspRoutineSignalPos=0, DcmDspRoutineSignalType=UINT8  # Project Standard Configuration
            RESULT_FsN30X_OUT (DcmDspRoutineRequestResOut)  # Project Standard Configuration
              DcmDspRequestRoutineResultsOutSignal_Par4Resp (DcmDspRoutineRequestResOutSignal): DcmDspRoutineSignalEndianness=BIG_ENDIAN, DcmDspRoutineSignalLength=8, DcmDspRoutineSignalPos=0, DcmDspRoutineSignalType=UINT8  # Project Standard Configuration
              DcmDspRequestRoutineResultsOutSignal_R1R2R3 (DcmDspRoutineRequestResOutSignal): DcmDspRoutineSignalEndianness=BIG_ENDIAN, DcmDspRoutineSignalLength=32, DcmDspRoutineSignalPos=8, DcmDspRoutineSignalType=VARIABLE_LENGTH  # Project Standard Configuration
          DcmDspRoutine_FsN31034_2gPlQH  # Project Standard Configuration
            DcmDspRoutineAuthorization: DcmDspRoutineSessionRef=DcmDspSessionRow_EXTENDED_DIAGNOSTIC_SESSION  # Project Standard Configuration
            DcmDspStartRoutineIn_START_FsN31034 (DcmDspStartRoutineIn)  # Project Standard Configuration
              4 x DcmDspStartRoutineInSignal:
                DcmDspStartRoutineInSignal_Data: DcmDspRoutineSignalPos=32  # Project Standard Configuration
                DcmDspStartRoutineInSignal_Len: DcmDspRoutineSignalEndianness=BIG_ENDIAN, DcmDspRoutineSignalLength=16, DcmDspRoutineSignalPos=16, DcmDspRoutineSignalType=UINT16  # Project Standard Configuration
                DcmDspStartRoutineInSignal_Par4Req: DcmDspRoutineSignalEndianness=BIG_ENDIAN, DcmDspRoutineSignalLength=8, DcmDspRoutineSignalPos=0, DcmDspRoutineSignalType=UINT8  # Project Standard Configuration
                DcmDspStartRoutineInSignal_Par5: DcmDspRoutineSignalEndianness=BIG_ENDIAN, DcmDspRoutineSignalLength=8, DcmDspRoutineSignalPos=8, DcmDspRoutineSignalType=UINT8  # Project Standard Configuration
            DcmDspStartRoutineOut_START_FsN31034 (DcmDspStartRoutineOut)  # Project Standard Configuration
              DcmDspStartRoutineOutSignal_Par4Resp (DcmDspStartRoutineOutSignal): DcmDspRoutineSignalEndianness=BIG_ENDIAN, DcmDspRoutineSignalLength=8, DcmDspRoutineSignalPos=0, DcmDspRoutineSignalType=UINT8  # Project Standard Configuration
          DcmDspRoutine_FsN5005_1TzqYQ  # Project Standard Configuration
            DcmDspRoutineAuthorization: DcmDspRoutineSessionRef=DcmDspSessionRow_EXTENDED_DIAGNOSTIC_SESSION  # Project Standard Configuration
            DcmDspStartRoutineIn_START_FsN5005 (DcmDspStartRoutineIn)  # Project Standard Configuration
              DcmDspStartRoutineInSignal_Adr (DcmDspStartRoutineInSignal): DcmDspRoutineSignalPos=8  # Project Standard Configuration
              DcmDspStartRoutineInSignal_Len (DcmDspStartRoutineInSignal): DcmDspRoutineSignalEndianness=BIG_ENDIAN, DcmDspRoutineSignalLength=8, DcmDspRoutineSignalPos=0, DcmDspRoutineSignalType=UINT8  # Project Standard Configuration
            DcmDspStartRoutineOut_START_FsN5005 (DcmDspStartRoutineOut)  # Project Standard Configuration
              DcmDspStartRoutineOutSignal_Res1 (DcmDspStartRoutineOutSignal): DcmDspRoutineSignalEndianness=BIG_ENDIAN, DcmDspRoutineSignalLength=8, DcmDspRoutineSignalPos=0, DcmDspRoutineSignalType=UINT8  # Project Standard Configuration
              DcmDspStartRoutineOutSignal_Res2 (DcmDspStartRoutineOutSignal): DcmDspRoutineSignalEndianness=BIG_ENDIAN, DcmDspRoutineSignalLength=8, DcmDspRoutineSignalPos=8, DcmDspRoutineSignalType=UINT8  # Project Standard Configuration
            RESULT_FsN5005_OUT (DcmDspRoutineRequestResOut)  # Project Standard Configuration
              4 x DcmDspRoutineRequestResOutSignal:
                DcmDspRequestRoutineResultsOutSignal_Len: DcmDspRoutineSignalEndianness=BIG_ENDIAN, DcmDspRoutineSignalLength=8, DcmDspRoutineSignalPos=16, DcmDspRoutineSignalType=UINT8  # Project Standard Configuration
                DcmDspRequestRoutineResultsOutSignal_Res1: DcmDspRoutineSignalEndianness=BIG_ENDIAN, DcmDspRoutineSignalLength=8, DcmDspRoutineSignalPos=0, DcmDspRoutineSignalType=UINT8  # Project Standard Configuration
                DcmDspRequestRoutineResultsOutSignal_Res2: DcmDspRoutineSignalEndianness=BIG_ENDIAN, DcmDspRoutineSignalLength=8, DcmDspRoutineSignalPos=8, DcmDspRoutineSignalType=UINT8  # Project Standard Configuration
                DcmDspRequestRoutineResultsOutSignal_SgMitFehlern: DcmDspRoutineSignalPos=24  # Project Standard Configuration
          DcmDspRoutine_FsN5012_1TzqZm  # Project Standard Configuration
            DcmDspRoutineAuthorization: DcmDspRoutineSessionRef=DcmDspSessionRow_DEFAULT_SESSION, DcmDspRoutineSessionRef=DcmDspSessionRow_EXTENDED_DIAGNOSTIC_SESSION  # Project Standard Configuration
            DcmDspStartRoutineOut_START_FsN5012 (DcmDspStartRoutineOut)  # Project Standard Configuration
              DcmDspStartRoutineOutSignal_Result1 (DcmDspStartRoutineOutSignal): DcmDspRoutineSignalLength=8, DcmDspRoutineSignalPos=0, DcmDspRoutineSignalType=UINT8  # Project Standard Configuration
              DcmDspStartRoutineOutSignal_Result2 (DcmDspStartRoutineOutSignal): DcmDspRoutineSignalLength=8, DcmDspRoutineSignalPos=8, DcmDspRoutineSignalType=UINT8  # Project Standard Configuration
            RESULT_FsN5012_OUT (DcmDspRoutineRequestResOut)  # Project Standard Configuration
              3 x DcmDspRoutineRequestResOutSignal:
                DcmDspRequestRoutineResultsOutSignal_RandomNumberFscsm: DcmDspRoutineSignalLength=128, DcmDspRoutineSignalPos=16, DcmDspRoutineSignalType=VARIABLE_LENGTH  # Project Standard Configuration
                DcmDspRequestRoutineResultsOutSignal_Result1: DcmDspRoutineSignalLength=8, DcmDspRoutineSignalPos=0, DcmDspRoutineSignalType=UINT8  # Project Standard Configuration
                DcmDspRequestRoutineResultsOutSignal_Result2: DcmDspRoutineSignalLength=8, DcmDspRoutineSignalPos=8, DcmDspRoutineSignalType=UINT8  # Project Standard Configuration
          DcmDspRoutine_FsN5034_1Tzr0B  # Project Standard Configuration
            DcmDspRoutineAuthorization: DcmDspRoutineSessionRef=DcmDspSessionRow_DEFAULT_SESSION, DcmDspRoutineSessionRef=DcmDspSessionRow_EXTENDED_DIAGNOSTIC_SESSION  # Project Standard Configuration
            DcmDspStartRoutineIn_START_FsN5034 (DcmDspStartRoutineIn)  # Project Standard Configuration
              DcmDspStartRoutineInSignal_Data (DcmDspStartRoutineInSignal): DcmDspRoutineSignalLength=792, DcmDspRoutineSignalPos=0, DcmDspRoutineSignalType=VARIABLE_LENGTH  # Project Standard Configuration
            DcmDspStartRoutineOut_START_FsN5034 (DcmDspStartRoutineOut)  # Project Standard Configuration
              DcmDspStartRoutineOutSignal_Result1 (DcmDspStartRoutineOutSignal): DcmDspRoutineSignalLength=8, DcmDspRoutineSignalPos=0, DcmDspRoutineSignalType=UINT8  # Project Standard Configuration
              DcmDspStartRoutineOutSignal_Result2 (DcmDspStartRoutineOutSignal): DcmDspRoutineSignalLength=8, DcmDspRoutineSignalPos=8, DcmDspRoutineSignalType=UINT8  # Project Standard Configuration
            RESULT_FsN5034_OUT (DcmDspRoutineRequestResOut)  # Project Standard Configuration
              DcmDspRequestRoutineResultsOutSignal_Result1 (DcmDspRoutineRequestResOutSignal): DcmDspRoutineSignalLength=8, DcmDspRoutineSignalPos=0, DcmDspRoutineSignalType=UINT8  # Project Standard Configuration
              DcmDspRequestRoutineResultsOutSignal_Result2 (DcmDspRoutineRequestResOutSignal): DcmDspRoutineSignalLength=8, DcmDspRoutineSignalPos=8, DcmDspRoutineSignalType=UINT8  # Project Standard Configuration
          DcmDspRoutine_FsN70X_YxKJ7  # Project Standard Configuration
            DcmDspRoutineAuthorization: DcmDspRoutineSessionRef=DcmDspSessionRow_DEFAULT_SESSION, DcmDspRoutineSessionRef=DcmDspSessionRow_EXTENDED_DIAGNOSTIC_SESSION  # Project Standard Configuration
            DcmDspStartRoutineIn_START_FsN70X (DcmDspStartRoutineIn)  # Project Standard Configuration
              DcmDspStartRoutineInSignal_Adr (DcmDspStartRoutineInSignal): DcmDspRoutineSignalEndianness=BIG_ENDIAN, DcmDspRoutineSignalLength=8, DcmDspRoutineSignalPos=8, DcmDspRoutineSignalType=UINT8  # Project Standard Configuration
              DcmDspStartRoutineInSignal_Par4Req (DcmDspStartRoutineInSignal): DcmDspRoutineSignalEndianness=BIG_ENDIAN, DcmDspRoutineSignalLength=8, DcmDspRoutineSignalPos=0, DcmDspRoutineSignalType=UINT8  # Project Standard Configuration
            DcmDspStartRoutineOut_START_FsN70X (DcmDspStartRoutineOut)  # Project Standard Configuration
              DcmDspStartRoutineOutSignal_Par4Resp (DcmDspStartRoutineOutSignal): DcmDspRoutineSignalEndianness=BIG_ENDIAN, DcmDspRoutineSignalLength=8, DcmDspRoutineSignalPos=0, DcmDspRoutineSignalType=UINT8  # Project Standard Configuration
            RESULT_FsN70X_OUT (DcmDspRoutineRequestResOut)  # Project Standard Configuration
              DcmDspRequestRoutineResultsOutSignal_Par4Resp (DcmDspRoutineRequestResOutSignal): DcmDspRoutineSignalEndianness=BIG_ENDIAN, DcmDspRoutineSignalLength=8, DcmDspRoutineSignalPos=0, DcmDspRoutineSignalType=UINT8  # Project Standard Configuration
              DcmDspRequestRoutineResultsOutSignal_Result (DcmDspRoutineRequestResOutSignal): DcmDspRoutineSignalEndianness=BIG_ENDIAN, DcmDspRoutineSignalLength=8, DcmDspRoutineSignalPos=8, DcmDspRoutineSignalType=UINT8  # Project Standard Configuration
          DcmDspRoutine_FsN7112_1TzSmF  # Project Standard Configuration
            DcmDspRoutineAuthorization: DcmDspRoutineSessionRef=DcmDspSessionRow_DEFAULT_SESSION, DcmDspRoutineSessionRef=DcmDspSessionRow_EXTENDED_DIAGNOSTIC_SESSION  # Project Standard Configuration
            DcmDspStartRoutineIn_START_FsN7112 (DcmDspStartRoutineIn)  # Project Standard Configuration
              DcmDspStartRoutineInSignal_Challenge (DcmDspStartRoutineInSignal): DcmDspRoutineSignalLength=128, DcmDspRoutineSignalPos=0, DcmDspRoutineSignalType=VARIABLE_LENGTH  # Project Standard Configuration
            DcmDspStartRoutineOut_START_FsN7112 (DcmDspStartRoutineOut)  # Project Standard Configuration
              DcmDspStartRoutineOutSignal_Result1 (DcmDspStartRoutineOutSignal): DcmDspRoutineSignalLength=8, DcmDspRoutineSignalPos=0, DcmDspRoutineSignalType=UINT8  # Project Standard Configuration
              DcmDspStartRoutineOutSignal_Result2 (DcmDspStartRoutineOutSignal): DcmDspRoutineSignalLength=8, DcmDspRoutineSignalPos=8, DcmDspRoutineSignalType=UINT8  # Project Standard Configuration
            RESULT_FsN7112_OUT (DcmDspRoutineRequestResOut)  # Project Standard Configuration
              3 x DcmDspRoutineRequestResOutSignal:
                DcmDspRequestRoutineResultsOutSignal_Result1: DcmDspRoutineSignalLength=8, DcmDspRoutineSignalPos=0, DcmDspRoutineSignalType=UINT8  # Project Standard Configuration
                DcmDspRequestRoutineResultsOutSignal_Result2: DcmDspRoutineSignalLength=8, DcmDspRoutineSignalPos=8, DcmDspRoutineSignalType=UINT8  # Project Standard Configuration
                DcmDspRequestRoutineResultsOutSignal_ResultResponse: DcmDspRoutineSignalLength=128, DcmDspRoutineSignalPos=16, DcmDspRoutineSignalType=VARIABLE_LENGTH  # Project Standard Configuration
          DcmDspRoutineInfo_pCCkH  # Project Standard Configuration
            DcmDspRoutineAuthorization: DcmDspRoutineSessionRef=DcmDspSessionRow_DEFAULT_SESSION, DcmDspRoutineSessionRef=DcmDspSessionRow_EXTENDED_DIAGNOSTIC_SESSION  # Project Standard Configuration
            DcmDspStartRoutineOut_START_GetActualConfig (DcmDspStartRoutineOut)  # Project Standard Configuration
              DcmDspStartRoutineOutSignal_EcuAddress (DcmDspStartRoutineOutSignal): DcmDspRoutineSignalLength=8, DcmDspRoutineSignalPos=8, DcmDspRoutineSignalType=UINT8  # Project Standard Configuration
              DcmDspStartRoutineOutSignal_StatIdsWert (DcmDspStartRoutineOutSignal): DcmDspRoutineSignalLength=8, DcmDspRoutineSignalPos=0, DcmDspRoutineSignalType=UINT8  # Project Standard Configuration
          DcmDspRoutineInfo_2sK1ff  # Project Standard Configuration
            DcmDspRoutineAuthorization: DcmDspRoutineSessionRef=DcmDspSessionRow_EXTENDED_DIAGNOSTIC_SESSION  # Project Standard Configuration
            DcmDspStartRoutineIn_START_IndividualDatenRettung (DcmDspStartRoutineIn)  # Project Standard Configuration
            DcmDspStartRoutineOut_START_IndividualDatenRettung (DcmDspStartRoutineOut)  # Project Standard Configuration
          DcmDspRoutine_InitLinBus_4NDgMR  # Project Standard Configuration
            DcmDspRoutineAuthorization:  # Project Standard Configuration
              DcmDspRoutineSessionRef = DcmDspSessionRow_CODING_SESSION
              DcmDspRoutineSessionRef = DcmDspSessionRow_DEFAULT_SESSION
              DcmDspRoutineSessionRef = DcmDspSessionRow_EXTENDED_DIAGNOSTIC_SESSION
          DcmDspRoutineInfo_4C5wFQ  # Project Standard Configuration
            DcmDspRoutineAuthorization: DcmDspRoutineSessionRef=DcmDspSessionRow_DEFAULT_SESSION, DcmDspRoutineSessionRef=DcmDspSessionRow_EXTENDED_DIAGNOSTIC_SESSION  # Project Standard Configuration
            DcmDspStartRoutineOut_START_InitLinSlave (DcmDspStartRoutineOut)  # Project Standard Configuration
              DcmDspStartRoutineOutSignal_Status (DcmDspStartRoutineOutSignal): DcmDspRoutineSignalEndianness=BIG_ENDIAN, DcmDspRoutineSignalLength=8, DcmDspRoutineSignalPos=0, DcmDspRoutineSignalType=UINT8  # Project Standard Configuration
          DcmDspRoutine_IsLoeschen_26SwJG  # Project Standard Configuration
            DcmDspRoutineAuthorization: DcmDspRoutineSessionRef=DcmDspSessionRow_DEFAULT_SESSION, DcmDspRoutineSessionRef=DcmDspSessionRow_EXTENDED_DIAGNOSTIC_SESSION  # Project Standard Configuration
          DcmDspRoutineInfo_3MGry8  # Project Standard Configuration
            DcmDspRoutineAuthorization: DcmDspRoutineSessionRef=DcmDspSessionRow_DEFAULT_SESSION, DcmDspRoutineSessionRef=DcmDspSessionRow_EXTENDED_DIAGNOSTIC_SESSION  # Project Standard Configuration
            RESULT_RamDatenSchreiben_OUT (DcmDspRoutineRequestResOut)  # Project Standard Configuration
              DcmDspRequestRoutineResultsOutSignal_StatRamDatenSchreiben (DcmDspRoutineRequestResOutSignal): DcmDspRoutineSignalEndianness=BIG_ENDIAN, DcmDspRoutineSignalLength=8, DcmDspRoutineSignalPos=0, DcmDspRoutineSignalType=UINT8  # Project Standard Configuration
          DcmDspRoutine_RcCpp_q1vmL  # Project Standard Configuration
            DcmDspRoutineAuthorization: DcmDspRoutineSessionRef=DcmDspSessionRow_DEFAULT_SESSION, DcmDspRoutineSessionRef=DcmDspSessionRow_EXTENDED_DIAGNOSTIC_SESSION  # Project Standard Configuration
            DcmDspStartRoutineIn_START_RcCpp (DcmDspStartRoutineIn)  # Project Standard Configuration
              DcmDspStartRoutineInSignal_RcCppRsr (DcmDspStartRoutineInSignal): DcmDspRoutineSignalPos=0  # Project Standard Configuration
            DcmDspStartRoutineOut_START_RcCpp (DcmDspStartRoutineOut)  # Project Standard Configuration
              DcmDspStartRoutineOutSignal_StatApprovalChargingState (DcmDspStartRoutineOutSignal): DcmDspRoutineSignalEndianness=BIG_ENDIAN, DcmDspRoutineSignalLength=8, DcmDspRoutineSignalPos=16, DcmDspRoutineSignalType=UINT8  # Project Standard Configuration
              DcmDspStartRoutineOutSignal_StatDuration (DcmDspStartRoutineOutSignal): DcmDspRoutineSignalEndianness=BIG_ENDIAN, DcmDspRoutineSignalLength=16, DcmDspRoutineSignalPos=0, DcmDspRoutineSignalType=UINT16  # Project Standard Configuration
          DcmDspRoutine_RcCppc_1Qt2kP  # Project Standard Configuration
            DcmDspRoutineAuthorization: DcmDspRoutineSessionRef=DcmDspSessionRow_EXTENDED_DIAGNOSTIC_SESSION  # Project Standard Configuration
            DcmDspStartRoutineOut_START_RcCppc (DcmDspStartRoutineOut)  # Project Standard Configuration
              DcmDspStartRoutineOutSignal_dataOut (DcmDspStartRoutineOutSignal): DcmDspRoutineSignalPos=0, DcmDspRoutineSignalType=VARIABLE_LENGTH  # Project Standard Configuration
          DcmDspRoutine_RcPad_q1zPQ  # Project Standard Configuration
            DcmDspRoutineAuthorization: DcmDspRoutineSessionRef=DcmDspSessionRow_EXTENDED_DIAGNOSTIC_SESSION  # Project Standard Configuration
            DcmDspStartRoutineIn_START_RcPad (DcmDspStartRoutineIn)  # Project Standard Configuration
              5 x DcmDspStartRoutineInSignal:
                DcmDspStartRoutineInSignal_AppSpecificParam  # Project Standard Configuration
                DcmDspStartRoutineInSignal_Dpt: DcmDspRoutineSignalEndianness=BIG_ENDIAN, DcmDspRoutineSignalLength=8, DcmDspRoutineSignalPos=0, DcmDspRoutineSignalType=UINT8  # Project Standard Configuration
                DcmDspStartRoutineInSignal_MemObjIdent: DcmDspRoutineSignalPos=24  # Project Standard Configuration
                DcmDspStartRoutineInSignal_MoiAfid: DcmDspRoutineSignalEndianness=BIG_ENDIAN, DcmDspRoutineSignalLength=8, DcmDspRoutineSignalPos=16, DcmDspRoutineSignalType=UINT8  # Project Standard Configuration
                DcmDspStartRoutineInSignal_Rsvd: DcmDspRoutineSignalEndianness=BIG_ENDIAN, DcmDspRoutineSignalLength=8, DcmDspRoutineSignalPos=8, DcmDspRoutineSignalType=UINT8  # Project Standard Configuration
            DcmDspStartRoutineOut_START_RcPad (DcmDspStartRoutineOut)  # Project Standard Configuration
              DcmDspStartRoutineOutSignal_Rs (DcmDspStartRoutineOutSignal): DcmDspRoutineSignalEndianness=BIG_ENDIAN, DcmDspRoutineSignalLength=8, DcmDspRoutineSignalPos=0, DcmDspRoutineSignalType=UINT8  # Project Standard Configuration
          DcmDspRoutine_RcRswedi_3rXcSz  # Project Standard Configuration
            DcmDspRoutineAuthorization: DcmDspRoutineSessionRef=DcmDspSessionRow_DEFAULT_SESSION, DcmDspRoutineSessionRef=DcmDspSessionRow_EXTENDED_DIAGNOSTIC_SESSION  # Project Standard Configuration
            DcmDspStartRoutineIn_START_RcRswedi (DcmDspStartRoutineIn)  # Project Standard Configuration
              DcmDspStartRoutineInSignal_DataIn (DcmDspStartRoutineInSignal): DcmDspRoutineSignalLength=64, DcmDspRoutineSignalPos=0, DcmDspRoutineSignalType=VARIABLE_LENGTH  # Project Standard Configuration
            DcmDspStartRoutineOut_START_RcRswedi (DcmDspStartRoutineOut)  # Project Standard Configuration
              DcmDspStartRoutineOutSignal_DataOut (DcmDspStartRoutineOutSignal): DcmDspRoutineSignalPos=0, DcmDspRoutineSignalType=VARIABLE_LENGTH  # Project Standard Configuration
          DcmDspRoutineInfo_1VGBKh  # Project Standard Configuration
            DcmDspRoutineAuthorization: DcmDspRoutineSessionRef=DcmDspSessionRow_DEFAULT_SESSION, DcmDspRoutineSessionRef=DcmDspSessionRow_EXTENDED_DIAGNOSTIC_SESSION  # Project Standard Configuration
            DcmDspStartRoutineIn_START_RequestPreferredProtocol (DcmDspStartRoutineIn)  # Project Standard Configuration
              DcmDspStartRoutineInSignal_SgbmId (DcmDspStartRoutineInSignal): DcmDspRoutineSignalEndianness=BIG_ENDIAN, DcmDspRoutineSignalLength=64, DcmDspRoutineSignalPos=0, DcmDspRoutineSignalType=VARIABLE_LENGTH  # Project Standard Configuration
            DcmDspStartRoutineOut_START_RequestPreferredProtocol (DcmDspStartRoutineOut)  # Project Standard Configuration
              DcmDspStartRoutineOutSignal_AnzahlItems (DcmDspStartRoutineOutSignal): DcmDspRoutineSignalEndianness=BIG_ENDIAN, DcmDspRoutineSignalLength=8, DcmDspRoutineSignalPos=0, DcmDspRoutineSignalType=UINT8  # Project Standard Configuration
              DcmDspStartRoutineOutSignal_FpRpp31011021Eopfld (DcmDspStartRoutineOutSignal): DcmDspRoutineSignalPos=8  # Project Standard Configuration
          DcmDspRoutineInfo_4HTyTy  # Project Standard Configuration
            DcmDspRoutineAuthorization: DcmDspRoutineSessionRef=DcmDspSessionRow_DEFAULT_SESSION, DcmDspRoutineSessionRef=DcmDspSessionRow_EXTENDED_DIAGNOSTIC_SESSION  # Project Standard Configuration
          DcmDspRoutineInfo_1gWdmq  # Project Standard Configuration
            DcmDspRoutineAuthorization: DcmDspRoutineSessionRef=DcmDspSessionRow_DEFAULT_SESSION, DcmDspRoutineSessionRef=DcmDspSessionRow_EXTENDED_DIAGNOSTIC_SESSION  # Project Standard Configuration
            DcmDspStartRoutineIn_START_SetDefaultBus (DcmDspStartRoutineIn)  # Project Standard Configuration
              DcmDspStartRoutineInSignal_ZustandDefaultBus (DcmDspStartRoutineInSignal): DcmDspRoutineSignalLength=8, DcmDspRoutineSignalPos=0, DcmDspRoutineSignalType=UINT8  # Project Standard Configuration
          DcmDspRoutineInfo_1X4xzf  # Project Standard Configuration
            DcmDspRoutineAuthorization: DcmDspRoutineSessionRef=DcmDspSessionRow_DEFAULT_SESSION, DcmDspRoutineSessionRef=DcmDspSessionRow_EXTENDED_DIAGNOSTIC_SESSION  # Project Standard Configuration
          DcmDspRoutineInfo_3yymQj  # Project Standard Configuration
            DcmDspRoutineAuthorization: DcmDspRoutineSessionRef=DcmDspSessionRow_DEFAULT_SESSION, DcmDspRoutineSessionRef=DcmDspSessionRow_EXTENDED_DIAGNOSTIC_SESSION  # Project Standard Configuration
            DcmDspStartRoutineIn_START_SteuernDmFssMaster (DcmDspStartRoutineIn)  # Project Standard Configuration
              DcmDspStartRoutineInSignal_ArgSignal (DcmDspStartRoutineInSignal): DcmDspRoutineSignalEndianness=BIG_ENDIAN, DcmDspRoutineSignalLength=8, DcmDspRoutineSignalPos=0, DcmDspRoutineSignalType=UINT8  # Project Standard Configuration
            DcmDspStartRoutineOut_START_SteuernDmFssMaster (DcmDspStartRoutineOut)  # Project Standard Configuration
              DcmDspStartRoutineOutSignal_StatSignal (DcmDspStartRoutineOutSignal): DcmDspRoutineSignalEndianness=BIG_ENDIAN, DcmDspRoutineSignalLength=8, DcmDspRoutineSignalPos=0, DcmDspRoutineSignalType=UINT8  # Project Standard Configuration
          DcmDspRoutine_Swt_3DPx9T  # Project Standard Configuration
            DcmDspRoutineAuthorization:  # Project Standard Configuration
              DcmDspRoutineSessionRef = DcmDspSessionRow_DEFAULT_SESSION
              DcmDspRoutineSessionRef = DcmDspSessionRow_EXTENDED_DIAGNOSTIC_SESSION
              DcmDspRoutineSessionRef = DcmDspSessionRow_SWT_SESSION
            DcmDspStartRoutineIn_START_Swt (DcmDspStartRoutineIn)  # Project Standard Configuration
              DcmDspStartRoutineInSignal_DataIn (DcmDspStartRoutineInSignal): DcmDspRoutineSignalPos=8, DcmDspRoutineSignalType=VARIABLE_LENGTH  # Project Standard Configuration
              DcmDspStartRoutineInSignal_RCOption (DcmDspStartRoutineInSignal): DcmDspRoutineSignalLength=8, DcmDspRoutineSignalPos=0, DcmDspRoutineSignalType=UINT8  # Project Standard Configuration
            DcmDspStartRoutineOut_START_Swt (DcmDspStartRoutineOut)  # Project Standard Configuration
              3 x DcmDspStartRoutineOutSignal:
                DcmDspStartRoutineOutSignal_DataOut: DcmDspRoutineSignalPos=16, DcmDspRoutineSignalType=VARIABLE_LENGTH  # Project Standard Configuration
                DcmDspStartRoutineOutSignal_RCOptionOut: DcmDspRoutineSignalLength=8, DcmDspRoutineSignalPos=0, DcmDspRoutineSignalType=UINT8  # Project Standard Configuration
                DcmDspStartRoutineOutSignal_ReturnCode: DcmDspRoutineSignalLength=8, DcmDspRoutineSignalPos=8, DcmDspRoutineSignalType=UINT8  # Project Standard Configuration
          DcmDspRoutineInfo_x6nJQ  # Project Standard Configuration
        7 x DcmDspDataInfo, all with DcmDspDataFixedLength=false:
          DcmDspDataInfo_bY4y4  # Project Standard Configuration
          DcmDspDataInfo_GCft1  # Project Standard Configuration
          DcmDspData_PiaProfile0_1ZT4CR  # Project Standard Configuration
          DcmDspData_PiaProfile1_1ZT4CS  # Project Standard Configuration
          DcmDspData_PiaProfile2_1ZT4CT  # Project Standard Configuration
          DcmDspData_PiaProfileA_1ZT4D9  # Project Standard Configuration
          DcmDspData_SvkAktuell_57zZ9W  # Project Standard Configuration
      DcmGeneral: DcmRequestManufacturerNotificationEnabled=true, DcmDspDataDefaultEndianness=BIG_ENDIAN, DcmRespondAllRequest=false  # Project Standard Configuration
