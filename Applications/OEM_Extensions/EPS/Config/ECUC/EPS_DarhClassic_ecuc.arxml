AUTOSAR XML (schema 4-3-0)
package /ActiveEcuC
  module config DarhClassic: implementation-config-variant=VARIANT-PRE-COMPILE
    CommonPublishedInformation: SwMajorVersion=5, SwMinorVersion=1, SwPatchVersion=0
    DarhActiveReportedEvent_DM_TEST_APPL (DarhActiveReportedEvent): DarhDemEvent=DmTestAppl
    DarhActiveReportedEvent_DM_TEST_COM (DarhActiveReportedEvent): DarhDemEvent=DmTestCom
