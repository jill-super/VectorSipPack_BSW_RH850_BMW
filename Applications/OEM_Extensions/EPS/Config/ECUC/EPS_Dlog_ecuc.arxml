AUTOSAR XML (schema 4-3-0)
package /ActiveEcuC
  module config Dlog: implementation-config-variant=VARIANT-PRE-COMPILE
    CommonPublishedInformation: SwMajorVersion=5, SwMinorVersion=1, SwPatchVersion=1
    Features: EnableEcu=true, EnableSvkCurrent=true, EnableSvkHistory=true
      SvkHistory: MaxNumberOfHistorySgbmIds=3, NumberOfSvkBackups=3
    General: DevErrorDetect=true, MaxNumberOfSweGroups=8
