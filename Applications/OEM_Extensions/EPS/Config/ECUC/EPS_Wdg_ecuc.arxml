AUTOSAR XML (schema 4-3-0)
package /ActiveEcuC
  module config Wdg: implementation-config-variant=VARIANT-POST-BUILD, module-description=Wdg_Impl
    WdgGeneral:
      WdgVersionCheckExternalModules = false
      WdgDevErrorDetect = false
      WdgDisableAllowed = true
      WdgIndex = 0
      WdgInitialTimeout = 0
      WdgMaxTimeout = 10
      WdgRunArea = RAM
      WdgTriggerLocation = NULL
      WdgVersionInfoApi = true
      WdgCriticalSectionProtection = true
      WdgVaryingActivationCodeMode = DISABLE
      WdgDeviceName = R7F701319
      WdgInterruptConsistencyCheck = false
      WdgWriteVerify = WV_DISABLE
      WdgUseWriteVerifyErrorInterface = false
      WdgClockRef = McuWdtacounterClk
    WdgPublishedInformation: WdgTriggerMode=WDG_WINDOW
    WdgSettingsConfig: WdgDefaultMode=WDGIF_OFF_MODE
      WdgSettingsFast: WdgClkSettingsFast=WDGCLK_DIVBY_2POWOF_9
      WdgSettingsOff
      WdgSettingsSlow: WdgClkSettingsSlow=WDGCLK_DIVBY_2POWOF_13
