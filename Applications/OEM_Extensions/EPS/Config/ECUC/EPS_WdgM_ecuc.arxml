AUTOSAR XML (schema 4-3-0)
package /ActiveEcuC
  module config WdgM: implementation-config-variant=VARIANT-PRE-COMPILE, module-description=WdgM_Impl
    WdgMConfigSet: WdgMInitialMode=WdgMMode
      WdgMMode:
        WdgMExpiredSupervisionCycleTol = 10
        WdgMModeId = 0
        WdgMSupervisionCycle = 0.01
        WdgMInitialTriggerModeId = 0
        WdgMModeCoreAssignment = 0
        WdgMTicksPerSecond = 100
        WdgMGlobalMemoryAppTaskRef = OsApplication_ASIL
        WdgMTrigger: WdgMWatchdogMode=WDGIF_OFF_MODE, WdgMTriggerConditionValue=5000, WdgMTriggerWindowStart=10, WdgMTriggerModeId=0, WdgMTriggerWatchdogRef=WdgMWatchdog
        WdgMAliveSupervision_StartApplication (WdgMAliveSupervision):
          WdgMExpectedAliveIndications = 10
          WdgMMaxMargin = 100
          WdgMMinMargin = 9
          WdgMSupervisionReferenceCycle = 10
          WdgMAliveSupervisionCheckpointRef = WdgMCheckpoint_StartApplication
        WdgMLocalStatusParams_StartApplication (WdgMLocalStatusParams):
          WdgMFailedAliveSupervisionRefCycleTol = 0
          WdgMSupervisedEntityInitialMode = WDGM_LOCAL_STATUS_OK
          WdgMFailedDeadlineRefCycleTol = 0
          WdgMDeadlineReferenceCycle = 0
          WdgMFailedProgramFlowRefCycleTol = 0
          WdgMProgramFlowReferenceCycle = 0
          WdgMLocalStatusSupervisedEntityRef = WdgMSupervisedEntity_StartApplication
    WdgMGeneral:
      WdgMDefensiveBehavior = true
      WdgMDevErrorDetect = true
      WdgMOffModeEnabled = true
      WdgMVersionInfoApi = true
      WdgMDemReport = false
      WdgMImmediateReset = true
      WdgMUseRte = true
      WdgMDemSupervisionReport = false
      WdgMFirstCycleAliveCounterReset = false
      WdgMAutosarDebugging = false
      WdgMUseOsSuspendInterrupt = true
      WdgMTimebaseSource = WDGM_INTERNAL_SOFTWARE_TICK
      WdgMSecondResetPath = false
      WdgMTickOverrunCorrection = false
      WdgMEntityDeactivationEnabled = false
      WdgMGenerateCPIdAsPortDefinedArgument = false
      WdgMStatusReportingMechanism = WDGM_USE_MODE_SWITCH_PORTS
      WdgMCallerIds: WdgMCallerId=0
      WdgMWatchdog: WdgMWatchdogName=Wdg, WdgMWatchdogDeviceRef=WdgIfDevice
      WdgMSupervisedEntity_StartApplication (WdgMSupervisedEntity):
        WdgMSupervisedEntityId = 0
        WdgMEnableEntityDeactivation = false
        WdgMInternalCheckpointInitialRef = WdgMCheckpoint_StartApplication
        WdgMAppTaskRef = OsApplication_ASIL
        WdgMCheckpoint_StartApplication (WdgMCheckpoint): WdgMCheckpointId=0
