AUTOSAR XML (schema 4-3-0)
package /ActiveEcuC
  module config NvM: implementation-config-variant=VARIANT-PRE-COMPILE, module-description=NvM_Impl
    3 x NvMBlockDescriptor, all with NvMBlockJobPriority=127, NvMBlockUseSyncMechanism=false, NvMBswMBlockStatusInformation=false, NvMInitBlockCallback=NULL_PTR, NvMReadRamBlockFromNvCallback=NULL_PTR, NvMSingleBlockCallback=NULL_PTR, NvMWriteBlockOnce=false, NvMWriteRamBlockToNvCallback=NULL_PTR, NvMUseServicePorts=true, NvMUseInitCallback=false, NvMAutomaticBlockLength=false, NvMBlockLengthCheckType=true, NvMBlockUseCRCCompMechanism=false:
      NVM_BLOCK_DLOG_SvkEntry: NvMBlockManagementType=NVM_BLOCK_DATASET, NvMBlockUseCrc=false, NvMBlockWriteProt=false, NvMNvBlockLength=97, NvMNvBlockNum=5, NvMNvramBlockIdentifier=27, NvMResistantToChangedSw=false, NvMRomBlockDataAddress=NULL_PTR, NvMSelectBlockForReadAll=false, NvMSelectBlockForWriteAll=false, NvMUseJobendCallback=true, NvMBlockCrcType=NVM_CRC16, NvMBlockLengthCheck=false, NvMRamBlockDataAddress=NULL_PTR
        NvMTargetBlockReference
          NvMFeeRef: NvMNameOfFeeBlock=FeeNVM_BLOCK_DLOG_SvkEntry
      NvM_BLOCK_DARH: NvMBlockCrcType=NVM_CRC16, NvMBlockManagementType=NVM_BLOCK_NATIVE, NvMBlockUseCrc=true, NvMBlockWriteProt=true, NvMCalcRamBlockCrc=false, NvMMaxNumOfReadRetries=0, NvMMaxNumOfWriteRetries=3, NvMRamBlockDataAddress=&Darh_ErrorQueue, NvMResistantToChangedSw=true, NvMRomBlockNum=1, NvMSelectBlockForReadAll=true, NvMSelectBlockForWriteAll=true, NvMStaticBlockIDCheck=false, NvMWriteVerification=false, NvMNvBlockLength=28, NvMNvBlockNum=1, NvMNvramBlockIdentifier=25, NvMUseJobendCallback=false, NvMBlockLengthCheck=true
        NvMTargetBlockReference
          NvMFeeRef: NvMNameOfFeeBlock=Fee_BLOCK_DARH
      NVM_BLOCK_DARH_DiagnoseMasterEnable: NvMBlockManagementType=NVM_BLOCK_NATIVE, NvMBlockUseCrc=false, NvMBlockWriteProt=false, NvMNvBlockLength=1, NvMNvBlockNum=1, NvMNvramBlockIdentifier=11, NvMRamBlockDataAddress=&Darh_DiagnoseMasterEnable, NvMResistantToChangedSw=true, NvMRomBlockDataAddress=NULL_PTR, NvMSelectBlockForReadAll=true, NvMSelectBlockForWriteAll=false, NvMUseJobendCallback=true, NvMBlockLengthCheck=true
        NvMTargetBlockReference
          NvMFeeRef: NvMNameOfFeeBlock=FeeNVM_BLOCK_DARH_DiagnoseMasterEnable
    NvMCommonVendorParams:
      NvMCrcIntBuffer = true
      NvMKillWriteAllApi = true
      NvMMultiblockId = MultiBlockRequest
      NvMCfgCbkIncludeList = Dem_Cbk.h
      NvMCfgCbkIncludeList = ComM.h
      NvMCfgCbkIncludeList = Dcm.h
      NvMCfgCbkIncludeList = Rte_Cbk.h
      NvMCfgCbkIncludeList = Dlog_NvM.h
      NvMCfgCbkIncludeList = Darh_NvM.h
      NvMCfgCbkIncludeList = Omc_NvM.h
    NVM_BLOCK_DCM_ROE (NvMBlockDescriptor):
      NvMBlockCrcType = NVM_CRC16
      NvMBlockManagementType = NVM_BLOCK_NATIVE
      NvMBlockUseCrc = true
      NvMBlockUseSyncMechanism = false
      NvMBlockWriteProt = false
      NvMCalcRamBlockCrc = false
      NvMMaxNumOfReadRetries = 0
      NvMMaxNumOfWriteRetries = 3
      NvMNvBlockBaseNumber = 1
      NvMRamBlockDataAddress = NULL_PTR
      NvMResistantToChangedSw = false
      NvMRomBlockDataAddress = &dcmSvc86DefaultNvMData
      NvMSelectBlockForReadAll = false
      NvMSelectBlockForWriteAll = false
      NvMStaticBlockIDCheck = false
      NvMWriteBlockOnce = false
      NvMWriteVerification = false
      NvMBswMBlockStatusInformation = false
      NvMInitBlockCallback = NULL_PTR
      NvMNvBlockNum = 1
      NvMReadRamBlockFromNvCallback = NULL_PTR
      NvMSingleBlockCallback = NULL_PTR
      NvMWriteRamBlockToNvCallback = NULL_PTR
      NvMUseServicePorts = false
      NvMUseJobendCallback = false
      NvMUseInitCallback = false
      NvMAutomaticBlockLength = false
      NvMBlockJobPriority = 127
      NvMBlockLengthCheck = true
      NvMBlockLengthCheckType = true
      NvMNvBlockLength = 4
      NvMNvramBlockIdentifier = 21
      NvMBlockUseCRCCompMechanism = false
      NvMTargetBlockReference
        NvMFeeRef: NvMNameOfFeeBlock=FeeNVM_BLOCK_DCM_ROE
    NvMCommon:
      NvMSafeBswChecks = true
      NvMApiConfigClass = NVM_API_CONFIG_CLASS_3
      NvMBswMMultiBlockJobStatusInformation = true
      NvMCompiledConfigId = 1
      NvMCrcNumOfBytes = 64
      NvMDatasetSelectionBits = 4
      NvMDevErrorDetect = true
      NvMDrvModeSwitch = true
      NvMDynamicConfiguration = false
      NvMJobPrioritization = false
      NvMPollingMode = false
      NvMSetRamBlockStatusApi = true
      NvMSizeStandardJobQueue = 8
      NvMVersionInfoApi = false
      NvMMaxNoOfWriteRetries = 1
      NvMMainFunctionPeriod = 0.01
      NvMUseBlockIdCheck = false
      NvMRepairRedundantBlocksApi = false
    23 x NvMBlockDescriptor, all with NvMBlockUseSyncMechanism=false, NvMBswMBlockStatusInformation=false, NvMWriteBlockOnce=false, NvMBlockUseCRCCompMechanism=false:
      NvMConfigBlock: NvMBlockCrcType=NVM_CRC16, NvMNvramBlockIdentifier=1, NvMBlockManagementType=NVM_BLOCK_REDUNDANT, NvMNvBlockNum=2, NvMBlockUseCrc=true, NvMNvBlockLength=2, NvMSelectBlockForReadAll=true, NvMResistantToChangedSw=true, NvMUseInitCallback=false, NvMSelectBlockForWriteAll=true, NvMCalcRamBlockCrc=false, NvMRomBlockDataAddress=NULL_PTR, NvMBlockJobPriority=127, NvMBlockWriteProt=false, NvMUseServicePorts=false, NvMUseJobendCallback=false
        NvMTargetBlockReference
          NvMFeeRef: NvMNameOfFeeBlock=FeeBlockConfiguration
      DemAdminDataBlock: NvMBlockJobPriority=127, NvMBlockManagementType=NVM_BLOCK_NATIVE, NvMBlockUseCrc=false, NvMBlockWriteProt=false, NvMNvBlockLength=12, NvMNvBlockNum=1, NvMNvramBlockIdentifier=2, NvMResistantToChangedSw=true, NvMUseServicePorts=false, NvMUseJobendCallback=true, NvMUseInitCallback=true, NvMRamBlockDataAddress=Dem_Cfg_AdminData, NvMRomBlockDataAddress=NULL_PTR, NvMSelectBlockForReadAll=true, NvMSelectBlockForWriteAll=true, NvMSingleBlockCallback=Dem_NvM_JobFinished, NvMInitBlockCallback=Dem_NvM_InitAdminData
        NvMTargetBlockReference
          NvMFeeRef: NvMNameOfFeeBlock=FeeDemAdminDataBlock
      DemPrimaryDataBlock0: NvMBlockJobPriority=127, NvMBlockManagementType=NVM_BLOCK_NATIVE, NvMBlockUseCrc=false, NvMBlockWriteProt=false, NvMNvBlockLength=32, NvMNvBlockNum=1, NvMNvramBlockIdentifier=6, NvMResistantToChangedSw=true, NvMUseServicePorts=false, NvMUseJobendCallback=true, NvMUseInitCallback=false, NvMRamBlockDataAddress=Dem_Cfg_PrimaryEntry_0, NvMRomBlockDataAddress=Dem_Cfg_MemoryEntryInit, NvMSelectBlockForReadAll=true, NvMSelectBlockForWriteAll=true, NvMSingleBlockCallback=Dem_NvM_JobFinished, NvMInitBlockCallback=NULL_PTR
        NvMTargetBlockReference
          NvMFeeRef: NvMNameOfFeeBlock=FeeDemPrimaryDataBlock0
      DemStatusDataBlock: NvMBlockJobPriority=127, NvMBlockManagementType=NVM_BLOCK_NATIVE, NvMBlockUseCrc=false, NvMBlockWriteProt=false, NvMNvBlockLength=48, NvMNvBlockNum=1, NvMNvramBlockIdentifier=19, NvMResistantToChangedSw=true, NvMUseServicePorts=false, NvMUseJobendCallback=true, NvMUseInitCallback=true, NvMRamBlockDataAddress=Dem_Cfg_StatusData, NvMRomBlockDataAddress=NULL_PTR, NvMSelectBlockForReadAll=true, NvMSelectBlockForWriteAll=true, NvMSingleBlockCallback=Dem_NvM_JobFinished, NvMInitBlockCallback=Dem_NvM_InitStatusData
        NvMTargetBlockReference
          NvMFeeRef: NvMNameOfFeeBlock=FeeDemStatusDataBlock
      DemPrimaryDataBlock1: NvMBlockJobPriority=127, NvMBlockManagementType=NVM_BLOCK_NATIVE, NvMBlockUseCrc=false, NvMBlockWriteProt=false, NvMNvBlockLength=32, NvMNvBlockNum=1, NvMNvramBlockIdentifier=7, NvMResistantToChangedSw=true, NvMUseServicePorts=false, NvMUseJobendCallback=true, NvMUseInitCallback=false, NvMRamBlockDataAddress=Dem_Cfg_PrimaryEntry_1, NvMRomBlockDataAddress=Dem_Cfg_MemoryEntryInit, NvMSelectBlockForReadAll=true, NvMSelectBlockForWriteAll=true, NvMSingleBlockCallback=Dem_NvM_JobFinished, NvMInitBlockCallback=NULL_PTR
        NvMTargetBlockReference
          NvMFeeRef: NvMNameOfFeeBlock=FeeDemPrimaryDataBlock1
      DemPrimaryDataBlock2: NvMBlockJobPriority=127, NvMBlockManagementType=NVM_BLOCK_NATIVE, NvMBlockUseCrc=false, NvMBlockWriteProt=false, NvMNvBlockLength=32, NvMNvBlockNum=1, NvMNvramBlockIdentifier=8, NvMResistantToChangedSw=true, NvMUseServicePorts=false, NvMUseJobendCallback=true, NvMUseInitCallback=false, NvMRamBlockDataAddress=Dem_Cfg_PrimaryEntry_2, NvMRomBlockDataAddress=Dem_Cfg_MemoryEntryInit, NvMSelectBlockForReadAll=true, NvMSelectBlockForWriteAll=true, NvMSingleBlockCallback=Dem_NvM_JobFinished, NvMInitBlockCallback=NULL_PTR
        NvMTargetBlockReference
          NvMFeeRef: NvMNameOfFeeBlock=FeeDemPrimaryDataBlock2
      DemPrimaryDataBlock3: NvMBlockJobPriority=127, NvMBlockManagementType=NVM_BLOCK_NATIVE, NvMBlockUseCrc=false, NvMBlockWriteProt=false, NvMNvBlockLength=32, NvMNvBlockNum=1, NvMNvramBlockIdentifier=9, NvMResistantToChangedSw=true, NvMUseServicePorts=false, NvMUseJobendCallback=true, NvMUseInitCallback=false, NvMRamBlockDataAddress=Dem_Cfg_PrimaryEntry_3, NvMRomBlockDataAddress=Dem_Cfg_MemoryEntryInit, NvMSelectBlockForReadAll=true, NvMSelectBlockForWriteAll=true, NvMSingleBlockCallback=Dem_NvM_JobFinished, NvMInitBlockCallback=NULL_PTR
        NvMTargetBlockReference
          NvMFeeRef: NvMNameOfFeeBlock=FeeDemPrimaryDataBlock3
      DemPrimaryDataBlock4: NvMBlockJobPriority=127, NvMBlockManagementType=NVM_BLOCK_NATIVE, NvMBlockUseCrc=false, NvMBlockWriteProt=false, NvMNvBlockLength=32, NvMNvBlockNum=1, NvMNvramBlockIdentifier=12, NvMResistantToChangedSw=true, NvMUseServicePorts=false, NvMUseJobendCallback=true, NvMUseInitCallback=false, NvMRamBlockDataAddress=Dem_Cfg_PrimaryEntry_4, NvMRomBlockDataAddress=Dem_Cfg_MemoryEntryInit, NvMSelectBlockForReadAll=true, NvMSelectBlockForWriteAll=true, NvMSingleBlockCallback=Dem_NvM_JobFinished, NvMInitBlockCallback=NULL_PTR
        NvMTargetBlockReference
          NvMFeeRef: NvMNameOfFeeBlock=FeeDemPrimaryDataBlock4
      DemPrimaryDataBlock5: NvMBlockJobPriority=127, NvMBlockManagementType=NVM_BLOCK_NATIVE, NvMBlockUseCrc=false, NvMBlockWriteProt=false, NvMNvBlockLength=32, NvMNvBlockNum=1, NvMNvramBlockIdentifier=14, NvMResistantToChangedSw=true, NvMUseServicePorts=false, NvMUseJobendCallback=true, NvMUseInitCallback=false, NvMRamBlockDataAddress=Dem_Cfg_PrimaryEntry_5, NvMRomBlockDataAddress=Dem_Cfg_MemoryEntryInit, NvMSelectBlockForReadAll=true, NvMSelectBlockForWriteAll=true, NvMSingleBlockCallback=Dem_NvM_JobFinished, NvMInitBlockCallback=NULL_PTR
        NvMTargetBlockReference
          NvMFeeRef: NvMNameOfFeeBlock=FeeDemPrimaryDataBlock5
      DemPrimaryDataBlock6: NvMBlockJobPriority=127, NvMBlockManagementType=NVM_BLOCK_NATIVE, NvMBlockUseCrc=false, NvMBlockWriteProt=false, NvMNvBlockLength=32, NvMNvBlockNum=1, NvMNvramBlockIdentifier=15, NvMResistantToChangedSw=true, NvMUseServicePorts=false, NvMUseJobendCallback=true, NvMUseInitCallback=false, NvMRamBlockDataAddress=Dem_Cfg_PrimaryEntry_6, NvMRomBlockDataAddress=Dem_Cfg_MemoryEntryInit, NvMSelectBlockForReadAll=true, NvMSelectBlockForWriteAll=true, NvMSingleBlockCallback=Dem_NvM_JobFinished, NvMInitBlockCallback=NULL_PTR
        NvMTargetBlockReference
          NvMFeeRef: NvMNameOfFeeBlock=FeeDemPrimaryDataBlock6
      DemPrimaryDataBlock7: NvMBlockJobPriority=127, NvMBlockManagementType=NVM_BLOCK_NATIVE, NvMBlockUseCrc=false, NvMBlockWriteProt=false, NvMNvBlockLength=32, NvMNvBlockNum=1, NvMNvramBlockIdentifier=17, NvMResistantToChangedSw=true, NvMUseServicePorts=false, NvMUseJobendCallback=true, NvMUseInitCallback=false, NvMRamBlockDataAddress=Dem_Cfg_PrimaryEntry_7, NvMRomBlockDataAddress=Dem_Cfg_MemoryEntryInit, NvMSelectBlockForReadAll=true, NvMSelectBlockForWriteAll=true, NvMSingleBlockCallback=Dem_NvM_JobFinished, NvMInitBlockCallback=NULL_PTR
        NvMTargetBlockReference
          NvMFeeRef: NvMNameOfFeeBlock=FeeDemPrimaryDataBlock7
      DemSecondaryDataBlock2: NvMBlockJobPriority=127, NvMBlockManagementType=NVM_BLOCK_NATIVE, NvMBlockUseCrc=false, NvMBlockWriteProt=false, NvMNvBlockLength=1, NvMNvBlockNum=1, NvMNvramBlockIdentifier=23, NvMUseServicePorts=false, NvMUseJobendCallback=true, NvMUseInitCallback=false, NvMRamBlockDataAddress=Dem_Cfg_SecondaryEntry_2, NvMRomBlockDataAddress=Dem_Cfg_MemoryEntryInit, NvMInitBlockCallback=NULL_PTR, NvMSelectBlockForReadAll=true, NvMSelectBlockForWriteAll=true, NvMSingleBlockCallback=Dem_NvM_JobFinished, NvMResistantToChangedSw=false
        NvMTargetBlockReference
          NvMFeeRef: NvMNameOfFeeBlock=FeeDemSecondaryDataBlock2
      DLOG_SVK_SYS_SUPP: NvMBlockJobPriority=127, NvMBlockManagementType=NVM_BLOCK_NATIVE, NvMBlockUseCrc=false, NvMBlockWriteProt=false, NvMNvBlockLength=41, NvMNvBlockNum=1, NvMNvramBlockIdentifier=16, NvMUseServicePorts=true, NvMUseJobendCallback=true, NvMUseInitCallback=true, NvMResistantToChangedSw=true, NvMBlockCrcType=NVM_CRC16, NvMBlockLengthCheckType=true, NvMBlockLengthCheck=false, NvMRamBlockDataAddress=NULL_PTR, NvMReadRamBlockFromNvCallback=NULL_PTR, NvMRomBlockDataAddress=NULL_PTR, NvMSingleBlockCallback=NULL_PTR, NvMWriteRamBlockToNvCallback=NULL_PTR
        NvMTargetBlockReference
          NvMFeeRef: NvMNameOfFeeBlock=FeeNVM_BLOCK_DLOG_SVK_SYS_SUPP
      TestStampDefaults: NvMBlockJobPriority=1, NvMBlockManagementType=NVM_BLOCK_NATIVE, NvMBlockUseCrc=false, NvMBlockWriteProt=false, NvMNvBlockLength=3, NvMNvBlockNum=1, NvMNvramBlockIdentifier=26, NvMResistantToChangedSw=false, NvMUseServicePorts=true, NvMUseJobendCallback=false, NvMUseInitCallback=false, NvMSingleBlockCallback=NULL_PTR, NvMReadRamBlockFromNvCallback=NULL_PTR, NvMBlockLengthCheckType=true, NvMBlockCrcType=NVM_CRC16, NvMSelectBlockForReadAll=false, NvMSelectBlockForWriteAll=false, NvMBlockLengthCheck=false, NvMRamBlockDataAddress=NULL_PTR, NvMRomBlockDataAddress=NULL_PTR
        NvMTargetBlockReference
          NvMFeeRef: NvMNameOfFeeBlock=FeeTestStampDefaults
      DemSecondaryDataBlock0: NvMBlockJobPriority=127, NvMBlockManagementType=NVM_BLOCK_NATIVE, NvMBlockUseCrc=false, NvMBlockWriteProt=false, NvMNvBlockLength=1, NvMNvBlockNum=1, NvMNvramBlockIdentifier=20, NvMUseServicePorts=false, NvMUseJobendCallback=true, NvMUseInitCallback=false, NvMRamBlockDataAddress=Dem_Cfg_SecondaryEntry_0, NvMRomBlockDataAddress=Dem_Cfg_MemoryEntryInit, NvMInitBlockCallback=NULL_PTR, NvMSelectBlockForReadAll=true, NvMSelectBlockForWriteAll=true, NvMSingleBlockCallback=Dem_NvM_JobFinished, NvMResistantToChangedSw=false
        NvMTargetBlockReference
          NvMFeeRef: NvMNameOfFeeBlock=FeeDemSecondaryDataBlock0
      NVM_BLOCK_BOOT_PROG_DATA: NvMBlockJobPriority=127, NvMBlockManagementType=NVM_BLOCK_NATIVE, NvMBlockUseCrc=false, NvMBlockWriteProt=true, NvMNvBlockLength=21, NvMNvBlockNum=1, NvMNvramBlockIdentifier=13, NvMResistantToChangedSw=false, NvMUseServicePorts=true, NvMUseJobendCallback=true, NvMUseInitCallback=true, NvMBlockLengthCheck=true, NvMBlockLengthCheckType=true, NvMBlockCrcType=NVM_CRC32, NvMRamBlockDataAddress=&Dlog_ProgData, NvMSelectBlockForReadAll=true, NvMSelectBlockForWriteAll=true, NvMStaticBlockIDCheck=false
        NvMTargetBlockReference
          NvMFeeRef: NvMNameOfFeeBlock=FeeNVM_BLOCK_BOOT_PROG_DATA
      DemSecondaryDataBlock1: NvMBlockJobPriority=127, NvMBlockManagementType=NVM_BLOCK_NATIVE, NvMBlockUseCrc=false, NvMBlockWriteProt=false, NvMNvBlockLength=1, NvMNvBlockNum=1, NvMNvramBlockIdentifier=22, NvMUseServicePorts=false, NvMUseJobendCallback=true, NvMUseInitCallback=false, NvMRamBlockDataAddress=Dem_Cfg_SecondaryEntry_1, NvMRomBlockDataAddress=Dem_Cfg_MemoryEntryInit, NvMInitBlockCallback=NULL_PTR, NvMSelectBlockForReadAll=true, NvMSelectBlockForWriteAll=true, NvMSingleBlockCallback=Dem_NvM_JobFinished, NvMResistantToChangedSw=false
        NvMTargetBlockReference
          NvMFeeRef: NvMNameOfFeeBlock=FeeDemSecondaryDataBlock1
      NVM_BLOCK_DLOG_SVK_PLANT: NvMBlockJobPriority=127, NvMBlockManagementType=NVM_BLOCK_NATIVE, NvMBlockUseCrc=false, NvMBlockWriteProt=true, NvMNvBlockLength=57, NvMNvBlockNum=1, NvMNvramBlockIdentifier=18, NvMUseServicePorts=true, NvMUseJobendCallback=false, NvMUseInitCallback=false, NvMResistantToChangedSw=false
        NvMTargetBlockReference
          NvMFeeRef: NvMNameOfFeeBlock=FeeNVM_BLOCK_DLOG_SVK_PLANT
      OmcDependencyNVMData: NvMBlockJobPriority=127, NvMBlockManagementType=NVM_BLOCK_NATIVE, NvMBlockUseCrc=false, NvMBlockWriteProt=false, NvMNvBlockLength=2, NvMNvBlockNum=1, NvMNvramBlockIdentifier=24, NvMUseServicePorts=true, NvMUseInitCallback=false, NvMRomBlockNum=1, NvMSelectBlockForReadAll=true, NvMSelectBlockForWriteAll=false, NvMBlockCrcType=NVM_CRC16, NvMCalcRamBlockCrc=false, NvMBlockLengthCheckType=true, NvMRomBlockDataAddress=Omc_DefaultNvData, NvMBlockLengthCheck=false, NvMRamBlockDataAddress=Omc_NvData, NvMResistantToChangedSw=false, NvMUseJobendCallback=true, NvMMaxNumOfWriteRetries=3, NvMMaxNumOfReadRetries=0  # UC:Derived from NvBlockNeeds
        NvMTargetBlockReference
          NvMFeeRef: NvMNameOfFeeBlock=FeeOmcDependencyNVMData
      NVM_BLOCK_BOOT_SVK_HISTORY: NvMBlockJobPriority=127, NvMBlockManagementType=NVM_BLOCK_NATIVE, NvMBlockUseCrc=false, NvMBlockWriteProt=true, NvMNvBlockLength=4, NvMNvBlockNum=1, NvMNvramBlockIdentifier=10, NvMResistantToChangedSw=false, NvMUseServicePorts=true, NvMUseJobendCallback=false, NvMUseInitCallback=true, NvMBlockLengthCheck=false, NvMBlockLengthCheckType=true, NvMBlockCrcType=NVM_CRC16, NvMRamBlockDataAddress=, NvMSelectBlockForReadAll=false, NvMSelectBlockForWriteAll=false
        NvMTargetBlockReference
          NvMFeeRef: NvMNameOfFeeBlock=FeeNVM_BLOCK_BOOT_SVK_HISTORY
      DLOG_SVK_BACKUP_0: NvMBlockJobPriority=127, NvMBlockManagementType=NVM_BLOCK_NATIVE, NvMBlockUseCrc=false, NvMBlockWriteProt=false, NvMNvBlockLength=41, NvMNvBlockNum=1, NvMNvramBlockIdentifier=3, NvMResistantToChangedSw=true, NvMUseServicePorts=true, NvMUseJobendCallback=false, NvMUseInitCallback=false, NvMBlockLengthCheckType=true, NvMBlockCrcType=NVM_CRC16, NvMInitBlockCallback=DLOG_SVK_BACKUP_0, NvMRamBlockDataAddress=NULL_PTR, NvMReadRamBlockFromNvCallback=NULL_PTR, NvMRomBlockDataAddress=NULL_PTR, NvMSingleBlockCallback=NULL_PTR, NvMSelectBlockForReadAll=false, NvMSelectBlockForWriteAll=false, NvMStaticBlockIDCheck=false, NvMWriteRamBlockToNvCallback=NULL_PTR
        NvMTargetBlockReference
          NvMFeeRef: NvMNameOfFeeBlock=FeeDLOG_SVK_BACKUP_0
      DLOG_SVK_BACKUP_1: NvMBlockJobPriority=127, NvMBlockManagementType=NVM_BLOCK_NATIVE, NvMBlockUseCrc=false, NvMBlockWriteProt=false, NvMNvBlockLength=41, NvMNvBlockNum=1, NvMNvramBlockIdentifier=4, NvMResistantToChangedSw=true, NvMUseServicePorts=true, NvMUseJobendCallback=false, NvMUseInitCallback=false, NvMBlockLengthCheckType=true, NvMBlockCrcType=NVM_CRC16, NvMInitBlockCallback=DLOG_SVK_BACKUP_0, NvMRamBlockDataAddress=NULL_PTR, NvMReadRamBlockFromNvCallback=NULL_PTR, NvMRomBlockDataAddress=NULL_PTR, NvMSingleBlockCallback=NULL_PTR, NvMSelectBlockForReadAll=false, NvMSelectBlockForWriteAll=false, NvMStaticBlockIDCheck=false, NvMWriteRamBlockToNvCallback=NULL_PTR, NvMMaxNumOfReadRetries=0, NvMMaxNumOfWriteRetries=3
        NvMTargetBlockReference
          NvMFeeRef: NvMNameOfFeeBlock=FeeDLOG_SVK_BACKUP_1
      DLOG_SVK_BACKUP_2: NvMBlockJobPriority=127, NvMBlockManagementType=NVM_BLOCK_NATIVE, NvMBlockUseCrc=false, NvMBlockWriteProt=false, NvMNvBlockLength=41, NvMNvBlockNum=1, NvMNvramBlockIdentifier=5, NvMResistantToChangedSw=true, NvMUseServicePorts=true, NvMUseJobendCallback=false, NvMUseInitCallback=false, NvMBlockLengthCheckType=true, NvMBlockCrcType=NVM_CRC16, NvMInitBlockCallback=DLOG_SVK_BACKUP_0, NvMRamBlockDataAddress=NULL_PTR, NvMReadRamBlockFromNvCallback=NULL_PTR, NvMRomBlockDataAddress=NULL_PTR, NvMSingleBlockCallback=NULL_PTR, NvMSelectBlockForReadAll=false, NvMSelectBlockForWriteAll=false, NvMStaticBlockIDCheck=false, NvMWriteRamBlockToNvCallback=NULL_PTR, NvMMaxNumOfReadRetries=0, NvMMaxNumOfWriteRetries=3
        NvMTargetBlockReference
          NvMFeeRef: NvMNameOfFeeBlock=FeeDLOG_SVK_BACKUP_2
