AUTOSAR XML (schema 4-3-0)
package /ActiveEcuC
  module config SysTime: implementation-config-variant=VARIANT-PRE-COMPILE
    SysTimeGeneral: SysTimeDevErrorDetect=true, SysTimeMainTaskCycle=0.01, SysTimeInitialTimeout=5
    CommonPublishedInformation: SwMajorVersion=5, SwMinorVersion=0, SwPatchVersion=3
