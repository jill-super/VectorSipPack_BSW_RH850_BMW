AUTOSAR XML (schema 4-3-0)
package /ActiveEcuC
  module config PduR: implementation-config-variant=VARIANT-PRE-COMPILE, module-description=PduR_Impl
    3 x PduRBswModules, all with PduRCancelReceive=false, PduRCancelTransmit=false, PduRChangeParameterRequestApi=false, PduRCommunicationInterface=true, PduRTransportProtocol=false, PduRTriggertransmit=true, PduRTxConfirmation=true, PduRUseTag=false:
      Com: PduRLowerModule=false, PduRUpperModule=true, PduRBswModuleRef=Com
      FrIf: PduRLowerModule=true, PduRUpperModule=false, PduRBswModuleRef=FrIf
      IpduM: PduRLowerModule=true, PduRUpperModule=true, PduRBswModuleRef=IpduM
    PduRGeneral: PduRDevErrorDetect=true, PduRVersionInfoApi=false, PduRMetaDataSupport=false, PduRPduCallback=false, PduRSwitching=false, PduRSafeBswChecks=true
      PduRGeneration:
        PduROutOfBoundsWriteProtectionStrategy = NONE
        PduROutOfBoundsWriteSanitizer = false
        PduROutOfBoundsReadSanitizer = false
        PduRNumericalDataTypeMinimizationStrategy = WITH_CAST
        PduRReduceConstantData2Define = false
        PduRBoolDataInArrayOfStructStrategy = BITMASKING
        PduRDeduplicateIndirectedData = true
        PduRDataDeduplicationStrategy = WITH_CAST
        PduRReduceBoolDataByNegationThreshold = 2
        PduRReduceBoolDataByNumericalComparisonThreshold = 2
        PduRReduceBoolDataByNumericalRelationThreshold = 2
        PduRReduceBoolDataByNumericalOperandStrategy = WITH_ANY_VALUE
        PduRReduceNumericalDataByOffsetThreshold = 2
        PduRReduceNumericalDataByArraySubtractionThreshold = 2
        PduRReduceDataByStreaming = false
        PduRShortSymbols = false
        PduRInterfacesForDeactivatedData = false
        PduRReferringKeysInComments = false
    PduRRoutingTables: PduRConfigurationId=0
      PduRRoutingTable
        87 x PduRRoutingPath:
          Fr_pduTr_FR_DBG_EPS_A_FlexRay_7d601c47: PduRRoutingPathCommunicationType=COMMUNICATION_INTERFACE  # FR_DBG_EPS
            DST_Fr_pduTr_FR_DBG_EPS_A_FlexRay_7d601c47 (PduRDestPdu):
              PduRDestPduHandleId = 10
              PduRDestPduDirection = TRANSMIT
              PduRDestPduRoutingType = API_FORWARDING
              PduRTransmissionConfirmation = false
              PduRDestPduDataProvision = PDUR_TRIGGERTRANSMIT
              PduRDestPduRef = pduTr_FR_DBG_EPS_A_FlexRay_pduPort_EPS_A_FlexRay_OUT_7d601c47_052bff33
              PduRDestPduPduRBswModulesRef = FrIf
            SRC_Fr_pduTr_FR_DBG_EPS_A_FlexRay_7d601c47 (PduRSrcPdu):
              PduRSourcePduHandleId = 9
              PduRSrcPduDirection = TRANSMIT
              PduRSrcPduRef = pduTr_FR_DBG_EPS_A_FlexRay_pduPort_EPS_A_FlexRay_OUT_7d601c47_052bff33
              PduRSrcPduPduRBswModulesRef = IpduM
          Fr_pduTr_SECU_RESP_A_FlexRay_7d601c47: PduRRoutingPathCommunicationType=COMMUNICATION_INTERFACE  # SECU_RESP
            DST_Fr_pduTr_SECU_RESP_A_FlexRay_7d601c47 (PduRDestPdu):
              PduRDestPduHandleId = 18
              PduRDestPduDirection = RECEIVE
              PduRDestPduRoutingType = API_FORWARDING
              PduRTransmissionConfirmation = false
              PduRDestPduRef = pduTr_SECU_RESP_A_FlexRay_pduPort_EPS_A_FlexRay_IN_7d601c47_052bff33
              PduRDestPduPduRBswModulesRef = Com
            SRC_Fr_pduTr_SECU_RESP_A_FlexRay_7d601c47 (PduRSrcPdu):
              PduRSourcePduHandleId = 17
              PduRSrcPduDirection = RECEIVE
              PduRSrcPduRef = pduTr_SECU_RESP_A_FlexRay_pduPort_EPS_A_FlexRay_IN_7d601c47_052bff33
              PduRSrcPduPduRBswModulesRef = IpduM
          SVC_434514f6_In: PduRRoutingPathCommunicationType=COMMUNICATION_INTERFACE
            DST_SVC_434514f6_In (PduRDestPdu):
              PduRDestPduHandleId = 1
              PduRDestPduDirection = RECEIVE
              PduRDestPduRoutingType = API_FORWARDING
              PduRTransmissionConfirmation = false
              PduRDestPduRef = SVC_434514f6_In
              PduRDestPduPduRBswModulesRef = IpduM
            SRC_SVC_434514f6_In (PduRSrcPdu): PduRSourcePduHandleId=28, PduRSrcPduDirection=RECEIVE, PduRSrcPduRef=SVC_434514f6_In, PduRSrcPduPduRBswModulesRef=FrIf
          Fr_pduTr_FAHRGESTELLNUMMER_A_FlexRay_7d601c47: PduRRoutingPathCommunicationType=COMMUNICATION_INTERFACE  # FAHRGESTELLNUMMER
            DST_Fr_pduTr_FAHRGESTELLNUMMER_A_FlexRay_7d601c47 (PduRDestPdu):
              PduRDestPduHandleId = 12
              PduRDestPduDirection = RECEIVE
              PduRDestPduRoutingType = API_FORWARDING
              PduRTransmissionConfirmation = false
              PduRDestPduRef = pduTr_FAHRGESTELLNUMMER_A_FlexRay_pduPort_EPS_A_FlexRay_IN_7d601c47_052bff33
              PduRDestPduPduRBswModulesRef = Com
            SRC_Fr_pduTr_FAHRGESTELLNUMMER_A_FlexRay_7d601c47 (PduRSrcPdu):
              PduRSourcePduHandleId = 11
              PduRSrcPduDirection = RECEIVE
              PduRSrcPduRef = pduTr_FAHRGESTELLNUMMER_A_FlexRay_pduPort_EPS_A_FlexRay_IN_7d601c47_052bff33
              PduRSrcPduPduRBswModulesRef = FrIf
          Fr_pduTr_AVL_RPM_WHL_A_FlexRay_7d601c47: PduRRoutingPathCommunicationType=COMMUNICATION_INTERFACE  # AVL_RPM_WHL
            SRC_Fr_pduTr_AVL_RPM_WHL_A_FlexRay_7d601c47 (PduRSrcPdu):
              PduRSourcePduHandleId = 2
              PduRSrcPduDirection = RECEIVE
              PduRSrcPduRef = pduTr_AVL_RPM_WHL_A_FlexRay_pduPort_EPS_A_FlexRay_IN_7d601c47_052bff33
              PduRSrcPduPduRBswModulesRef = FrIf
            DST_Fr_pduTr_AVL_RPM_WHL_A_FlexRay_7d601c47 (PduRDestPdu):
              PduRDestPduHandleId = 3
              PduRDestPduDirection = RECEIVE
              PduRDestPduRoutingType = API_FORWARDING
              PduRTransmissionConfirmation = false
              PduRDestPduRef = pduTr_AVL_RPM_WHL_A_FlexRay_pduPort_EPS_A_FlexRay_IN_7d601c47_052bff33
              PduRDestPduPduRBswModulesRef = Com
          Fr_pduTr_SECU_FAHRGESTELLNUMMER_A_FlexRay_7d601c47: PduRRoutingPathCommunicationType=COMMUNICATION_INTERFACE  # SECU_FAHRGESTELLNUMMER
            DST_Fr_pduTr_SECU_FAHRGESTELLNUMMER_A_FlexRay_7d601c47 (PduRDestPdu):
              PduRDestPduHandleId = 17
              PduRDestPduDirection = RECEIVE
              PduRDestPduRoutingType = API_FORWARDING
              PduRTransmissionConfirmation = false
              PduRDestPduRef = pduTr_SECU_FAHRGESTELLNUMMER_A_FlexRay_pduPort_EPS_A_FlexRay_IN_7d601c47_052bff33
              PduRDestPduPduRBswModulesRef = Com
            SRC_Fr_pduTr_SECU_FAHRGESTELLNUMMER_A_FlexRay_7d601c47 (PduRSrcPdu):
              PduRSourcePduHandleId = 16
              PduRSrcPduDirection = RECEIVE
              PduRSrcPduRef = pduTr_SECU_FAHRGESTELLNUMMER_A_FlexRay_pduPort_EPS_A_FlexRay_IN_7d601c47_052bff33
              PduRSrcPduPduRBswModulesRef = FrIf
          Fr_pduTr_ACLNY_MASSCNTR_A_FlexRay_7d601c47: PduRRoutingPathCommunicationType=COMMUNICATION_INTERFACE  # ACLNY_MASSCNTR
            DST_Fr_pduTr_ACLNY_MASSCNTR_A_FlexRay_7d601c47 (PduRDestPdu):
              PduRDestPduHandleId = 2
              PduRDestPduDirection = RECEIVE
              PduRDestPduRoutingType = API_FORWARDING
              PduRTransmissionConfirmation = false
              PduRDestPduRef = pduTr_ACLNY_MASSCNTR_A_FlexRay_pduPort_EPS_A_FlexRay_IN_7d601c47_052bff33
              PduRDestPduPduRBswModulesRef = Com
            SRC_Fr_pduTr_ACLNY_MASSCNTR_A_FlexRay_7d601c47 (PduRSrcPdu):
              PduRSourcePduHandleId = 1
              PduRSrcPduDirection = RECEIVE
              PduRSrcPduRef = pduTr_ACLNY_MASSCNTR_A_FlexRay_pduPort_EPS_A_FlexRay_IN_7d601c47_052bff33
              PduRSrcPduPduRBswModulesRef = FrIf
          Fr_pduTr_DT_EST_A_FlexRay_7d601c47: PduRRoutingPathCommunicationType=COMMUNICATION_INTERFACE  # DT_EST
            DST_Fr_pduTr_DT_EST_A_FlexRay_7d601c47 (PduRDestPdu):
              PduRDestPduHandleId = 8
              PduRDestPduDirection = TRANSMIT
              PduRDestPduRoutingType = API_FORWARDING
              PduRDestPduDataProvision = PDUR_TRIGGERTRANSMIT
              PduRTransmissionConfirmation = false
              PduRDestPduRef = pduTr_DT_EST_A_FlexRay_pduPort_EPS_A_FlexRay_OUT_7d601c47_052bff33
              PduRDestPduPduRBswModulesRef = FrIf
            SRC_Fr_pduTr_DT_EST_A_FlexRay_7d601c47 (PduRSrcPdu):
              PduRSourcePduHandleId = 7
              PduRSrcPduDirection = TRANSMIT
              PduRSrcPduRef = pduTr_DT_EST_A_FlexRay_pduPort_EPS_A_FlexRay_OUT_7d601c47_052bff33
              PduRSrcPduPduRBswModulesRef = Com
          Fr_pduTr_DISP_CC_EPS_A_FlexRay_7d601c47: PduRRoutingPathCommunicationType=COMMUNICATION_INTERFACE  # DISP_CC_EPS
            DST_Fr_pduTr_DISP_CC_EPS_A_FlexRay_7d601c47 (PduRDestPdu):
              PduRDestPduHandleId = 7
              PduRDestPduDirection = TRANSMIT
              PduRDestPduRoutingType = API_FORWARDING
              PduRDestPduDataProvision = PDUR_TRIGGERTRANSMIT
              PduRTransmissionConfirmation = true
              PduRDestPduRef = pduTr_DISP_CC_EPS_A_FlexRay_pduPort_EPS_A_FlexRay_OUT_7d601c47_052bff33
              PduRDestPduPduRBswModulesRef = FrIf
            SRC_Fr_pduTr_DISP_CC_EPS_A_FlexRay_7d601c47 (PduRSrcPdu):
              PduRSourcePduHandleId = 6
              PduRSrcPduDirection = TRANSMIT
              PduRSrcPduRef = pduTr_DISP_CC_EPS_A_FlexRay_pduPort_EPS_A_FlexRay_OUT_7d601c47_052bff33
              PduRSrcPduPduRBswModulesRef = Com
          Fr_pduTr_RQ_STG_EFAN_A_FlexRay_7d601c47: PduRRoutingPathCommunicationType=COMMUNICATION_INTERFACE  # RQ_STG_EFAN
            SRC_Fr_pduTr_RQ_STG_EFAN_A_FlexRay_7d601c47 (PduRSrcPdu):
              PduRSourcePduHandleId = 10
              PduRSrcPduDirection = TRANSMIT
              PduRSrcPduRef = pduTr_RQ_STG_EFAN_A_FlexRay_pduPort_EPS_A_FlexRay_OUT_7d601c47_052bff33
              PduRSrcPduPduRBswModulesRef = Com
            DST_Fr_pduTr_RQ_STG_EFAN_A_FlexRay_7d601c47 (PduRDestPdu):
              PduRDestPduHandleId = 11
              PduRDestPduDirection = TRANSMIT
              PduRDestPduRoutingType = API_FORWARDING
              PduRTransmissionConfirmation = false
              PduRDestPduDataProvision = PDUR_TRIGGERTRANSMIT
              PduRDestPduRef = pduTr_RQ_STG_EFAN_A_FlexRay_pduPort_EPS_A_FlexRay_OUT_7d601c47_052bff33
              PduRDestPduPduRBswModulesRef = IpduM
          Fr_pduTr_ST_DIAG_OBD_3_DRDY_A_FlexRay_7d601c47: PduRRoutingPathCommunicationType=COMMUNICATION_INTERFACE  # ST_DIAG_OBD_3_DRDY
            DST_Fr_pduTr_ST_DIAG_OBD_3_DRDY_A_FlexRay_7d601c47 (PduRDestPdu):
              PduRDestPduHandleId = 13
              PduRDestPduDirection = TRANSMIT
              PduRDestPduRoutingType = API_FORWARDING
              PduRDestPduDataProvision = PDUR_TRIGGERTRANSMIT
              PduRTransmissionConfirmation = true
              PduRDestPduRef = pduTr_ST_DIAG_OBD_3_DRDY_A_FlexRay_pduPort_EPS_A_FlexRay_OUT_7d601c47_052bff33
              PduRDestPduPduRBswModulesRef = FrIf
            SRC_Fr_pduTr_ST_DIAG_OBD_3_DRDY_A_FlexRay_7d601c47 (PduRSrcPdu):
              PduRSourcePduHandleId = 12
              PduRSrcPduDirection = TRANSMIT
              PduRSrcPduRef = pduTr_ST_DIAG_OBD_3_DRDY_A_FlexRay_pduPort_EPS_A_FlexRay_OUT_7d601c47_052bff33
              PduRSrcPduPduRBswModulesRef = Com
          Fr_pduTr_A_TEMP_A_FlexRay_7d601c47: PduRRoutingPathCommunicationType=COMMUNICATION_INTERFACE  # A_TEMP
            DST_Fr_pduTr_A_TEMP_A_FlexRay_7d601c47 (PduRDestPdu):
              PduRDestPduHandleId = 4
              PduRDestPduDirection = RECEIVE
              PduRDestPduRoutingType = API_FORWARDING
              PduRTransmissionConfirmation = false
              PduRDestPduRef = pduTr_A_TEMP_A_FlexRay_pduPort_EPS_A_FlexRay_IN_7d601c47_052bff33
              PduRDestPduPduRBswModulesRef = Com
            SRC_Fr_pduTr_A_TEMP_A_FlexRay_7d601c47 (PduRSrcPdu):
              PduRSourcePduHandleId = 3
              PduRSrcPduDirection = RECEIVE
              PduRSrcPduRef = pduTr_A_TEMP_A_FlexRay_pduPort_EPS_A_FlexRay_IN_7d601c47_052bff33
              PduRSrcPduPduRBswModulesRef = FrIf
          ANFRAGE_434514f6_Out: PduRRoutingPathCommunicationType=COMMUNICATION_INTERFACE
            DST_ANFRAGE_434514f6_Out (PduRDestPdu):
              PduRDestPduHandleId = 0
              PduRDestPduDirection = TRANSMIT
              PduRDestPduRoutingType = API_FORWARDING
              PduRTransmissionConfirmation = true
              PduRDestPduDataProvision = PDUR_TRIGGERTRANSMIT
              PduRDestPduRef = ANFRAGE_434514f6_Out
              PduRDestPduPduRBswModulesRef = IpduM
            SRC_ANFRAGE_434514f6_Out (PduRSrcPdu): PduRSourcePduHandleId=0, PduRSrcPduDirection=TRANSMIT, PduRSrcPduRef=ANFRAGE_434514f6_Out, PduRSrcPduPduRBswModulesRef=Com
          Fr_pduTr_TAR_QTA_STRMOM_DV_A_FlexRay_7d601c47: PduRRoutingPathCommunicationType=COMMUNICATION_INTERFACE  # TAR_QTA_STRMOM_DV
            SRC_Fr_pduTr_TAR_QTA_STRMOM_DV_A_FlexRay_7d601c47 (PduRSrcPdu):
              PduRSourcePduHandleId = 24
              PduRSrcPduDirection = RECEIVE
              PduRSrcPduRef = pduTr_TAR_QTA_STRMOM_DV_A_FlexRay_pduPort_EPS_A_FlexRay_IN_7d601c47_052bff33
              PduRSrcPduPduRBswModulesRef = FrIf
            DST_Fr_pduTr_TAR_QTA_STRMOM_DV_A_FlexRay_7d601c47 (PduRDestPdu):
              PduRDestPduHandleId = 25
              PduRDestPduDirection = RECEIVE
              PduRDestPduRoutingType = API_FORWARDING
              PduRTransmissionConfirmation = false
              PduRDestPduRef = pduTr_TAR_QTA_STRMOM_DV_A_FlexRay_pduPort_EPS_A_FlexRay_IN_7d601c47_052bff33
              PduRDestPduPduRBswModulesRef = Com
          Fr_pduTr_KILOMETERSTAND_A_FlexRay_7d601c47: PduRRoutingPathCommunicationType=COMMUNICATION_INTERFACE  # KILOMETERSTAND
            DST_Fr_pduTr_KILOMETERSTAND_A_FlexRay_7d601c47 (PduRDestPdu):
              PduRDestPduHandleId = 14
              PduRDestPduDirection = RECEIVE
              PduRDestPduRoutingType = API_FORWARDING
              PduRTransmissionConfirmation = false
              PduRDestPduRef = pduTr_KILOMETERSTAND_A_FlexRay_pduPort_EPS_A_FlexRay_IN_7d601c47_052bff33
              PduRDestPduPduRBswModulesRef = Com
            SRC_Fr_pduTr_KILOMETERSTAND_A_FlexRay_7d601c47 (PduRSrcPdu):
              PduRSourcePduHandleId = 13
              PduRSrcPduDirection = RECEIVE
              PduRSrcPduRef = pduTr_KILOMETERSTAND_A_FlexRay_pduPort_EPS_A_FlexRay_IN_7d601c47_052bff33
              PduRSrcPduPduRBswModulesRef = FrIf
          Fr_pduTr_VYAW_VEH_A_FlexRay_7d601c47: PduRRoutingPathCommunicationType=COMMUNICATION_INTERFACE  # VYAW_VEH
            DST_Fr_pduTr_VYAW_VEH_A_FlexRay_7d601c47 (PduRDestPdu):
              PduRDestPduHandleId = 27
              PduRDestPduDirection = RECEIVE
              PduRDestPduRoutingType = API_FORWARDING
              PduRTransmissionConfirmation = false
              PduRDestPduRef = pduTr_VYAW_VEH_A_FlexRay_pduPort_EPS_A_FlexRay_IN_7d601c47_052bff33
              PduRDestPduPduRBswModulesRef = Com
            SRC_Fr_pduTr_VYAW_VEH_A_FlexRay_7d601c47 (PduRSrcPdu):
              PduRSourcePduHandleId = 26
              PduRSrcPduDirection = RECEIVE
              PduRSrcPduRef = pduTr_VYAW_VEH_A_FlexRay_pduPort_EPS_A_FlexRay_IN_7d601c47_052bff33
              PduRSrcPduPduRBswModulesRef = FrIf
          Fr_pduTr_ST_STAB_DSC_A_FlexRay_7d601c47: PduRRoutingPathCommunicationType=COMMUNICATION_INTERFACE  # ST_STAB_DSC
            DST_Fr_pduTr_ST_STAB_DSC_A_FlexRay_7d601c47 (PduRDestPdu):
              PduRDestPduHandleId = 22
              PduRDestPduDirection = RECEIVE
              PduRDestPduRoutingType = API_FORWARDING
              PduRTransmissionConfirmation = false
              PduRDestPduRef = pduTr_ST_STAB_DSC_A_FlexRay_pduPort_EPS_A_FlexRay_IN_7d601c47_052bff33
              PduRDestPduPduRBswModulesRef = Com
            SRC_Fr_pduTr_ST_STAB_DSC_A_FlexRay_7d601c47 (PduRSrcPdu):
              PduRSourcePduHandleId = 21
              PduRSrcPduDirection = RECEIVE
              PduRSrcPduRef = pduTr_ST_STAB_DSC_A_FlexRay_pduPort_EPS_A_FlexRay_IN_7d601c47_052bff33
              PduRSrcPduPduRBswModulesRef = FrIf
          Fr_pduTr_DIAG_OBD_ENG_A_FlexRay_7d601c47: PduRRoutingPathCommunicationType=COMMUNICATION_INTERFACE  # DIAG_OBD_ENG
            DST_Fr_pduTr_DIAG_OBD_ENG_A_FlexRay_7d601c47 (PduRDestPdu):
              PduRDestPduHandleId = 8
              PduRDestPduDirection = RECEIVE
              PduRDestPduRoutingType = API_FORWARDING
              PduRTransmissionConfirmation = false
              PduRDestPduRef = pduTr_DIAG_OBD_ENG_A_FlexRay_pduPort_EPS_A_FlexRay_IN_7d601c47_052bff33
              PduRDestPduPduRBswModulesRef = Com
            SRC_Fr_pduTr_DIAG_OBD_ENG_A_FlexRay_7d601c47 (PduRSrcPdu):
              PduRSourcePduHandleId = 7
              PduRSrcPduDirection = RECEIVE
              PduRSrcPduRef = pduTr_DIAG_OBD_ENG_A_FlexRay_pduPort_EPS_A_FlexRay_IN_7d601c47_052bff33
              PduRSrcPduPduRBswModulesRef = FrIf
          Fr_pduTr_TAR_STMOM_DV_ACT_A_FlexRay_7d601c47: PduRRoutingPathCommunicationType=COMMUNICATION_INTERFACE  # TAR_STMOM_DV_ACT
            SRC_Fr_pduTr_TAR_STMOM_DV_ACT_A_FlexRay_7d601c47 (PduRSrcPdu):
              PduRSourcePduHandleId = 25
              PduRSrcPduDirection = RECEIVE
              PduRSrcPduRef = pduTr_TAR_STMOM_DV_ACT_A_FlexRay_pduPort_EPS_A_FlexRay_IN_7d601c47_052bff33
              PduRSrcPduPduRBswModulesRef = FrIf
            DST_Fr_pduTr_TAR_STMOM_DV_ACT_A_FlexRay_7d601c47 (PduRDestPdu):
              PduRDestPduHandleId = 26
              PduRDestPduDirection = RECEIVE
              PduRDestPduRoutingType = API_FORWARDING
              PduRTransmissionConfirmation = false
              PduRDestPduRef = pduTr_TAR_STMOM_DV_ACT_A_FlexRay_pduPort_EPS_A_FlexRay_IN_7d601c47_052bff33
              PduRDestPduPduRBswModulesRef = Com
          Fr_pduTr_ENGTORQ_EPS_A_FlexRay_7d601c47: PduRRoutingPathCommunicationType=COMMUNICATION_INTERFACE  # ENGTORQ_EPS
            SRC_Fr_pduTr_ENGTORQ_EPS_A_FlexRay_7d601c47 (PduRSrcPdu):
              PduRSourcePduHandleId = 8
              PduRSrcPduDirection = TRANSMIT
              PduRSrcPduRef = pduTr_ENGTORQ_EPS_A_FlexRay_pduPort_EPS_A_FlexRay_OUT_7d601c47_052bff33
              PduRSrcPduPduRBswModulesRef = Com
            DST_Fr_pduTr_ENGTORQ_EPS_A_FlexRay_7d601c47 (PduRDestPdu):
              PduRDestPduHandleId = 9
              PduRDestPduDirection = TRANSMIT
              PduRDestPduRoutingType = API_FORWARDING
              PduRDestPduDataProvision = PDUR_TRIGGERTRANSMIT
              PduRTransmissionConfirmation = false
              PduRDestPduRef = pduTr_ENGTORQ_EPS_A_FlexRay_pduPort_EPS_A_FlexRay_OUT_7d601c47_052bff33
              PduRDestPduPduRBswModulesRef = FrIf
          Fr_pduTr_ST_ENERG_GEN_A_FlexRay_7d601c47: PduRRoutingPathCommunicationType=COMMUNICATION_INTERFACE  # ST_ENERG_GEN
            DST_Fr_pduTr_ST_ENERG_GEN_A_FlexRay_7d601c47 (PduRDestPdu):
              PduRDestPduHandleId = 21
              PduRDestPduDirection = RECEIVE
              PduRDestPduRoutingType = API_FORWARDING
              PduRTransmissionConfirmation = false
              PduRDestPduRef = pduTr_ST_ENERG_GEN_A_FlexRay_pduPort_EPS_A_FlexRay_IN_7d601c47_052bff33
              PduRDestPduPduRBswModulesRef = Com
            SRC_Fr_pduTr_ST_ENERG_GEN_A_FlexRay_7d601c47 (PduRSrcPdu):
              PduRSourcePduHandleId = 20
              PduRSrcPduDirection = RECEIVE
              PduRSrcPduRef = pduTr_ST_ENERG_GEN_A_FlexRay_pduPort_EPS_A_FlexRay_IN_7d601c47_052bff33
              PduRSrcPduPduRBswModulesRef = FrIf
          Fr_pduTr_AVL_PO_EPS_A_FlexRay_7d601c47: PduRRoutingPathCommunicationType=COMMUNICATION_INTERFACE  # AVL_PO_EPS
            DST_Fr_pduTr_AVL_PO_EPS_A_FlexRay_7d601c47 (PduRDestPdu):
              PduRDestPduHandleId = 3
              PduRDestPduDirection = TRANSMIT
              PduRDestPduRoutingType = API_FORWARDING
              PduRDestPduDataProvision = PDUR_TRIGGERTRANSMIT
              PduRTransmissionConfirmation = false
              PduRDestPduRef = pduTr_AVL_PO_EPS_A_FlexRay_pduPort_EPS_A_FlexRay_OUT_7d601c47_052bff33
              PduRDestPduPduRBswModulesRef = FrIf
            SRC_Fr_pduTr_AVL_PO_EPS_A_FlexRay_7d601c47 (PduRSrcPdu):
              PduRSourcePduHandleId = 2
              PduRSrcPduDirection = TRANSMIT
              PduRSrcPduRef = pduTr_AVL_PO_EPS_A_FlexRay_pduPort_EPS_A_FlexRay_OUT_7d601c47_052bff33
              PduRSrcPduPduRBswModulesRef = Com
          Fr_pduTr_AVL_STMOM_DV_ACT_A_FlexRay_7d601c47: PduRRoutingPathCommunicationType=COMMUNICATION_INTERFACE  # AVL_STMOM_DV_ACT
            SRC_Fr_pduTr_AVL_STMOM_DV_ACT_A_FlexRay_7d601c47 (PduRSrcPdu):
              PduRSourcePduHandleId = 3
              PduRSrcPduDirection = TRANSMIT
              PduRSrcPduRef = pduTr_AVL_STMOM_DV_ACT_A_FlexRay_pduPort_EPS_A_FlexRay_OUT_7d601c47_052bff33
              PduRSrcPduPduRBswModulesRef = Com
            DST_Fr_pduTr_AVL_STMOM_DV_ACT_A_FlexRay_7d601c47 (PduRDestPdu):
              PduRDestPduHandleId = 4
              PduRDestPduDirection = TRANSMIT
              PduRDestPduRoutingType = API_FORWARDING
              PduRDestPduDataProvision = PDUR_TRIGGERTRANSMIT
              PduRTransmissionConfirmation = false
              PduRDestPduRef = pduTr_AVL_STMOM_DV_ACT_A_FlexRay_pduPort_EPS_A_FlexRay_OUT_7d601c47_052bff33
              PduRDestPduPduRBswModulesRef = FrIf
          Fr_pduTr_SU_CLE_DRDY_DXP_A_FlexRay_7d601c47: PduRRoutingPathCommunicationType=COMMUNICATION_INTERFACE  # SU_CLE_DRDY_DXP
            DST_Fr_pduTr_SU_CLE_DRDY_DXP_A_FlexRay_7d601c47 (PduRDestPdu):
              PduRDestPduHandleId = 23
              PduRDestPduDirection = RECEIVE
              PduRDestPduRoutingType = API_FORWARDING
              PduRTransmissionConfirmation = false
              PduRDestPduRef = pduTr_SU_CLE_DRDY_DXP_A_FlexRay_pduPort_EPS_A_FlexRay_IN_7d601c47_052bff33
              PduRDestPduPduRBswModulesRef = Com
            SRC_Fr_pduTr_SU_CLE_DRDY_DXP_A_FlexRay_7d601c47 (PduRSrcPdu):
              PduRSourcePduHandleId = 22
              PduRSrcPduDirection = RECEIVE
              PduRSrcPduRef = pduTr_SU_CLE_DRDY_DXP_A_FlexRay_pduPort_EPS_A_FlexRay_IN_7d601c47_052bff33
              PduRSrcPduPduRBswModulesRef = FrIf
          Fr_pduTr_ENSU_SFY_A_FlexRay_7d601c47: PduRRoutingPathCommunicationType=COMMUNICATION_INTERFACE  # ENSU_SFY
            DST_Fr_pduTr_ENSU_SFY_A_FlexRay_7d601c47 (PduRDestPdu):
              PduRDestPduHandleId = 10
              PduRDestPduDirection = RECEIVE
              PduRDestPduRoutingType = API_FORWARDING
              PduRTransmissionConfirmation = false
              PduRDestPduRef = pduTr_ENSU_SFY_A_FlexRay_pduPort_EPS_A_FlexRay_IN_7d601c47_052bff33
              PduRDestPduPduRBswModulesRef = Com
            SRC_Fr_pduTr_ENSU_SFY_A_FlexRay_7d601c47 (PduRSrcPdu):
              PduRSourcePduHandleId = 9
              PduRSrcPduDirection = RECEIVE
              PduRSrcPduRef = pduTr_ENSU_SFY_A_FlexRay_pduPort_EPS_A_FlexRay_IN_7d601c47_052bff33
              PduRSrcPduPduRBswModulesRef = FrIf
          Fr_pduTr_SECU_CHAL_A_FlexRay_7d601c47: PduRRoutingPathCommunicationType=COMMUNICATION_INTERFACE  # SECU_CHAL
            DST_Fr_pduTr_SECU_CHAL_A_FlexRay_7d601c47 (PduRDestPdu):
              PduRDestPduHandleId = 12
              PduRDestPduDirection = TRANSMIT
              PduRDestPduRoutingType = API_FORWARDING
              PduRTransmissionConfirmation = true
              PduRDestPduDataProvision = PDUR_TRIGGERTRANSMIT
              PduRDestPduRef = pduTr_SECU_CHAL_A_FlexRay_pduPort_EPS_A_FlexRay_OUT_7d601c47_052bff33
              PduRDestPduPduRBswModulesRef = IpduM
            SRC_Fr_pduTr_SECU_CHAL_A_FlexRay_7d601c47 (PduRSrcPdu):
              PduRSourcePduHandleId = 11
              PduRSrcPduDirection = TRANSMIT
              PduRSrcPduRef = pduTr_SECU_CHAL_A_FlexRay_pduPort_EPS_A_FlexRay_OUT_7d601c47_052bff33
              PduRSrcPduPduRBswModulesRef = Com
          Fr_pduTr_ST_CENG_A_FlexRay_7d601c47: PduRRoutingPathCommunicationType=COMMUNICATION_INTERFACE  # ST_CENG
            DST_Fr_pduTr_ST_CENG_A_FlexRay_7d601c47 (PduRDestPdu):
              PduRDestPduHandleId = 20
              PduRDestPduDirection = RECEIVE
              PduRDestPduRoutingType = API_FORWARDING
              PduRTransmissionConfirmation = false
              PduRDestPduRef = pduTr_ST_CENG_A_FlexRay_pduPort_EPS_A_FlexRay_IN_7d601c47_052bff33
              PduRDestPduPduRBswModulesRef = Com
            SRC_Fr_pduTr_ST_CENG_A_FlexRay_7d601c47 (PduRSrcPdu):
              PduRSourcePduHandleId = 19
              PduRSrcPduDirection = RECEIVE
              PduRSrcPduRef = pduTr_ST_CENG_A_FlexRay_pduPort_EPS_A_FlexRay_IN_7d601c47_052bff33
              PduRSrcPduPduRBswModulesRef = FrIf
          Fr_pduTr_OFFS_QUAD_EPS_A_FlexRay_7d601c47: PduRRoutingPathCommunicationType=COMMUNICATION_INTERFACE  # OFFS_QUAD_EPS
            SRC_Fr_pduTr_OFFS_QUAD_EPS_A_FlexRay_7d601c47 (PduRSrcPdu):
              PduRSourcePduHandleId = 14
              PduRSrcPduDirection = RECEIVE
              PduRSrcPduRef = pduTr_OFFS_QUAD_EPS_A_FlexRay_pduPort_EPS_A_FlexRay_IN_7d601c47_052bff33
              PduRSrcPduPduRBswModulesRef = FrIf
            DST_Fr_pduTr_OFFS_QUAD_EPS_A_FlexRay_7d601c47 (PduRDestPdu):
              PduRDestPduHandleId = 15
              PduRDestPduDirection = RECEIVE
              PduRDestPduRoutingType = API_FORWARDING
              PduRTransmissionConfirmation = false
              PduRDestPduRef = pduTr_OFFS_QUAD_EPS_A_FlexRay_pduPort_EPS_A_FlexRay_IN_7d601c47_052bff33
              PduRDestPduPduRBswModulesRef = Com
          Fr_pduTr_ST_EST_A_FlexRay_7d601c47: PduRRoutingPathCommunicationType=COMMUNICATION_INTERFACE  # ST_EST
            SRC_Fr_pduTr_ST_EST_A_FlexRay_7d601c47 (PduRSrcPdu):
              PduRSourcePduHandleId = 13
              PduRSrcPduDirection = TRANSMIT
              PduRSrcPduRef = pduTr_ST_EST_A_FlexRay_pduPort_EPS_A_FlexRay_OUT_7d601c47_052bff33
              PduRSrcPduPduRBswModulesRef = Com
            DST_Fr_pduTr_ST_EST_A_FlexRay_7d601c47 (PduRDestPdu):
              PduRDestPduHandleId = 14
              PduRDestPduDirection = TRANSMIT
              PduRDestPduRoutingType = API_FORWARDING
              PduRDestPduDataProvision = PDUR_TRIGGERTRANSMIT
              PduRTransmissionConfirmation = true
              PduRDestPduRef = pduTr_ST_EST_A_FlexRay_pduPort_EPS_A_FlexRay_OUT_7d601c47_052bff33
              PduRDestPduPduRBswModulesRef = FrIf
          Fr_pduTr_V_VEH_A_FlexRay_7d601c47: PduRRoutingPathCommunicationType=COMMUNICATION_INTERFACE  # V_VEH
            SRC_Fr_pduTr_V_VEH_A_FlexRay_7d601c47 (PduRSrcPdu):
              PduRSourcePduHandleId = 27
              PduRSrcPduDirection = RECEIVE
              PduRSrcPduRef = pduTr_V_VEH_A_FlexRay_pduPort_EPS_A_FlexRay_IN_7d601c47_052bff33
              PduRSrcPduPduRBswModulesRef = FrIf
            DST_Fr_pduTr_V_VEH_A_FlexRay_7d601c47 (PduRDestPdu):
              PduRDestPduHandleId = 28
              PduRDestPduDirection = RECEIVE
              PduRDestPduRoutingType = API_FORWARDING
              PduRTransmissionConfirmation = false
              PduRDestPduRef = pduTr_V_VEH_A_FlexRay_pduPort_EPS_A_FlexRay_IN_7d601c47_052bff33
              PduRDestPduPduRBswModulesRef = Com
          Fr_pduTr_AVL_FORC_GRD_A_FlexRay_7d601c47: PduRRoutingPathCommunicationType=COMMUNICATION_INTERFACE  # AVL_FORC_GRD
            SRC_Fr_pduTr_AVL_FORC_GRD_A_FlexRay_7d601c47 (PduRSrcPdu):
              PduRSourcePduHandleId = 1
              PduRSrcPduDirection = TRANSMIT
              PduRSrcPduRef = pduTr_AVL_FORC_GRD_A_FlexRay_pduPort_EPS_A_FlexRay_OUT_7d601c47_052bff33
              PduRSrcPduPduRBswModulesRef = Com
            DST_Fr_pduTr_AVL_FORC_GRD_A_FlexRay_7d601c47 (PduRDestPdu):
              PduRDestPduHandleId = 2
              PduRDestPduDirection = TRANSMIT
              PduRDestPduRoutingType = API_FORWARDING
              PduRDestPduDataProvision = PDUR_TRIGGERTRANSMIT
              PduRTransmissionConfirmation = false
              PduRDestPduRef = pduTr_AVL_FORC_GRD_A_FlexRay_pduPort_EPS_A_FlexRay_OUT_7d601c47_052bff33
              PduRDestPduPduRBswModulesRef = FrIf
          Fr_pduTr_DBG_EPS_BS_MOD_58_BYTE_A_FlexRay_7d601c47: PduRRoutingPathCommunicationType=COMMUNICATION_INTERFACE  # DBG_EPS_BS_MOD_58_BYTE
            DST_Fr_pduTr_DBG_EPS_BS_MOD_58_BYTE_A_FlexRay_7d601c47 (PduRDestPdu):
              PduRDestPduHandleId = 5
              PduRDestPduDirection = TRANSMIT
              PduRDestPduRoutingType = API_FORWARDING
              PduRTransmissionConfirmation = false
              PduRDestPduDataProvision = PDUR_TRIGGERTRANSMIT
              PduRDestPduRef = pduTr_DBG_EPS_BS_MOD_58_BYTE_A_FlexRay_pduPort_EPS_A_FlexRay_OUT_7d601c47_052bff33
              PduRDestPduPduRBswModulesRef = IpduM
            SRC_Fr_pduTr_DBG_EPS_BS_MOD_58_BYTE_A_FlexRay_7d601c47 (PduRSrcPdu):
              PduRSourcePduHandleId = 4
              PduRSrcPduDirection = TRANSMIT
              PduRSrcPduRef = pduTr_DBG_EPS_BS_MOD_58_BYTE_A_FlexRay_pduPort_EPS_A_FlexRay_OUT_7d601c47_052bff33
              PduRSrcPduPduRBswModulesRef = Com
          Fr_pduTr_CTR_DIAG_OBD_DRDY_A_FlexRay_7d601c47: PduRRoutingPathCommunicationType=COMMUNICATION_INTERFACE  # CTR_DIAG_OBD_DRDY
            DST_Fr_pduTr_CTR_DIAG_OBD_DRDY_A_FlexRay_7d601c47 (PduRDestPdu):
              PduRDestPduHandleId = 6
              PduRDestPduDirection = RECEIVE
              PduRDestPduRoutingType = API_FORWARDING
              PduRTransmissionConfirmation = false
              PduRDestPduRef = pduTr_CTR_DIAG_OBD_DRDY_A_FlexRay_pduPort_EPS_A_FlexRay_IN_7d601c47_052bff33
              PduRDestPduPduRBswModulesRef = Com
            SRC_Fr_pduTr_CTR_DIAG_OBD_DRDY_A_FlexRay_7d601c47 (PduRSrcPdu):
              PduRSourcePduHandleId = 5
              PduRSrcPduDirection = RECEIVE
              PduRSrcPduRef = pduTr_CTR_DIAG_OBD_DRDY_A_FlexRay_pduPort_EPS_A_FlexRay_IN_7d601c47_052bff33
              PduRSrcPduPduRBswModulesRef = FrIf
          Fr_pduTr_SU_EPS_A_FlexRay_7d601c47: PduRRoutingPathCommunicationType=COMMUNICATION_INTERFACE  # SU_EPS
            SRC_Fr_pduTr_SU_EPS_A_FlexRay_7d601c47 (PduRSrcPdu):
              PduRSourcePduHandleId = 14
              PduRSrcPduDirection = TRANSMIT
              PduRSrcPduRef = pduTr_SU_EPS_A_FlexRay_pduPort_EPS_A_FlexRay_OUT_7d601c47_052bff33
              PduRSrcPduPduRBswModulesRef = Com
            DST_Fr_pduTr_SU_EPS_A_FlexRay_7d601c47 (PduRDestPdu):
              PduRDestPduHandleId = 15
              PduRDestPduDirection = TRANSMIT
              PduRDestPduRoutingType = API_FORWARDING
              PduRDestPduDataProvision = PDUR_TRIGGERTRANSMIT
              PduRTransmissionConfirmation = true
              PduRDestPduRef = pduTr_SU_EPS_A_FlexRay_pduPort_EPS_A_FlexRay_OUT_7d601c47_052bff33
              PduRDestPduPduRBswModulesRef = FrIf
          Fr_pduTr_RELATIVZEIT_A_FlexRay_7d601c47: PduRRoutingPathCommunicationType=COMMUNICATION_INTERFACE  # RELATIVZEIT
            SRC_Fr_pduTr_RELATIVZEIT_A_FlexRay_7d601c47 (PduRSrcPdu):
              PduRSourcePduHandleId = 15
              PduRSrcPduDirection = RECEIVE
              PduRSrcPduRef = pduTr_RELATIVZEIT_A_FlexRay_pduPort_EPS_A_FlexRay_IN_7d601c47_052bff33
              PduRSrcPduPduRBswModulesRef = FrIf
            DST_Fr_pduTr_RELATIVZEIT_A_FlexRay_7d601c47 (PduRDestPdu):
              PduRDestPduHandleId = 16
              PduRDestPduDirection = RECEIVE
              PduRDestPduRoutingType = API_FORWARDING
              PduRTransmissionConfirmation = false
              PduRDestPduRef = pduTr_RELATIVZEIT_A_FlexRay_pduPort_EPS_A_FlexRay_IN_7d601c47_052bff33
              PduRDestPduPduRBswModulesRef = Com
          Fr_pduTr_DBG_EPS_MOD_EXT_120_BYTE_A_FlexRay_7d601c47: PduRRoutingPathCommunicationType=COMMUNICATION_INTERFACE  # DBG_EPS_MOD_EXT_120_BYTE
            SRC_Fr_pduTr_DBG_EPS_MOD_EXT_120_BYTE_A_FlexRay_7d601c47 (PduRSrcPdu):
              PduRSourcePduHandleId = 5
              PduRSrcPduDirection = TRANSMIT
              PduRSrcPduRef = pduTr_DBG_EPS_MOD_EXT_120_BYTE_A_FlexRay_pduPort_EPS_A_FlexRay_OUT_7d601c47_052bff33
              PduRSrcPduPduRBswModulesRef = Com
            DST_Fr_pduTr_DBG_EPS_MOD_EXT_120_BYTE_A_FlexRay_7d601c47 (PduRDestPdu):
              PduRDestPduHandleId = 6
              PduRDestPduDirection = TRANSMIT
              PduRDestPduRoutingType = API_FORWARDING
              PduRTransmissionConfirmation = false
              PduRDestPduDataProvision = PDUR_TRIGGERTRANSMIT
              PduRDestPduRef = pduTr_DBG_EPS_MOD_EXT_120_BYTE_A_FlexRay_pduPort_EPS_A_FlexRay_OUT_7d601c47_052bff33
              PduRDestPduPduRBswModulesRef = IpduM
          Fr_pduTr_FZZSTD_A_FlexRay_7d601c47: PduRRoutingPathCommunicationType=COMMUNICATION_INTERFACE  # FZZSTD
            SRC_Fr_pduTr_FZZSTD_A_FlexRay_7d601c47 (PduRSrcPdu):
              PduRSourcePduHandleId = 12
              PduRSrcPduDirection = RECEIVE
              PduRSrcPduRef = pduTr_FZZSTD_A_FlexRay_pduPort_EPS_A_FlexRay_IN_7d601c47_052bff33
              PduRSrcPduPduRBswModulesRef = FrIf
            DST_Fr_pduTr_FZZSTD_A_FlexRay_7d601c47 (PduRDestPdu):
              PduRDestPduHandleId = 13
              PduRDestPduDirection = RECEIVE
              PduRDestPduRoutingType = API_FORWARDING
              PduRTransmissionConfirmation = false
              PduRDestPduRef = pduTr_FZZSTD_A_FlexRay_pduPort_EPS_A_FlexRay_IN_7d601c47_052bff33
              PduRDestPduPduRBswModulesRef = Com
          Fr_pduTr_ENERG_DGR_DRDY_A_FlexRay_7d601c47: PduRRoutingPathCommunicationType=COMMUNICATION_INTERFACE  # ENERG_DGR_DRDY
            SRC_Fr_pduTr_ENERG_DGR_DRDY_A_FlexRay_7d601c47 (PduRSrcPdu):
              PduRSourcePduHandleId = 8
              PduRSrcPduDirection = RECEIVE
              PduRSrcPduRef = pduTr_ENERG_DGR_DRDY_A_FlexRay_pduPort_EPS_A_FlexRay_IN_7d601c47_052bff33
              PduRSrcPduPduRBswModulesRef = FrIf
            DST_Fr_pduTr_ENERG_DGR_DRDY_A_FlexRay_7d601c47 (PduRDestPdu):
              PduRDestPduHandleId = 9
              PduRDestPduDirection = RECEIVE
              PduRDestPduRoutingType = API_FORWARDING
              PduRTransmissionConfirmation = false
              PduRDestPduRef = pduTr_ENERG_DGR_DRDY_A_FlexRay_pduPort_EPS_A_FlexRay_IN_7d601c47_052bff33
              PduRDestPduPduRBswModulesRef = Com
          Fr_pduTr_STEA_OFFS_A_FlexRay_7d601c47: PduRRoutingPathCommunicationType=COMMUNICATION_INTERFACE  # STEA_OFFS
            SRC_Fr_pduTr_STEA_OFFS_A_FlexRay_7d601c47 (PduRSrcPdu):
              PduRSourcePduHandleId = 18
              PduRSrcPduDirection = RECEIVE
              PduRSrcPduRef = pduTr_STEA_OFFS_A_FlexRay_pduPort_EPS_A_FlexRay_IN_7d601c47_052bff33
              PduRSrcPduPduRBswModulesRef = FrIf
            DST_Fr_pduTr_STEA_OFFS_A_FlexRay_7d601c47 (PduRDestPdu):
              PduRDestPduHandleId = 19
              PduRDestPduDirection = RECEIVE
              PduRDestPduRoutingType = API_FORWARDING
              PduRTransmissionConfirmation = false
              PduRDestPduRef = pduTr_STEA_OFFS_A_FlexRay_pduPort_EPS_A_FlexRay_IN_7d601c47_052bff33
              PduRDestPduPduRBswModulesRef = Com
          Fr_pduTr_TAR_ESTP_VIRT_FTAX_A_FlexRay_7d601c47: PduRRoutingPathCommunicationType=COMMUNICATION_INTERFACE  # TAR_ESTP_VIRT_FTAX
            DST_Fr_pduTr_TAR_ESTP_VIRT_FTAX_A_FlexRay_7d601c47 (PduRDestPdu):
              PduRDestPduHandleId = 24
              PduRDestPduDirection = RECEIVE
              PduRDestPduRoutingType = API_FORWARDING
              PduRTransmissionConfirmation = false
              PduRDestPduRef = pduTr_TAR_ESTP_VIRT_FTAX_A_FlexRay_pduPort_EPS_A_FlexRay_IN_7d601c47_052bff33
              PduRDestPduPduRBswModulesRef = Com
            SRC_Fr_pduTr_TAR_ESTP_VIRT_FTAX_A_FlexRay_7d601c47 (PduRSrcPdu):
              PduRSourcePduHandleId = 23
              PduRSrcPduDirection = RECEIVE
              PduRSrcPduRef = pduTr_TAR_ESTP_VIRT_FTAX_A_FlexRay_pduPort_EPS_A_FlexRay_IN_7d601c47_052bff33
              PduRSrcPduPduRBswModulesRef = FrIf
          Fr_pduTr_CTR_VIB_STW_DISP_EXMI_SP2015_A_FlexRay_7d601c47: PduRRoutingPathCommunicationType=COMMUNICATION_INTERFACE  # CTR_VIB_STW_DISP_EXMI_SP2015
            DST_Fr_pduTr_CTR_VIB_STW_DISP_EXMI_SP2015_A_FlexRay_7d601c47 (PduRDestPdu):
              PduRDestPduHandleId = 7
              PduRDestPduDirection = RECEIVE
              PduRDestPduRoutingType = API_FORWARDING
              PduRTransmissionConfirmation = false
              PduRDestPduRef = pduTr_CTR_VIB_STW_DISP_EXMI_SP2015_A_FlexRay_pduPort_EPS_A_FlexRay_IN_7d601c47_052bff33
              PduRDestPduPduRBswModulesRef = Com
            SRC_Fr_pduTr_CTR_VIB_STW_DISP_EXMI_SP2015_A_FlexRay_7d601c47 (PduRSrcPdu):
              PduRSourcePduHandleId = 6
              PduRSrcPduDirection = RECEIVE
              PduRSrcPduRef = pduTr_CTR_VIB_STW_DISP_EXMI_SP2015_A_FlexRay_pduPort_EPS_A_FlexRay_IN_7d601c47_052bff33
              PduRSrcPduPduRBswModulesRef = FrIf
          Fr_pduTr_CON_VEH_A_FlexRay_7d601c47: PduRRoutingPathCommunicationType=COMMUNICATION_INTERFACE  # CON_VEH
            SRC_Fr_pduTr_CON_VEH_A_FlexRay_7d601c47 (PduRSrcPdu):
              PduRSourcePduHandleId = 4
              PduRSrcPduDirection = RECEIVE
              PduRSrcPduRef = pduTr_CON_VEH_A_FlexRay_pduPort_EPS_A_FlexRay_IN_7d601c47_052bff33
              PduRSrcPduPduRBswModulesRef = FrIf
            DST_Fr_pduTr_CON_VEH_A_FlexRay_7d601c47 (PduRDestPdu):
              PduRDestPduHandleId = 5
              PduRDestPduDirection = RECEIVE
              PduRDestPduRoutingType = API_FORWARDING
              PduRTransmissionConfirmation = false
              PduRDestPduRef = pduTr_CON_VEH_A_FlexRay_pduPort_EPS_A_FlexRay_IN_7d601c47_052bff33
              PduRDestPduPduRBswModulesRef = Com
          ANFRAGE_434514f6_In: PduRRoutingPathCommunicationType=COMMUNICATION_INTERFACE
            DST_ANFRAGE_434514f6_In (PduRDestPdu):
              PduRDestPduHandleId = 0
              PduRDestPduDirection = RECEIVE
              PduRDestPduRoutingType = API_FORWARDING
              PduRTransmissionConfirmation = false
              PduRDestPduRef = ANFRAGE_434514f6_In
              PduRDestPduPduRBswModulesRef = Com
            SRC_ANFRAGE_434514f6_In (PduRSrcPdu): PduRSourcePduHandleId=0, PduRSrcPduDirection=RECEIVE, PduRSrcPduRef=ANFRAGE_434514f6_In, PduRSrcPduPduRBswModulesRef=IpduM
          SVC_434514f6_Out: PduRRoutingPathCommunicationType=COMMUNICATION_INTERFACE
            SRC_SVC_434514f6_Out (PduRSrcPdu): PduRSourcePduHandleId=29, PduRSrcPduDirection=TRANSMIT, PduRSrcPduRef=SVC_434514f6_Out, PduRSrcPduPduRBswModulesRef=IpduM
            DST_SVC_434514f6_Out (PduRDestPdu):
              PduRDestPduHandleId = 1
              PduRDestPduDirection = TRANSMIT
              PduRDestPduRoutingType = API_FORWARDING
              PduRTransmissionConfirmation = true
              PduRDestPduDataProvision = PDUR_TRIGGERTRANSMIT
              PduRDestPduRef = SVC_434514f6_Out
              PduRDestPduPduRBswModulesRef = FrIf
          Fr_pduTr_ERRM_BN_U_A_FlexRay_7d601c47: PduRRoutingPathCommunicationType=COMMUNICATION_INTERFACE  # ERRM_BN_U
            SRC_Fr_pduTr_ERRM_BN_U_A_FlexRay_7d601c47 (PduRSrcPdu):
              PduRSourcePduHandleId = 10
              PduRSrcPduDirection = RECEIVE
              PduRSrcPduRef = pduTr_ERRM_BN_U_A_FlexRay_pduPort_EPS_A_FlexRay_IN_7d601c47_052bff33
              PduRSrcPduPduRBswModulesRef = FrIf
            DST_Fr_pduTr_ERRM_BN_U_A_FlexRay_7d601c47 (PduRDestPdu):
              PduRDestPduHandleId = 11
              PduRDestPduDirection = RECEIVE
              PduRDestPduRoutingType = API_FORWARDING
              PduRTransmissionConfirmation = false
              PduRDestPduRef = pduTr_ERRM_BN_U_A_FlexRay_pduPort_EPS_A_FlexRay_IN_7d601c47_052bff33
              PduRDestPduPduRBswModulesRef = Com
          PduRRoutingPath_PT_TL_BRC_FR_32_TxF0_0xDF: PduRRoutingPathCommunicationType=TRANSPORT_PROTOCOL
            PduRDestPdu:
              PduRDestPduHandleId = 0
              PduRDestPduDirection = RECEIVE
              PduRDestPduRoutingType = API_FORWARDING
              PduRDestPduRef = PT_TL_BRC_FR_32_TxF0_0xDF_PP_TL_BRC_FR_32_TxF0_0xDF_Rx_7d601c47_052bff33
              PduRDestPduPduRBswModulesRef = Dcm
            PduRSrcPdu:
              PduRSourcePduHandleId = 0
              PduRSrcPduDirection = RECEIVE
              PduRSrcPduRef = PT_TL_BRC_FR_32_TxF0_0xDF_PP_TL_BRC_FR_32_TxF0_0xDF_Rx_7d601c47_052bff33
              PduRSrcPduPduRBswModulesRef = FrTp
          PduRRoutingPath_PT_TL_BRC_FR_32_TxF1_0xDF: PduRRoutingPathCommunicationType=TRANSPORT_PROTOCOL
            PduRDestPdu_001 (PduRDestPdu):
              PduRDestPduHandleId = 1
              PduRDestPduDirection = RECEIVE
              PduRDestPduRoutingType = API_FORWARDING
              PduRDestPduRef = PT_TL_BRC_FR_32_TxF1_0xDF_PP_TL_BRC_FR_32_TxF1_0xDF_Rx_7d601c47_052bff33
              PduRDestPduPduRBswModulesRef = Dcm
            PduRSrcPdu_001 (PduRSrcPdu):
              PduRSourcePduHandleId = 1
              PduRSrcPduDirection = RECEIVE
              PduRSrcPduRef = PT_TL_BRC_FR_32_TxF1_0xDF_PP_TL_BRC_FR_32_TxF1_0xDF_Rx_7d601c47_052bff33
              PduRSrcPduPduRBswModulesRef = FrTp
          PduRRoutingPath_PT_TL_BRC_FR_32_TxF2_0xDF: PduRRoutingPathCommunicationType=TRANSPORT_PROTOCOL
            PduRDestPdu_002 (PduRDestPdu):
              PduRDestPduHandleId = 2
              PduRDestPduDirection = RECEIVE
              PduRDestPduRoutingType = API_FORWARDING
              PduRDestPduRef = PT_TL_BRC_FR_32_TxF2_0xDF_PP_TL_BRC_FR_32_TxF2_0xDF_Rx_7d601c47_052bff33
              PduRDestPduPduRBswModulesRef = Dcm
            PduRSrcPdu_002 (PduRSrcPdu):
              PduRSourcePduHandleId = 2
              PduRSrcPduDirection = RECEIVE
              PduRSrcPduRef = PT_TL_BRC_FR_32_TxF2_0xDF_PP_TL_BRC_FR_32_TxF2_0xDF_Rx_7d601c47_052bff33
              PduRSrcPduPduRBswModulesRef = FrTp
          PduRRoutingPath_PT_TL_BRC_FR_32_TxF3_0xDF: PduRRoutingPathCommunicationType=TRANSPORT_PROTOCOL
            PduRDestPdu_003 (PduRDestPdu):
              PduRDestPduHandleId = 3
              PduRDestPduDirection = RECEIVE
              PduRDestPduRoutingType = API_FORWARDING
              PduRDestPduRef = PT_TL_BRC_FR_32_TxF3_0xDF_PP_TL_BRC_FR_32_TxF3_0xDF_Rx_7d601c47_052bff33
              PduRDestPduPduRBswModulesRef = Dcm
            PduRSrcPdu_003 (PduRSrcPdu):
              PduRSourcePduHandleId = 3
              PduRSrcPduDirection = RECEIVE
              PduRSrcPduRef = PT_TL_BRC_FR_32_TxF3_0xDF_PP_TL_BRC_FR_32_TxF3_0xDF_Rx_7d601c47_052bff33
              PduRSrcPduPduRBswModulesRef = FrTp
          PduRRoutingPath_PT_TL_BRC_FR_32_TxF4_0xDF: PduRRoutingPathCommunicationType=TRANSPORT_PROTOCOL
            PduRDestPdu_004 (PduRDestPdu):
              PduRDestPduHandleId = 4
              PduRDestPduDirection = RECEIVE
              PduRDestPduRoutingType = API_FORWARDING
              PduRDestPduRef = PT_TL_BRC_FR_32_TxF4_0xDF_PP_TL_BRC_FR_32_TxF4_0xDF_Rx_7d601c47_052bff33
              PduRDestPduPduRBswModulesRef = Dcm
            PduRSrcPdu_004 (PduRSrcPdu):
              PduRSourcePduHandleId = 4
              PduRSrcPduDirection = RECEIVE
              PduRSrcPduRef = PT_TL_BRC_FR_32_TxF4_0xDF_PP_TL_BRC_FR_32_TxF4_0xDF_Rx_7d601c47_052bff33
              PduRSrcPduPduRBswModulesRef = FrTp
          PduRRoutingPath_PT_TL_BRC_FR_32_TxF5_0xDF: PduRRoutingPathCommunicationType=TRANSPORT_PROTOCOL
            PduRDestPdu_005 (PduRDestPdu):
              PduRDestPduHandleId = 5
              PduRDestPduDirection = RECEIVE
              PduRDestPduRoutingType = API_FORWARDING
              PduRDestPduRef = PT_TL_BRC_FR_32_TxF5_0xDF_PP_TL_BRC_FR_32_TxF5_0xDF_Rx_7d601c47_052bff33
              PduRDestPduPduRBswModulesRef = Dcm
            PduRSrcPdu_005 (PduRSrcPdu):
              PduRSourcePduHandleId = 5
              PduRSrcPduDirection = RECEIVE
              PduRSrcPduRef = PT_TL_BRC_FR_32_TxF5_0xDF_PP_TL_BRC_FR_32_TxF5_0xDF_Rx_7d601c47_052bff33
              PduRSrcPduPduRBswModulesRef = FrTp
          PduRRoutingPath_PT_TL_BRC_FR_32_TxF6_0xDF: PduRRoutingPathCommunicationType=TRANSPORT_PROTOCOL
            PduRDestPdu_006 (PduRDestPdu):
              PduRDestPduHandleId = 6
              PduRDestPduDirection = RECEIVE
              PduRDestPduRoutingType = API_FORWARDING
              PduRDestPduRef = PT_TL_BRC_FR_32_TxF6_0xDF_PP_TL_BRC_FR_32_TxF6_0xDF_Rx_7d601c47_052bff33
              PduRDestPduPduRBswModulesRef = Dcm
            PduRSrcPdu_006 (PduRSrcPdu):
              PduRSourcePduHandleId = 6
              PduRSrcPduDirection = RECEIVE
              PduRSrcPduRef = PT_TL_BRC_FR_32_TxF6_0xDF_PP_TL_BRC_FR_32_TxF6_0xDF_Rx_7d601c47_052bff33
              PduRSrcPduPduRBswModulesRef = FrTp
          PduRRoutingPath_PT_TL_BRC_FR_32_TxF7_0xDF: PduRRoutingPathCommunicationType=TRANSPORT_PROTOCOL
            PduRDestPdu_007 (PduRDestPdu):
              PduRDestPduHandleId = 7
              PduRDestPduDirection = RECEIVE
              PduRDestPduRoutingType = API_FORWARDING
              PduRDestPduRef = PT_TL_BRC_FR_32_TxF7_0xDF_PP_TL_BRC_FR_32_TxF7_0xDF_Rx_7d601c47_052bff33
              PduRDestPduPduRBswModulesRef = Dcm
            PduRSrcPdu_007 (PduRSrcPdu):
              PduRSourcePduHandleId = 7
              PduRSrcPduDirection = RECEIVE
              PduRSrcPduRef = PT_TL_BRC_FR_32_TxF7_0xDF_PP_TL_BRC_FR_32_TxF7_0xDF_Rx_7d601c47_052bff33
              PduRSrcPduPduRBswModulesRef = FrTp
          PduRRoutingPath_PT_TL_BRC_FR_32_TxF8_0xDF: PduRRoutingPathCommunicationType=TRANSPORT_PROTOCOL
            PduRDestPdu_008 (PduRDestPdu):
              PduRDestPduHandleId = 8
              PduRDestPduDirection = RECEIVE
              PduRDestPduRoutingType = API_FORWARDING
              PduRDestPduRef = PT_TL_BRC_FR_32_TxF8_0xDF_PP_TL_BRC_FR_32_TxF8_0xDF_Rx_7d601c47_052bff33
              PduRDestPduPduRBswModulesRef = Dcm
            PduRSrcPdu_008 (PduRSrcPdu):
              PduRSourcePduHandleId = 8
              PduRSrcPduDirection = RECEIVE
              PduRSrcPduRef = PT_TL_BRC_FR_32_TxF8_0xDF_PP_TL_BRC_FR_32_TxF8_0xDF_Rx_7d601c47_052bff33
              PduRSrcPduPduRBswModulesRef = FrTp
          PduRRoutingPath_PT_TL_BRC_FR_32_TxF9_0xDF: PduRRoutingPathCommunicationType=TRANSPORT_PROTOCOL
            PduRDestPdu_009 (PduRDestPdu):
              PduRDestPduHandleId = 9
              PduRDestPduDirection = RECEIVE
              PduRDestPduRoutingType = API_FORWARDING
              PduRDestPduRef = PT_TL_BRC_FR_32_TxF9_0xDF_PP_TL_BRC_FR_32_TxF9_0xDF_Rx_7d601c47_052bff33
              PduRDestPduPduRBswModulesRef = Dcm
            PduRSrcPdu_009 (PduRSrcPdu):
              PduRSourcePduHandleId = 9
              PduRSrcPduDirection = RECEIVE
              PduRSrcPduRef = PT_TL_BRC_FR_32_TxF9_0xDF_PP_TL_BRC_FR_32_TxF9_0xDF_Rx_7d601c47_052bff33
              PduRSrcPduPduRBswModulesRef = FrTp
          PduRRoutingPath_PT_TL_BRC_FR_32_TxFA_0xDF: PduRRoutingPathCommunicationType=TRANSPORT_PROTOCOL
            PduRDestPdu_010 (PduRDestPdu):
              PduRDestPduHandleId = 10
              PduRDestPduDirection = RECEIVE
              PduRDestPduRoutingType = API_FORWARDING
              PduRDestPduRef = PT_TL_BRC_FR_32_TxFA_0xDF_PP_TL_BRC_FR_32_TxFA_0xDF_Rx_7d601c47_052bff33
              PduRDestPduPduRBswModulesRef = Dcm
            PduRSrcPdu_010 (PduRSrcPdu):
              PduRSourcePduHandleId = 10
              PduRSrcPduDirection = RECEIVE
              PduRSrcPduRef = PT_TL_BRC_FR_32_TxFA_0xDF_PP_TL_BRC_FR_32_TxFA_0xDF_Rx_7d601c47_052bff33
              PduRSrcPduPduRBswModulesRef = FrTp
          PduRRoutingPath_PT_TL_BRC_FR_32_TxFB_0xDF: PduRRoutingPathCommunicationType=TRANSPORT_PROTOCOL
            PduRDestPdu_011 (PduRDestPdu):
              PduRDestPduHandleId = 11
              PduRDestPduDirection = RECEIVE
              PduRDestPduRoutingType = API_FORWARDING
              PduRDestPduRef = PT_TL_BRC_FR_32_TxFB_0xDF_PP_TL_BRC_FR_32_TxFB_0xDF_Rx_7d601c47_052bff33
              PduRDestPduPduRBswModulesRef = Dcm
            PduRSrcPdu_011 (PduRSrcPdu):
              PduRSourcePduHandleId = 11
              PduRSrcPduDirection = RECEIVE
              PduRSrcPduRef = PT_TL_BRC_FR_32_TxFB_0xDF_PP_TL_BRC_FR_32_TxFB_0xDF_Rx_7d601c47_052bff33
              PduRSrcPduPduRBswModulesRef = FrTp
          PduRRoutingPath_PT_TL_BRC_FR_32_TxFC_0xDF: PduRRoutingPathCommunicationType=TRANSPORT_PROTOCOL
            PduRDestPdu_012 (PduRDestPdu):
              PduRDestPduHandleId = 12
              PduRDestPduDirection = RECEIVE
              PduRDestPduRoutingType = API_FORWARDING
              PduRDestPduRef = PT_TL_BRC_FR_32_TxFC_0xDF_PP_TL_BRC_FR_32_TxFC_0xDF_Rx_7d601c47_052bff33
              PduRDestPduPduRBswModulesRef = Dcm
            PduRSrcPdu_012 (PduRSrcPdu):
              PduRSourcePduHandleId = 12
              PduRSrcPduDirection = RECEIVE
              PduRSrcPduRef = PT_TL_BRC_FR_32_TxFC_0xDF_PP_TL_BRC_FR_32_TxFC_0xDF_Rx_7d601c47_052bff33
              PduRSrcPduPduRBswModulesRef = FrTp
          PduRRoutingPath_PT_TL_BRC_FR_32_TxFD_0xDF: PduRRoutingPathCommunicationType=TRANSPORT_PROTOCOL
            PduRDestPdu_013 (PduRDestPdu):
              PduRDestPduHandleId = 13
              PduRDestPduDirection = RECEIVE
              PduRDestPduRoutingType = API_FORWARDING
              PduRDestPduRef = PT_TL_BRC_FR_32_TxFD_0xDF_PP_TL_BRC_FR_32_TxFD_0xDF_Rx_7d601c47_052bff33
              PduRDestPduPduRBswModulesRef = Dcm
            PduRSrcPdu_013 (PduRSrcPdu):
              PduRSourcePduHandleId = 13
              PduRSrcPduDirection = RECEIVE
              PduRSrcPduRef = PT_TL_BRC_FR_32_TxFD_0xDF_PP_TL_BRC_FR_32_TxFD_0xDF_Rx_7d601c47_052bff33
              PduRSrcPduPduRBswModulesRef = FrTp
          PduRRoutingPath_TL_ECU_TRNSM_FR_32_00BC0001_RxF0: PduRRoutingPathCommunicationType=TRANSPORT_PROTOCOL
            PduRDestPdu_014 (PduRDestPdu):
              PduRDestPduHandleId = 0
              PduRDestPduDirection = TRANSMIT
              PduRDestPduRoutingType = API_FORWARDING
              PduRDestPduRef = PT_TL_ECU_TRNSM_FR_32_00BC0001_RxF0_PP_TL_ECU_TRNSM_FR_32_00BC0001_RxF0_Tx_7d601c47_052bff33
              PduRDestPduPduRBswModulesRef = FrTp
            PduRSrcPdu_014 (PduRSrcPdu):
              PduRSourcePduHandleId = 15
              PduRSrcPduDirection = TRANSMIT
              PduRSrcPduRef = PT_TL_ECU_TRNSM_FR_32_00BC0001_RxF0_PP_TL_ECU_TRNSM_FR_32_00BC0001_RxF0_Tx_7d601c47_052bff33
              PduRSrcPduPduRBswModulesRef = Dcm
          PduRRoutingPath_TL_ECU_TRNSM_FR_32_00BC0001_RxF1: PduRRoutingPathCommunicationType=TRANSPORT_PROTOCOL
            PduRDestPdu_015 (PduRDestPdu):
              PduRDestPduHandleId = 1
              PduRDestPduDirection = TRANSMIT
              PduRDestPduRoutingType = API_FORWARDING
              PduRDestPduRef = PT_TL_ECU_TRNSM_FR_32_00BC0001_RxF1_PP_TL_ECU_TRNSM_FR_32_00BC0001_RxF1_Tx_7d601c47_052bff33
              PduRDestPduPduRBswModulesRef = FrTp
            PduRSrcPdu_015 (PduRSrcPdu):
              PduRSourcePduHandleId = 16
              PduRSrcPduDirection = TRANSMIT
              PduRSrcPduRef = PT_TL_ECU_TRNSM_FR_32_00BC0001_RxF1_PP_TL_ECU_TRNSM_FR_32_00BC0001_RxF1_Tx_7d601c47_052bff33
              PduRSrcPduPduRBswModulesRef = Dcm
          PduRRoutingPath_TL_ECU_TRNSM_FR_32_00BC0001_RxF2: PduRRoutingPathCommunicationType=TRANSPORT_PROTOCOL
            PduRDestPdu_016 (PduRDestPdu):
              PduRDestPduHandleId = 2
              PduRDestPduDirection = TRANSMIT
              PduRDestPduRoutingType = API_FORWARDING
              PduRDestPduRef = PT_TL_ECU_TRNSM_FR_32_00BC0001_RxF2_PP_TL_ECU_TRNSM_FR_32_00BC0001_RxF2_Tx_7d601c47_052bff33
              PduRDestPduPduRBswModulesRef = FrTp
            PduRSrcPdu_016 (PduRSrcPdu):
              PduRSourcePduHandleId = 17
              PduRSrcPduDirection = TRANSMIT
              PduRSrcPduRef = PT_TL_ECU_TRNSM_FR_32_00BC0001_RxF2_PP_TL_ECU_TRNSM_FR_32_00BC0001_RxF2_Tx_7d601c47_052bff33
              PduRSrcPduPduRBswModulesRef = Dcm
          PduRRoutingPath_TL_ECU_TRNSM_FR_32_00BC0001_RxF3: PduRRoutingPathCommunicationType=TRANSPORT_PROTOCOL
            PduRDestPdu_017 (PduRDestPdu):
              PduRDestPduHandleId = 3
              PduRDestPduDirection = TRANSMIT
              PduRDestPduRoutingType = API_FORWARDING
              PduRDestPduRef = PT_TL_ECU_TRNSM_FR_32_00BC0001_RxF3_PP_TL_ECU_TRNSM_FR_32_00BC0001_RxF3_Tx_7d601c47_052bff33
              PduRDestPduPduRBswModulesRef = FrTp
            PduRSrcPdu_017 (PduRSrcPdu):
              PduRSourcePduHandleId = 18
              PduRSrcPduDirection = TRANSMIT
              PduRSrcPduRef = PT_TL_ECU_TRNSM_FR_32_00BC0001_RxF3_PP_TL_ECU_TRNSM_FR_32_00BC0001_RxF3_Tx_7d601c47_052bff33
              PduRSrcPduPduRBswModulesRef = Dcm
          PduRRoutingPath_TL_ECU_TRNSM_FR_32_00BC0001_RxF4: PduRRoutingPathCommunicationType=TRANSPORT_PROTOCOL
            PduRDestPdu_018 (PduRDestPdu):
              PduRDestPduHandleId = 4
              PduRDestPduDirection = TRANSMIT
              PduRDestPduRoutingType = API_FORWARDING
              PduRDestPduRef = PT_TL_ECU_TRNSM_FR_32_00BC0001_RxF4_PP_TL_ECU_TRNSM_FR_32_00BC0001_RxF4_Tx_7d601c47_052bff33
              PduRDestPduPduRBswModulesRef = FrTp
            PduRSrcPdu_018 (PduRSrcPdu):
              PduRSourcePduHandleId = 19
              PduRSrcPduDirection = TRANSMIT
              PduRSrcPduRef = PT_TL_ECU_TRNSM_FR_32_00BC0001_RxF4_PP_TL_ECU_TRNSM_FR_32_00BC0001_RxF4_Tx_7d601c47_052bff33
              PduRSrcPduPduRBswModulesRef = Dcm
          PduRRoutingPath_TL_ECU_TRNSM_FR_32_00BC0001_RxF5: PduRRoutingPathCommunicationType=TRANSPORT_PROTOCOL
            PduRDestPdu_019 (PduRDestPdu):
              PduRDestPduHandleId = 5
              PduRDestPduDirection = TRANSMIT
              PduRDestPduRoutingType = API_FORWARDING
              PduRDestPduRef = PT_TL_ECU_TRNSM_FR_32_00BC0001_RxF5_PP_TL_ECU_TRNSM_FR_32_00BC0001_RxF5_Tx_7d601c47_052bff33
              PduRDestPduPduRBswModulesRef = FrTp
            PduRSrcPdu_019 (PduRSrcPdu):
              PduRSourcePduHandleId = 20
              PduRSrcPduDirection = TRANSMIT
              PduRSrcPduRef = PT_TL_ECU_TRNSM_FR_32_00BC0001_RxF5_PP_TL_ECU_TRNSM_FR_32_00BC0001_RxF5_Tx_7d601c47_052bff33
              PduRSrcPduPduRBswModulesRef = Dcm
          PduRRoutingPath_TL_ECU_TRNSM_FR_32_00BC0001_RxF6: PduRRoutingPathCommunicationType=TRANSPORT_PROTOCOL
            PduRDestPdu_020 (PduRDestPdu):
              PduRDestPduHandleId = 6
              PduRDestPduDirection = TRANSMIT
              PduRDestPduRoutingType = API_FORWARDING
              PduRDestPduRef = PT_TL_ECU_TRNSM_FR_32_00BC0001_RxF6_PP_TL_ECU_TRNSM_FR_32_00BC0001_RxF6_Tx_7d601c47_052bff33
              PduRDestPduPduRBswModulesRef = FrTp
            PduRSrcPdu_020 (PduRSrcPdu):
              PduRSourcePduHandleId = 21
              PduRSrcPduDirection = TRANSMIT
              PduRSrcPduRef = PT_TL_ECU_TRNSM_FR_32_00BC0001_RxF6_PP_TL_ECU_TRNSM_FR_32_00BC0001_RxF6_Tx_7d601c47_052bff33
              PduRSrcPduPduRBswModulesRef = Dcm
          PduRRoutingPath_TL_ECU_TRNSM_FR_32_00BC0001_RxF7: PduRRoutingPathCommunicationType=TRANSPORT_PROTOCOL
            PduRDestPdu_021 (PduRDestPdu):
              PduRDestPduHandleId = 7
              PduRDestPduDirection = TRANSMIT
              PduRDestPduRoutingType = API_FORWARDING
              PduRDestPduRef = PT_TL_ECU_TRNSM_FR_32_00BC0001_RxF7_PP_TL_ECU_TRNSM_FR_32_00BC0001_RxF7_Tx_7d601c47_052bff33
              PduRDestPduPduRBswModulesRef = FrTp
            PduRSrcPdu_021 (PduRSrcPdu):
              PduRSourcePduHandleId = 22
              PduRSrcPduDirection = TRANSMIT
              PduRSrcPduRef = PT_TL_ECU_TRNSM_FR_32_00BC0001_RxF7_PP_TL_ECU_TRNSM_FR_32_00BC0001_RxF7_Tx_7d601c47_052bff33
              PduRSrcPduPduRBswModulesRef = Dcm
          PduRRoutingPath_TL_ECU_TRNSM_FR_32_00BC0001_RxF8: PduRRoutingPathCommunicationType=TRANSPORT_PROTOCOL
            PduRDestPdu_022 (PduRDestPdu):
              PduRDestPduHandleId = 8
              PduRDestPduDirection = TRANSMIT
              PduRDestPduRoutingType = API_FORWARDING
              PduRDestPduRef = PT_TL_ECU_TRNSM_FR_32_00BC0001_RxF8_PP_TL_ECU_TRNSM_FR_32_00BC0001_RxF8_Tx_7d601c47_052bff33
              PduRDestPduPduRBswModulesRef = FrTp
            PduRSrcPdu_022 (PduRSrcPdu):
              PduRSourcePduHandleId = 23
              PduRSrcPduDirection = TRANSMIT
              PduRSrcPduRef = PT_TL_ECU_TRNSM_FR_32_00BC0001_RxF8_PP_TL_ECU_TRNSM_FR_32_00BC0001_RxF8_Tx_7d601c47_052bff33
              PduRSrcPduPduRBswModulesRef = Dcm
          PduRRoutingPath_TL_ECU_TRNSM_FR_32_00BC0001_RxF9: PduRRoutingPathCommunicationType=TRANSPORT_PROTOCOL
            PduRDestPdu_023 (PduRDestPdu):
              PduRDestPduHandleId = 9
              PduRDestPduDirection = TRANSMIT
              PduRDestPduRoutingType = API_FORWARDING
              PduRDestPduRef = PT_TL_ECU_TRNSM_FR_32_00BC0001_RxF9_PP_TL_ECU_TRNSM_FR_32_00BC0001_RxF9_Tx_7d601c47_052bff33
              PduRDestPduPduRBswModulesRef = FrTp
            PduRSrcPdu_023 (PduRSrcPdu):
              PduRSourcePduHandleId = 24
              PduRSrcPduDirection = TRANSMIT
              PduRSrcPduRef = PT_TL_ECU_TRNSM_FR_32_00BC0001_RxF9_PP_TL_ECU_TRNSM_FR_32_00BC0001_RxF9_Tx_7d601c47_052bff33
              PduRSrcPduPduRBswModulesRef = Dcm
          PduRRoutingPath_TL_ECU_TRNSM_FR_32_00BC0001_RxFA: PduRRoutingPathCommunicationType=TRANSPORT_PROTOCOL
            PduRDestPdu_024 (PduRDestPdu):
              PduRDestPduHandleId = 10
              PduRDestPduDirection = TRANSMIT
              PduRDestPduRoutingType = API_FORWARDING
              PduRDestPduRef = PT_TL_ECU_TRNSM_FR_32_00BC0001_RxFA_PP_TL_ECU_TRNSM_FR_32_00BC0001_RxFA_Tx_7d601c47_052bff33
              PduRDestPduPduRBswModulesRef = FrTp
            PduRSrcPdu_024 (PduRSrcPdu):
              PduRSourcePduHandleId = 25
              PduRSrcPduDirection = TRANSMIT
              PduRSrcPduRef = PT_TL_ECU_TRNSM_FR_32_00BC0001_RxFA_PP_TL_ECU_TRNSM_FR_32_00BC0001_RxFA_Tx_7d601c47_052bff33
              PduRSrcPduPduRBswModulesRef = Dcm
          PduRRoutingPath_TL_ECU_TRNSM_FR_32_00BC0001_RxFB: PduRRoutingPathCommunicationType=TRANSPORT_PROTOCOL
            PduRDestPdu_025 (PduRDestPdu):
              PduRDestPduHandleId = 11
              PduRDestPduDirection = TRANSMIT
              PduRDestPduRoutingType = API_FORWARDING
              PduRDestPduRef = PT_TL_ECU_TRNSM_FR_32_00BC0001_RxFB_PP_TL_ECU_TRNSM_FR_32_00BC0001_RxFB_Tx_7d601c47_052bff33
              PduRDestPduPduRBswModulesRef = FrTp
            PduRSrcPdu_025 (PduRSrcPdu):
              PduRSourcePduHandleId = 26
              PduRSrcPduDirection = TRANSMIT
              PduRSrcPduRef = PT_TL_ECU_TRNSM_FR_32_00BC0001_RxFB_PP_TL_ECU_TRNSM_FR_32_00BC0001_RxFB_Tx_7d601c47_052bff33
              PduRSrcPduPduRBswModulesRef = Dcm
          PduRRoutingPath_TL_ECU_TRNSM_FR_32_00BC0001_RxFC: PduRRoutingPathCommunicationType=TRANSPORT_PROTOCOL
            PduRDestPdu_026 (PduRDestPdu):
              PduRDestPduHandleId = 12
              PduRDestPduDirection = TRANSMIT
              PduRDestPduRoutingType = API_FORWARDING
              PduRDestPduRef = PT_TL_ECU_TRNSM_FR_32_00BC0001_RxFC_PP_TL_ECU_TRNSM_FR_32_00BC0001_RxFC_Tx_7d601c47_052bff33
              PduRDestPduPduRBswModulesRef = FrTp
            PduRSrcPdu_026 (PduRSrcPdu):
              PduRSourcePduHandleId = 27
              PduRSrcPduDirection = TRANSMIT
              PduRSrcPduRef = PT_TL_ECU_TRNSM_FR_32_00BC0001_RxFC_PP_TL_ECU_TRNSM_FR_32_00BC0001_RxFC_Tx_7d601c47_052bff33
              PduRSrcPduPduRBswModulesRef = Dcm
          PduRRoutingPath_TL_ECU_TRNSM_FR_32_00BC0001_RxFD: PduRRoutingPathCommunicationType=TRANSPORT_PROTOCOL
            PduRDestPdu_027 (PduRDestPdu):
              PduRDestPduHandleId = 13
              PduRDestPduDirection = TRANSMIT
              PduRDestPduRoutingType = API_FORWARDING
              PduRDestPduRef = PT_TL_ECU_TRNSM_FR_32_00BC0001_RxFD_PP_TL_ECU_TRNSM_FR_32_00BC0001_RxFD_Tx_7d601c47_052bff33
              PduRDestPduPduRBswModulesRef = FrTp
            PduRSrcPdu_027 (PduRSrcPdu):
              PduRSourcePduHandleId = 28
              PduRSrcPduDirection = TRANSMIT
              PduRSrcPduRef = PT_TL_ECU_TRNSM_FR_32_00BC0001_RxFD_PP_TL_ECU_TRNSM_FR_32_00BC0001_RxFD_Tx_7d601c47_052bff33
              PduRSrcPduPduRBswModulesRef = Dcm
          PduRRoutingPath_TL_MST_GW_TRNSM_FR_254_00980001_TxF0: PduRRoutingPathCommunicationType=TRANSPORT_PROTOCOL
            PduRDestPdu_028 (PduRDestPdu):
              PduRDestPduHandleId = 14
              PduRDestPduDirection = RECEIVE
              PduRDestPduRoutingType = API_FORWARDING
              PduRDestPduRef = PT_TL_MST_GW_TRNSM_FR_254_00980001_TxF0_PP_TL_MST_GW_TRNSM_FR_254_00980001_TxF0_Rx_7d601c47_052bff33
              PduRDestPduPduRBswModulesRef = Dcm
            PduRSrcPdu_028 (PduRSrcPdu):
              PduRSourcePduHandleId = 14
              PduRSrcPduDirection = RECEIVE
              PduRSrcPduRef = PT_TL_MST_GW_TRNSM_FR_254_00980001_TxF0_PP_TL_MST_GW_TRNSM_FR_254_00980001_TxF0_Rx_7d601c47_052bff33
              PduRSrcPduPduRBswModulesRef = FrTp
          PduRRoutingPath_TL_MST_GW_TRNSM_FR_254_00980001_TxF1: PduRRoutingPathCommunicationType=TRANSPORT_PROTOCOL
            PduRDestPdu_029 (PduRDestPdu):
              PduRDestPduHandleId = 15
              PduRDestPduDirection = RECEIVE
              PduRDestPduRoutingType = API_FORWARDING
              PduRDestPduRef = PT_TL_MST_GW_TRNSM_FR_254_00980001_TxF1_PP_TL_MST_GW_TRNSM_FR_254_00980001_TxF1_Rx_7d601c47_052bff33
              PduRDestPduPduRBswModulesRef = Dcm
            PduRSrcPdu_029 (PduRSrcPdu):
              PduRSourcePduHandleId = 15
              PduRSrcPduDirection = RECEIVE
              PduRSrcPduRef = PT_TL_MST_GW_TRNSM_FR_254_00980001_TxF1_PP_TL_MST_GW_TRNSM_FR_254_00980001_TxF1_Rx_7d601c47_052bff33
              PduRSrcPduPduRBswModulesRef = FrTp
          PduRRoutingPath_TL_MST_GW_TRNSM_FR_254_00980001_TxF2: PduRRoutingPathCommunicationType=TRANSPORT_PROTOCOL
            PduRDestPdu_030 (PduRDestPdu):
              PduRDestPduHandleId = 16
              PduRDestPduDirection = RECEIVE
              PduRDestPduRoutingType = API_FORWARDING
              PduRDestPduRef = PT_TL_MST_GW_TRNSM_FR_254_00980001_TxF2_PP_TL_MST_GW_TRNSM_FR_254_00980001_TxF2_Rx_7d601c47_052bff33
              PduRDestPduPduRBswModulesRef = Dcm
            PduRSrcPdu_030 (PduRSrcPdu):
              PduRSourcePduHandleId = 16
              PduRSrcPduDirection = RECEIVE
              PduRSrcPduRef = PT_TL_MST_GW_TRNSM_FR_254_00980001_TxF2_PP_TL_MST_GW_TRNSM_FR_254_00980001_TxF2_Rx_7d601c47_052bff33
              PduRSrcPduPduRBswModulesRef = FrTp
          PduRRoutingPath_TL_MST_GW_TRNSM_FR_254_00980001_TxF3: PduRRoutingPathCommunicationType=TRANSPORT_PROTOCOL
            PduRDestPdu_031 (PduRDestPdu):
              PduRDestPduHandleId = 17
              PduRDestPduDirection = RECEIVE
              PduRDestPduRoutingType = API_FORWARDING
              PduRDestPduRef = PT_TL_MST_GW_TRNSM_FR_254_00980001_TxF3_PP_TL_MST_GW_TRNSM_FR_254_00980001_TxF3_Rx_7d601c47_052bff33
              PduRDestPduPduRBswModulesRef = Dcm
            PduRSrcPdu_031 (PduRSrcPdu):
              PduRSourcePduHandleId = 17
              PduRSrcPduDirection = RECEIVE
              PduRSrcPduRef = PT_TL_MST_GW_TRNSM_FR_254_00980001_TxF3_PP_TL_MST_GW_TRNSM_FR_254_00980001_TxF3_Rx_7d601c47_052bff33
              PduRSrcPduPduRBswModulesRef = FrTp
          PduRRoutingPath_TL_MST_GW_TRNSM_FR_254_00980001_TxF4: PduRRoutingPathCommunicationType=TRANSPORT_PROTOCOL
            PduRDestPdu_032 (PduRDestPdu):
              PduRDestPduHandleId = 18
              PduRDestPduDirection = RECEIVE
              PduRDestPduRoutingType = API_FORWARDING
              PduRDestPduRef = PT_TL_MST_GW_TRNSM_FR_254_00980001_TxF4_PP_TL_MST_GW_TRNSM_FR_254_00980001_TxF4_Rx_7d601c47_052bff33
              PduRDestPduPduRBswModulesRef = Dcm
            PduRSrcPdu_032 (PduRSrcPdu):
              PduRSourcePduHandleId = 18
              PduRSrcPduDirection = RECEIVE
              PduRSrcPduRef = PT_TL_MST_GW_TRNSM_FR_254_00980001_TxF4_PP_TL_MST_GW_TRNSM_FR_254_00980001_TxF4_Rx_7d601c47_052bff33
              PduRSrcPduPduRBswModulesRef = FrTp
          PduRRoutingPath_TL_MST_GW_TRNSM_FR_254_00980001_TxF5: PduRRoutingPathCommunicationType=TRANSPORT_PROTOCOL
            PduRDestPdu_033 (PduRDestPdu):
              PduRDestPduHandleId = 19
              PduRDestPduDirection = RECEIVE
              PduRDestPduRoutingType = API_FORWARDING
              PduRDestPduRef = PT_TL_MST_GW_TRNSM_FR_254_00980001_TxF5_PP_TL_MST_GW_TRNSM_FR_254_00980001_TxF5_Rx_7d601c47_052bff33
              PduRDestPduPduRBswModulesRef = Dcm
            PduRSrcPdu_033 (PduRSrcPdu):
              PduRSourcePduHandleId = 19
              PduRSrcPduDirection = RECEIVE
              PduRSrcPduRef = PT_TL_MST_GW_TRNSM_FR_254_00980001_TxF5_PP_TL_MST_GW_TRNSM_FR_254_00980001_TxF5_Rx_7d601c47_052bff33
              PduRSrcPduPduRBswModulesRef = FrTp
          PduRRoutingPath_TL_MST_GW_TRNSM_FR_254_00980001_TxF6: PduRRoutingPathCommunicationType=TRANSPORT_PROTOCOL
            PduRDestPdu_034 (PduRDestPdu):
              PduRDestPduHandleId = 20
              PduRDestPduDirection = RECEIVE
              PduRDestPduRoutingType = API_FORWARDING
              PduRDestPduRef = PT_TL_MST_GW_TRNSM_FR_254_00980001_TxF6_PP_TL_MST_GW_TRNSM_FR_254_00980001_TxF6_Rx_7d601c47_052bff33
              PduRDestPduPduRBswModulesRef = Dcm
            PduRSrcPdu_034 (PduRSrcPdu):
              PduRSourcePduHandleId = 20
              PduRSrcPduDirection = RECEIVE
              PduRSrcPduRef = PT_TL_MST_GW_TRNSM_FR_254_00980001_TxF6_PP_TL_MST_GW_TRNSM_FR_254_00980001_TxF6_Rx_7d601c47_052bff33
              PduRSrcPduPduRBswModulesRef = FrTp
          PduRRoutingPath_TL_MST_GW_TRNSM_FR_254_00980001_TxF7: PduRRoutingPathCommunicationType=TRANSPORT_PROTOCOL
            PduRDestPdu_035 (PduRDestPdu):
              PduRDestPduHandleId = 21
              PduRDestPduDirection = RECEIVE
              PduRDestPduRoutingType = API_FORWARDING
              PduRDestPduRef = PT_TL_MST_GW_TRNSM_FR_254_00980001_TxF7_PP_TL_MST_GW_TRNSM_FR_254_00980001_TxF7_Rx_7d601c47_052bff33
              PduRDestPduPduRBswModulesRef = Dcm
            PduRSrcPdu_035 (PduRSrcPdu):
              PduRSourcePduHandleId = 21
              PduRSrcPduDirection = RECEIVE
              PduRSrcPduRef = PT_TL_MST_GW_TRNSM_FR_254_00980001_TxF7_PP_TL_MST_GW_TRNSM_FR_254_00980001_TxF7_Rx_7d601c47_052bff33
              PduRSrcPduPduRBswModulesRef = FrTp
          PduRRoutingPath_TL_MST_GW_TRNSM_FR_254_00980001_TxF8: PduRRoutingPathCommunicationType=TRANSPORT_PROTOCOL
            PduRDestPdu_036 (PduRDestPdu):
              PduRDestPduHandleId = 22
              PduRDestPduDirection = RECEIVE
              PduRDestPduRoutingType = API_FORWARDING
              PduRDestPduRef = PT_TL_MST_GW_TRNSM_FR_254_00980001_TxF8_PP_TL_MST_GW_TRNSM_FR_254_00980001_TxF8_Rx_7d601c47_052bff33
              PduRDestPduPduRBswModulesRef = Dcm
            PduRSrcPdu_036 (PduRSrcPdu):
              PduRSourcePduHandleId = 22
              PduRSrcPduDirection = RECEIVE
              PduRSrcPduRef = PT_TL_MST_GW_TRNSM_FR_254_00980001_TxF8_PP_TL_MST_GW_TRNSM_FR_254_00980001_TxF8_Rx_7d601c47_052bff33
              PduRSrcPduPduRBswModulesRef = FrTp
          PduRRoutingPath_TL_MST_GW_TRNSM_FR_254_00980001_TxF9: PduRRoutingPathCommunicationType=TRANSPORT_PROTOCOL
            PduRDestPdu_037 (PduRDestPdu):
              PduRDestPduHandleId = 23
              PduRDestPduDirection = RECEIVE
              PduRDestPduRoutingType = API_FORWARDING
              PduRDestPduRef = PT_TL_MST_GW_TRNSM_FR_254_00980001_TxF9_PP_TL_MST_GW_TRNSM_FR_254_00980001_TxF9_Rx_7d601c47_052bff33
              PduRDestPduPduRBswModulesRef = Dcm
            PduRSrcPdu_037 (PduRSrcPdu):
              PduRSourcePduHandleId = 23
              PduRSrcPduDirection = RECEIVE
              PduRSrcPduRef = PT_TL_MST_GW_TRNSM_FR_254_00980001_TxF9_PP_TL_MST_GW_TRNSM_FR_254_00980001_TxF9_Rx_7d601c47_052bff33
              PduRSrcPduPduRBswModulesRef = FrTp
          PduRRoutingPath_TL_MST_GW_TRNSM_FR_254_00980001_TxFA: PduRRoutingPathCommunicationType=TRANSPORT_PROTOCOL
            PduRDestPdu_038 (PduRDestPdu):
              PduRDestPduHandleId = 24
              PduRDestPduDirection = RECEIVE
              PduRDestPduRoutingType = API_FORWARDING
              PduRDestPduRef = PT_TL_MST_GW_TRNSM_FR_254_00980001_TxFA_PP_TL_MST_GW_TRNSM_FR_254_00980001_TxFA_Rx_7d601c47_052bff33
              PduRDestPduPduRBswModulesRef = Dcm
            PduRSrcPdu_038 (PduRSrcPdu):
              PduRSourcePduHandleId = 24
              PduRSrcPduDirection = RECEIVE
              PduRSrcPduRef = PT_TL_MST_GW_TRNSM_FR_254_00980001_TxFA_PP_TL_MST_GW_TRNSM_FR_254_00980001_TxFA_Rx_7d601c47_052bff33
              PduRSrcPduPduRBswModulesRef = FrTp
          PduRRoutingPath_TL_MST_GW_TRNSM_FR_254_00980001_TxFB: PduRRoutingPathCommunicationType=TRANSPORT_PROTOCOL
            PduRDestPdu_039 (PduRDestPdu):
              PduRDestPduHandleId = 25
              PduRDestPduDirection = RECEIVE
              PduRDestPduRoutingType = API_FORWARDING
              PduRDestPduRef = PT_TL_MST_GW_TRNSM_FR_254_00980001_TxFB_PP_TL_MST_GW_TRNSM_FR_254_00980001_TxFB_Rx_7d601c47_052bff33
              PduRDestPduPduRBswModulesRef = Dcm
            PduRSrcPdu_039 (PduRSrcPdu):
              PduRSourcePduHandleId = 25
              PduRSrcPduDirection = RECEIVE
              PduRSrcPduRef = PT_TL_MST_GW_TRNSM_FR_254_00980001_TxFB_PP_TL_MST_GW_TRNSM_FR_254_00980001_TxFB_Rx_7d601c47_052bff33
              PduRSrcPduPduRBswModulesRef = FrTp
          PduRRoutingPath_TL_MST_GW_TRNSM_FR_254_00980001_TxFC: PduRRoutingPathCommunicationType=TRANSPORT_PROTOCOL
            PduRDestPdu_040 (PduRDestPdu):
              PduRDestPduHandleId = 26
              PduRDestPduDirection = RECEIVE
              PduRDestPduRoutingType = API_FORWARDING
              PduRDestPduRef = PT_TL_MST_GW_TRNSM_FR_254_00980001_TxFC_PP_TL_MST_GW_TRNSM_FR_254_00980001_TxFC_Rx_7d601c47_052bff33
              PduRDestPduPduRBswModulesRef = Dcm
            PduRSrcPdu_040 (PduRSrcPdu):
              PduRSourcePduHandleId = 26
              PduRSrcPduDirection = RECEIVE
              PduRSrcPduRef = PT_TL_MST_GW_TRNSM_FR_254_00980001_TxFC_PP_TL_MST_GW_TRNSM_FR_254_00980001_TxFC_Rx_7d601c47_052bff33
              PduRSrcPduPduRBswModulesRef = FrTp
          PduRRoutingPath_TL_MST_GW_TRNSM_FR_254_00980001_TxFD: PduRRoutingPathCommunicationType=TRANSPORT_PROTOCOL
            PduRDestPdu_041 (PduRDestPdu):
              PduRDestPduHandleId = 27
              PduRDestPduDirection = RECEIVE
              PduRDestPduRoutingType = API_FORWARDING
              PduRDestPduRef = PT_TL_MST_GW_TRNSM_FR_254_00980001_TxFD_PP_TL_MST_GW_TRNSM_FR_254_00980001_TxFD_Rx_7d601c47_052bff33
              PduRDestPduPduRBswModulesRef = Dcm
            PduRSrcPdu_041 (PduRSrcPdu):
              PduRSourcePduHandleId = 27
              PduRSrcPduDirection = RECEIVE
              PduRSrcPduRef = PT_TL_MST_GW_TRNSM_FR_254_00980001_TxFD_PP_TL_MST_GW_TRNSM_FR_254_00980001_TxFD_Rx_7d601c47_052bff33
              PduRSrcPduPduRBswModulesRef = FrTp
    FrTp (PduRBswModules):
      PduRCancelReceive = false
      PduRCancelTransmit = false
      PduRChangeParameterRequestApi = false
      PduRCommunicationInterface = false
      PduRLowerModule = true
      PduRTransportProtocol = true
      PduRTriggertransmit = false
      PduRTxConfirmation = false
      PduRUpperModule = false
      PduRUseTag = false
      PduRBswModuleRef = FrTp
    Dcm (PduRBswModules):
      PduRCancelReceive = false
      PduRCancelTransmit = false
      PduRChangeParameterRequestApi = false
      PduRCommunicationInterface = false
      PduRLowerModule = false
      PduRTransportProtocol = true
      PduRTriggertransmit = false
      PduRTxConfirmation = false
      PduRUpperModule = true
      PduRUseTag = true
      PduRBswModuleRef = Dcm
