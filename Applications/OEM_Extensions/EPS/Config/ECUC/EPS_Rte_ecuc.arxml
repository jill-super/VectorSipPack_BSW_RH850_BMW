[part 2 of 2: package /ActiveEcuC]
AUTOSAR XML (schema 4-3-0)
package /ActiveEcuC  (continued)
  module config Rte: implementation-config-variant=VARIANT-PRE-COMPILE, module-description=Rte_Impl  (continued)
    DemSatellite_0_EcuSwComposition (RteSwComponentInstance): RteSoftwareComponentInstanceRef=DemSatellite_0  (continued)
      1420 x RteEventToTaskMapping, all with RteImmediateRestart=false:  (continued)
        OpEventGetDTCOfEvent_GetDTCOfEvent_EvtInfo_FrifEAcsChA: RteEventRef=OpEventGetDTCOfEvent_GetDTCOfEvent_EvtInfo_FrifEAcsChA
        OpEventGetDTCOfEvent_GetDTCOfEvent_Event_FrifEAcsChA: RteEventRef=OpEventGetDTCOfEvent_GetDTCOfEvent_Event_FrifEAcsChA
        OpEventGetDTCOfEvent_GetDTCOfEvent_EvtInfo_CantrcvEBusFaCanError: RteEventRef=OpEventGetDTCOfEvent_GetDTCOfEvent_EvtInfo_CantrcvEBusFaCanError
        OpEventGetDTCOfEvent_GetDTCOfEvent_Event_CantrcvEBusFaCanError: RteEventRef=OpEventGetDTCOfEvent_GetDTCOfEvent_Event_CantrcvEBusFaCanError
        OpEventGetDTCOfEvent_GetDTCOfEvent_EvtInfo_CantrcvEBusLeCanError: RteEventRef=OpEventGetDTCOfEvent_GetDTCOfEvent_EvtInfo_CantrcvEBusLeCanError
        OpEventGetDTCOfEvent_GetDTCOfEvent_Event_CantrcvEBusLeCanError: RteEventRef=OpEventGetDTCOfEvent_GetDTCOfEvent_Event_CantrcvEBusLeCanError
        OpEventGetDTCOfEvent_GetDTCOfEvent_EvtInfo_CantrcvEBusLpCanError: RteEventRef=OpEventGetDTCOfEvent_GetDTCOfEvent_EvtInfo_CantrcvEBusLpCanError
        OpEventGetDTCOfEvent_GetDTCOfEvent_Event_CantrcvEBusLpCanError: RteEventRef=OpEventGetDTCOfEvent_GetDTCOfEvent_Event_CantrcvEBusLpCanError
        OpEventGetDTCOfEvent_GetDTCOfEvent_EvtInfo_CantrcvEBusZsgCanError: RteEventRef=OpEventGetDTCOfEvent_GetDTCOfEvent_EvtInfo_CantrcvEBusZsgCanError
        OpEventGetDTCOfEvent_GetDTCOfEvent_Event_CantrcvEBusZsgCanError: RteEventRef=OpEventGetDTCOfEvent_GetDTCOfEvent_Event_CantrcvEBusZsgCanError
        OpEventGetDTCOfEvent_GetDTCOfEvent_EvtInfo_EthSignalQualityLow: RteEventRef=OpEventGetDTCOfEvent_GetDTCOfEvent_EvtInfo_EthSignalQualityLow
        OpEventGetDTCOfEvent_GetDTCOfEvent_Event_EthSignalQualityLow: RteEventRef=OpEventGetDTCOfEvent_GetDTCOfEvent_Event_EthSignalQualityLow
        OpEventGetDTCOfEvent_GetDTCOfEvent_EvtInfo_DemEventParameter_FlsConfigSet_FLS_E_COMPARE_FAILED: RteEventRef=OpEventGetDTCOfEvent_GetDTCOfEvent_EvtInfo_DemEventParameter_FlsConfigSet_FLS_E_COMPARE_FAILED
        OpEventGetDTCOfEvent_GetDTCOfEvent_EvtInfo_DemEventParameter_FlsConfigSet_FLS_E_ERASE_FAILED: RteEventRef=OpEventGetDTCOfEvent_GetDTCOfEvent_EvtInfo_DemEventParameter_FlsConfigSet_FLS_E_ERASE_FAILED
        OpEventGetDTCOfEvent_GetDTCOfEvent_EvtInfo_DemEventParameter_FlsConfigSet_FLS_E_READ_FAILED: RteEventRef=OpEventGetDTCOfEvent_GetDTCOfEvent_EvtInfo_DemEventParameter_FlsConfigSet_FLS_E_READ_FAILED
        OpEventGetDTCOfEvent_GetDTCOfEvent_EvtInfo_DemEventParameter_FlsConfigSet_FLS_E_WRITE_FAILED: RteEventRef=OpEventGetDTCOfEvent_GetDTCOfEvent_EvtInfo_DemEventParameter_FlsConfigSet_FLS_E_WRITE_FAILED
        OpEventGetDTCOfEvent_GetDTCOfEvent_EvtInfo_DemEventParameter_FlsConfigSet_FLS_E_READ_DED_FAILED: RteEventRef=OpEventGetDTCOfEvent_GetDTCOfEvent_EvtInfo_DemEventParameter_FlsConfigSet_FLS_E_READ_DED_FAILED
        OpEventGetDTCOfEvent_GetDTCOfEvent_EvtInfo_DemEventParameter_FlsConfigSet_FLS_E_UNEXPECTED_FLASH_ID: RteEventRef=OpEventGetDTCOfEvent_GetDTCOfEvent_EvtInfo_DemEventParameter_FlsConfigSet_FLS_E_UNEXPECTED_FLASH_ID
        OpEventGetDTCOfEvent_GetDTCOfEvent_EvtInfo_DemEventParameter_FlsConfigSet_MCU_E_CLOCK_FAILED: RteEventRef=OpEventGetDTCOfEvent_GetDTCOfEvent_EvtInfo_DemEventParameter_FlsConfigSet_MCU_E_CLOCK_FAILED
        OpEventGetDTCOfEvent_GetDTCOfEvent_EvtInfo_DemEventParameter_FlsConfigSet_MCU_E_HW_FAILED: RteEventRef=OpEventGetDTCOfEvent_GetDTCOfEvent_EvtInfo_DemEventParameter_FlsConfigSet_MCU_E_HW_FAILED
        OpEventGetDTCOfEvent_GetDTCOfEvent_EvtInfo_DemEventParameter_FlsConfigSet_MCU_E_STARTUP_FAILED: RteEventRef=OpEventGetDTCOfEvent_GetDTCOfEvent_EvtInfo_DemEventParameter_FlsConfigSet_MCU_E_STARTUP_FAILED
        OpEventGetDTCOfEvent_GetDTCOfEvent_EvtInfo_DemEventParameter_FlsConfigSet_FLS_E_ECC_FAILED: RteEventRef=OpEventGetDTCOfEvent_GetDTCOfEvent_EvtInfo_DemEventParameter_FlsConfigSet_FLS_E_ECC_FAILED
        OpEventGetDTCOfEvent_GetDTCOfEvent_EvtInfo_DemEventParameter_FlsConfigSet_FLS_E_VRFY_FAILED: RteEventRef=OpEventGetDTCOfEvent_GetDTCOfEvent_EvtInfo_DemEventParameter_FlsConfigSet_FLS_E_VRFY_FAILED
        OpEventGetDTCOfEvent_GetDTCOfEvent_EvtInfo_DemEventParameter_FlsConfigSet_FLS_E_INT_FAILED: RteEventRef=OpEventGetDTCOfEvent_GetDTCOfEvent_EvtInfo_DemEventParameter_FlsConfigSet_FLS_E_INT_FAILED
        OpEventGetDTCOfEvent_GetDTCOfEvent_EvtInfo_DemEventParameter_FlsConfigSet_FLS_E_HW_FAILED: RteEventRef=OpEventGetDTCOfEvent_GetDTCOfEvent_EvtInfo_DemEventParameter_FlsConfigSet_FLS_E_HW_FAILED
        OpEventGetDTCOfEvent_GetDTCOfEvent_GeneralEventInfo: RteEventRef=OpEventGetDTCOfEvent_GetDTCOfEvent_GeneralEventInfo
        OpEventGetFaultDetectionCounter_GetFaultDetectionCounter_EvtInfo_FrtrcvEFrErrnTrcv0: RteEventRef=OpEventGetFaultDetectionCounter_GetFaultDetectionCounter_EvtInfo_FrtrcvEFrErrnTrcv0
        OpEventGetFaultDetectionCounter_GetFaultDetectionCounter_Event_FrtrcvEFrErrnTrcv0: RteEventRef=OpEventGetFaultDetectionCounter_GetFaultDetectionCounter_Event_FrtrcvEFrErrnTrcv0
        OpEventGetFaultDetectionCounter_GetFaultDetectionCounter_EvtInfo_CansmEBusIukCanOff: RteEventRef=OpEventGetFaultDetectionCounter_GetFaultDetectionCounter_EvtInfo_CansmEBusIukCanOff
        OpEventGetFaultDetectionCounter_GetFaultDetectionCounter_Event_CansmEBusIukCanOff: RteEventRef=OpEventGetFaultDetectionCounter_GetFaultDetectionCounter_Event_CansmEBusIukCanOff
        OpEventGetFaultDetectionCounter_GetFaultDetectionCounter_EvtInfo_FrtrcvEFrErrnTrcv2: RteEventRef=OpEventGetFaultDetectionCounter_GetFaultDetectionCounter_EvtInfo_FrtrcvEFrErrnTrcv2
        OpEventGetFaultDetectionCounter_GetFaultDetectionCounter_Event_FrtrcvEFrErrnTrcv2: RteEventRef=OpEventGetFaultDetectionCounter_GetFaultDetectionCounter_Event_FrtrcvEFrErrnTrcv2
        OpEventGetFaultDetectionCounter_GetFaultDetectionCounter_EvtInfo_FrtrcvEFrErrnTrcv1: RteEventRef=OpEventGetFaultDetectionCounter_GetFaultDetectionCounter_EvtInfo_FrtrcvEFrErrnTrcv1
        OpEventGetFaultDetectionCounter_GetFaultDetectionCounter_Event_FrtrcvEFrErrnTrcv1: RteEventRef=OpEventGetFaultDetectionCounter_GetFaultDetectionCounter_Event_FrtrcvEFrErrnTrcv1
        OpEventGetFaultDetectionCounter_GetFaultDetectionCounter_EvtInfo_FrtrcvEFrErrnTrcv4: RteEventRef=OpEventGetFaultDetectionCounter_GetFaultDetectionCounter_EvtInfo_FrtrcvEFrErrnTrcv4
        OpEventGetFaultDetectionCounter_GetFaultDetectionCounter_Event_FrtrcvEFrErrnTrcv4: RteEventRef=OpEventGetFaultDetectionCounter_GetFaultDetectionCounter_Event_FrtrcvEFrErrnTrcv4
        OpEventGetFaultDetectionCounter_GetFaultDetectionCounter_EvtInfo_FrtrcvEFrErrnTrcv3: RteEventRef=OpEventGetFaultDetectionCounter_GetFaultDetectionCounter_EvtInfo_FrtrcvEFrErrnTrcv3
        OpEventGetFaultDetectionCounter_GetFaultDetectionCounter_Event_FrtrcvEFrErrnTrcv3: RteEventRef=OpEventGetFaultDetectionCounter_GetFaultDetectionCounter_Event_FrtrcvEFrErrnTrcv3
        OpEventGetFaultDetectionCounter_GetFaultDetectionCounter_EvtInfo_FrtrcvEFrErrnTrcv6: RteEventRef=OpEventGetFaultDetectionCounter_GetFaultDetectionCounter_EvtInfo_FrtrcvEFrErrnTrcv6
        OpEventGetFaultDetectionCounter_GetFaultDetectionCounter_Event_FrtrcvEFrErrnTrcv6: RteEventRef=OpEventGetFaultDetectionCounter_GetFaultDetectionCounter_Event_FrtrcvEFrErrnTrcv6
        OpEventGetFaultDetectionCounter_GetFaultDetectionCounter_EvtInfo_FrtrcvEFrErrnTrcv5: RteEventRef=OpEventGetFaultDetectionCounter_GetFaultDetectionCounter_EvtInfo_FrtrcvEFrErrnTrcv5
        OpEventGetFaultDetectionCounter_GetFaultDetectionCounter_Event_FrtrcvEFrErrnTrcv5: RteEventRef=OpEventGetFaultDetectionCounter_GetFaultDetectionCounter_Event_FrtrcvEFrErrnTrcv5
        OpEventGetFaultDetectionCounter_GetFaultDetectionCounter_EvtInfo_CansmEBusBodyCanOff: RteEventRef=OpEventGetFaultDetectionCounter_GetFaultDetectionCounter_EvtInfo_CansmEBusBodyCanOff
        OpEventGetFaultDetectionCounter_GetFaultDetectionCounter_Event_CansmEBusBodyCanOff: RteEventRef=OpEventGetFaultDetectionCounter_GetFaultDetectionCounter_Event_CansmEBusBodyCanOff
        OpEventGetFaultDetectionCounter_GetFaultDetectionCounter_EvtInfo_CbsReplacementValue: RteEventRef=OpEventGetFaultDetectionCounter_GetFaultDetectionCounter_EvtInfo_CbsReplacementValue
        OpEventGetFaultDetectionCounter_GetFaultDetectionCounter_Event_CbsReplacementValue: RteEventRef=OpEventGetFaultDetectionCounter_GetFaultDetectionCounter_Event_CbsReplacementValue
        OpEventGetFaultDetectionCounter_GetFaultDetectionCounter_EvtInfo_CansmEBusLeCanOff: RteEventRef=OpEventGetFaultDetectionCounter_GetFaultDetectionCounter_EvtInfo_CansmEBusLeCanOff
        OpEventGetFaultDetectionCounter_GetFaultDetectionCounter_Event_CansmEBusLeCanOff: RteEventRef=OpEventGetFaultDetectionCounter_GetFaultDetectionCounter_Event_CansmEBusLeCanOff
        OpEventGetFaultDetectionCounter_GetFaultDetectionCounter_EvtInfo_CansmEBusZsgCanOff: RteEventRef=OpEventGetFaultDetectionCounter_GetFaultDetectionCounter_EvtInfo_CansmEBusZsgCanOff
        OpEventGetFaultDetectionCounter_GetFaultDetectionCounter_Event_CansmEBusZsgCanOff: RteEventRef=OpEventGetFaultDetectionCounter_GetFaultDetectionCounter_Event_CansmEBusZsgCanOff
        OpEventGetFaultDetectionCounter_GetFaultDetectionCounter_EvtInfo_CodingEventWrongVehicle: RteEventRef=OpEventGetFaultDetectionCounter_GetFaultDetectionCounter_EvtInfo_CodingEventWrongVehicle
        OpEventGetFaultDetectionCounter_GetFaultDetectionCounter_Event_CodingEventWrongVehicle: RteEventRef=OpEventGetFaultDetectionCounter_GetFaultDetectionCounter_Event_CodingEventWrongVehicle
        OpEventGetFaultDetectionCounter_GetFaultDetectionCounter_EvtInfo_FrsmEClusterStartup: RteEventRef=OpEventGetFaultDetectionCounter_GetFaultDetectionCounter_EvtInfo_FrsmEClusterStartup
        OpEventGetFaultDetectionCounter_GetFaultDetectionCounter_Event_FrsmEClusterStartup: RteEventRef=OpEventGetFaultDetectionCounter_GetFaultDetectionCounter_Event_FrsmEClusterStartup
        OpEventGetFaultDetectionCounter_GetFaultDetectionCounter_EvtInfo_CansmEBusACanOff: RteEventRef=OpEventGetFaultDetectionCounter_GetFaultDetectionCounter_EvtInfo_CansmEBusACanOff
        OpEventGetFaultDetectionCounter_GetFaultDetectionCounter_Event_CansmEBusACanOff: RteEventRef=OpEventGetFaultDetectionCounter_GetFaultDetectionCounter_Event_CansmEBusACanOff
        OpEventGetFaultDetectionCounter_GetFaultDetectionCounter_EvtInfo_CansmEBusKCanOff: RteEventRef=OpEventGetFaultDetectionCounter_GetFaultDetectionCounter_EvtInfo_CansmEBusKCanOff
        OpEventGetFaultDetectionCounter_GetFaultDetectionCounter_Event_CansmEBusKCanOff: RteEventRef=OpEventGetFaultDetectionCounter_GetFaultDetectionCounter_Event_CansmEBusKCanOff
        OpEventGetFaultDetectionCounter_GetFaultDetectionCounter_EvtInfo_CantrcvEBusKCanError: RteEventRef=OpEventGetFaultDetectionCounter_GetFaultDetectionCounter_EvtInfo_CantrcvEBusKCanError
        OpEventGetFaultDetectionCounter_GetFaultDetectionCounter_Event_CantrcvEBusKCanError: RteEventRef=OpEventGetFaultDetectionCounter_GetFaultDetectionCounter_Event_CantrcvEBusKCanError
        OpEventGetFaultDetectionCounter_GetFaultDetectionCounter_EvtInfo_FrtrcvEFrBuserrorTrcv0: RteEventRef=OpEventGetFaultDetectionCounter_GetFaultDetectionCounter_EvtInfo_FrtrcvEFrBuserrorTrcv0
        OpEventGetFaultDetectionCounter_GetFaultDetectionCounter_Event_FrtrcvEFrBuserrorTrcv0: RteEventRef=OpEventGetFaultDetectionCounter_GetFaultDetectionCounter_Event_FrtrcvEFrBuserrorTrcv0
        OpEventGetFaultDetectionCounter_GetFaultDetectionCounter_EvtInfo_FrtrcvEFrErrnTrcv7: RteEventRef=OpEventGetFaultDetectionCounter_GetFaultDetectionCounter_EvtInfo_FrtrcvEFrErrnTrcv7
        OpEventGetFaultDetectionCounter_GetFaultDetectionCounter_Event_FrtrcvEFrErrnTrcv7: RteEventRef=OpEventGetFaultDetectionCounter_GetFaultDetectionCounter_Event_FrtrcvEFrErrnTrcv7
        OpEventGetFaultDetectionCounter_GetFaultDetectionCounter_EvtInfo_CansmEBusFaCanOff: RteEventRef=OpEventGetFaultDetectionCounter_GetFaultDetectionCounter_EvtInfo_CansmEBusFaCanOff
        OpEventGetFaultDetectionCounter_GetFaultDetectionCounter_Event_CansmEBusFaCanOff: RteEventRef=OpEventGetFaultDetectionCounter_GetFaultDetectionCounter_Event_CansmEBusFaCanOff
        OpEventGetFaultDetectionCounter_GetFaultDetectionCounter_EvtInfo_CantrcvEBusB2CanError: RteEventRef=OpEventGetFaultDetectionCounter_GetFaultDetectionCounter_EvtInfo_CantrcvEBusB2CanError
        OpEventGetFaultDetectionCounter_GetFaultDetectionCounter_Event_CantrcvEBusB2CanError: RteEventRef=OpEventGetFaultDetectionCounter_GetFaultDetectionCounter_Event_CantrcvEBusB2CanError
        OpEventGetFaultDetectionCounter_GetFaultDetectionCounter_EvtInfo_DtcCd0605: RteEventRef=OpEventGetFaultDetectionCounter_GetFaultDetectionCounter_EvtInfo_DtcCd0605
        OpEventGetFaultDetectionCounter_GetFaultDetectionCounter_Event_DtcCd0605: RteEventRef=OpEventGetFaultDetectionCounter_GetFaultDetectionCounter_Event_DtcCd0605
        OpEventGetFaultDetectionCounter_GetFaultDetectionCounter_EvtInfo_DtcCd0606: RteEventRef=OpEventGetFaultDetectionCounter_GetFaultDetectionCounter_EvtInfo_DtcCd0606
        OpEventGetFaultDetectionCounter_GetFaultDetectionCounter_Event_DtcCd0606: RteEventRef=OpEventGetFaultDetectionCounter_GetFaultDetectionCounter_Event_DtcCd0606
        OpEventGetFaultDetectionCounter_GetFaultDetectionCounter_EvtInfo_DtcCd0607: RteEventRef=OpEventGetFaultDetectionCounter_GetFaultDetectionCounter_EvtInfo_DtcCd0607
        OpEventGetFaultDetectionCounter_GetFaultDetectionCounter_Event_DtcCd0607: RteEventRef=OpEventGetFaultDetectionCounter_GetFaultDetectionCounter_Event_DtcCd0607
        OpEventGetFaultDetectionCounter_GetFaultDetectionCounter_EvtInfo_PiaEIoError: RteEventRef=OpEventGetFaultDetectionCounter_GetFaultDetectionCounter_EvtInfo_PiaEIoError
        OpEventGetFaultDetectionCounter_GetFaultDetectionCounter_Event_PiaEIoError: RteEventRef=OpEventGetFaultDetectionCounter_GetFaultDetectionCounter_Event_PiaEIoError
        OpEventGetFaultDetectionCounter_GetFaultDetectionCounter_EvtInfo_DtcCd0601: RteEventRef=OpEventGetFaultDetectionCounter_GetFaultDetectionCounter_EvtInfo_DtcCd0601
        OpEventGetFaultDetectionCounter_GetFaultDetectionCounter_Event_DtcCd0601: RteEventRef=OpEventGetFaultDetectionCounter_GetFaultDetectionCounter_Event_DtcCd0601
        OpEventGetFaultDetectionCounter_GetFaultDetectionCounter_EvtInfo_SwtExternalCheckFailure: RteEventRef=OpEventGetFaultDetectionCounter_GetFaultDetectionCounter_EvtInfo_SwtExternalCheckFailure
        OpEventGetFaultDetectionCounter_GetFaultDetectionCounter_Event_SwtExternalCheckFailure: RteEventRef=OpEventGetFaultDetectionCounter_GetFaultDetectionCounter_Event_SwtExternalCheckFailure
        OpEventGetFaultDetectionCounter_GetFaultDetectionCounter_EvtInfo_CantrcvEBusBodyCanError: RteEventRef=OpEventGetFaultDetectionCounter_GetFaultDetectionCounter_EvtInfo_CantrcvEBusBodyCanError
        OpEventGetFaultDetectionCounter_GetFaultDetectionCounter_Event_CantrcvEBusBodyCanError: RteEventRef=OpEventGetFaultDetectionCounter_GetFaultDetectionCounter_Event_CantrcvEBusBodyCanError
        OpEventGetFaultDetectionCounter_GetFaultDetectionCounter_EvtInfo_CantrcvEBusIukError: RteEventRef=OpEventGetFaultDetectionCounter_GetFaultDetectionCounter_EvtInfo_CantrcvEBusIukError
        OpEventGetFaultDetectionCounter_GetFaultDetectionCounter_Event_CantrcvEBusIukError: RteEventRef=OpEventGetFaultDetectionCounter_GetFaultDetectionCounter_Event_CantrcvEBusIukError
        OpEventGetFaultDetectionCounter_GetFaultDetectionCounter_EvtInfo_SwtInternalCheckFailure: RteEventRef=OpEventGetFaultDetectionCounter_GetFaultDetectionCounter_EvtInfo_SwtInternalCheckFailure
        OpEventGetFaultDetectionCounter_GetFaultDetectionCounter_Event_SwtInternalCheckFailure: RteEventRef=OpEventGetFaultDetectionCounter_GetFaultDetectionCounter_Event_SwtInternalCheckFailure
        OpEventGetFaultDetectionCounter_GetFaultDetectionCounter_EvtInfo_DmTestAppl: RteEventRef=OpEventGetFaultDetectionCounter_GetFaultDetectionCounter_EvtInfo_DmTestAppl
        OpEventGetFaultDetectionCounter_GetFaultDetectionCounter_Event_DmTestAppl: RteEventRef=OpEventGetFaultDetectionCounter_GetFaultDetectionCounter_Event_DmTestAppl
        OpEventGetFaultDetectionCounter_GetFaultDetectionCounter_EvtInfo_Dtc000032: RteEventRef=OpEventGetFaultDetectionCounter_GetFaultDetectionCounter_EvtInfo_Dtc000032
        OpEventGetFaultDetectionCounter_GetFaultDetectionCounter_Event_Dtc000032: RteEventRef=OpEventGetFaultDetectionCounter_GetFaultDetectionCounter_Event_Dtc000032
        OpEventGetFaultDetectionCounter_GetFaultDetectionCounter_EvtInfo_Dtc000031: RteEventRef=OpEventGetFaultDetectionCounter_GetFaultDetectionCounter_EvtInfo_Dtc000031
        OpEventGetFaultDetectionCounter_GetFaultDetectionCounter_Event_Dtc000031: RteEventRef=OpEventGetFaultDetectionCounter_GetFaultDetectionCounter_Event_Dtc000031
        OpEventGetFaultDetectionCounter_GetFaultDetectionCounter_EvtInfo_FrsmEClusterSyncLoss: RteEventRef=OpEventGetFaultDetectionCounter_GetFaultDetectionCounter_EvtInfo_FrsmEClusterSyncLoss
        OpEventGetFaultDetectionCounter_GetFaultDetectionCounter_Event_FrsmEClusterSyncLoss: RteEventRef=OpEventGetFaultDetectionCounter_GetFaultDetectionCounter_Event_FrsmEClusterSyncLoss
        OpEventGetFaultDetectionCounter_GetFaultDetectionCounter_EvtInfo_Dtc000030: RteEventRef=OpEventGetFaultDetectionCounter_GetFaultDetectionCounter_EvtInfo_Dtc000030
        OpEventGetFaultDetectionCounter_GetFaultDetectionCounter_Event_Dtc000030: RteEventRef=OpEventGetFaultDetectionCounter_GetFaultDetectionCounter_Event_Dtc000030
        OpEventGetFaultDetectionCounter_GetFaultDetectionCounter_EvtInfo_Dtc000034: RteEventRef=OpEventGetFaultDetectionCounter_GetFaultDetectionCounter_EvtInfo_Dtc000034
        OpEventGetFaultDetectionCounter_GetFaultDetectionCounter_Event_Dtc000034: RteEventRef=OpEventGetFaultDetectionCounter_GetFaultDetectionCounter_Event_Dtc000034
        OpEventGetFaultDetectionCounter_GetFaultDetectionCounter_EvtInfo_Dtc000033: RteEventRef=OpEventGetFaultDetectionCounter_GetFaultDetectionCounter_EvtInfo_Dtc000033
        OpEventGetFaultDetectionCounter_GetFaultDetectionCounter_Event_Dtc000033: RteEventRef=OpEventGetFaultDetectionCounter_GetFaultDetectionCounter_Event_Dtc000033
        OpEventGetFaultDetectionCounter_GetFaultDetectionCounter_EvtInfo_Undervoltage: RteEventRef=OpEventGetFaultDetectionCounter_GetFaultDetectionCounter_EvtInfo_Undervoltage
        OpEventGetFaultDetectionCounter_GetFaultDetectionCounter_Event_Undervoltage: RteEventRef=OpEventGetFaultDetectionCounter_GetFaultDetectionCounter_Event_Undervoltage
        OpEventGetFaultDetectionCounter_GetFaultDetectionCounter_EvtInfo_CodingEventTransactionFailed: RteEventRef=OpEventGetFaultDetectionCounter_GetFaultDetectionCounter_EvtInfo_CodingEventTransactionFailed
        OpEventGetFaultDetectionCounter_GetFaultDetectionCounter_Event_CodingEventTransactionFailed: RteEventRef=OpEventGetFaultDetectionCounter_GetFaultDetectionCounter_Event_CodingEventTransactionFailed
        OpEventGetFaultDetectionCounter_GetFaultDetectionCounter_EvtInfo_FrifENitChA: RteEventRef=OpEventGetFaultDetectionCounter_GetFaultDetectionCounter_EvtInfo_FrifENitChA
        OpEventGetFaultDetectionCounter_GetFaultDetectionCounter_Event_FrifENitChA: RteEventRef=OpEventGetFaultDetectionCounter_GetFaultDetectionCounter_Event_FrifENitChA
        OpEventGetFaultDetectionCounter_GetFaultDetectionCounter_EvtInfo_CansmEBusLpCanOff: RteEventRef=OpEventGetFaultDetectionCounter_GetFaultDetectionCounter_EvtInfo_CansmEBusLpCanOff
        OpEventGetFaultDetectionCounter_GetFaultDetectionCounter_Event_CansmEBusLpCanOff: RteEventRef=OpEventGetFaultDetectionCounter_GetFaultDetectionCounter_Event_CansmEBusLpCanOff
        OpEventGetFaultDetectionCounter_GetFaultDetectionCounter_EvtInfo_NVM_E_HARDWARE: RteEventRef=OpEventGetFaultDetectionCounter_GetFaultDetectionCounter_EvtInfo_NVM_E_HARDWARE
        OpEventGetFaultDetectionCounter_GetFaultDetectionCounter_EvtInfo_VsmEventOpmode: RteEventRef=OpEventGetFaultDetectionCounter_GetFaultDetectionCounter_EvtInfo_VsmEventOpmode
        OpEventGetFaultDetectionCounter_GetFaultDetectionCounter_Event_VsmEventOpmode: RteEventRef=OpEventGetFaultDetectionCounter_GetFaultDetectionCounter_Event_VsmEventOpmode
        OpEventGetFaultDetectionCounter_GetFaultDetectionCounter_EvtInfo_LIN_E_TIMEOUT: RteEventRef=OpEventGetFaultDetectionCounter_GetFaultDetectionCounter_EvtInfo_LIN_E_TIMEOUT
        OpEventGetFaultDetectionCounter_GetFaultDetectionCounter_EvtInfo_CantrcvEBusACanError: RteEventRef=OpEventGetFaultDetectionCounter_GetFaultDetectionCounter_EvtInfo_CantrcvEBusACanError
        OpEventGetFaultDetectionCounter_GetFaultDetectionCounter_Event_CantrcvEBusACanError: RteEventRef=OpEventGetFaultDetectionCounter_GetFaultDetectionCounter_Event_CantrcvEBusACanError
        OpEventGetFaultDetectionCounter_GetFaultDetectionCounter_EvtInfo_UDPNM_E_TCPIP_TRANSMIT_ERROR: RteEventRef=OpEventGetFaultDetectionCounter_GetFaultDetectionCounter_EvtInfo_UDPNM_E_TCPIP_TRANSMIT_ERROR
        OpEventGetFaultDetectionCounter_GetFaultDetectionCounter_EvtInfo_DmTestCom: RteEventRef=OpEventGetFaultDetectionCounter_GetFaultDetectionCounter_EvtInfo_DmTestCom
        OpEventGetFaultDetectionCounter_GetFaultDetectionCounter_Event_DmTestCom: RteEventRef=OpEventGetFaultDetectionCounter_GetFaultDetectionCounter_Event_DmTestCom
        OpEventGetFaultDetectionCounter_GetFaultDetectionCounter_EvtInfo_CodingEventSignatureError: RteEventRef=OpEventGetFaultDetectionCounter_GetFaultDetectionCounter_EvtInfo_CodingEventSignatureError
        OpEventGetFaultDetectionCounter_GetFaultDetectionCounter_Event_CodingEventSignatureError: RteEventRef=OpEventGetFaultDetectionCounter_GetFaultDetectionCounter_Event_CodingEventSignatureError
        OpEventGetFaultDetectionCounter_GetFaultDetectionCounter_EvtInfo_CodingEventUnqualifiedData: RteEventRef=OpEventGetFaultDetectionCounter_GetFaultDetectionCounter_EvtInfo_CodingEventUnqualifiedData
        OpEventGetFaultDetectionCounter_GetFaultDetectionCounter_Event_CodingEventUnqualifiedData: RteEventRef=OpEventGetFaultDetectionCounter_GetFaultDetectionCounter_Event_CodingEventUnqualifiedData
        OpEventGetFaultDetectionCounter_GetFaultDetectionCounter_EvtInfo_CodingEventInvalidData: RteEventRef=OpEventGetFaultDetectionCounter_GetFaultDetectionCounter_EvtInfo_CodingEventInvalidData
        OpEventGetFaultDetectionCounter_GetFaultDetectionCounter_Event_CodingEventInvalidData: RteEventRef=OpEventGetFaultDetectionCounter_GetFaultDetectionCounter_Event_CodingEventInvalidData
        OpEventGetFaultDetectionCounter_GetFaultDetectionCounter_EvtInfo_CansmEBusB2CanOff: RteEventRef=OpEventGetFaultDetectionCounter_GetFaultDetectionCounter_EvtInfo_CansmEBusB2CanOff
        OpEventGetFaultDetectionCounter_GetFaultDetectionCounter_Event_CansmEBusB2CanOff: RteEventRef=OpEventGetFaultDetectionCounter_GetFaultDetectionCounter_Event_CansmEBusB2CanOff
        OpEventGetFaultDetectionCounter_GetFaultDetectionCounter_EvtInfo_Overvoltage: RteEventRef=OpEventGetFaultDetectionCounter_GetFaultDetectionCounter_EvtInfo_Overvoltage
        OpEventGetFaultDetectionCounter_GetFaultDetectionCounter_Event_Overvoltage: RteEventRef=OpEventGetFaultDetectionCounter_GetFaultDetectionCounter_Event_Overvoltage
        OpEventGetFaultDetectionCounter_GetFaultDetectionCounter_EvtInfo_CodingEventNotCoded: RteEventRef=OpEventGetFaultDetectionCounter_GetFaultDetectionCounter_EvtInfo_CodingEventNotCoded
        OpEventGetFaultDetectionCounter_GetFaultDetectionCounter_Event_CodingEventNotCoded: RteEventRef=OpEventGetFaultDetectionCounter_GetFaultDetectionCounter_Event_CodingEventNotCoded
        OpEventGetFaultDetectionCounter_GetFaultDetectionCounter_EvtInfo_FrifEAcsChA: RteEventRef=OpEventGetFaultDetectionCounter_GetFaultDetectionCounter_EvtInfo_FrifEAcsChA
        OpEventGetFaultDetectionCounter_GetFaultDetectionCounter_Event_FrifEAcsChA: RteEventRef=OpEventGetFaultDetectionCounter_GetFaultDetectionCounter_Event_FrifEAcsChA
        OpEventGetFaultDetectionCounter_GetFaultDetectionCounter_EvtInfo_CantrcvEBusFaCanError: RteEventRef=OpEventGetFaultDetectionCounter_GetFaultDetectionCounter_EvtInfo_CantrcvEBusFaCanError
        OpEventGetFaultDetectionCounter_GetFaultDetectionCounter_Event_CantrcvEBusFaCanError: RteEventRef=OpEventGetFaultDetectionCounter_GetFaultDetectionCounter_Event_CantrcvEBusFaCanError
        OpEventGetFaultDetectionCounter_GetFaultDetectionCounter_EvtInfo_CantrcvEBusLeCanError: RteEventRef=OpEventGetFaultDetectionCounter_GetFaultDetectionCounter_EvtInfo_CantrcvEBusLeCanError
        OpEventGetFaultDetectionCounter_GetFaultDetectionCounter_Event_CantrcvEBusLeCanError: RteEventRef=OpEventGetFaultDetectionCounter_GetFaultDetectionCounter_Event_CantrcvEBusLeCanError
        OpEventGetFaultDetectionCounter_GetFaultDetectionCounter_EvtInfo_CantrcvEBusLpCanError: RteEventRef=OpEventGetFaultDetectionCounter_GetFaultDetectionCounter_EvtInfo_CantrcvEBusLpCanError
        OpEventGetFaultDetectionCounter_GetFaultDetectionCounter_Event_CantrcvEBusLpCanError: RteEventRef=OpEventGetFaultDetectionCounter_GetFaultDetectionCounter_Event_CantrcvEBusLpCanError
        OpEventGetFaultDetectionCounter_GetFaultDetectionCounter_EvtInfo_CantrcvEBusZsgCanError: RteEventRef=OpEventGetFaultDetectionCounter_GetFaultDetectionCounter_EvtInfo_CantrcvEBusZsgCanError
        OpEventGetFaultDetectionCounter_GetFaultDetectionCounter_Event_CantrcvEBusZsgCanError: RteEventRef=OpEventGetFaultDetectionCounter_GetFaultDetectionCounter_Event_CantrcvEBusZsgCanError
        OpEventGetFaultDetectionCounter_GetFaultDetectionCounter_EvtInfo_EthSignalQualityLow: RteEventRef=OpEventGetFaultDetectionCounter_GetFaultDetectionCounter_EvtInfo_EthSignalQualityLow
        OpEventGetFaultDetectionCounter_GetFaultDetectionCounter_Event_EthSignalQualityLow: RteEventRef=OpEventGetFaultDetectionCounter_GetFaultDetectionCounter_Event_EthSignalQualityLow
        OpEventGetFaultDetectionCounter_GetFaultDetectionCounter_EvtInfo_DemEventParameter_FlsConfigSet_FLS_E_COMPARE_FAILED: RteEventRef=OpEventGetFaultDetectionCounter_GetFaultDetectionCounter_EvtInfo_DemEventParameter_FlsConfigSet_FLS_E_COMPARE_FAILED
        OpEventGetFaultDetectionCounter_GetFaultDetectionCounter_EvtInfo_DemEventParameter_FlsConfigSet_FLS_E_ERASE_FAILED: RteEventRef=OpEventGetFaultDetectionCounter_GetFaultDetectionCounter_EvtInfo_DemEventParameter_FlsConfigSet_FLS_E_ERASE_FAILED
        OpEventGetFaultDetectionCounter_GetFaultDetectionCounter_EvtInfo_DemEventParameter_FlsConfigSet_FLS_E_READ_FAILED: RteEventRef=OpEventGetFaultDetectionCounter_GetFaultDetectionCounter_EvtInfo_DemEventParameter_FlsConfigSet_FLS_E_READ_FAILED
        OpEventGetFaultDetectionCounter_GetFaultDetectionCounter_EvtInfo_DemEventParameter_FlsConfigSet_FLS_E_WRITE_FAILED: RteEventRef=OpEventGetFaultDetectionCounter_GetFaultDetectionCounter_EvtInfo_DemEventParameter_FlsConfigSet_FLS_E_WRITE_FAILED
        OpEventGetFaultDetectionCounter_GetFaultDetectionCounter_EvtInfo_DemEventParameter_FlsConfigSet_FLS_E_READ_DED_FAILED: RteEventRef=OpEventGetFaultDetectionCounter_GetFaultDetectionCounter_EvtInfo_DemEventParameter_FlsConfigSet_FLS_E_READ_DED_FAILED
        OpEventGetFaultDetectionCounter_GetFaultDetectionCounter_EvtInfo_DemEventParameter_FlsConfigSet_FLS_E_UNEXPECTED_FLASH_ID: RteEventRef=OpEventGetFaultDetectionCounter_GetFaultDetectionCounter_EvtInfo_DemEventParameter_FlsConfigSet_FLS_E_UNEXPECTED_FLASH_ID
        OpEventGetFaultDetectionCounter_GetFaultDetectionCounter_EvtInfo_DemEventParameter_FlsConfigSet_MCU_E_CLOCK_FAILED: RteEventRef=OpEventGetFaultDetectionCounter_GetFaultDetectionCounter_EvtInfo_DemEventParameter_FlsConfigSet_MCU_E_CLOCK_FAILED
        OpEventGetFaultDetectionCounter_GetFaultDetectionCounter_EvtInfo_DemEventParameter_FlsConfigSet_MCU_E_HW_FAILED: RteEventRef=OpEventGetFaultDetectionCounter_GetFaultDetectionCounter_EvtInfo_DemEventParameter_FlsConfigSet_MCU_E_HW_FAILED
        OpEventGetFaultDetectionCounter_GetFaultDetectionCounter_EvtInfo_DemEventParameter_FlsConfigSet_MCU_E_STARTUP_FAILED: RteEventRef=OpEventGetFaultDetectionCounter_GetFaultDetectionCounter_EvtInfo_DemEventParameter_FlsConfigSet_MCU_E_STARTUP_FAILED
        OpEventGetFaultDetectionCounter_GetFaultDetectionCounter_EvtInfo_DemEventParameter_FlsConfigSet_FLS_E_ECC_FAILED: RteEventRef=OpEventGetFaultDetectionCounter_GetFaultDetectionCounter_EvtInfo_DemEventParameter_FlsConfigSet_FLS_E_ECC_FAILED
        OpEventGetFaultDetectionCounter_GetFaultDetectionCounter_EvtInfo_DemEventParameter_FlsConfigSet_FLS_E_VRFY_FAILED: RteEventRef=OpEventGetFaultDetectionCounter_GetFaultDetectionCounter_EvtInfo_DemEventParameter_FlsConfigSet_FLS_E_VRFY_FAILED
        OpEventGetFaultDetectionCounter_GetFaultDetectionCounter_EvtInfo_DemEventParameter_FlsConfigSet_FLS_E_INT_FAILED: RteEventRef=OpEventGetFaultDetectionCounter_GetFaultDetectionCounter_EvtInfo_DemEventParameter_FlsConfigSet_FLS_E_INT_FAILED
        OpEventGetFaultDetectionCounter_GetFaultDetectionCounter_EvtInfo_DemEventParameter_FlsConfigSet_FLS_E_HW_FAILED: RteEventRef=OpEventGetFaultDetectionCounter_GetFaultDetectionCounter_EvtInfo_DemEventParameter_FlsConfigSet_FLS_E_HW_FAILED
        OpEventGetFaultDetectionCounter_GetFaultDetectionCounter_GeneralEventInfo: RteEventRef=OpEventGetFaultDetectionCounter_GetFaultDetectionCounter_GeneralEventInfo
        OpEventGetEventFreezeFrameDataEx_GetEventFreezeFrameDataEx_EvtInfo_FrtrcvEFrErrnTrcv0: RteEventRef=OpEventGetEventFreezeFrameDataEx_GetEventFreezeFrameDataEx_EvtInfo_FrtrcvEFrErrnTrcv0
        OpEventGetEventFreezeFrameDataEx_GetEventFreezeFrameDataEx_Event_FrtrcvEFrErrnTrcv0: RteEventRef=OpEventGetEventFreezeFrameDataEx_GetEventFreezeFrameDataEx_Event_FrtrcvEFrErrnTrcv0
        OpEventGetEventFreezeFrameDataEx_GetEventFreezeFrameDataEx_EvtInfo_CansmEBusIukCanOff: RteEventRef=OpEventGetEventFreezeFrameDataEx_GetEventFreezeFrameDataEx_EvtInfo_CansmEBusIukCanOff
        OpEventGetEventFreezeFrameDataEx_GetEventFreezeFrameDataEx_Event_CansmEBusIukCanOff: RteEventRef=OpEventGetEventFreezeFrameDataEx_GetEventFreezeFrameDataEx_Event_CansmEBusIukCanOff
        OpEventGetEventFreezeFrameDataEx_GetEventFreezeFrameDataEx_EvtInfo_FrtrcvEFrErrnTrcv2: RteEventRef=OpEventGetEventFreezeFrameDataEx_GetEventFreezeFrameDataEx_EvtInfo_FrtrcvEFrErrnTrcv2
        OpEventGetEventFreezeFrameDataEx_GetEventFreezeFrameDataEx_Event_FrtrcvEFrErrnTrcv2: RteEventRef=OpEventGetEventFreezeFrameDataEx_GetEventFreezeFrameDataEx_Event_FrtrcvEFrErrnTrcv2
        OpEventGetEventFreezeFrameDataEx_GetEventFreezeFrameDataEx_EvtInfo_FrtrcvEFrErrnTrcv1: RteEventRef=OpEventGetEventFreezeFrameDataEx_GetEventFreezeFrameDataEx_EvtInfo_FrtrcvEFrErrnTrcv1
        OpEventGetEventFreezeFrameDataEx_GetEventFreezeFrameDataEx_Event_FrtrcvEFrErrnTrcv1: RteEventRef=OpEventGetEventFreezeFrameDataEx_GetEventFreezeFrameDataEx_Event_FrtrcvEFrErrnTrcv1
        OpEventGetEventFreezeFrameDataEx_GetEventFreezeFrameDataEx_EvtInfo_FrtrcvEFrErrnTrcv4: RteEventRef=OpEventGetEventFreezeFrameDataEx_GetEventFreezeFrameDataEx_EvtInfo_FrtrcvEFrErrnTrcv4
        OpEventGetEventFreezeFrameDataEx_GetEventFreezeFrameDataEx_Event_FrtrcvEFrErrnTrcv4: RteEventRef=OpEventGetEventFreezeFrameDataEx_GetEventFreezeFrameDataEx_Event_FrtrcvEFrErrnTrcv4
        OpEventGetEventFreezeFrameDataEx_GetEventFreezeFrameDataEx_EvtInfo_FrtrcvEFrErrnTrcv3: RteEventRef=OpEventGetEventFreezeFrameDataEx_GetEventFreezeFrameDataEx_EvtInfo_FrtrcvEFrErrnTrcv3
        OpEventGetEventFreezeFrameDataEx_GetEventFreezeFrameDataEx_Event_FrtrcvEFrErrnTrcv3: RteEventRef=OpEventGetEventFreezeFrameDataEx_GetEventFreezeFrameDataEx_Event_FrtrcvEFrErrnTrcv3
        OpEventGetEventFreezeFrameDataEx_GetEventFreezeFrameDataEx_EvtInfo_FrtrcvEFrErrnTrcv6: RteEventRef=OpEventGetEventFreezeFrameDataEx_GetEventFreezeFrameDataEx_EvtInfo_FrtrcvEFrErrnTrcv6
        OpEventGetEventFreezeFrameDataEx_GetEventFreezeFrameDataEx_Event_FrtrcvEFrErrnTrcv6: RteEventRef=OpEventGetEventFreezeFrameDataEx_GetEventFreezeFrameDataEx_Event_FrtrcvEFrErrnTrcv6
        OpEventGetEventFreezeFrameDataEx_GetEventFreezeFrameDataEx_EvtInfo_FrtrcvEFrErrnTrcv5: RteEventRef=OpEventGetEventFreezeFrameDataEx_GetEventFreezeFrameDataEx_EvtInfo_FrtrcvEFrErrnTrcv5
        OpEventGetEventFreezeFrameDataEx_GetEventFreezeFrameDataEx_Event_FrtrcvEFrErrnTrcv5: RteEventRef=OpEventGetEventFreezeFrameDataEx_GetEventFreezeFrameDataEx_Event_FrtrcvEFrErrnTrcv5
        OpEventGetEventFreezeFrameDataEx_GetEventFreezeFrameDataEx_EvtInfo_CansmEBusBodyCanOff: RteEventRef=OpEventGetEventFreezeFrameDataEx_GetEventFreezeFrameDataEx_EvtInfo_CansmEBusBodyCanOff
        OpEventGetEventFreezeFrameDataEx_GetEventFreezeFrameDataEx_Event_CansmEBusBodyCanOff: RteEventRef=OpEventGetEventFreezeFrameDataEx_GetEventFreezeFrameDataEx_Event_CansmEBusBodyCanOff
        OpEventGetEventFreezeFrameDataEx_GetEventFreezeFrameDataEx_EvtInfo_CbsReplacementValue: RteEventRef=OpEventGetEventFreezeFrameDataEx_GetEventFreezeFrameDataEx_EvtInfo_CbsReplacementValue
        OpEventGetEventFreezeFrameDataEx_GetEventFreezeFrameDataEx_Event_CbsReplacementValue: RteEventRef=OpEventGetEventFreezeFrameDataEx_GetEventFreezeFrameDataEx_Event_CbsReplacementValue
        OpEventGetEventFreezeFrameDataEx_GetEventFreezeFrameDataEx_EvtInfo_CansmEBusLeCanOff: RteEventRef=OpEventGetEventFreezeFrameDataEx_GetEventFreezeFrameDataEx_EvtInfo_CansmEBusLeCanOff
        OpEventGetEventFreezeFrameDataEx_GetEventFreezeFrameDataEx_Event_CansmEBusLeCanOff: RteEventRef=OpEventGetEventFreezeFrameDataEx_GetEventFreezeFrameDataEx_Event_CansmEBusLeCanOff
        OpEventGetEventFreezeFrameDataEx_GetEventFreezeFrameDataEx_EvtInfo_CansmEBusZsgCanOff: RteEventRef=OpEventGetEventFreezeFrameDataEx_GetEventFreezeFrameDataEx_EvtInfo_CansmEBusZsgCanOff
        OpEventGetEventFreezeFrameDataEx_GetEventFreezeFrameDataEx_Event_CansmEBusZsgCanOff: RteEventRef=OpEventGetEventFreezeFrameDataEx_GetEventFreezeFrameDataEx_Event_CansmEBusZsgCanOff
        OpEventGetEventFreezeFrameDataEx_GetEventFreezeFrameDataEx_EvtInfo_CodingEventWrongVehicle: RteEventRef=OpEventGetEventFreezeFrameDataEx_GetEventFreezeFrameDataEx_EvtInfo_CodingEventWrongVehicle
        OpEventGetEventFreezeFrameDataEx_GetEventFreezeFrameDataEx_Event_CodingEventWrongVehicle: RteEventRef=OpEventGetEventFreezeFrameDataEx_GetEventFreezeFrameDataEx_Event_CodingEventWrongVehicle
        OpEventGetEventFreezeFrameDataEx_GetEventFreezeFrameDataEx_EvtInfo_FrsmEClusterStartup: RteEventRef=OpEventGetEventFreezeFrameDataEx_GetEventFreezeFrameDataEx_EvtInfo_FrsmEClusterStartup
        OpEventGetEventFreezeFrameDataEx_GetEventFreezeFrameDataEx_Event_FrsmEClusterStartup: RteEventRef=OpEventGetEventFreezeFrameDataEx_GetEventFreezeFrameDataEx_Event_FrsmEClusterStartup
        OpEventGetEventFreezeFrameDataEx_GetEventFreezeFrameDataEx_EvtInfo_CansmEBusACanOff: RteEventRef=OpEventGetEventFreezeFrameDataEx_GetEventFreezeFrameDataEx_EvtInfo_CansmEBusACanOff
        OpEventGetEventFreezeFrameDataEx_GetEventFreezeFrameDataEx_Event_CansmEBusACanOff: RteEventRef=OpEventGetEventFreezeFrameDataEx_GetEventFreezeFrameDataEx_Event_CansmEBusACanOff
        OpEventGetEventFreezeFrameDataEx_GetEventFreezeFrameDataEx_EvtInfo_CansmEBusKCanOff: RteEventRef=OpEventGetEventFreezeFrameDataEx_GetEventFreezeFrameDataEx_EvtInfo_CansmEBusKCanOff
        OpEventGetEventFreezeFrameDataEx_GetEventFreezeFrameDataEx_Event_CansmEBusKCanOff: RteEventRef=OpEventGetEventFreezeFrameDataEx_GetEventFreezeFrameDataEx_Event_CansmEBusKCanOff
        OpEventGetEventFreezeFrameDataEx_GetEventFreezeFrameDataEx_EvtInfo_CantrcvEBusKCanError: RteEventRef=OpEventGetEventFreezeFrameDataEx_GetEventFreezeFrameDataEx_EvtInfo_CantrcvEBusKCanError
        OpEventGetEventFreezeFrameDataEx_GetEventFreezeFrameDataEx_Event_CantrcvEBusKCanError: RteEventRef=OpEventGetEventFreezeFrameDataEx_GetEventFreezeFrameDataEx_Event_CantrcvEBusKCanError
        OpEventGetEventFreezeFrameDataEx_GetEventFreezeFrameDataEx_EvtInfo_FrtrcvEFrBuserrorTrcv0: RteEventRef=OpEventGetEventFreezeFrameDataEx_GetEventFreezeFrameDataEx_EvtInfo_FrtrcvEFrBuserrorTrcv0
        OpEventGetEventFreezeFrameDataEx_GetEventFreezeFrameDataEx_Event_FrtrcvEFrBuserrorTrcv0: RteEventRef=OpEventGetEventFreezeFrameDataEx_GetEventFreezeFrameDataEx_Event_FrtrcvEFrBuserrorTrcv0
        OpEventGetEventFreezeFrameDataEx_GetEventFreezeFrameDataEx_EvtInfo_FrtrcvEFrErrnTrcv7: RteEventRef=OpEventGetEventFreezeFrameDataEx_GetEventFreezeFrameDataEx_EvtInfo_FrtrcvEFrErrnTrcv7
        OpEventGetEventFreezeFrameDataEx_GetEventFreezeFrameDataEx_Event_FrtrcvEFrErrnTrcv7: RteEventRef=OpEventGetEventFreezeFrameDataEx_GetEventFreezeFrameDataEx_Event_FrtrcvEFrErrnTrcv7
        OpEventGetEventFreezeFrameDataEx_GetEventFreezeFrameDataEx_EvtInfo_CansmEBusFaCanOff: RteEventRef=OpEventGetEventFreezeFrameDataEx_GetEventFreezeFrameDataEx_EvtInfo_CansmEBusFaCanOff
        OpEventGetEventFreezeFrameDataEx_GetEventFreezeFrameDataEx_Event_CansmEBusFaCanOff: RteEventRef=OpEventGetEventFreezeFrameDataEx_GetEventFreezeFrameDataEx_Event_CansmEBusFaCanOff
        OpEventGetEventFreezeFrameDataEx_GetEventFreezeFrameDataEx_EvtInfo_CantrcvEBusB2CanError: RteEventRef=OpEventGetEventFreezeFrameDataEx_GetEventFreezeFrameDataEx_EvtInfo_CantrcvEBusB2CanError
        OpEventGetEventFreezeFrameDataEx_GetEventFreezeFrameDataEx_Event_CantrcvEBusB2CanError: RteEventRef=OpEventGetEventFreezeFrameDataEx_GetEventFreezeFrameDataEx_Event_CantrcvEBusB2CanError
        OpEventGetEventFreezeFrameDataEx_GetEventFreezeFrameDataEx_EvtInfo_DtcCd0605: RteEventRef=OpEventGetEventFreezeFrameDataEx_GetEventFreezeFrameDataEx_EvtInfo_DtcCd0605
        OpEventGetEventFreezeFrameDataEx_GetEventFreezeFrameDataEx_Event_DtcCd0605: RteEventRef=OpEventGetEventFreezeFrameDataEx_GetEventFreezeFrameDataEx_Event_DtcCd0605
        OpEventGetEventFreezeFrameDataEx_GetEventFreezeFrameDataEx_EvtInfo_DtcCd0606: RteEventRef=OpEventGetEventFreezeFrameDataEx_GetEventFreezeFrameDataEx_EvtInfo_DtcCd0606
        OpEventGetEventFreezeFrameDataEx_GetEventFreezeFrameDataEx_Event_DtcCd0606: RteEventRef=OpEventGetEventFreezeFrameDataEx_GetEventFreezeFrameDataEx_Event_DtcCd0606
        OpEventGetEventFreezeFrameDataEx_GetEventFreezeFrameDataEx_EvtInfo_DtcCd0607: RteEventRef=OpEventGetEventFreezeFrameDataEx_GetEventFreezeFrameDataEx_EvtInfo_DtcCd0607
        OpEventGetEventFreezeFrameDataEx_GetEventFreezeFrameDataEx_Event_DtcCd0607: RteEventRef=OpEventGetEventFreezeFrameDataEx_GetEventFreezeFrameDataEx_Event_DtcCd0607
        OpEventGetEventFreezeFrameDataEx_GetEventFreezeFrameDataEx_EvtInfo_PiaEIoError: RteEventRef=OpEventGetEventFreezeFrameDataEx_GetEventFreezeFrameDataEx_EvtInfo_PiaEIoError
        OpEventGetEventFreezeFrameDataEx_GetEventFreezeFrameDataEx_Event_PiaEIoError: RteEventRef=OpEventGetEventFreezeFrameDataEx_GetEventFreezeFrameDataEx_Event_PiaEIoError
        OpEventGetEventFreezeFrameDataEx_GetEventFreezeFrameDataEx_EvtInfo_DtcCd0601: RteEventRef=OpEventGetEventFreezeFrameDataEx_GetEventFreezeFrameDataEx_EvtInfo_DtcCd0601
        OpEventGetEventFreezeFrameDataEx_GetEventFreezeFrameDataEx_Event_DtcCd0601: RteEventRef=OpEventGetEventFreezeFrameDataEx_GetEventFreezeFrameDataEx_Event_DtcCd0601
        OpEventGetEventFreezeFrameDataEx_GetEventFreezeFrameDataEx_EvtInfo_SwtExternalCheckFailure: RteEventRef=OpEventGetEventFreezeFrameDataEx_GetEventFreezeFrameDataEx_EvtInfo_SwtExternalCheckFailure
        OpEventGetEventFreezeFrameDataEx_GetEventFreezeFrameDataEx_Event_SwtExternalCheckFailure: RteEventRef=OpEventGetEventFreezeFrameDataEx_GetEventFreezeFrameDataEx_Event_SwtExternalCheckFailure
        OpEventGetEventFreezeFrameDataEx_GetEventFreezeFrameDataEx_EvtInfo_CantrcvEBusBodyCanError: RteEventRef=OpEventGetEventFreezeFrameDataEx_GetEventFreezeFrameDataEx_EvtInfo_CantrcvEBusBodyCanError
        OpEventGetEventFreezeFrameDataEx_GetEventFreezeFrameDataEx_Event_CantrcvEBusBodyCanError: RteEventRef=OpEventGetEventFreezeFrameDataEx_GetEventFreezeFrameDataEx_Event_CantrcvEBusBodyCanError
        OpEventGetEventFreezeFrameDataEx_GetEventFreezeFrameDataEx_EvtInfo_CantrcvEBusIukError: RteEventRef=OpEventGetEventFreezeFrameDataEx_GetEventFreezeFrameDataEx_EvtInfo_CantrcvEBusIukError
        OpEventGetEventFreezeFrameDataEx_GetEventFreezeFrameDataEx_Event_CantrcvEBusIukError: RteEventRef=OpEventGetEventFreezeFrameDataEx_GetEventFreezeFrameDataEx_Event_CantrcvEBusIukError
        OpEventGetEventFreezeFrameDataEx_GetEventFreezeFrameDataEx_EvtInfo_SwtInternalCheckFailure: RteEventRef=OpEventGetEventFreezeFrameDataEx_GetEventFreezeFrameDataEx_EvtInfo_SwtInternalCheckFailure
        OpEventGetEventFreezeFrameDataEx_GetEventFreezeFrameDataEx_Event_SwtInternalCheckFailure: RteEventRef=OpEventGetEventFreezeFrameDataEx_GetEventFreezeFrameDataEx_Event_SwtInternalCheckFailure
        OpEventGetEventFreezeFrameDataEx_GetEventFreezeFrameDataEx_EvtInfo_DmTestAppl: RteEventRef=OpEventGetEventFreezeFrameDataEx_GetEventFreezeFrameDataEx_EvtInfo_DmTestAppl
        OpEventGetEventFreezeFrameDataEx_GetEventFreezeFrameDataEx_Event_DmTestAppl: RteEventRef=OpEventGetEventFreezeFrameDataEx_GetEventFreezeFrameDataEx_Event_DmTestAppl
        OpEventGetEventFreezeFrameDataEx_GetEventFreezeFrameDataEx_EvtInfo_Dtc000032: RteEventRef=OpEventGetEventFreezeFrameDataEx_GetEventFreezeFrameDataEx_EvtInfo_Dtc000032
        OpEventGetEventFreezeFrameDataEx_GetEventFreezeFrameDataEx_Event_Dtc000032: RteEventRef=OpEventGetEventFreezeFrameDataEx_GetEventFreezeFrameDataEx_Event_Dtc000032
        OpEventGetEventFreezeFrameDataEx_GetEventFreezeFrameDataEx_EvtInfo_Dtc000031: RteEventRef=OpEventGetEventFreezeFrameDataEx_GetEventFreezeFrameDataEx_EvtInfo_Dtc000031
        OpEventGetEventFreezeFrameDataEx_GetEventFreezeFrameDataEx_Event_Dtc000031: RteEventRef=OpEventGetEventFreezeFrameDataEx_GetEventFreezeFrameDataEx_Event_Dtc000031
        OpEventGetEventFreezeFrameDataEx_GetEventFreezeFrameDataEx_EvtInfo_FrsmEClusterSyncLoss: RteEventRef=OpEventGetEventFreezeFrameDataEx_GetEventFreezeFrameDataEx_EvtInfo_FrsmEClusterSyncLoss
        OpEventGetEventFreezeFrameDataEx_GetEventFreezeFrameDataEx_Event_FrsmEClusterSyncLoss: RteEventRef=OpEventGetEventFreezeFrameDataEx_GetEventFreezeFrameDataEx_Event_FrsmEClusterSyncLoss
        OpEventGetEventFreezeFrameDataEx_GetEventFreezeFrameDataEx_EvtInfo_Dtc000030: RteEventRef=OpEventGetEventFreezeFrameDataEx_GetEventFreezeFrameDataEx_EvtInfo_Dtc000030
        OpEventGetEventFreezeFrameDataEx_GetEventFreezeFrameDataEx_Event_Dtc000030: RteEventRef=OpEventGetEventFreezeFrameDataEx_GetEventFreezeFrameDataEx_Event_Dtc000030
        OpEventGetEventFreezeFrameDataEx_GetEventFreezeFrameDataEx_EvtInfo_Dtc000034: RteEventRef=OpEventGetEventFreezeFrameDataEx_GetEventFreezeFrameDataEx_EvtInfo_Dtc000034
        OpEventGetEventFreezeFrameDataEx_GetEventFreezeFrameDataEx_Event_Dtc000034: RteEventRef=OpEventGetEventFreezeFrameDataEx_GetEventFreezeFrameDataEx_Event_Dtc000034
        OpEventGetEventFreezeFrameDataEx_GetEventFreezeFrameDataEx_EvtInfo_Dtc000033: RteEventRef=OpEventGetEventFreezeFrameDataEx_GetEventFreezeFrameDataEx_EvtInfo_Dtc000033
        OpEventGetEventFreezeFrameDataEx_GetEventFreezeFrameDataEx_Event_Dtc000033: RteEventRef=OpEventGetEventFreezeFrameDataEx_GetEventFreezeFrameDataEx_Event_Dtc000033
        OpEventGetEventFreezeFrameDataEx_GetEventFreezeFrameDataEx_EvtInfo_Undervoltage: RteEventRef=OpEventGetEventFreezeFrameDataEx_GetEventFreezeFrameDataEx_EvtInfo_Undervoltage
        OpEventGetEventFreezeFrameDataEx_GetEventFreezeFrameDataEx_Event_Undervoltage: RteEventRef=OpEventGetEventFreezeFrameDataEx_GetEventFreezeFrameDataEx_Event_Undervoltage
        OpEventGetEventFreezeFrameDataEx_GetEventFreezeFrameDataEx_EvtInfo_CodingEventTransactionFailed: RteEventRef=OpEventGetEventFreezeFrameDataEx_GetEventFreezeFrameDataEx_EvtInfo_CodingEventTransactionFailed
        OpEventGetEventFreezeFrameDataEx_GetEventFreezeFrameDataEx_Event_CodingEventTransactionFailed: RteEventRef=OpEventGetEventFreezeFrameDataEx_GetEventFreezeFrameDataEx_Event_CodingEventTransactionFailed
        OpEventGetEventFreezeFrameDataEx_GetEventFreezeFrameDataEx_EvtInfo_FrifENitChA: RteEventRef=OpEventGetEventFreezeFrameDataEx_GetEventFreezeFrameDataEx_EvtInfo_FrifENitChA
        OpEventGetEventFreezeFrameDataEx_GetEventFreezeFrameDataEx_Event_FrifENitChA: RteEventRef=OpEventGetEventFreezeFrameDataEx_GetEventFreezeFrameDataEx_Event_FrifENitChA
        OpEventGetEventFreezeFrameDataEx_GetEventFreezeFrameDataEx_EvtInfo_CansmEBusLpCanOff: RteEventRef=OpEventGetEventFreezeFrameDataEx_GetEventFreezeFrameDataEx_EvtInfo_CansmEBusLpCanOff
        OpEventGetEventFreezeFrameDataEx_GetEventFreezeFrameDataEx_Event_CansmEBusLpCanOff: RteEventRef=OpEventGetEventFreezeFrameDataEx_GetEventFreezeFrameDataEx_Event_CansmEBusLpCanOff
        OpEventGetEventFreezeFrameDataEx_GetEventFreezeFrameDataEx_EvtInfo_NVM_E_HARDWARE: RteEventRef=OpEventGetEventFreezeFrameDataEx_GetEventFreezeFrameDataEx_EvtInfo_NVM_E_HARDWARE
        OpEventGetEventFreezeFrameDataEx_GetEventFreezeFrameDataEx_EvtInfo_VsmEventOpmode: RteEventRef=OpEventGetEventFreezeFrameDataEx_GetEventFreezeFrameDataEx_EvtInfo_VsmEventOpmode
        OpEventGetEventFreezeFrameDataEx_GetEventFreezeFrameDataEx_Event_VsmEventOpmode: RteEventRef=OpEventGetEventFreezeFrameDataEx_GetEventFreezeFrameDataEx_Event_VsmEventOpmode
        OpEventGetEventFreezeFrameDataEx_GetEventFreezeFrameDataEx_EvtInfo_LIN_E_TIMEOUT: RteEventRef=OpEventGetEventFreezeFrameDataEx_GetEventFreezeFrameDataEx_EvtInfo_LIN_E_TIMEOUT
        OpEventGetEventFreezeFrameDataEx_GetEventFreezeFrameDataEx_EvtInfo_CantrcvEBusACanError: RteEventRef=OpEventGetEventFreezeFrameDataEx_GetEventFreezeFrameDataEx_EvtInfo_CantrcvEBusACanError
        OpEventGetEventFreezeFrameDataEx_GetEventFreezeFrameDataEx_Event_CantrcvEBusACanError: RteEventRef=OpEventGetEventFreezeFrameDataEx_GetEventFreezeFrameDataEx_Event_CantrcvEBusACanError
        OpEventGetEventFreezeFrameDataEx_GetEventFreezeFrameDataEx_EvtInfo_UDPNM_E_TCPIP_TRANSMIT_ERROR: RteEventRef=OpEventGetEventFreezeFrameDataEx_GetEventFreezeFrameDataEx_EvtInfo_UDPNM_E_TCPIP_TRANSMIT_ERROR
        OpEventGetEventFreezeFrameDataEx_GetEventFreezeFrameDataEx_EvtInfo_DmTestCom: RteEventRef=OpEventGetEventFreezeFrameDataEx_GetEventFreezeFrameDataEx_EvtInfo_DmTestCom
        OpEventGetEventFreezeFrameDataEx_GetEventFreezeFrameDataEx_Event_DmTestCom: RteEventRef=OpEventGetEventFreezeFrameDataEx_GetEventFreezeFrameDataEx_Event_DmTestCom
        OpEventGetEventFreezeFrameDataEx_GetEventFreezeFrameDataEx_EvtInfo_CodingEventSignatureError: RteEventRef=OpEventGetEventFreezeFrameDataEx_GetEventFreezeFrameDataEx_EvtInfo_CodingEventSignatureError
        OpEventGetEventFreezeFrameDataEx_GetEventFreezeFrameDataEx_Event_CodingEventSignatureError: RteEventRef=OpEventGetEventFreezeFrameDataEx_GetEventFreezeFrameDataEx_Event_CodingEventSignatureError
        OpEventGetEventFreezeFrameDataEx_GetEventFreezeFrameDataEx_EvtInfo_CodingEventUnqualifiedData: RteEventRef=OpEventGetEventFreezeFrameDataEx_GetEventFreezeFrameDataEx_EvtInfo_CodingEventUnqualifiedData
        OpEventGetEventFreezeFrameDataEx_GetEventFreezeFrameDataEx_Event_CodingEventUnqualifiedData: RteEventRef=OpEventGetEventFreezeFrameDataEx_GetEventFreezeFrameDataEx_Event_CodingEventUnqualifiedData
        OpEventGetEventFreezeFrameDataEx_GetEventFreezeFrameDataEx_EvtInfo_CodingEventInvalidData: RteEventRef=OpEventGetEventFreezeFrameDataEx_GetEventFreezeFrameDataEx_EvtInfo_CodingEventInvalidData
        OpEventGetEventFreezeFrameDataEx_GetEventFreezeFrameDataEx_Event_CodingEventInvalidData: RteEventRef=OpEventGetEventFreezeFrameDataEx_GetEventFreezeFrameDataEx_Event_CodingEventInvalidData
        OpEventGetEventFreezeFrameDataEx_GetEventFreezeFrameDataEx_EvtInfo_CansmEBusB2CanOff: RteEventRef=OpEventGetEventFreezeFrameDataEx_GetEventFreezeFrameDataEx_EvtInfo_CansmEBusB2CanOff
        OpEventGetEventFreezeFrameDataEx_GetEventFreezeFrameDataEx_Event_CansmEBusB2CanOff: RteEventRef=OpEventGetEventFreezeFrameDataEx_GetEventFreezeFrameDataEx_Event_CansmEBusB2CanOff
        OpEventGetEventFreezeFrameDataEx_GetEventFreezeFrameDataEx_EvtInfo_Overvoltage: RteEventRef=OpEventGetEventFreezeFrameDataEx_GetEventFreezeFrameDataEx_EvtInfo_Overvoltage
        OpEventGetEventFreezeFrameDataEx_GetEventFreezeFrameDataEx_Event_Overvoltage: RteEventRef=OpEventGetEventFreezeFrameDataEx_GetEventFreezeFrameDataEx_Event_Overvoltage
        OpEventGetEventFreezeFrameDataEx_GetEventFreezeFrameDataEx_EvtInfo_CodingEventNotCoded: RteEventRef=OpEventGetEventFreezeFrameDataEx_GetEventFreezeFrameDataEx_EvtInfo_CodingEventNotCoded
        OpEventGetEventFreezeFrameDataEx_GetEventFreezeFrameDataEx_Event_CodingEventNotCoded: RteEventRef=OpEventGetEventFreezeFrameDataEx_GetEventFreezeFrameDataEx_Event_CodingEventNotCoded
        OpEventGetEventFreezeFrameDataEx_GetEventFreezeFrameDataEx_EvtInfo_FrifEAcsChA: RteEventRef=OpEventGetEventFreezeFrameDataEx_GetEventFreezeFrameDataEx_EvtInfo_FrifEAcsChA
        OpEventGetEventFreezeFrameDataEx_GetEventFreezeFrameDataEx_Event_FrifEAcsChA: RteEventRef=OpEventGetEventFreezeFrameDataEx_GetEventFreezeFrameDataEx_Event_FrifEAcsChA
        OpEventGetEventFreezeFrameDataEx_GetEventFreezeFrameDataEx_EvtInfo_CantrcvEBusFaCanError: RteEventRef=OpEventGetEventFreezeFrameDataEx_GetEventFreezeFrameDataEx_EvtInfo_CantrcvEBusFaCanError
        OpEventGetEventFreezeFrameDataEx_GetEventFreezeFrameDataEx_Event_CantrcvEBusFaCanError: RteEventRef=OpEventGetEventFreezeFrameDataEx_GetEventFreezeFrameDataEx_Event_CantrcvEBusFaCanError
        OpEventGetEventFreezeFrameDataEx_GetEventFreezeFrameDataEx_EvtInfo_CantrcvEBusLeCanError: RteEventRef=OpEventGetEventFreezeFrameDataEx_GetEventFreezeFrameDataEx_EvtInfo_CantrcvEBusLeCanError
        OpEventGetEventFreezeFrameDataEx_GetEventFreezeFrameDataEx_Event_CantrcvEBusLeCanError: RteEventRef=OpEventGetEventFreezeFrameDataEx_GetEventFreezeFrameDataEx_Event_CantrcvEBusLeCanError
        OpEventGetEventFreezeFrameDataEx_GetEventFreezeFrameDataEx_EvtInfo_CantrcvEBusLpCanError: RteEventRef=OpEventGetEventFreezeFrameDataEx_GetEventFreezeFrameDataEx_EvtInfo_CantrcvEBusLpCanError
        OpEventGetEventFreezeFrameDataEx_GetEventFreezeFrameDataEx_Event_CantrcvEBusLpCanError: RteEventRef=OpEventGetEventFreezeFrameDataEx_GetEventFreezeFrameDataEx_Event_CantrcvEBusLpCanError
        OpEventGetEventFreezeFrameDataEx_GetEventFreezeFrameDataEx_EvtInfo_CantrcvEBusZsgCanError: RteEventRef=OpEventGetEventFreezeFrameDataEx_GetEventFreezeFrameDataEx_EvtInfo_CantrcvEBusZsgCanError
        OpEventGetEventFreezeFrameDataEx_GetEventFreezeFrameDataEx_Event_CantrcvEBusZsgCanError: RteEventRef=OpEventGetEventFreezeFrameDataEx_GetEventFreezeFrameDataEx_Event_CantrcvEBusZsgCanError
        OpEventGetEventFreezeFrameDataEx_GetEventFreezeFrameDataEx_EvtInfo_EthSignalQualityLow: RteEventRef=OpEventGetEventFreezeFrameDataEx_GetEventFreezeFrameDataEx_EvtInfo_EthSignalQualityLow
        OpEventGetEventFreezeFrameDataEx_GetEventFreezeFrameDataEx_Event_EthSignalQualityLow: RteEventRef=OpEventGetEventFreezeFrameDataEx_GetEventFreezeFrameDataEx_Event_EthSignalQualityLow
        OpEventGetEventFreezeFrameDataEx_GetEventFreezeFrameDataEx_EvtInfo_DemEventParameter_FlsConfigSet_FLS_E_COMPARE_FAILED: RteEventRef=OpEventGetEventFreezeFrameDataEx_GetEventFreezeFrameDataEx_EvtInfo_DemEventParameter_FlsConfigSet_FLS_E_COMPARE_FAILED
        OpEventGetEventFreezeFrameDataEx_GetEventFreezeFrameDataEx_EvtInfo_DemEventParameter_FlsConfigSet_FLS_E_ERASE_FAILED: RteEventRef=OpEventGetEventFreezeFrameDataEx_GetEventFreezeFrameDataEx_EvtInfo_DemEventParameter_FlsConfigSet_FLS_E_ERASE_FAILED
        OpEventGetEventFreezeFrameDataEx_GetEventFreezeFrameDataEx_EvtInfo_DemEventParameter_FlsConfigSet_FLS_E_READ_FAILED: RteEventRef=OpEventGetEventFreezeFrameDataEx_GetEventFreezeFrameDataEx_EvtInfo_DemEventParameter_FlsConfigSet_FLS_E_READ_FAILED
        OpEventGetEventFreezeFrameDataEx_GetEventFreezeFrameDataEx_EvtInfo_DemEventParameter_FlsConfigSet_FLS_E_WRITE_FAILED: RteEventRef=OpEventGetEventFreezeFrameDataEx_GetEventFreezeFrameDataEx_EvtInfo_DemEventParameter_FlsConfigSet_FLS_E_WRITE_FAILED
        OpEventGetEventFreezeFrameDataEx_GetEventFreezeFrameDataEx_EvtInfo_DemEventParameter_FlsConfigSet_FLS_E_READ_DED_FAILED: RteEventRef=OpEventGetEventFreezeFrameDataEx_GetEventFreezeFrameDataEx_EvtInfo_DemEventParameter_FlsConfigSet_FLS_E_READ_DED_FAILED
        OpEventGetEventFreezeFrameDataEx_GetEventFreezeFrameDataEx_EvtInfo_DemEventParameter_FlsConfigSet_FLS_E_UNEXPECTED_FLASH_ID: RteEventRef=OpEventGetEventFreezeFrameDataEx_GetEventFreezeFrameDataEx_EvtInfo_DemEventParameter_FlsConfigSet_FLS_E_UNEXPECTED_FLASH_ID
        OpEventGetEventFreezeFrameDataEx_GetEventFreezeFrameDataEx_EvtInfo_DemEventParameter_FlsConfigSet_MCU_E_CLOCK_FAILED: RteEventRef=OpEventGetEventFreezeFrameDataEx_GetEventFreezeFrameDataEx_EvtInfo_DemEventParameter_FlsConfigSet_MCU_E_CLOCK_FAILED
        OpEventGetEventFreezeFrameDataEx_GetEventFreezeFrameDataEx_EvtInfo_DemEventParameter_FlsConfigSet_MCU_E_HW_FAILED: RteEventRef=OpEventGetEventFreezeFrameDataEx_GetEventFreezeFrameDataEx_EvtInfo_DemEventParameter_FlsConfigSet_MCU_E_HW_FAILED
        OpEventGetEventFreezeFrameDataEx_GetEventFreezeFrameDataEx_EvtInfo_DemEventParameter_FlsConfigSet_MCU_E_STARTUP_FAILED: RteEventRef=OpEventGetEventFreezeFrameDataEx_GetEventFreezeFrameDataEx_EvtInfo_DemEventParameter_FlsConfigSet_MCU_E_STARTUP_FAILED
        OpEventGetEventFreezeFrameDataEx_GetEventFreezeFrameDataEx_EvtInfo_DemEventParameter_FlsConfigSet_FLS_E_ECC_FAILED: RteEventRef=OpEventGetEventFreezeFrameDataEx_GetEventFreezeFrameDataEx_EvtInfo_DemEventParameter_FlsConfigSet_FLS_E_ECC_FAILED
        OpEventGetEventFreezeFrameDataEx_GetEventFreezeFrameDataEx_EvtInfo_DemEventParameter_FlsConfigSet_FLS_E_VRFY_FAILED: RteEventRef=OpEventGetEventFreezeFrameDataEx_GetEventFreezeFrameDataEx_EvtInfo_DemEventParameter_FlsConfigSet_FLS_E_VRFY_FAILED
        OpEventGetEventFreezeFrameDataEx_GetEventFreezeFrameDataEx_EvtInfo_DemEventParameter_FlsConfigSet_FLS_E_INT_FAILED: RteEventRef=OpEventGetEventFreezeFrameDataEx_GetEventFreezeFrameDataEx_EvtInfo_DemEventParameter_FlsConfigSet_FLS_E_INT_FAILED
        OpEventGetEventFreezeFrameDataEx_GetEventFreezeFrameDataEx_EvtInfo_DemEventParameter_FlsConfigSet_FLS_E_HW_FAILED: RteEventRef=OpEventGetEventFreezeFrameDataEx_GetEventFreezeFrameDataEx_EvtInfo_DemEventParameter_FlsConfigSet_FLS_E_HW_FAILED
        OpEventGetEventFreezeFrameDataEx_GetEventFreezeFrameDataEx_GeneralEventInfo: RteEventRef=OpEventGetEventFreezeFrameDataEx_GetEventFreezeFrameDataEx_GeneralEventInfo
        OpEventGetEventExtendedDataRecordEx_GetEventExtendedDataRecordEx_EvtInfo_FrtrcvEFrErrnTrcv0: RteEventRef=OpEventGetEventExtendedDataRecordEx_GetEventExtendedDataRecordEx_EvtInfo_FrtrcvEFrErrnTrcv0
        OpEventGetEventExtendedDataRecordEx_GetEventExtendedDataRecordEx_Event_FrtrcvEFrErrnTrcv0: RteEventRef=OpEventGetEventExtendedDataRecordEx_GetEventExtendedDataRecordEx_Event_FrtrcvEFrErrnTrcv0
        OpEventGetEventExtendedDataRecordEx_GetEventExtendedDataRecordEx_EvtInfo_CansmEBusIukCanOff: RteEventRef=OpEventGetEventExtendedDataRecordEx_GetEventExtendedDataRecordEx_EvtInfo_CansmEBusIukCanOff
        OpEventGetEventExtendedDataRecordEx_GetEventExtendedDataRecordEx_Event_CansmEBusIukCanOff: RteEventRef=OpEventGetEventExtendedDataRecordEx_GetEventExtendedDataRecordEx_Event_CansmEBusIukCanOff
        OpEventGetEventExtendedDataRecordEx_GetEventExtendedDataRecordEx_EvtInfo_FrtrcvEFrErrnTrcv2: RteEventRef=OpEventGetEventExtendedDataRecordEx_GetEventExtendedDataRecordEx_EvtInfo_FrtrcvEFrErrnTrcv2
        OpEventGetEventExtendedDataRecordEx_GetEventExtendedDataRecordEx_Event_FrtrcvEFrErrnTrcv2: RteEventRef=OpEventGetEventExtendedDataRecordEx_GetEventExtendedDataRecordEx_Event_FrtrcvEFrErrnTrcv2
        OpEventGetEventExtendedDataRecordEx_GetEventExtendedDataRecordEx_EvtInfo_FrtrcvEFrErrnTrcv1: RteEventRef=OpEventGetEventExtendedDataRecordEx_GetEventExtendedDataRecordEx_EvtInfo_FrtrcvEFrErrnTrcv1
        OpEventGetEventExtendedDataRecordEx_GetEventExtendedDataRecordEx_Event_FrtrcvEFrErrnTrcv1: RteEventRef=OpEventGetEventExtendedDataRecordEx_GetEventExtendedDataRecordEx_Event_FrtrcvEFrErrnTrcv1
        OpEventGetEventExtendedDataRecordEx_GetEventExtendedDataRecordEx_EvtInfo_FrtrcvEFrErrnTrcv4: RteEventRef=OpEventGetEventExtendedDataRecordEx_GetEventExtendedDataRecordEx_EvtInfo_FrtrcvEFrErrnTrcv4
        OpEventGetEventExtendedDataRecordEx_GetEventExtendedDataRecordEx_Event_FrtrcvEFrErrnTrcv4: RteEventRef=OpEventGetEventExtendedDataRecordEx_GetEventExtendedDataRecordEx_Event_FrtrcvEFrErrnTrcv4
        OpEventGetEventExtendedDataRecordEx_GetEventExtendedDataRecordEx_EvtInfo_FrtrcvEFrErrnTrcv3: RteEventRef=OpEventGetEventExtendedDataRecordEx_GetEventExtendedDataRecordEx_EvtInfo_FrtrcvEFrErrnTrcv3
        OpEventGetEventExtendedDataRecordEx_GetEventExtendedDataRecordEx_Event_FrtrcvEFrErrnTrcv3: RteEventRef=OpEventGetEventExtendedDataRecordEx_GetEventExtendedDataRecordEx_Event_FrtrcvEFrErrnTrcv3
        OpEventGetEventExtendedDataRecordEx_GetEventExtendedDataRecordEx_EvtInfo_FrtrcvEFrErrnTrcv6: RteEventRef=OpEventGetEventExtendedDataRecordEx_GetEventExtendedDataRecordEx_EvtInfo_FrtrcvEFrErrnTrcv6
        OpEventGetEventExtendedDataRecordEx_GetEventExtendedDataRecordEx_Event_FrtrcvEFrErrnTrcv6: RteEventRef=OpEventGetEventExtendedDataRecordEx_GetEventExtendedDataRecordEx_Event_FrtrcvEFrErrnTrcv6
        OpEventGetEventExtendedDataRecordEx_GetEventExtendedDataRecordEx_EvtInfo_FrtrcvEFrErrnTrcv5: RteEventRef=OpEventGetEventExtendedDataRecordEx_GetEventExtendedDataRecordEx_EvtInfo_FrtrcvEFrErrnTrcv5
        OpEventGetEventExtendedDataRecordEx_GetEventExtendedDataRecordEx_Event_FrtrcvEFrErrnTrcv5: RteEventRef=OpEventGetEventExtendedDataRecordEx_GetEventExtendedDataRecordEx_Event_FrtrcvEFrErrnTrcv5
        OpEventGetEventExtendedDataRecordEx_GetEventExtendedDataRecordEx_EvtInfo_CansmEBusBodyCanOff: RteEventRef=OpEventGetEventExtendedDataRecordEx_GetEventExtendedDataRecordEx_EvtInfo_CansmEBusBodyCanOff
        OpEventGetEventExtendedDataRecordEx_GetEventExtendedDataRecordEx_Event_CansmEBusBodyCanOff: RteEventRef=OpEventGetEventExtendedDataRecordEx_GetEventExtendedDataRecordEx_Event_CansmEBusBodyCanOff
        OpEventGetEventExtendedDataRecordEx_GetEventExtendedDataRecordEx_EvtInfo_CbsReplacementValue: RteEventRef=OpEventGetEventExtendedDataRecordEx_GetEventExtendedDataRecordEx_EvtInfo_CbsReplacementValue
        OpEventGetEventExtendedDataRecordEx_GetEventExtendedDataRecordEx_Event_CbsReplacementValue: RteEventRef=OpEventGetEventExtendedDataRecordEx_GetEventExtendedDataRecordEx_Event_CbsReplacementValue
        OpEventGetEventExtendedDataRecordEx_GetEventExtendedDataRecordEx_EvtInfo_CansmEBusLeCanOff: RteEventRef=OpEventGetEventExtendedDataRecordEx_GetEventExtendedDataRecordEx_EvtInfo_CansmEBusLeCanOff
        OpEventGetEventExtendedDataRecordEx_GetEventExtendedDataRecordEx_Event_CansmEBusLeCanOff: RteEventRef=OpEventGetEventExtendedDataRecordEx_GetEventExtendedDataRecordEx_Event_CansmEBusLeCanOff
        OpEventGetEventExtendedDataRecordEx_GetEventExtendedDataRecordEx_EvtInfo_CansmEBusZsgCanOff: RteEventRef=OpEventGetEventExtendedDataRecordEx_GetEventExtendedDataRecordEx_EvtInfo_CansmEBusZsgCanOff
        OpEventGetEventExtendedDataRecordEx_GetEventExtendedDataRecordEx_Event_CansmEBusZsgCanOff: RteEventRef=OpEventGetEventExtendedDataRecordEx_GetEventExtendedDataRecordEx_Event_CansmEBusZsgCanOff
        OpEventGetEventExtendedDataRecordEx_GetEventExtendedDataRecordEx_EvtInfo_CodingEventWrongVehicle: RteEventRef=OpEventGetEventExtendedDataRecordEx_GetEventExtendedDataRecordEx_EvtInfo_CodingEventWrongVehicle
        OpEventGetEventExtendedDataRecordEx_GetEventExtendedDataRecordEx_Event_CodingEventWrongVehicle: RteEventRef=OpEventGetEventExtendedDataRecordEx_GetEventExtendedDataRecordEx_Event_CodingEventWrongVehicle
        OpEventGetEventExtendedDataRecordEx_GetEventExtendedDataRecordEx_EvtInfo_FrsmEClusterStartup: RteEventRef=OpEventGetEventExtendedDataRecordEx_GetEventExtendedDataRecordEx_EvtInfo_FrsmEClusterStartup
        OpEventGetEventExtendedDataRecordEx_GetEventExtendedDataRecordEx_Event_FrsmEClusterStartup: RteEventRef=OpEventGetEventExtendedDataRecordEx_GetEventExtendedDataRecordEx_Event_FrsmEClusterStartup
        OpEventGetEventExtendedDataRecordEx_GetEventExtendedDataRecordEx_EvtInfo_CansmEBusACanOff: RteEventRef=OpEventGetEventExtendedDataRecordEx_GetEventExtendedDataRecordEx_EvtInfo_CansmEBusACanOff
        OpEventGetEventExtendedDataRecordEx_GetEventExtendedDataRecordEx_Event_CansmEBusACanOff: RteEventRef=OpEventGetEventExtendedDataRecordEx_GetEventExtendedDataRecordEx_Event_CansmEBusACanOff
        OpEventGetEventExtendedDataRecordEx_GetEventExtendedDataRecordEx_EvtInfo_CansmEBusKCanOff: RteEventRef=OpEventGetEventExtendedDataRecordEx_GetEventExtendedDataRecordEx_EvtInfo_CansmEBusKCanOff
        OpEventGetEventExtendedDataRecordEx_GetEventExtendedDataRecordEx_Event_CansmEBusKCanOff: RteEventRef=OpEventGetEventExtendedDataRecordEx_GetEventExtendedDataRecordEx_Event_CansmEBusKCanOff
        OpEventGetEventExtendedDataRecordEx_GetEventExtendedDataRecordEx_EvtInfo_CantrcvEBusKCanError: RteEventRef=OpEventGetEventExtendedDataRecordEx_GetEventExtendedDataRecordEx_EvtInfo_CantrcvEBusKCanError
        OpEventGetEventExtendedDataRecordEx_GetEventExtendedDataRecordEx_Event_CantrcvEBusKCanError: RteEventRef=OpEventGetEventExtendedDataRecordEx_GetEventExtendedDataRecordEx_Event_CantrcvEBusKCanError
        OpEventGetEventExtendedDataRecordEx_GetEventExtendedDataRecordEx_EvtInfo_FrtrcvEFrBuserrorTrcv0: RteEventRef=OpEventGetEventExtendedDataRecordEx_GetEventExtendedDataRecordEx_EvtInfo_FrtrcvEFrBuserrorTrcv0
        OpEventGetEventExtendedDataRecordEx_GetEventExtendedDataRecordEx_Event_FrtrcvEFrBuserrorTrcv0: RteEventRef=OpEventGetEventExtendedDataRecordEx_GetEventExtendedDataRecordEx_Event_FrtrcvEFrBuserrorTrcv0
        OpEventGetEventExtendedDataRecordEx_GetEventExtendedDataRecordEx_EvtInfo_FrtrcvEFrErrnTrcv7: RteEventRef=OpEventGetEventExtendedDataRecordEx_GetEventExtendedDataRecordEx_EvtInfo_FrtrcvEFrErrnTrcv7
        OpEventGetEventExtendedDataRecordEx_GetEventExtendedDataRecordEx_Event_FrtrcvEFrErrnTrcv7: RteEventRef=OpEventGetEventExtendedDataRecordEx_GetEventExtendedDataRecordEx_Event_FrtrcvEFrErrnTrcv7
        OpEventGetEventExtendedDataRecordEx_GetEventExtendedDataRecordEx_EvtInfo_CansmEBusFaCanOff: RteEventRef=OpEventGetEventExtendedDataRecordEx_GetEventExtendedDataRecordEx_EvtInfo_CansmEBusFaCanOff
        OpEventGetEventExtendedDataRecordEx_GetEventExtendedDataRecordEx_Event_CansmEBusFaCanOff: RteEventRef=OpEventGetEventExtendedDataRecordEx_GetEventExtendedDataRecordEx_Event_CansmEBusFaCanOff
        OpEventGetEventExtendedDataRecordEx_GetEventExtendedDataRecordEx_EvtInfo_CantrcvEBusB2CanError: RteEventRef=OpEventGetEventExtendedDataRecordEx_GetEventExtendedDataRecordEx_EvtInfo_CantrcvEBusB2CanError
        OpEventGetEventExtendedDataRecordEx_GetEventExtendedDataRecordEx_Event_CantrcvEBusB2CanError: RteEventRef=OpEventGetEventExtendedDataRecordEx_GetEventExtendedDataRecordEx_Event_CantrcvEBusB2CanError
        OpEventGetEventExtendedDataRecordEx_GetEventExtendedDataRecordEx_EvtInfo_DtcCd0605: RteEventRef=OpEventGetEventExtendedDataRecordEx_GetEventExtendedDataRecordEx_EvtInfo_DtcCd0605
        OpEventGetEventExtendedDataRecordEx_GetEventExtendedDataRecordEx_Event_DtcCd0605: RteEventRef=OpEventGetEventExtendedDataRecordEx_GetEventExtendedDataRecordEx_Event_DtcCd0605
        OpEventGetEventExtendedDataRecordEx_GetEventExtendedDataRecordEx_EvtInfo_DtcCd0606: RteEventRef=OpEventGetEventExtendedDataRecordEx_GetEventExtendedDataRecordEx_EvtInfo_DtcCd0606
        OpEventGetEventExtendedDataRecordEx_GetEventExtendedDataRecordEx_Event_DtcCd0606: RteEventRef=OpEventGetEventExtendedDataRecordEx_GetEventExtendedDataRecordEx_Event_DtcCd0606
        OpEventGetEventExtendedDataRecordEx_GetEventExtendedDataRecordEx_EvtInfo_DtcCd0607: RteEventRef=OpEventGetEventExtendedDataRecordEx_GetEventExtendedDataRecordEx_EvtInfo_DtcCd0607
        OpEventGetEventExtendedDataRecordEx_GetEventExtendedDataRecordEx_Event_DtcCd0607: RteEventRef=OpEventGetEventExtendedDataRecordEx_GetEventExtendedDataRecordEx_Event_DtcCd0607
        OpEventGetEventExtendedDataRecordEx_GetEventExtendedDataRecordEx_EvtInfo_PiaEIoError: RteEventRef=OpEventGetEventExtendedDataRecordEx_GetEventExtendedDataRecordEx_EvtInfo_PiaEIoError
        OpEventGetEventExtendedDataRecordEx_GetEventExtendedDataRecordEx_Event_PiaEIoError: RteEventRef=OpEventGetEventExtendedDataRecordEx_GetEventExtendedDataRecordEx_Event_PiaEIoError
        OpEventGetEventExtendedDataRecordEx_GetEventExtendedDataRecordEx_EvtInfo_DtcCd0601: RteEventRef=OpEventGetEventExtendedDataRecordEx_GetEventExtendedDataRecordEx_EvtInfo_DtcCd0601
        OpEventGetEventExtendedDataRecordEx_GetEventExtendedDataRecordEx_Event_DtcCd0601: RteEventRef=OpEventGetEventExtendedDataRecordEx_GetEventExtendedDataRecordEx_Event_DtcCd0601
        OpEventGetEventExtendedDataRecordEx_GetEventExtendedDataRecordEx_EvtInfo_SwtExternalCheckFailure: RteEventRef=OpEventGetEventExtendedDataRecordEx_GetEventExtendedDataRecordEx_EvtInfo_SwtExternalCheckFailure
        OpEventGetEventExtendedDataRecordEx_GetEventExtendedDataRecordEx_Event_SwtExternalCheckFailure: RteEventRef=OpEventGetEventExtendedDataRecordEx_GetEventExtendedDataRecordEx_Event_SwtExternalCheckFailure
        OpEventGetEventExtendedDataRecordEx_GetEventExtendedDataRecordEx_EvtInfo_CantrcvEBusBodyCanError: RteEventRef=OpEventGetEventExtendedDataRecordEx_GetEventExtendedDataRecordEx_EvtInfo_CantrcvEBusBodyCanError
        OpEventGetEventExtendedDataRecordEx_GetEventExtendedDataRecordEx_Event_CantrcvEBusBodyCanError: RteEventRef=OpEventGetEventExtendedDataRecordEx_GetEventExtendedDataRecordEx_Event_CantrcvEBusBodyCanError
        OpEventGetEventExtendedDataRecordEx_GetEventExtendedDataRecordEx_EvtInfo_CantrcvEBusIukError: RteEventRef=OpEventGetEventExtendedDataRecordEx_GetEventExtendedDataRecordEx_EvtInfo_CantrcvEBusIukError
        OpEventGetEventExtendedDataRecordEx_GetEventExtendedDataRecordEx_Event_CantrcvEBusIukError: RteEventRef=OpEventGetEventExtendedDataRecordEx_GetEventExtendedDataRecordEx_Event_CantrcvEBusIukError
        OpEventGetEventExtendedDataRecordEx_GetEventExtendedDataRecordEx_EvtInfo_SwtInternalCheckFailure: RteEventRef=OpEventGetEventExtendedDataRecordEx_GetEventExtendedDataRecordEx_EvtInfo_SwtInternalCheckFailure
        OpEventGetEventExtendedDataRecordEx_GetEventExtendedDataRecordEx_Event_SwtInternalCheckFailure: RteEventRef=OpEventGetEventExtendedDataRecordEx_GetEventExtendedDataRecordEx_Event_SwtInternalCheckFailure
        OpEventGetEventExtendedDataRecordEx_GetEventExtendedDataRecordEx_EvtInfo_DmTestAppl: RteEventRef=OpEventGetEventExtendedDataRecordEx_GetEventExtendedDataRecordEx_EvtInfo_DmTestAppl
        OpEventGetEventExtendedDataRecordEx_GetEventExtendedDataRecordEx_Event_DmTestAppl: RteEventRef=OpEventGetEventExtendedDataRecordEx_GetEventExtendedDataRecordEx_Event_DmTestAppl
        OpEventGetEventExtendedDataRecordEx_GetEventExtendedDataRecordEx_EvtInfo_Dtc000032: RteEventRef=OpEventGetEventExtendedDataRecordEx_GetEventExtendedDataRecordEx_EvtInfo_Dtc000032
        OpEventGetEventExtendedDataRecordEx_GetEventExtendedDataRecordEx_Event_Dtc000032: RteEventRef=OpEventGetEventExtendedDataRecordEx_GetEventExtendedDataRecordEx_Event_Dtc000032
        OpEventGetEventExtendedDataRecordEx_GetEventExtendedDataRecordEx_EvtInfo_Dtc000031: RteEventRef=OpEventGetEventExtendedDataRecordEx_GetEventExtendedDataRecordEx_EvtInfo_Dtc000031
        OpEventGetEventExtendedDataRecordEx_GetEventExtendedDataRecordEx_Event_Dtc000031: RteEventRef=OpEventGetEventExtendedDataRecordEx_GetEventExtendedDataRecordEx_Event_Dtc000031
        OpEventGetEventExtendedDataRecordEx_GetEventExtendedDataRecordEx_EvtInfo_FrsmEClusterSyncLoss: RteEventRef=OpEventGetEventExtendedDataRecordEx_GetEventExtendedDataRecordEx_EvtInfo_FrsmEClusterSyncLoss
        OpEventGetEventExtendedDataRecordEx_GetEventExtendedDataRecordEx_Event_FrsmEClusterSyncLoss: RteEventRef=OpEventGetEventExtendedDataRecordEx_GetEventExtendedDataRecordEx_Event_FrsmEClusterSyncLoss
        OpEventGetEventExtendedDataRecordEx_GetEventExtendedDataRecordEx_EvtInfo_Dtc000030: RteEventRef=OpEventGetEventExtendedDataRecordEx_GetEventExtendedDataRecordEx_EvtInfo_Dtc000030
        OpEventGetEventExtendedDataRecordEx_GetEventExtendedDataRecordEx_Event_Dtc000030: RteEventRef=OpEventGetEventExtendedDataRecordEx_GetEventExtendedDataRecordEx_Event_Dtc000030
        OpEventGetEventExtendedDataRecordEx_GetEventExtendedDataRecordEx_EvtInfo_Dtc000034: RteEventRef=OpEventGetEventExtendedDataRecordEx_GetEventExtendedDataRecordEx_EvtInfo_Dtc000034
        OpEventGetEventExtendedDataRecordEx_GetEventExtendedDataRecordEx_Event_Dtc000034: RteEventRef=OpEventGetEventExtendedDataRecordEx_GetEventExtendedDataRecordEx_Event_Dtc000034
        OpEventGetEventExtendedDataRecordEx_GetEventExtendedDataRecordEx_EvtInfo_Dtc000033: RteEventRef=OpEventGetEventExtendedDataRecordEx_GetEventExtendedDataRecordEx_EvtInfo_Dtc000033
        OpEventGetEventExtendedDataRecordEx_GetEventExtendedDataRecordEx_Event_Dtc000033: RteEventRef=OpEventGetEventExtendedDataRecordEx_GetEventExtendedDataRecordEx_Event_Dtc000033
        OpEventGetEventExtendedDataRecordEx_GetEventExtendedDataRecordEx_EvtInfo_Undervoltage: RteEventRef=OpEventGetEventExtendedDataRecordEx_GetEventExtendedDataRecordEx_EvtInfo_Undervoltage
        OpEventGetEventExtendedDataRecordEx_GetEventExtendedDataRecordEx_Event_Undervoltage: RteEventRef=OpEventGetEventExtendedDataRecordEx_GetEventExtendedDataRecordEx_Event_Undervoltage
        OpEventGetEventExtendedDataRecordEx_GetEventExtendedDataRecordEx_EvtInfo_CodingEventTransactionFailed: RteEventRef=OpEventGetEventExtendedDataRecordEx_GetEventExtendedDataRecordEx_EvtInfo_CodingEventTransactionFailed
        OpEventGetEventExtendedDataRecordEx_GetEventExtendedDataRecordEx_Event_CodingEventTransactionFailed: RteEventRef=OpEventGetEventExtendedDataRecordEx_GetEventExtendedDataRecordEx_Event_CodingEventTransactionFailed
        OpEventGetEventExtendedDataRecordEx_GetEventExtendedDataRecordEx_EvtInfo_FrifENitChA: RteEventRef=OpEventGetEventExtendedDataRecordEx_GetEventExtendedDataRecordEx_EvtInfo_FrifENitChA
        OpEventGetEventExtendedDataRecordEx_GetEventExtendedDataRecordEx_Event_FrifENitChA: RteEventRef=OpEventGetEventExtendedDataRecordEx_GetEventExtendedDataRecordEx_Event_FrifENitChA
        OpEventGetEventExtendedDataRecordEx_GetEventExtendedDataRecordEx_EvtInfo_CansmEBusLpCanOff: RteEventRef=OpEventGetEventExtendedDataRecordEx_GetEventExtendedDataRecordEx_EvtInfo_CansmEBusLpCanOff
        OpEventGetEventExtendedDataRecordEx_GetEventExtendedDataRecordEx_Event_CansmEBusLpCanOff: RteEventRef=OpEventGetEventExtendedDataRecordEx_GetEventExtendedDataRecordEx_Event_CansmEBusLpCanOff
        OpEventGetEventExtendedDataRecordEx_GetEventExtendedDataRecordEx_EvtInfo_NVM_E_HARDWARE: RteEventRef=OpEventGetEventExtendedDataRecordEx_GetEventExtendedDataRecordEx_EvtInfo_NVM_E_HARDWARE
        OpEventGetEventExtendedDataRecordEx_GetEventExtendedDataRecordEx_EvtInfo_VsmEventOpmode: RteEventRef=OpEventGetEventExtendedDataRecordEx_GetEventExtendedDataRecordEx_EvtInfo_VsmEventOpmode
        OpEventGetEventExtendedDataRecordEx_GetEventExtendedDataRecordEx_Event_VsmEventOpmode: RteEventRef=OpEventGetEventExtendedDataRecordEx_GetEventExtendedDataRecordEx_Event_VsmEventOpmode
        OpEventGetEventExtendedDataRecordEx_GetEventExtendedDataRecordEx_EvtInfo_LIN_E_TIMEOUT: RteEventRef=OpEventGetEventExtendedDataRecordEx_GetEventExtendedDataRecordEx_EvtInfo_LIN_E_TIMEOUT
        OpEventGetEventExtendedDataRecordEx_GetEventExtendedDataRecordEx_EvtInfo_CantrcvEBusACanError: RteEventRef=OpEventGetEventExtendedDataRecordEx_GetEventExtendedDataRecordEx_EvtInfo_CantrcvEBusACanError
        OpEventGetEventExtendedDataRecordEx_GetEventExtendedDataRecordEx_Event_CantrcvEBusACanError: RteEventRef=OpEventGetEventExtendedDataRecordEx_GetEventExtendedDataRecordEx_Event_CantrcvEBusACanError
        OpEventGetEventExtendedDataRecordEx_GetEventExtendedDataRecordEx_EvtInfo_UDPNM_E_TCPIP_TRANSMIT_ERROR: RteEventRef=OpEventGetEventExtendedDataRecordEx_GetEventExtendedDataRecordEx_EvtInfo_UDPNM_E_TCPIP_TRANSMIT_ERROR
        OpEventGetEventExtendedDataRecordEx_GetEventExtendedDataRecordEx_EvtInfo_DmTestCom: RteEventRef=OpEventGetEventExtendedDataRecordEx_GetEventExtendedDataRecordEx_EvtInfo_DmTestCom
        OpEventGetEventExtendedDataRecordEx_GetEventExtendedDataRecordEx_Event_DmTestCom: RteEventRef=OpEventGetEventExtendedDataRecordEx_GetEventExtendedDataRecordEx_Event_DmTestCom
        OpEventGetEventExtendedDataRecordEx_GetEventExtendedDataRecordEx_EvtInfo_CodingEventSignatureError: RteEventRef=OpEventGetEventExtendedDataRecordEx_GetEventExtendedDataRecordEx_EvtInfo_CodingEventSignatureError
        OpEventGetEventExtendedDataRecordEx_GetEventExtendedDataRecordEx_Event_CodingEventSignatureError: RteEventRef=OpEventGetEventExtendedDataRecordEx_GetEventExtendedDataRecordEx_Event_CodingEventSignatureError
        OpEventGetEventExtendedDataRecordEx_GetEventExtendedDataRecordEx_EvtInfo_CodingEventUnqualifiedData: RteEventRef=OpEventGetEventExtendedDataRecordEx_GetEventExtendedDataRecordEx_EvtInfo_CodingEventUnqualifiedData
        OpEventGetEventExtendedDataRecordEx_GetEventExtendedDataRecordEx_Event_CodingEventUnqualifiedData: RteEventRef=OpEventGetEventExtendedDataRecordEx_GetEventExtendedDataRecordEx_Event_CodingEventUnqualifiedData
        OpEventGetEventExtendedDataRecordEx_GetEventExtendedDataRecordEx_EvtInfo_CodingEventInvalidData: RteEventRef=OpEventGetEventExtendedDataRecordEx_GetEventExtendedDataRecordEx_EvtInfo_CodingEventInvalidData
        OpEventGetEventExtendedDataRecordEx_GetEventExtendedDataRecordEx_Event_CodingEventInvalidData: RteEventRef=OpEventGetEventExtendedDataRecordEx_GetEventExtendedDataRecordEx_Event_CodingEventInvalidData
        OpEventGetEventExtendedDataRecordEx_GetEventExtendedDataRecordEx_EvtInfo_CansmEBusB2CanOff: RteEventRef=OpEventGetEventExtendedDataRecordEx_GetEventExtendedDataRecordEx_EvtInfo_CansmEBusB2CanOff
        OpEventGetEventExtendedDataRecordEx_GetEventExtendedDataRecordEx_Event_CansmEBusB2CanOff: RteEventRef=OpEventGetEventExtendedDataRecordEx_GetEventExtendedDataRecordEx_Event_CansmEBusB2CanOff
        OpEventGetEventExtendedDataRecordEx_GetEventExtendedDataRecordEx_EvtInfo_Overvoltage: RteEventRef=OpEventGetEventExtendedDataRecordEx_GetEventExtendedDataRecordEx_EvtInfo_Overvoltage
        OpEventGetEventExtendedDataRecordEx_GetEventExtendedDataRecordEx_Event_Overvoltage: RteEventRef=OpEventGetEventExtendedDataRecordEx_GetEventExtendedDataRecordEx_Event_Overvoltage
        OpEventGetEventExtendedDataRecordEx_GetEventExtendedDataRecordEx_EvtInfo_CodingEventNotCoded: RteEventRef=OpEventGetEventExtendedDataRecordEx_GetEventExtendedDataRecordEx_EvtInfo_CodingEventNotCoded
        OpEventGetEventExtendedDataRecordEx_GetEventExtendedDataRecordEx_Event_CodingEventNotCoded: RteEventRef=OpEventGetEventExtendedDataRecordEx_GetEventExtendedDataRecordEx_Event_CodingEventNotCoded
        OpEventGetEventExtendedDataRecordEx_GetEventExtendedDataRecordEx_EvtInfo_FrifEAcsChA: RteEventRef=OpEventGetEventExtendedDataRecordEx_GetEventExtendedDataRecordEx_EvtInfo_FrifEAcsChA
        OpEventGetEventExtendedDataRecordEx_GetEventExtendedDataRecordEx_Event_FrifEAcsChA: RteEventRef=OpEventGetEventExtendedDataRecordEx_GetEventExtendedDataRecordEx_Event_FrifEAcsChA
        OpEventGetEventExtendedDataRecordEx_GetEventExtendedDataRecordEx_EvtInfo_CantrcvEBusFaCanError: RteEventRef=OpEventGetEventExtendedDataRecordEx_GetEventExtendedDataRecordEx_EvtInfo_CantrcvEBusFaCanError
        OpEventGetEventExtendedDataRecordEx_GetEventExtendedDataRecordEx_Event_CantrcvEBusFaCanError: RteEventRef=OpEventGetEventExtendedDataRecordEx_GetEventExtendedDataRecordEx_Event_CantrcvEBusFaCanError
        OpEventGetEventExtendedDataRecordEx_GetEventExtendedDataRecordEx_EvtInfo_CantrcvEBusLeCanError: RteEventRef=OpEventGetEventExtendedDataRecordEx_GetEventExtendedDataRecordEx_EvtInfo_CantrcvEBusLeCanError
        OpEventGetEventExtendedDataRecordEx_GetEventExtendedDataRecordEx_Event_CantrcvEBusLeCanError: RteEventRef=OpEventGetEventExtendedDataRecordEx_GetEventExtendedDataRecordEx_Event_CantrcvEBusLeCanError
        OpEventGetEventExtendedDataRecordEx_GetEventExtendedDataRecordEx_EvtInfo_CantrcvEBusLpCanError: RteEventRef=OpEventGetEventExtendedDataRecordEx_GetEventExtendedDataRecordEx_EvtInfo_CantrcvEBusLpCanError
        OpEventGetEventExtendedDataRecordEx_GetEventExtendedDataRecordEx_Event_CantrcvEBusLpCanError: RteEventRef=OpEventGetEventExtendedDataRecordEx_GetEventExtendedDataRecordEx_Event_CantrcvEBusLpCanError
        OpEventGetEventExtendedDataRecordEx_GetEventExtendedDataRecordEx_EvtInfo_CantrcvEBusZsgCanError: RteEventRef=OpEventGetEventExtendedDataRecordEx_GetEventExtendedDataRecordEx_EvtInfo_CantrcvEBusZsgCanError
        OpEventGetEventExtendedDataRecordEx_GetEventExtendedDataRecordEx_Event_CantrcvEBusZsgCanError: RteEventRef=OpEventGetEventExtendedDataRecordEx_GetEventExtendedDataRecordEx_Event_CantrcvEBusZsgCanError
        OpEventGetEventExtendedDataRecordEx_GetEventExtendedDataRecordEx_EvtInfo_EthSignalQualityLow: RteEventRef=OpEventGetEventExtendedDataRecordEx_GetEventExtendedDataRecordEx_EvtInfo_EthSignalQualityLow
        OpEventGetEventExtendedDataRecordEx_GetEventExtendedDataRecordEx_Event_EthSignalQualityLow: RteEventRef=OpEventGetEventExtendedDataRecordEx_GetEventExtendedDataRecordEx_Event_EthSignalQualityLow
        OpEventGetEventExtendedDataRecordEx_GetEventExtendedDataRecordEx_EvtInfo_DemEventParameter_FlsConfigSet_FLS_E_COMPARE_FAILED: RteEventRef=OpEventGetEventExtendedDataRecordEx_GetEventExtendedDataRecordEx_EvtInfo_DemEventParameter_FlsConfigSet_FLS_E_COMPARE_FAILED
        OpEventGetEventExtendedDataRecordEx_GetEventExtendedDataRecordEx_EvtInfo_DemEventParameter_FlsConfigSet_FLS_E_ERASE_FAILED: RteEventRef=OpEventGetEventExtendedDataRecordEx_GetEventExtendedDataRecordEx_EvtInfo_DemEventParameter_FlsConfigSet_FLS_E_ERASE_FAILED
        OpEventGetEventExtendedDataRecordEx_GetEventExtendedDataRecordEx_EvtInfo_DemEventParameter_FlsConfigSet_FLS_E_READ_FAILED: RteEventRef=OpEventGetEventExtendedDataRecordEx_GetEventExtendedDataRecordEx_EvtInfo_DemEventParameter_FlsConfigSet_FLS_E_READ_FAILED
        OpEventGetEventExtendedDataRecordEx_GetEventExtendedDataRecordEx_EvtInfo_DemEventParameter_FlsConfigSet_FLS_E_WRITE_FAILED: RteEventRef=OpEventGetEventExtendedDataRecordEx_GetEventExtendedDataRecordEx_EvtInfo_DemEventParameter_FlsConfigSet_FLS_E_WRITE_FAILED
        OpEventGetEventExtendedDataRecordEx_GetEventExtendedDataRecordEx_EvtInfo_DemEventParameter_FlsConfigSet_FLS_E_READ_DED_FAILED: RteEventRef=OpEventGetEventExtendedDataRecordEx_GetEventExtendedDataRecordEx_EvtInfo_DemEventParameter_FlsConfigSet_FLS_E_READ_DED_FAILED
        OpEventGetEventExtendedDataRecordEx_GetEventExtendedDataRecordEx_EvtInfo_DemEventParameter_FlsConfigSet_FLS_E_UNEXPECTE_bccf2493: RteEventRef=OpEventGetEventExtendedDataRecordEx_GetEventExtendedDataRecordEx_EvtInfo_DemEventParameter_FlsConfigSet_FLS_E_UNEXPECTE_bccf2493
        OpEventGetEventExtendedDataRecordEx_GetEventExtendedDataRecordEx_EvtInfo_DemEventParameter_FlsConfigSet_MCU_E_CLOCK_FAILED: RteEventRef=OpEventGetEventExtendedDataRecordEx_GetEventExtendedDataRecordEx_EvtInfo_DemEventParameter_FlsConfigSet_MCU_E_CLOCK_FAILED
        OpEventGetEventExtendedDataRecordEx_GetEventExtendedDataRecordEx_EvtInfo_DemEventParameter_FlsConfigSet_MCU_E_HW_FAILED: RteEventRef=OpEventGetEventExtendedDataRecordEx_GetEventExtendedDataRecordEx_EvtInfo_DemEventParameter_FlsConfigSet_MCU_E_HW_FAILED
        OpEventGetEventExtendedDataRecordEx_GetEventExtendedDataRecordEx_EvtInfo_DemEventParameter_FlsConfigSet_MCU_E_STARTUP_FAILED: RteEventRef=OpEventGetEventExtendedDataRecordEx_GetEventExtendedDataRecordEx_EvtInfo_DemEventParameter_FlsConfigSet_MCU_E_STARTUP_FAILED
        OpEventGetEventExtendedDataRecordEx_GetEventExtendedDataRecordEx_EvtInfo_DemEventParameter_FlsConfigSet_FLS_E_ECC_FAILED: RteEventRef=OpEventGetEventExtendedDataRecordEx_GetEventExtendedDataRecordEx_EvtInfo_DemEventParameter_FlsConfigSet_FLS_E_ECC_FAILED
        OpEventGetEventExtendedDataRecordEx_GetEventExtendedDataRecordEx_EvtInfo_DemEventParameter_FlsConfigSet_FLS_E_VRFY_FAILED: RteEventRef=OpEventGetEventExtendedDataRecordEx_GetEventExtendedDataRecordEx_EvtInfo_DemEventParameter_FlsConfigSet_FLS_E_VRFY_FAILED
        OpEventGetEventExtendedDataRecordEx_GetEventExtendedDataRecordEx_EvtInfo_DemEventParameter_FlsConfigSet_FLS_E_INT_FAILED: RteEventRef=OpEventGetEventExtendedDataRecordEx_GetEventExtendedDataRecordEx_EvtInfo_DemEventParameter_FlsConfigSet_FLS_E_INT_FAILED
        OpEventGetEventExtendedDataRecordEx_GetEventExtendedDataRecordEx_EvtInfo_DemEventParameter_FlsConfigSet_FLS_E_HW_FAILED: RteEventRef=OpEventGetEventExtendedDataRecordEx_GetEventExtendedDataRecordEx_EvtInfo_DemEventParameter_FlsConfigSet_FLS_E_HW_FAILED
        OpEventGetEventExtendedDataRecordEx_GetEventExtendedDataRecordEx_GeneralEventInfo: RteEventRef=OpEventGetEventExtendedDataRecordEx_GetEventExtendedDataRecordEx_GeneralEventInfo
        OpEventGetEventEnableCondition_GetEventEnableCondition_EvtInfo_FrtrcvEFrErrnTrcv0: RteEventRef=OpEventGetEventEnableCondition_GetEventEnableCondition_EvtInfo_FrtrcvEFrErrnTrcv0
        OpEventGetEventEnableCondition_GetEventEnableCondition_EvtInfo_CansmEBusIukCanOff: RteEventRef=OpEventGetEventEnableCondition_GetEventEnableCondition_EvtInfo_CansmEBusIukCanOff
        OpEventGetEventEnableCondition_GetEventEnableCondition_EvtInfo_FrtrcvEFrErrnTrcv2: RteEventRef=OpEventGetEventEnableCondition_GetEventEnableCondition_EvtInfo_FrtrcvEFrErrnTrcv2
        OpEventGetEventEnableCondition_GetEventEnableCondition_EvtInfo_FrtrcvEFrErrnTrcv1: RteEventRef=OpEventGetEventEnableCondition_GetEventEnableCondition_EvtInfo_FrtrcvEFrErrnTrcv1
        OpEventGetEventEnableCondition_GetEventEnableCondition_EvtInfo_FrtrcvEFrErrnTrcv4: RteEventRef=OpEventGetEventEnableCondition_GetEventEnableCondition_EvtInfo_FrtrcvEFrErrnTrcv4
        OpEventGetEventEnableCondition_GetEventEnableCondition_EvtInfo_FrtrcvEFrErrnTrcv3: RteEventRef=OpEventGetEventEnableCondition_GetEventEnableCondition_EvtInfo_FrtrcvEFrErrnTrcv3
        OpEventGetEventEnableCondition_GetEventEnableCondition_EvtInfo_FrtrcvEFrErrnTrcv6: RteEventRef=OpEventGetEventEnableCondition_GetEventEnableCondition_EvtInfo_FrtrcvEFrErrnTrcv6
        OpEventGetEventEnableCondition_GetEventEnableCondition_EvtInfo_FrtrcvEFrErrnTrcv5: RteEventRef=OpEventGetEventEnableCondition_GetEventEnableCondition_EvtInfo_FrtrcvEFrErrnTrcv5
        OpEventGetEventEnableCondition_GetEventEnableCondition_EvtInfo_CansmEBusBodyCanOff: RteEventRef=OpEventGetEventEnableCondition_GetEventEnableCondition_EvtInfo_CansmEBusBodyCanOff
        OpEventGetEventEnableCondition_GetEventEnableCondition_EvtInfo_CbsReplacementValue: RteEventRef=OpEventGetEventEnableCondition_GetEventEnableCondition_EvtInfo_CbsReplacementValue
        OpEventGetEventEnableCondition_GetEventEnableCondition_EvtInfo_CansmEBusLeCanOff: RteEventRef=OpEventGetEventEnableCondition_GetEventEnableCondition_EvtInfo_CansmEBusLeCanOff
        OpEventGetEventEnableCondition_GetEventEnableCondition_EvtInfo_CansmEBusZsgCanOff: RteEventRef=OpEventGetEventEnableCondition_GetEventEnableCondition_EvtInfo_CansmEBusZsgCanOff
        OpEventGetEventEnableCondition_GetEventEnableCondition_EvtInfo_CodingEventWrongVehicle: RteEventRef=OpEventGetEventEnableCondition_GetEventEnableCondition_EvtInfo_CodingEventWrongVehicle
        OpEventGetEventEnableCondition_GetEventEnableCondition_EvtInfo_FrsmEClusterStartup: RteEventRef=OpEventGetEventEnableCondition_GetEventEnableCondition_EvtInfo_FrsmEClusterStartup
        OpEventGetEventEnableCondition_GetEventEnableCondition_EvtInfo_CansmEBusACanOff: RteEventRef=OpEventGetEventEnableCondition_GetEventEnableCondition_EvtInfo_CansmEBusACanOff
        OpEventGetEventEnableCondition_GetEventEnableCondition_EvtInfo_CansmEBusKCanOff: RteEventRef=OpEventGetEventEnableCondition_GetEventEnableCondition_EvtInfo_CansmEBusKCanOff
        OpEventGetEventEnableCondition_GetEventEnableCondition_EvtInfo_CantrcvEBusKCanError: RteEventRef=OpEventGetEventEnableCondition_GetEventEnableCondition_EvtInfo_CantrcvEBusKCanError
        OpEventGetEventEnableCondition_GetEventEnableCondition_EvtInfo_FrtrcvEFrBuserrorTrcv0: RteEventRef=OpEventGetEventEnableCondition_GetEventEnableCondition_EvtInfo_FrtrcvEFrBuserrorTrcv0
        OpEventGetEventEnableCondition_GetEventEnableCondition_EvtInfo_FrtrcvEFrErrnTrcv7: RteEventRef=OpEventGetEventEnableCondition_GetEventEnableCondition_EvtInfo_FrtrcvEFrErrnTrcv7
        OpEventGetEventEnableCondition_GetEventEnableCondition_EvtInfo_CansmEBusFaCanOff: RteEventRef=OpEventGetEventEnableCondition_GetEventEnableCondition_EvtInfo_CansmEBusFaCanOff
        OpEventGetEventEnableCondition_GetEventEnableCondition_EvtInfo_CantrcvEBusB2CanError: RteEventRef=OpEventGetEventEnableCondition_GetEventEnableCondition_EvtInfo_CantrcvEBusB2CanError
        OpEventGetEventEnableCondition_GetEventEnableCondition_EvtInfo_DtcCd{0605..0607}: RteEventRef=OpEventGetEventEnableCondition_GetEventEnableCondition_EvtInfo_DtcCd{0605..0607}
        OpEventGetEventEnableCondition_GetEventEnableCondition_EvtInfo_PiaEIoError: RteEventRef=OpEventGetEventEnableCondition_GetEventEnableCondition_EvtInfo_PiaEIoError
        OpEventGetEventEnableCondition_GetEventEnableCondition_EvtInfo_DtcCd0601: RteEventRef=OpEventGetEventEnableCondition_GetEventEnableCondition_EvtInfo_DtcCd0601
        OpEventGetEventEnableCondition_GetEventEnableCondition_EvtInfo_SwtExternalCheckFailure: RteEventRef=OpEventGetEventEnableCondition_GetEventEnableCondition_EvtInfo_SwtExternalCheckFailure
        OpEventGetEventEnableCondition_GetEventEnableCondition_EvtInfo_CantrcvEBusBodyCanError: RteEventRef=OpEventGetEventEnableCondition_GetEventEnableCondition_EvtInfo_CantrcvEBusBodyCanError
        OpEventGetEventEnableCondition_GetEventEnableCondition_EvtInfo_CantrcvEBusIukError: RteEventRef=OpEventGetEventEnableCondition_GetEventEnableCondition_EvtInfo_CantrcvEBusIukError
        OpEventGetEventEnableCondition_GetEventEnableCondition_EvtInfo_SwtInternalCheckFailure: RteEventRef=OpEventGetEventEnableCondition_GetEventEnableCondition_EvtInfo_SwtInternalCheckFailure
        OpEventGetEventEnableCondition_GetEventEnableCondition_EvtInfo_DmTestAppl: RteEventRef=OpEventGetEventEnableCondition_GetEventEnableCondition_EvtInfo_DmTestAppl
        OpEventGetEventEnableCondition_GetEventEnableCondition_EvtInfo_Dtc000032: RteEventRef=OpEventGetEventEnableCondition_GetEventEnableCondition_EvtInfo_Dtc000032
        OpEventGetEventEnableCondition_GetEventEnableCondition_EvtInfo_Dtc000031: RteEventRef=OpEventGetEventEnableCondition_GetEventEnableCondition_EvtInfo_Dtc000031
        OpEventGetEventEnableCondition_GetEventEnableCondition_EvtInfo_FrsmEClusterSyncLoss: RteEventRef=OpEventGetEventEnableCondition_GetEventEnableCondition_EvtInfo_FrsmEClusterSyncLoss
        OpEventGetEventEnableCondition_GetEventEnableCondition_EvtInfo_Dtc000030: RteEventRef=OpEventGetEventEnableCondition_GetEventEnableCondition_EvtInfo_Dtc000030
        OpEventGetEventEnableCondition_GetEventEnableCondition_EvtInfo_Dtc000034: RteEventRef=OpEventGetEventEnableCondition_GetEventEnableCondition_EvtInfo_Dtc000034
        OpEventGetEventEnableCondition_GetEventEnableCondition_EvtInfo_Dtc000033: RteEventRef=OpEventGetEventEnableCondition_GetEventEnableCondition_EvtInfo_Dtc000033
        OpEventGetEventEnableCondition_GetEventEnableCondition_EvtInfo_Undervoltage: RteEventRef=OpEventGetEventEnableCondition_GetEventEnableCondition_EvtInfo_Undervoltage
        OpEventGetEventEnableCondition_GetEventEnableCondition_EvtInfo_CodingEventTransactionFailed: RteEventRef=OpEventGetEventEnableCondition_GetEventEnableCondition_EvtInfo_CodingEventTransactionFailed
        OpEventGetEventEnableCondition_GetEventEnableCondition_EvtInfo_FrifENitChA: RteEventRef=OpEventGetEventEnableCondition_GetEventEnableCondition_EvtInfo_FrifENitChA
        OpEventGetEventEnableCondition_GetEventEnableCondition_EvtInfo_CansmEBusLpCanOff: RteEventRef=OpEventGetEventEnableCondition_GetEventEnableCondition_EvtInfo_CansmEBusLpCanOff
        OpEventGetEventEnableCondition_GetEventEnableCondition_EvtInfo_NVM_E_HARDWARE: RteEventRef=OpEventGetEventEnableCondition_GetEventEnableCondition_EvtInfo_NVM_E_HARDWARE
        OpEventGetEventEnableCondition_GetEventEnableCondition_EvtInfo_VsmEventOpmode: RteEventRef=OpEventGetEventEnableCondition_GetEventEnableCondition_EvtInfo_VsmEventOpmode
        OpEventGetEventEnableCondition_GetEventEnableCondition_EvtInfo_LIN_E_TIMEOUT: RteEventRef=OpEventGetEventEnableCondition_GetEventEnableCondition_EvtInfo_LIN_E_TIMEOUT
        OpEventGetEventEnableCondition_GetEventEnableCondition_EvtInfo_CantrcvEBusACanError: RteEventRef=OpEventGetEventEnableCondition_GetEventEnableCondition_EvtInfo_CantrcvEBusACanError
        OpEventGetEventEnableCondition_GetEventEnableCondition_EvtInfo_UDPNM_E_TCPIP_TRANSMIT_ERROR: RteEventRef=OpEventGetEventEnableCondition_GetEventEnableCondition_EvtInfo_UDPNM_E_TCPIP_TRANSMIT_ERROR
        OpEventGetEventEnableCondition_GetEventEnableCondition_EvtInfo_DmTestCom: RteEventRef=OpEventGetEventEnableCondition_GetEventEnableCondition_EvtInfo_DmTestCom
        OpEventGetEventEnableCondition_GetEventEnableCondition_EvtInfo_CodingEventSignatureError: RteEventRef=OpEventGetEventEnableCondition_GetEventEnableCondition_EvtInfo_CodingEventSignatureError
        OpEventGetEventEnableCondition_GetEventEnableCondition_EvtInfo_CodingEventUnqualifiedData: RteEventRef=OpEventGetEventEnableCondition_GetEventEnableCondition_EvtInfo_CodingEventUnqualifiedData
        OpEventGetEventEnableCondition_GetEventEnableCondition_EvtInfo_CodingEventInvalidData: RteEventRef=OpEventGetEventEnableCondition_GetEventEnableCondition_EvtInfo_CodingEventInvalidData
        OpEventGetEventEnableCondition_GetEventEnableCondition_EvtInfo_CansmEBusB2CanOff: RteEventRef=OpEventGetEventEnableCondition_GetEventEnableCondition_EvtInfo_CansmEBusB2CanOff
        OpEventGetEventEnableCondition_GetEventEnableCondition_EvtInfo_Overvoltage: RteEventRef=OpEventGetEventEnableCondition_GetEventEnableCondition_EvtInfo_Overvoltage
        OpEventGetEventEnableCondition_GetEventEnableCondition_EvtInfo_CodingEventNotCoded: RteEventRef=OpEventGetEventEnableCondition_GetEventEnableCondition_EvtInfo_CodingEventNotCoded
        OpEventGetEventEnableCondition_GetEventEnableCondition_EvtInfo_FrifEAcsChA: RteEventRef=OpEventGetEventEnableCondition_GetEventEnableCondition_EvtInfo_FrifEAcsChA
        OpEventGetEventEnableCondition_GetEventEnableCondition_EvtInfo_CantrcvEBusFaCanError: RteEventRef=OpEventGetEventEnableCondition_GetEventEnableCondition_EvtInfo_CantrcvEBusFaCanError
        OpEventGetEventEnableCondition_GetEventEnableCondition_EvtInfo_CantrcvEBusLeCanError: RteEventRef=OpEventGetEventEnableCondition_GetEventEnableCondition_EvtInfo_CantrcvEBusLeCanError
        OpEventGetEventEnableCondition_GetEventEnableCondition_EvtInfo_CantrcvEBusLpCanError: RteEventRef=OpEventGetEventEnableCondition_GetEventEnableCondition_EvtInfo_CantrcvEBusLpCanError
        OpEventGetEventEnableCondition_GetEventEnableCondition_EvtInfo_CantrcvEBusZsgCanError: RteEventRef=OpEventGetEventEnableCondition_GetEventEnableCondition_EvtInfo_CantrcvEBusZsgCanError
        OpEventGetEventEnableCondition_GetEventEnableCondition_EvtInfo_EthSignalQualityLow: RteEventRef=OpEventGetEventEnableCondition_GetEventEnableCondition_EvtInfo_EthSignalQualityLow
        OpEventGetEventEnableCondition_GetEventEnableCondition_EvtInfo_DemEventParameter_FlsConfigSet_FLS_E_COMPARE_FAILED: RteEventRef=OpEventGetEventEnableCondition_GetEventEnableCondition_EvtInfo_DemEventParameter_FlsConfigSet_FLS_E_COMPARE_FAILED
        OpEventGetEventEnableCondition_GetEventEnableCondition_EvtInfo_DemEventParameter_FlsConfigSet_FLS_E_ERASE_FAILED: RteEventRef=OpEventGetEventEnableCondition_GetEventEnableCondition_EvtInfo_DemEventParameter_FlsConfigSet_FLS_E_ERASE_FAILED
        OpEventGetEventEnableCondition_GetEventEnableCondition_EvtInfo_DemEventParameter_FlsConfigSet_FLS_E_READ_FAILED: RteEventRef=OpEventGetEventEnableCondition_GetEventEnableCondition_EvtInfo_DemEventParameter_FlsConfigSet_FLS_E_READ_FAILED
        OpEventGetEventEnableCondition_GetEventEnableCondition_EvtInfo_DemEventParameter_FlsConfigSet_FLS_E_WRITE_FAILED: RteEventRef=OpEventGetEventEnableCondition_GetEventEnableCondition_EvtInfo_DemEventParameter_FlsConfigSet_FLS_E_WRITE_FAILED
        OpEventGetEventEnableCondition_GetEventEnableCondition_EvtInfo_DemEventParameter_FlsConfigSet_FLS_E_READ_DED_FAILED: RteEventRef=OpEventGetEventEnableCondition_GetEventEnableCondition_EvtInfo_DemEventParameter_FlsConfigSet_FLS_E_READ_DED_FAILED
        OpEventGetEventEnableCondition_GetEventEnableCondition_EvtInfo_DemEventParameter_FlsConfigSet_FLS_E_UNEXPECTED_FLASH_ID: RteEventRef=OpEventGetEventEnableCondition_GetEventEnableCondition_EvtInfo_DemEventParameter_FlsConfigSet_FLS_E_UNEXPECTED_FLASH_ID
        OpEventGetEventEnableCondition_GetEventEnableCondition_EvtInfo_DemEventParameter_FlsConfigSet_MCU_E_CLOCK_FAILED: RteEventRef=OpEventGetEventEnableCondition_GetEventEnableCondition_EvtInfo_DemEventParameter_FlsConfigSet_MCU_E_CLOCK_FAILED
        OpEventGetEventEnableCondition_GetEventEnableCondition_EvtInfo_DemEventParameter_FlsConfigSet_MCU_E_HW_FAILED: RteEventRef=OpEventGetEventEnableCondition_GetEventEnableCondition_EvtInfo_DemEventParameter_FlsConfigSet_MCU_E_HW_FAILED
        OpEventGetEventEnableCondition_GetEventEnableCondition_EvtInfo_DemEventParameter_FlsConfigSet_MCU_E_STARTUP_FAILED: RteEventRef=OpEventGetEventEnableCondition_GetEventEnableCondition_EvtInfo_DemEventParameter_FlsConfigSet_MCU_E_STARTUP_FAILED
        OpEventGetEventEnableCondition_GetEventEnableCondition_EvtInfo_DemEventParameter_FlsConfigSet_FLS_E_ECC_FAILED: RteEventRef=OpEventGetEventEnableCondition_GetEventEnableCondition_EvtInfo_DemEventParameter_FlsConfigSet_FLS_E_ECC_FAILED
        OpEventGetEventEnableCondition_GetEventEnableCondition_EvtInfo_DemEventParameter_FlsConfigSet_FLS_E_VRFY_FAILED: RteEventRef=OpEventGetEventEnableCondition_GetEventEnableCondition_EvtInfo_DemEventParameter_FlsConfigSet_FLS_E_VRFY_FAILED
        OpEventGetEventEnableCondition_GetEventEnableCondition_EvtInfo_DemEventParameter_FlsConfigSet_FLS_E_INT_FAILED: RteEventRef=OpEventGetEventEnableCondition_GetEventEnableCondition_EvtInfo_DemEventParameter_FlsConfigSet_FLS_E_INT_FAILED
        OpEventGetEventEnableCondition_GetEventEnableCondition_EvtInfo_DemEventParameter_FlsConfigSet_FLS_E_HW_FAILED: RteEventRef=OpEventGetEventEnableCondition_GetEventEnableCondition_EvtInfo_DemEventParameter_FlsConfigSet_FLS_E_HW_FAILED
        OpEventGetEventEnableCondition_GetEventEnableCondition_GeneralEventInfo: RteEventRef=OpEventGetEventEnableCondition_GetEventEnableCondition_GeneralEventInfo
        OpEventGetDebouncingOfEvent_GetDebouncingOfEvent_EvtInfo_FrtrcvEFrErrnTrcv0: RteEventRef=OpEventGetDebouncingOfEvent_GetDebouncingOfEvent_EvtInfo_FrtrcvEFrErrnTrcv0
        OpEventGetDebouncingOfEvent_GetDebouncingOfEvent_EvtInfo_CansmEBusIukCanOff: RteEventRef=OpEventGetDebouncingOfEvent_GetDebouncingOfEvent_EvtInfo_CansmEBusIukCanOff
        OpEventGetDebouncingOfEvent_GetDebouncingOfEvent_EvtInfo_FrtrcvEFrErrnTrcv2: RteEventRef=OpEventGetDebouncingOfEvent_GetDebouncingOfEvent_EvtInfo_FrtrcvEFrErrnTrcv2
        OpEventGetDebouncingOfEvent_GetDebouncingOfEvent_EvtInfo_FrtrcvEFrErrnTrcv1: RteEventRef=OpEventGetDebouncingOfEvent_GetDebouncingOfEvent_EvtInfo_FrtrcvEFrErrnTrcv1
        OpEventGetDebouncingOfEvent_GetDebouncingOfEvent_EvtInfo_FrtrcvEFrErrnTrcv4: RteEventRef=OpEventGetDebouncingOfEvent_GetDebouncingOfEvent_EvtInfo_FrtrcvEFrErrnTrcv4
        OpEventGetDebouncingOfEvent_GetDebouncingOfEvent_EvtInfo_FrtrcvEFrErrnTrcv3: RteEventRef=OpEventGetDebouncingOfEvent_GetDebouncingOfEvent_EvtInfo_FrtrcvEFrErrnTrcv3
        OpEventGetDebouncingOfEvent_GetDebouncingOfEvent_EvtInfo_FrtrcvEFrErrnTrcv6: RteEventRef=OpEventGetDebouncingOfEvent_GetDebouncingOfEvent_EvtInfo_FrtrcvEFrErrnTrcv6
        OpEventGetDebouncingOfEvent_GetDebouncingOfEvent_EvtInfo_FrtrcvEFrErrnTrcv5: RteEventRef=OpEventGetDebouncingOfEvent_GetDebouncingOfEvent_EvtInfo_FrtrcvEFrErrnTrcv5
        OpEventGetDebouncingOfEvent_GetDebouncingOfEvent_EvtInfo_CansmEBusBodyCanOff: RteEventRef=OpEventGetDebouncingOfEvent_GetDebouncingOfEvent_EvtInfo_CansmEBusBodyCanOff
        OpEventGetDebouncingOfEvent_GetDebouncingOfEvent_EvtInfo_CbsReplacementValue: RteEventRef=OpEventGetDebouncingOfEvent_GetDebouncingOfEvent_EvtInfo_CbsReplacementValue
        OpEventGetDebouncingOfEvent_GetDebouncingOfEvent_EvtInfo_CansmEBusLeCanOff: RteEventRef=OpEventGetDebouncingOfEvent_GetDebouncingOfEvent_EvtInfo_CansmEBusLeCanOff
        OpEventGetDebouncingOfEvent_GetDebouncingOfEvent_EvtInfo_CansmEBusZsgCanOff: RteEventRef=OpEventGetDebouncingOfEvent_GetDebouncingOfEvent_EvtInfo_CansmEBusZsgCanOff
        OpEventGetDebouncingOfEvent_GetDebouncingOfEvent_EvtInfo_CodingEventWrongVehicle: RteEventRef=OpEventGetDebouncingOfEvent_GetDebouncingOfEvent_EvtInfo_CodingEventWrongVehicle
        OpEventGetDebouncingOfEvent_GetDebouncingOfEvent_EvtInfo_FrsmEClusterStartup: RteEventRef=OpEventGetDebouncingOfEvent_GetDebouncingOfEvent_EvtInfo_FrsmEClusterStartup
        OpEventGetDebouncingOfEvent_GetDebouncingOfEvent_EvtInfo_CansmEBusACanOff: RteEventRef=OpEventGetDebouncingOfEvent_GetDebouncingOfEvent_EvtInfo_CansmEBusACanOff
        OpEventGetDebouncingOfEvent_GetDebouncingOfEvent_EvtInfo_CansmEBusKCanOff: RteEventRef=OpEventGetDebouncingOfEvent_GetDebouncingOfEvent_EvtInfo_CansmEBusKCanOff
        OpEventGetDebouncingOfEvent_GetDebouncingOfEvent_EvtInfo_CantrcvEBusKCanError: RteEventRef=OpEventGetDebouncingOfEvent_GetDebouncingOfEvent_EvtInfo_CantrcvEBusKCanError
        OpEventGetDebouncingOfEvent_GetDebouncingOfEvent_EvtInfo_FrtrcvEFrBuserrorTrcv0: RteEventRef=OpEventGetDebouncingOfEvent_GetDebouncingOfEvent_EvtInfo_FrtrcvEFrBuserrorTrcv0
        OpEventGetDebouncingOfEvent_GetDebouncingOfEvent_EvtInfo_FrtrcvEFrErrnTrcv7: RteEventRef=OpEventGetDebouncingOfEvent_GetDebouncingOfEvent_EvtInfo_FrtrcvEFrErrnTrcv7
        OpEventGetDebouncingOfEvent_GetDebouncingOfEvent_EvtInfo_CansmEBusFaCanOff: RteEventRef=OpEventGetDebouncingOfEvent_GetDebouncingOfEvent_EvtInfo_CansmEBusFaCanOff
        OpEventGetDebouncingOfEvent_GetDebouncingOfEvent_EvtInfo_CantrcvEBusB2CanError: RteEventRef=OpEventGetDebouncingOfEvent_GetDebouncingOfEvent_EvtInfo_CantrcvEBusB2CanError
        OpEventGetDebouncingOfEvent_GetDebouncingOfEvent_EvtInfo_DtcCd{0605..0607}: RteEventRef=OpEventGetDebouncingOfEvent_GetDebouncingOfEvent_EvtInfo_DtcCd{0605..0607}
        OpEventGetDebouncingOfEvent_GetDebouncingOfEvent_EvtInfo_PiaEIoError: RteEventRef=OpEventGetDebouncingOfEvent_GetDebouncingOfEvent_EvtInfo_PiaEIoError
        OpEventGetDebouncingOfEvent_GetDebouncingOfEvent_EvtInfo_DtcCd0601: RteEventRef=OpEventGetDebouncingOfEvent_GetDebouncingOfEvent_EvtInfo_DtcCd0601
        OpEventGetDebouncingOfEvent_GetDebouncingOfEvent_EvtInfo_SwtExternalCheckFailure: RteEventRef=OpEventGetDebouncingOfEvent_GetDebouncingOfEvent_EvtInfo_SwtExternalCheckFailure
        OpEventGetDebouncingOfEvent_GetDebouncingOfEvent_EvtInfo_CantrcvEBusBodyCanError: RteEventRef=OpEventGetDebouncingOfEvent_GetDebouncingOfEvent_EvtInfo_CantrcvEBusBodyCanError
        OpEventGetDebouncingOfEvent_GetDebouncingOfEvent_EvtInfo_CantrcvEBusIukError: RteEventRef=OpEventGetDebouncingOfEvent_GetDebouncingOfEvent_EvtInfo_CantrcvEBusIukError
        OpEventGetDebouncingOfEvent_GetDebouncingOfEvent_EvtInfo_SwtInternalCheckFailure: RteEventRef=OpEventGetDebouncingOfEvent_GetDebouncingOfEvent_EvtInfo_SwtInternalCheckFailure
        OpEventGetDebouncingOfEvent_GetDebouncingOfEvent_EvtInfo_DmTestAppl: RteEventRef=OpEventGetDebouncingOfEvent_GetDebouncingOfEvent_EvtInfo_DmTestAppl
        OpEventGetDebouncingOfEvent_GetDebouncingOfEvent_EvtInfo_Dtc000032: RteEventRef=OpEventGetDebouncingOfEvent_GetDebouncingOfEvent_EvtInfo_Dtc000032
        OpEventGetDebouncingOfEvent_GetDebouncingOfEvent_EvtInfo_Dtc000031: RteEventRef=OpEventGetDebouncingOfEvent_GetDebouncingOfEvent_EvtInfo_Dtc000031
        OpEventGetDebouncingOfEvent_GetDebouncingOfEvent_EvtInfo_FrsmEClusterSyncLoss: RteEventRef=OpEventGetDebouncingOfEvent_GetDebouncingOfEvent_EvtInfo_FrsmEClusterSyncLoss
        OpEventGetDebouncingOfEvent_GetDebouncingOfEvent_EvtInfo_Dtc000030: RteEventRef=OpEventGetDebouncingOfEvent_GetDebouncingOfEvent_EvtInfo_Dtc000030
        OpEventGetDebouncingOfEvent_GetDebouncingOfEvent_EvtInfo_Dtc000034: RteEventRef=OpEventGetDebouncingOfEvent_GetDebouncingOfEvent_EvtInfo_Dtc000034
        OpEventGetDebouncingOfEvent_GetDebouncingOfEvent_EvtInfo_Dtc000033: RteEventRef=OpEventGetDebouncingOfEvent_GetDebouncingOfEvent_EvtInfo_Dtc000033
        OpEventGetDebouncingOfEvent_GetDebouncingOfEvent_EvtInfo_Undervoltage: RteEventRef=OpEventGetDebouncingOfEvent_GetDebouncingOfEvent_EvtInfo_Undervoltage
        OpEventGetDebouncingOfEvent_GetDebouncingOfEvent_EvtInfo_CodingEventTransactionFailed: RteEventRef=OpEventGetDebouncingOfEvent_GetDebouncingOfEvent_EvtInfo_CodingEventTransactionFailed
        OpEventGetDebouncingOfEvent_GetDebouncingOfEvent_EvtInfo_FrifENitChA: RteEventRef=OpEventGetDebouncingOfEvent_GetDebouncingOfEvent_EvtInfo_FrifENitChA
        OpEventGetDebouncingOfEvent_GetDebouncingOfEvent_EvtInfo_CansmEBusLpCanOff: RteEventRef=OpEventGetDebouncingOfEvent_GetDebouncingOfEvent_EvtInfo_CansmEBusLpCanOff
        OpEventGetDebouncingOfEvent_GetDebouncingOfEvent_EvtInfo_NVM_E_HARDWARE: RteEventRef=OpEventGetDebouncingOfEvent_GetDebouncingOfEvent_EvtInfo_NVM_E_HARDWARE
        OpEventGetDebouncingOfEvent_GetDebouncingOfEvent_EvtInfo_VsmEventOpmode: RteEventRef=OpEventGetDebouncingOfEvent_GetDebouncingOfEvent_EvtInfo_VsmEventOpmode
        OpEventGetDebouncingOfEvent_GetDebouncingOfEvent_EvtInfo_LIN_E_TIMEOUT: RteEventRef=OpEventGetDebouncingOfEvent_GetDebouncingOfEvent_EvtInfo_LIN_E_TIMEOUT
        OpEventGetDebouncingOfEvent_GetDebouncingOfEvent_EvtInfo_CantrcvEBusACanError: RteEventRef=OpEventGetDebouncingOfEvent_GetDebouncingOfEvent_EvtInfo_CantrcvEBusACanError
        OpEventGetDebouncingOfEvent_GetDebouncingOfEvent_EvtInfo_UDPNM_E_TCPIP_TRANSMIT_ERROR: RteEventRef=OpEventGetDebouncingOfEvent_GetDebouncingOfEvent_EvtInfo_UDPNM_E_TCPIP_TRANSMIT_ERROR
        OpEventGetDebouncingOfEvent_GetDebouncingOfEvent_EvtInfo_DmTestCom: RteEventRef=OpEventGetDebouncingOfEvent_GetDebouncingOfEvent_EvtInfo_DmTestCom
        OpEventGetDebouncingOfEvent_GetDebouncingOfEvent_EvtInfo_CodingEventSignatureError: RteEventRef=OpEventGetDebouncingOfEvent_GetDebouncingOfEvent_EvtInfo_CodingEventSignatureError
        OpEventGetDebouncingOfEvent_GetDebouncingOfEvent_EvtInfo_CodingEventUnqualifiedData: RteEventRef=OpEventGetDebouncingOfEvent_GetDebouncingOfEvent_EvtInfo_CodingEventUnqualifiedData
        OpEventGetDebouncingOfEvent_GetDebouncingOfEvent_EvtInfo_CodingEventInvalidData: RteEventRef=OpEventGetDebouncingOfEvent_GetDebouncingOfEvent_EvtInfo_CodingEventInvalidData
        OpEventGetDebouncingOfEvent_GetDebouncingOfEvent_EvtInfo_CansmEBusB2CanOff: RteEventRef=OpEventGetDebouncingOfEvent_GetDebouncingOfEvent_EvtInfo_CansmEBusB2CanOff
        OpEventGetDebouncingOfEvent_GetDebouncingOfEvent_EvtInfo_Overvoltage: RteEventRef=OpEventGetDebouncingOfEvent_GetDebouncingOfEvent_EvtInfo_Overvoltage
        OpEventGetDebouncingOfEvent_GetDebouncingOfEvent_EvtInfo_CodingEventNotCoded: RteEventRef=OpEventGetDebouncingOfEvent_GetDebouncingOfEvent_EvtInfo_CodingEventNotCoded
        OpEventGetDebouncingOfEvent_GetDebouncingOfEvent_EvtInfo_FrifEAcsChA: RteEventRef=OpEventGetDebouncingOfEvent_GetDebouncingOfEvent_EvtInfo_FrifEAcsChA
        OpEventGetDebouncingOfEvent_GetDebouncingOfEvent_EvtInfo_CantrcvEBusFaCanError: RteEventRef=OpEventGetDebouncingOfEvent_GetDebouncingOfEvent_EvtInfo_CantrcvEBusFaCanError
        OpEventGetDebouncingOfEvent_GetDebouncingOfEvent_EvtInfo_CantrcvEBusLeCanError: RteEventRef=OpEventGetDebouncingOfEvent_GetDebouncingOfEvent_EvtInfo_CantrcvEBusLeCanError
        OpEventGetDebouncingOfEvent_GetDebouncingOfEvent_EvtInfo_CantrcvEBusLpCanError: RteEventRef=OpEventGetDebouncingOfEvent_GetDebouncingOfEvent_EvtInfo_CantrcvEBusLpCanError
        OpEventGetDebouncingOfEvent_GetDebouncingOfEvent_EvtInfo_CantrcvEBusZsgCanError: RteEventRef=OpEventGetDebouncingOfEvent_GetDebouncingOfEvent_EvtInfo_CantrcvEBusZsgCanError
        OpEventGetDebouncingOfEvent_GetDebouncingOfEvent_EvtInfo_EthSignalQualityLow: RteEventRef=OpEventGetDebouncingOfEvent_GetDebouncingOfEvent_EvtInfo_EthSignalQualityLow
        OpEventGetDebouncingOfEvent_GetDebouncingOfEvent_EvtInfo_DemEventParameter_FlsConfigSet_FLS_E_COMPARE_FAILED: RteEventRef=OpEventGetDebouncingOfEvent_GetDebouncingOfEvent_EvtInfo_DemEventParameter_FlsConfigSet_FLS_E_COMPARE_FAILED
        OpEventGetDebouncingOfEvent_GetDebouncingOfEvent_EvtInfo_DemEventParameter_FlsConfigSet_FLS_E_ERASE_FAILED: RteEventRef=OpEventGetDebouncingOfEvent_GetDebouncingOfEvent_EvtInfo_DemEventParameter_FlsConfigSet_FLS_E_ERASE_FAILED
        OpEventGetDebouncingOfEvent_GetDebouncingOfEvent_EvtInfo_DemEventParameter_FlsConfigSet_FLS_E_READ_FAILED: RteEventRef=OpEventGetDebouncingOfEvent_GetDebouncingOfEvent_EvtInfo_DemEventParameter_FlsConfigSet_FLS_E_READ_FAILED
        OpEventGetDebouncingOfEvent_GetDebouncingOfEvent_EvtInfo_DemEventParameter_FlsConfigSet_FLS_E_WRITE_FAILED: RteEventRef=OpEventGetDebouncingOfEvent_GetDebouncingOfEvent_EvtInfo_DemEventParameter_FlsConfigSet_FLS_E_WRITE_FAILED
        OpEventGetDebouncingOfEvent_GetDebouncingOfEvent_EvtInfo_DemEventParameter_FlsConfigSet_FLS_E_READ_DED_FAILED: RteEventRef=OpEventGetDebouncingOfEvent_GetDebouncingOfEvent_EvtInfo_DemEventParameter_FlsConfigSet_FLS_E_READ_DED_FAILED
        OpEventGetDebouncingOfEvent_GetDebouncingOfEvent_EvtInfo_DemEventParameter_FlsConfigSet_FLS_E_UNEXPECTED_FLASH_ID: RteEventRef=OpEventGetDebouncingOfEvent_GetDebouncingOfEvent_EvtInfo_DemEventParameter_FlsConfigSet_FLS_E_UNEXPECTED_FLASH_ID
        OpEventGetDebouncingOfEvent_GetDebouncingOfEvent_EvtInfo_DemEventParameter_FlsConfigSet_MCU_E_CLOCK_FAILED: RteEventRef=OpEventGetDebouncingOfEvent_GetDebouncingOfEvent_EvtInfo_DemEventParameter_FlsConfigSet_MCU_E_CLOCK_FAILED
        OpEventGetDebouncingOfEvent_GetDebouncingOfEvent_EvtInfo_DemEventParameter_FlsConfigSet_MCU_E_HW_FAILED: RteEventRef=OpEventGetDebouncingOfEvent_GetDebouncingOfEvent_EvtInfo_DemEventParameter_FlsConfigSet_MCU_E_HW_FAILED
        OpEventGetDebouncingOfEvent_GetDebouncingOfEvent_EvtInfo_DemEventParameter_FlsConfigSet_MCU_E_STARTUP_FAILED: RteEventRef=OpEventGetDebouncingOfEvent_GetDebouncingOfEvent_EvtInfo_DemEventParameter_FlsConfigSet_MCU_E_STARTUP_FAILED
        OpEventGetDebouncingOfEvent_GetDebouncingOfEvent_EvtInfo_DemEventParameter_FlsConfigSet_FLS_E_ECC_FAILED: RteEventRef=OpEventGetDebouncingOfEvent_GetDebouncingOfEvent_EvtInfo_DemEventParameter_FlsConfigSet_FLS_E_ECC_FAILED
        OpEventGetDebouncingOfEvent_GetDebouncingOfEvent_EvtInfo_DemEventParameter_FlsConfigSet_FLS_E_VRFY_FAILED: RteEventRef=OpEventGetDebouncingOfEvent_GetDebouncingOfEvent_EvtInfo_DemEventParameter_FlsConfigSet_FLS_E_VRFY_FAILED
        OpEventGetDebouncingOfEvent_GetDebouncingOfEvent_EvtInfo_DemEventParameter_FlsConfigSet_FLS_E_INT_FAILED: RteEventRef=OpEventGetDebouncingOfEvent_GetDebouncingOfEvent_EvtInfo_DemEventParameter_FlsConfigSet_FLS_E_INT_FAILED
        OpEventGetDebouncingOfEvent_GetDebouncingOfEvent_EvtInfo_DemEventParameter_FlsConfigSet_FLS_E_HW_FAILED: RteEventRef=OpEventGetDebouncingOfEvent_GetDebouncingOfEvent_EvtInfo_DemEventParameter_FlsConfigSet_FLS_E_HW_FAILED
        OpEventGetDebouncingOfEvent_GetDebouncingOfEvent_GeneralEventInfo: RteEventRef=OpEventGetDebouncingOfEvent_GetDebouncingOfEvent_GeneralEventInfo
        OpEventGetMonitorStatus_GetMonitorStatus_EvtInfo_FrtrcvEFrErrnTrcv0: RteEventRef=OpEventGetMonitorStatus_GetMonitorStatus_EvtInfo_FrtrcvEFrErrnTrcv0
        OpEventGetMonitorStatus_GetMonitorStatus_EvtInfo_CansmEBusIukCanOff: RteEventRef=OpEventGetMonitorStatus_GetMonitorStatus_EvtInfo_CansmEBusIukCanOff
        OpEventGetMonitorStatus_GetMonitorStatus_EvtInfo_FrtrcvEFrErrnTrcv2: RteEventRef=OpEventGetMonitorStatus_GetMonitorStatus_EvtInfo_FrtrcvEFrErrnTrcv2
        OpEventGetMonitorStatus_GetMonitorStatus_EvtInfo_FrtrcvEFrErrnTrcv1: RteEventRef=OpEventGetMonitorStatus_GetMonitorStatus_EvtInfo_FrtrcvEFrErrnTrcv1
        OpEventGetMonitorStatus_GetMonitorStatus_EvtInfo_FrtrcvEFrErrnTrcv4: RteEventRef=OpEventGetMonitorStatus_GetMonitorStatus_EvtInfo_FrtrcvEFrErrnTrcv4
        OpEventGetMonitorStatus_GetMonitorStatus_EvtInfo_FrtrcvEFrErrnTrcv3: RteEventRef=OpEventGetMonitorStatus_GetMonitorStatus_EvtInfo_FrtrcvEFrErrnTrcv3
        OpEventGetMonitorStatus_GetMonitorStatus_EvtInfo_FrtrcvEFrErrnTrcv6: RteEventRef=OpEventGetMonitorStatus_GetMonitorStatus_EvtInfo_FrtrcvEFrErrnTrcv6
        OpEventGetMonitorStatus_GetMonitorStatus_EvtInfo_FrtrcvEFrErrnTrcv5: RteEventRef=OpEventGetMonitorStatus_GetMonitorStatus_EvtInfo_FrtrcvEFrErrnTrcv5
        OpEventGetMonitorStatus_GetMonitorStatus_EvtInfo_CansmEBusBodyCanOff: RteEventRef=OpEventGetMonitorStatus_GetMonitorStatus_EvtInfo_CansmEBusBodyCanOff
        OpEventGetMonitorStatus_GetMonitorStatus_EvtInfo_CbsReplacementValue: RteEventRef=OpEventGetMonitorStatus_GetMonitorStatus_EvtInfo_CbsReplacementValue
        OpEventGetMonitorStatus_GetMonitorStatus_EvtInfo_CansmEBusLeCanOff: RteEventRef=OpEventGetMonitorStatus_GetMonitorStatus_EvtInfo_CansmEBusLeCanOff
        OpEventGetMonitorStatus_GetMonitorStatus_EvtInfo_CansmEBusZsgCanOff: RteEventRef=OpEventGetMonitorStatus_GetMonitorStatus_EvtInfo_CansmEBusZsgCanOff
        OpEventGetMonitorStatus_GetMonitorStatus_EvtInfo_CodingEventWrongVehicle: RteEventRef=OpEventGetMonitorStatus_GetMonitorStatus_EvtInfo_CodingEventWrongVehicle
        OpEventGetMonitorStatus_GetMonitorStatus_EvtInfo_FrsmEClusterStartup: RteEventRef=OpEventGetMonitorStatus_GetMonitorStatus_EvtInfo_FrsmEClusterStartup
        OpEventGetMonitorStatus_GetMonitorStatus_EvtInfo_CansmEBusACanOff: RteEventRef=OpEventGetMonitorStatus_GetMonitorStatus_EvtInfo_CansmEBusACanOff
        OpEventGetMonitorStatus_GetMonitorStatus_EvtInfo_CansmEBusKCanOff: RteEventRef=OpEventGetMonitorStatus_GetMonitorStatus_EvtInfo_CansmEBusKCanOff
        OpEventGetMonitorStatus_GetMonitorStatus_EvtInfo_CantrcvEBusKCanError: RteEventRef=OpEventGetMonitorStatus_GetMonitorStatus_EvtInfo_CantrcvEBusKCanError
        OpEventGetMonitorStatus_GetMonitorStatus_EvtInfo_FrtrcvEFrBuserrorTrcv0: RteEventRef=OpEventGetMonitorStatus_GetMonitorStatus_EvtInfo_FrtrcvEFrBuserrorTrcv0
        OpEventGetMonitorStatus_GetMonitorStatus_EvtInfo_FrtrcvEFrErrnTrcv7: RteEventRef=OpEventGetMonitorStatus_GetMonitorStatus_EvtInfo_FrtrcvEFrErrnTrcv7
        OpEventGetMonitorStatus_GetMonitorStatus_EvtInfo_CansmEBusFaCanOff: RteEventRef=OpEventGetMonitorStatus_GetMonitorStatus_EvtInfo_CansmEBusFaCanOff
        OpEventGetMonitorStatus_GetMonitorStatus_EvtInfo_CantrcvEBusB2CanError: RteEventRef=OpEventGetMonitorStatus_GetMonitorStatus_EvtInfo_CantrcvEBusB2CanError
        OpEventGetMonitorStatus_GetMonitorStatus_EvtInfo_DtcCd{0605..0607}: RteEventRef=OpEventGetMonitorStatus_GetMonitorStatus_EvtInfo_DtcCd{0605..0607}
        OpEventGetMonitorStatus_GetMonitorStatus_EvtInfo_PiaEIoError: RteEventRef=OpEventGetMonitorStatus_GetMonitorStatus_EvtInfo_PiaEIoError
        OpEventGetMonitorStatus_GetMonitorStatus_EvtInfo_DtcCd0601: RteEventRef=OpEventGetMonitorStatus_GetMonitorStatus_EvtInfo_DtcCd0601
        OpEventGetMonitorStatus_GetMonitorStatus_EvtInfo_SwtExternalCheckFailure: RteEventRef=OpEventGetMonitorStatus_GetMonitorStatus_EvtInfo_SwtExternalCheckFailure
        OpEventGetMonitorStatus_GetMonitorStatus_EvtInfo_CantrcvEBusBodyCanError: RteEventRef=OpEventGetMonitorStatus_GetMonitorStatus_EvtInfo_CantrcvEBusBodyCanError
        OpEventGetMonitorStatus_GetMonitorStatus_EvtInfo_CantrcvEBusIukError: RteEventRef=OpEventGetMonitorStatus_GetMonitorStatus_EvtInfo_CantrcvEBusIukError
        OpEventGetMonitorStatus_GetMonitorStatus_EvtInfo_SwtInternalCheckFailure: RteEventRef=OpEventGetMonitorStatus_GetMonitorStatus_EvtInfo_SwtInternalCheckFailure
        OpEventGetMonitorStatus_GetMonitorStatus_EvtInfo_DmTestAppl: RteEventRef=OpEventGetMonitorStatus_GetMonitorStatus_EvtInfo_DmTestAppl
        OpEventGetMonitorStatus_GetMonitorStatus_EvtInfo_Dtc000032: RteEventRef=OpEventGetMonitorStatus_GetMonitorStatus_EvtInfo_Dtc000032
        OpEventGetMonitorStatus_GetMonitorStatus_EvtInfo_Dtc000031: RteEventRef=OpEventGetMonitorStatus_GetMonitorStatus_EvtInfo_Dtc000031
        OpEventGetMonitorStatus_GetMonitorStatus_EvtInfo_FrsmEClusterSyncLoss: RteEventRef=OpEventGetMonitorStatus_GetMonitorStatus_EvtInfo_FrsmEClusterSyncLoss
        OpEventGetMonitorStatus_GetMonitorStatus_EvtInfo_Dtc000030: RteEventRef=OpEventGetMonitorStatus_GetMonitorStatus_EvtInfo_Dtc000030
        OpEventGetMonitorStatus_GetMonitorStatus_EvtInfo_Dtc000034: RteEventRef=OpEventGetMonitorStatus_GetMonitorStatus_EvtInfo_Dtc000034
        OpEventGetMonitorStatus_GetMonitorStatus_EvtInfo_Dtc000033: RteEventRef=OpEventGetMonitorStatus_GetMonitorStatus_EvtInfo_Dtc000033
        OpEventGetMonitorStatus_GetMonitorStatus_EvtInfo_Undervoltage: RteEventRef=OpEventGetMonitorStatus_GetMonitorStatus_EvtInfo_Undervoltage
        OpEventGetMonitorStatus_GetMonitorStatus_EvtInfo_CodingEventTransactionFailed: RteEventRef=OpEventGetMonitorStatus_GetMonitorStatus_EvtInfo_CodingEventTransactionFailed
        OpEventGetMonitorStatus_GetMonitorStatus_EvtInfo_FrifENitChA: RteEventRef=OpEventGetMonitorStatus_GetMonitorStatus_EvtInfo_FrifENitChA
        OpEventGetMonitorStatus_GetMonitorStatus_EvtInfo_CansmEBusLpCanOff: RteEventRef=OpEventGetMonitorStatus_GetMonitorStatus_EvtInfo_CansmEBusLpCanOff
        OpEventGetMonitorStatus_GetMonitorStatus_EvtInfo_NVM_E_HARDWARE: RteEventRef=OpEventGetMonitorStatus_GetMonitorStatus_EvtInfo_NVM_E_HARDWARE
        OpEventGetMonitorStatus_GetMonitorStatus_EvtInfo_VsmEventOpmode: RteEventRef=OpEventGetMonitorStatus_GetMonitorStatus_EvtInfo_VsmEventOpmode
        OpEventGetMonitorStatus_GetMonitorStatus_EvtInfo_LIN_E_TIMEOUT: RteEventRef=OpEventGetMonitorStatus_GetMonitorStatus_EvtInfo_LIN_E_TIMEOUT
        OpEventGetMonitorStatus_GetMonitorStatus_EvtInfo_CantrcvEBusACanError: RteEventRef=OpEventGetMonitorStatus_GetMonitorStatus_EvtInfo_CantrcvEBusACanError
        OpEventGetMonitorStatus_GetMonitorStatus_EvtInfo_UDPNM_E_TCPIP_TRANSMIT_ERROR: RteEventRef=OpEventGetMonitorStatus_GetMonitorStatus_EvtInfo_UDPNM_E_TCPIP_TRANSMIT_ERROR
        OpEventGetMonitorStatus_GetMonitorStatus_EvtInfo_DmTestCom: RteEventRef=OpEventGetMonitorStatus_GetMonitorStatus_EvtInfo_DmTestCom
        OpEventGetMonitorStatus_GetMonitorStatus_EvtInfo_CodingEventSignatureError: RteEventRef=OpEventGetMonitorStatus_GetMonitorStatus_EvtInfo_CodingEventSignatureError
        OpEventGetMonitorStatus_GetMonitorStatus_EvtInfo_CodingEventUnqualifiedData: RteEventRef=OpEventGetMonitorStatus_GetMonitorStatus_EvtInfo_CodingEventUnqualifiedData
        OpEventGetMonitorStatus_GetMonitorStatus_EvtInfo_CodingEventInvalidData: RteEventRef=OpEventGetMonitorStatus_GetMonitorStatus_EvtInfo_CodingEventInvalidData
        OpEventGetMonitorStatus_GetMonitorStatus_EvtInfo_CansmEBusB2CanOff: RteEventRef=OpEventGetMonitorStatus_GetMonitorStatus_EvtInfo_CansmEBusB2CanOff
        OpEventGetMonitorStatus_GetMonitorStatus_EvtInfo_Overvoltage: RteEventRef=OpEventGetMonitorStatus_GetMonitorStatus_EvtInfo_Overvoltage
        OpEventGetMonitorStatus_GetMonitorStatus_EvtInfo_CodingEventNotCoded: RteEventRef=OpEventGetMonitorStatus_GetMonitorStatus_EvtInfo_CodingEventNotCoded
        OpEventGetMonitorStatus_GetMonitorStatus_EvtInfo_FrifEAcsChA: RteEventRef=OpEventGetMonitorStatus_GetMonitorStatus_EvtInfo_FrifEAcsChA
        OpEventGetMonitorStatus_GetMonitorStatus_EvtInfo_CantrcvEBusFaCanError: RteEventRef=OpEventGetMonitorStatus_GetMonitorStatus_EvtInfo_CantrcvEBusFaCanError
        OpEventGetMonitorStatus_GetMonitorStatus_EvtInfo_CantrcvEBusLeCanError: RteEventRef=OpEventGetMonitorStatus_GetMonitorStatus_EvtInfo_CantrcvEBusLeCanError
        OpEventGetMonitorStatus_GetMonitorStatus_EvtInfo_CantrcvEBusLpCanError: RteEventRef=OpEventGetMonitorStatus_GetMonitorStatus_EvtInfo_CantrcvEBusLpCanError
        OpEventGetMonitorStatus_GetMonitorStatus_EvtInfo_CantrcvEBusZsgCanError: RteEventRef=OpEventGetMonitorStatus_GetMonitorStatus_EvtInfo_CantrcvEBusZsgCanError
        OpEventGetMonitorStatus_GetMonitorStatus_EvtInfo_EthSignalQualityLow: RteEventRef=OpEventGetMonitorStatus_GetMonitorStatus_EvtInfo_EthSignalQualityLow
        OpEventGetMonitorStatus_GetMonitorStatus_EvtInfo_DemEventParameter_FlsConfigSet_FLS_E_COMPARE_FAILED: RteEventRef=OpEventGetMonitorStatus_GetMonitorStatus_EvtInfo_DemEventParameter_FlsConfigSet_FLS_E_COMPARE_FAILED
        OpEventGetMonitorStatus_GetMonitorStatus_EvtInfo_DemEventParameter_FlsConfigSet_FLS_E_ERASE_FAILED: RteEventRef=OpEventGetMonitorStatus_GetMonitorStatus_EvtInfo_DemEventParameter_FlsConfigSet_FLS_E_ERASE_FAILED
        OpEventGetMonitorStatus_GetMonitorStatus_EvtInfo_DemEventParameter_FlsConfigSet_FLS_E_READ_FAILED: RteEventRef=OpEventGetMonitorStatus_GetMonitorStatus_EvtInfo_DemEventParameter_FlsConfigSet_FLS_E_READ_FAILED
        OpEventGetMonitorStatus_GetMonitorStatus_EvtInfo_DemEventParameter_FlsConfigSet_FLS_E_WRITE_FAILED: RteEventRef=OpEventGetMonitorStatus_GetMonitorStatus_EvtInfo_DemEventParameter_FlsConfigSet_FLS_E_WRITE_FAILED
        OpEventGetMonitorStatus_GetMonitorStatus_EvtInfo_DemEventParameter_FlsConfigSet_FLS_E_READ_DED_FAILED: RteEventRef=OpEventGetMonitorStatus_GetMonitorStatus_EvtInfo_DemEventParameter_FlsConfigSet_FLS_E_READ_DED_FAILED
        OpEventGetMonitorStatus_GetMonitorStatus_EvtInfo_DemEventParameter_FlsConfigSet_FLS_E_UNEXPECTED_FLASH_ID: RteEventRef=OpEventGetMonitorStatus_GetMonitorStatus_EvtInfo_DemEventParameter_FlsConfigSet_FLS_E_UNEXPECTED_FLASH_ID
        OpEventGetMonitorStatus_GetMonitorStatus_EvtInfo_DemEventParameter_FlsConfigSet_MCU_E_CLOCK_FAILED: RteEventRef=OpEventGetMonitorStatus_GetMonitorStatus_EvtInfo_DemEventParameter_FlsConfigSet_MCU_E_CLOCK_FAILED
        OpEventGetMonitorStatus_GetMonitorStatus_EvtInfo_DemEventParameter_FlsConfigSet_MCU_E_HW_FAILED: RteEventRef=OpEventGetMonitorStatus_GetMonitorStatus_EvtInfo_DemEventParameter_FlsConfigSet_MCU_E_HW_FAILED
        OpEventGetMonitorStatus_GetMonitorStatus_EvtInfo_DemEventParameter_FlsConfigSet_MCU_E_STARTUP_FAILED: RteEventRef=OpEventGetMonitorStatus_GetMonitorStatus_EvtInfo_DemEventParameter_FlsConfigSet_MCU_E_STARTUP_FAILED
        OpEventGetMonitorStatus_GetMonitorStatus_EvtInfo_DemEventParameter_FlsConfigSet_FLS_E_ECC_FAILED: RteEventRef=OpEventGetMonitorStatus_GetMonitorStatus_EvtInfo_DemEventParameter_FlsConfigSet_FLS_E_ECC_FAILED
        OpEventGetMonitorStatus_GetMonitorStatus_EvtInfo_DemEventParameter_FlsConfigSet_FLS_E_VRFY_FAILED: RteEventRef=OpEventGetMonitorStatus_GetMonitorStatus_EvtInfo_DemEventParameter_FlsConfigSet_FLS_E_VRFY_FAILED
        OpEventGetMonitorStatus_GetMonitorStatus_EvtInfo_DemEventParameter_FlsConfigSet_FLS_E_INT_FAILED: RteEventRef=OpEventGetMonitorStatus_GetMonitorStatus_EvtInfo_DemEventParameter_FlsConfigSet_FLS_E_INT_FAILED
        OpEventGetMonitorStatus_GetMonitorStatus_EvtInfo_DemEventParameter_FlsConfigSet_FLS_E_HW_FAILED: RteEventRef=OpEventGetMonitorStatus_GetMonitorStatus_EvtInfo_DemEventParameter_FlsConfigSet_FLS_E_HW_FAILED
        OpEventGetMonitorStatus_GetMonitorStatus_GeneralEventInfo: RteEventRef=OpEventGetMonitorStatus_GetMonitorStatus_GeneralEventInfo
        OpEventSetEventStatus_SetEventStatus_Event_FrtrcvEFrErrnTrcv0: RteEventRef=OpEventSetEventStatus_SetEventStatus_Event_FrtrcvEFrErrnTrcv0
        OpEventSetEventStatus_SetEventStatus_Event_CansmEBusIukCanOff: RteEventRef=OpEventSetEventStatus_SetEventStatus_Event_CansmEBusIukCanOff
        OpEventSetEventStatus_SetEventStatus_Event_FrtrcvEFrErrnTrcv2: RteEventRef=OpEventSetEventStatus_SetEventStatus_Event_FrtrcvEFrErrnTrcv2
        OpEventSetEventStatus_SetEventStatus_Event_FrtrcvEFrErrnTrcv1: RteEventRef=OpEventSetEventStatus_SetEventStatus_Event_FrtrcvEFrErrnTrcv1
        OpEventSetEventStatus_SetEventStatus_Event_FrtrcvEFrErrnTrcv4: RteEventRef=OpEventSetEventStatus_SetEventStatus_Event_FrtrcvEFrErrnTrcv4
        OpEventSetEventStatus_SetEventStatus_Event_FrtrcvEFrErrnTrcv3: RteEventRef=OpEventSetEventStatus_SetEventStatus_Event_FrtrcvEFrErrnTrcv3
        OpEventSetEventStatus_SetEventStatus_Event_FrtrcvEFrErrnTrcv6: RteEventRef=OpEventSetEventStatus_SetEventStatus_Event_FrtrcvEFrErrnTrcv6
        OpEventSetEventStatus_SetEventStatus_Event_FrtrcvEFrErrnTrcv5: RteEventRef=OpEventSetEventStatus_SetEventStatus_Event_FrtrcvEFrErrnTrcv5
        OpEventSetEventStatus_SetEventStatus_Event_CansmEBusBodyCanOff: RteEventRef=OpEventSetEventStatus_SetEventStatus_Event_CansmEBusBodyCanOff
        OpEventSetEventStatus_SetEventStatus_Event_CbsReplacementValue: RteEventRef=OpEventSetEventStatus_SetEventStatus_Event_CbsReplacementValue
        OpEventSetEventStatus_SetEventStatus_Event_CansmEBusLeCanOff: RteEventRef=OpEventSetEventStatus_SetEventStatus_Event_CansmEBusLeCanOff
        OpEventSetEventStatus_SetEventStatus_Event_CansmEBusZsgCanOff: RteEventRef=OpEventSetEventStatus_SetEventStatus_Event_CansmEBusZsgCanOff
        OpEventSetEventStatus_SetEventStatus_Event_CodingEventWrongVehicle: RteEventRef=OpEventSetEventStatus_SetEventStatus_Event_CodingEventWrongVehicle
        OpEventSetEventStatus_SetEventStatus_Event_FrsmEClusterStartup: RteEventRef=OpEventSetEventStatus_SetEventStatus_Event_FrsmEClusterStartup
        OpEventSetEventStatus_SetEventStatus_Event_CansmEBusACanOff: RteEventRef=OpEventSetEventStatus_SetEventStatus_Event_CansmEBusACanOff
        OpEventSetEventStatus_SetEventStatus_Event_CansmEBusKCanOff: RteEventRef=OpEventSetEventStatus_SetEventStatus_Event_CansmEBusKCanOff
        OpEventSetEventStatus_SetEventStatus_Event_CantrcvEBusKCanError: RteEventRef=OpEventSetEventStatus_SetEventStatus_Event_CantrcvEBusKCanError
        OpEventSetEventStatus_SetEventStatus_Event_FrtrcvEFrBuserrorTrcv0: RteEventRef=OpEventSetEventStatus_SetEventStatus_Event_FrtrcvEFrBuserrorTrcv0
        OpEventSetEventStatus_SetEventStatus_Event_FrtrcvEFrErrnTrcv7: RteEventRef=OpEventSetEventStatus_SetEventStatus_Event_FrtrcvEFrErrnTrcv7
        OpEventSetEventStatus_SetEventStatus_Event_CansmEBusFaCanOff: RteEventRef=OpEventSetEventStatus_SetEventStatus_Event_CansmEBusFaCanOff
        OpEventSetEventStatus_SetEventStatus_Event_CantrcvEBusB2CanError: RteEventRef=OpEventSetEventStatus_SetEventStatus_Event_CantrcvEBusB2CanError
        OpEventSetEventStatus_SetEventStatus_Event_DtcCd{0605..0607}: RteEventRef=OpEventSetEventStatus_SetEventStatus_Event_DtcCd{0605..0607}
        OpEventSetEventStatus_SetEventStatus_Event_PiaEIoError: RteEventRef=OpEventSetEventStatus_SetEventStatus_Event_PiaEIoError
        OpEventSetEventStatus_SetEventStatus_Event_DtcCd0601: RteEventRef=OpEventSetEventStatus_SetEventStatus_Event_DtcCd0601
        OpEventSetEventStatus_SetEventStatus_Event_SwtExternalCheckFailure: RteEventRef=OpEventSetEventStatus_SetEventStatus_Event_SwtExternalCheckFailure
        OpEventSetEventStatus_SetEventStatus_Event_CantrcvEBusBodyCanError: RteEventRef=OpEventSetEventStatus_SetEventStatus_Event_CantrcvEBusBodyCanError
        OpEventSetEventStatus_SetEventStatus_Event_CantrcvEBusIukError: RteEventRef=OpEventSetEventStatus_SetEventStatus_Event_CantrcvEBusIukError
        OpEventSetEventStatus_SetEventStatus_Event_SwtInternalCheckFailure: RteEventRef=OpEventSetEventStatus_SetEventStatus_Event_SwtInternalCheckFailure
        OpEventSetEventStatus_SetEventStatus_Event_DmTestAppl: RteEventRef=OpEventSetEventStatus_SetEventStatus_Event_DmTestAppl
        OpEventSetEventStatus_SetEventStatus_Event_Dtc000032: RteEventRef=OpEventSetEventStatus_SetEventStatus_Event_Dtc000032
        OpEventSetEventStatus_SetEventStatus_Event_Dtc000031: RteEventRef=OpEventSetEventStatus_SetEventStatus_Event_Dtc000031
        OpEventSetEventStatus_SetEventStatus_Event_FrsmEClusterSyncLoss: RteEventRef=OpEventSetEventStatus_SetEventStatus_Event_FrsmEClusterSyncLoss
        OpEventSetEventStatus_SetEventStatus_Event_Dtc000030: RteEventRef=OpEventSetEventStatus_SetEventStatus_Event_Dtc000030
        OpEventSetEventStatus_SetEventStatus_Event_Dtc000034: RteEventRef=OpEventSetEventStatus_SetEventStatus_Event_Dtc000034
        OpEventSetEventStatus_SetEventStatus_Event_Dtc000033: RteEventRef=OpEventSetEventStatus_SetEventStatus_Event_Dtc000033
        OpEventSetEventStatus_SetEventStatus_Event_Undervoltage: RteEventRef=OpEventSetEventStatus_SetEventStatus_Event_Undervoltage
        OpEventSetEventStatus_SetEventStatus_Event_CodingEventTransactionFailed: RteEventRef=OpEventSetEventStatus_SetEventStatus_Event_CodingEventTransactionFailed
        OpEventSetEventStatus_SetEventStatus_Event_FrifENitChA: RteEventRef=OpEventSetEventStatus_SetEventStatus_Event_FrifENitChA
        OpEventSetEventStatus_SetEventStatus_Event_CansmEBusLpCanOff: RteEventRef=OpEventSetEventStatus_SetEventStatus_Event_CansmEBusLpCanOff
        OpEventSetEventStatus_SetEventStatus_Event_VsmEventOpmode: RteEventRef=OpEventSetEventStatus_SetEventStatus_Event_VsmEventOpmode
        OpEventSetEventStatus_SetEventStatus_Event_CantrcvEBusACanError: RteEventRef=OpEventSetEventStatus_SetEventStatus_Event_CantrcvEBusACanError
        OpEventSetEventStatus_SetEventStatus_Event_DmTestCom: RteEventRef=OpEventSetEventStatus_SetEventStatus_Event_DmTestCom
        OpEventSetEventStatus_SetEventStatus_Event_CodingEventSignatureError: RteEventRef=OpEventSetEventStatus_SetEventStatus_Event_CodingEventSignatureError
        OpEventSetEventStatus_SetEventStatus_Event_CodingEventUnqualifiedData: RteEventRef=OpEventSetEventStatus_SetEventStatus_Event_CodingEventUnqualifiedData
        OpEventSetEventStatus_SetEventStatus_Event_CodingEventInvalidData: RteEventRef=OpEventSetEventStatus_SetEventStatus_Event_CodingEventInvalidData
        OpEventSetEventStatus_SetEventStatus_Event_CansmEBusB2CanOff: RteEventRef=OpEventSetEventStatus_SetEventStatus_Event_CansmEBusB2CanOff
        OpEventSetEventStatus_SetEventStatus_Event_Overvoltage: RteEventRef=OpEventSetEventStatus_SetEventStatus_Event_Overvoltage
        OpEventSetEventStatus_SetEventStatus_Event_CodingEventNotCoded: RteEventRef=OpEventSetEventStatus_SetEventStatus_Event_CodingEventNotCoded
        OpEventSetEventStatus_SetEventStatus_Event_FrifEAcsChA: RteEventRef=OpEventSetEventStatus_SetEventStatus_Event_FrifEAcsChA
        OpEventSetEventStatus_SetEventStatus_Event_CantrcvEBusFaCanError: RteEventRef=OpEventSetEventStatus_SetEventStatus_Event_CantrcvEBusFaCanError
        OpEventSetEventStatus_SetEventStatus_Event_CantrcvEBusLeCanError: RteEventRef=OpEventSetEventStatus_SetEventStatus_Event_CantrcvEBusLeCanError
        OpEventSetEventStatus_SetEventStatus_Event_CantrcvEBusLpCanError: RteEventRef=OpEventSetEventStatus_SetEventStatus_Event_CantrcvEBusLpCanError
        OpEventSetEventStatus_SetEventStatus_Event_CantrcvEBusZsgCanError: RteEventRef=OpEventSetEventStatus_SetEventStatus_Event_CantrcvEBusZsgCanError
        OpEventSetEventStatus_SetEventStatus_Event_EthSignalQualityLow: RteEventRef=OpEventSetEventStatus_SetEventStatus_Event_EthSignalQualityLow
        OpEventResetEventStatus_ResetEventStatus_Event_FrtrcvEFrErrnTrcv0: RteEventRef=OpEventResetEventStatus_ResetEventStatus_Event_FrtrcvEFrErrnTrcv0
        OpEventResetEventStatus_ResetEventStatus_Event_CansmEBusIukCanOff: RteEventRef=OpEventResetEventStatus_ResetEventStatus_Event_CansmEBusIukCanOff
        OpEventResetEventStatus_ResetEventStatus_Event_FrtrcvEFrErrnTrcv2: RteEventRef=OpEventResetEventStatus_ResetEventStatus_Event_FrtrcvEFrErrnTrcv2
        OpEventResetEventStatus_ResetEventStatus_Event_FrtrcvEFrErrnTrcv1: RteEventRef=OpEventResetEventStatus_ResetEventStatus_Event_FrtrcvEFrErrnTrcv1
        OpEventResetEventStatus_ResetEventStatus_Event_FrtrcvEFrErrnTrcv4: RteEventRef=OpEventResetEventStatus_ResetEventStatus_Event_FrtrcvEFrErrnTrcv4
        OpEventResetEventStatus_ResetEventStatus_Event_FrtrcvEFrErrnTrcv3: RteEventRef=OpEventResetEventStatus_ResetEventStatus_Event_FrtrcvEFrErrnTrcv3
        OpEventResetEventStatus_ResetEventStatus_Event_FrtrcvEFrErrnTrcv6: RteEventRef=OpEventResetEventStatus_ResetEventStatus_Event_FrtrcvEFrErrnTrcv6
        OpEventResetEventStatus_ResetEventStatus_Event_FrtrcvEFrErrnTrcv5: RteEventRef=OpEventResetEventStatus_ResetEventStatus_Event_FrtrcvEFrErrnTrcv5
        OpEventResetEventStatus_ResetEventStatus_Event_CansmEBusBodyCanOff: RteEventRef=OpEventResetEventStatus_ResetEventStatus_Event_CansmEBusBodyCanOff
        OpEventResetEventStatus_ResetEventStatus_Event_CbsReplacementValue: RteEventRef=OpEventResetEventStatus_ResetEventStatus_Event_CbsReplacementValue
        OpEventResetEventStatus_ResetEventStatus_Event_CansmEBusLeCanOff: RteEventRef=OpEventResetEventStatus_ResetEventStatus_Event_CansmEBusLeCanOff
        OpEventResetEventStatus_ResetEventStatus_Event_CansmEBusZsgCanOff: RteEventRef=OpEventResetEventStatus_ResetEventStatus_Event_CansmEBusZsgCanOff
        OpEventResetEventStatus_ResetEventStatus_Event_CodingEventWrongVehicle: RteEventRef=OpEventResetEventStatus_ResetEventStatus_Event_CodingEventWrongVehicle
        OpEventResetEventStatus_ResetEventStatus_Event_FrsmEClusterStartup: RteEventRef=OpEventResetEventStatus_ResetEventStatus_Event_FrsmEClusterStartup
        OpEventResetEventStatus_ResetEventStatus_Event_CansmEBusACanOff: RteEventRef=OpEventResetEventStatus_ResetEventStatus_Event_CansmEBusACanOff
        OpEventResetEventStatus_ResetEventStatus_Event_CansmEBusKCanOff: RteEventRef=OpEventResetEventStatus_ResetEventStatus_Event_CansmEBusKCanOff
        OpEventResetEventStatus_ResetEventStatus_Event_CantrcvEBusKCanError: RteEventRef=OpEventResetEventStatus_ResetEventStatus_Event_CantrcvEBusKCanError
        OpEventResetEventStatus_ResetEventStatus_Event_FrtrcvEFrBuserrorTrcv0: RteEventRef=OpEventResetEventStatus_ResetEventStatus_Event_FrtrcvEFrBuserrorTrcv0
        OpEventResetEventStatus_ResetEventStatus_Event_FrtrcvEFrErrnTrcv7: RteEventRef=OpEventResetEventStatus_ResetEventStatus_Event_FrtrcvEFrErrnTrcv7
        OpEventResetEventStatus_ResetEventStatus_Event_CansmEBusFaCanOff: RteEventRef=OpEventResetEventStatus_ResetEventStatus_Event_CansmEBusFaCanOff
        OpEventResetEventStatus_ResetEventStatus_Event_CantrcvEBusB2CanError: RteEventRef=OpEventResetEventStatus_ResetEventStatus_Event_CantrcvEBusB2CanError
        OpEventResetEventStatus_ResetEventStatus_Event_DtcCd{0605..0607}: RteEventRef=OpEventResetEventStatus_ResetEventStatus_Event_DtcCd{0605..0607}
        OpEventResetEventStatus_ResetEventStatus_Event_PiaEIoError: RteEventRef=OpEventResetEventStatus_ResetEventStatus_Event_PiaEIoError
        OpEventResetEventStatus_ResetEventStatus_Event_DtcCd0601: RteEventRef=OpEventResetEventStatus_ResetEventStatus_Event_DtcCd0601
        OpEventResetEventStatus_ResetEventStatus_Event_SwtExternalCheckFailure: RteEventRef=OpEventResetEventStatus_ResetEventStatus_Event_SwtExternalCheckFailure
        OpEventResetEventStatus_ResetEventStatus_Event_CantrcvEBusBodyCanError: RteEventRef=OpEventResetEventStatus_ResetEventStatus_Event_CantrcvEBusBodyCanError
        OpEventResetEventStatus_ResetEventStatus_Event_CantrcvEBusIukError: RteEventRef=OpEventResetEventStatus_ResetEventStatus_Event_CantrcvEBusIukError
        OpEventResetEventStatus_ResetEventStatus_Event_SwtInternalCheckFailure: RteEventRef=OpEventResetEventStatus_ResetEventStatus_Event_SwtInternalCheckFailure
        OpEventResetEventStatus_ResetEventStatus_Event_DmTestAppl: RteEventRef=OpEventResetEventStatus_ResetEventStatus_Event_DmTestAppl
        OpEventResetEventStatus_ResetEventStatus_Event_Dtc000032: RteEventRef=OpEventResetEventStatus_ResetEventStatus_Event_Dtc000032
        OpEventResetEventStatus_ResetEventStatus_Event_Dtc000031: RteEventRef=OpEventResetEventStatus_ResetEventStatus_Event_Dtc000031
        OpEventResetEventStatus_ResetEventStatus_Event_FrsmEClusterSyncLoss: RteEventRef=OpEventResetEventStatus_ResetEventStatus_Event_FrsmEClusterSyncLoss
        OpEventResetEventStatus_ResetEventStatus_Event_Dtc000030: RteEventRef=OpEventResetEventStatus_ResetEventStatus_Event_Dtc000030
        OpEventResetEventStatus_ResetEventStatus_Event_Dtc000034: RteEventRef=OpEventResetEventStatus_ResetEventStatus_Event_Dtc000034
        OpEventResetEventStatus_ResetEventStatus_Event_Dtc000033: RteEventRef=OpEventResetEventStatus_ResetEventStatus_Event_Dtc000033
        OpEventResetEventStatus_ResetEventStatus_Event_Undervoltage: RteEventRef=OpEventResetEventStatus_ResetEventStatus_Event_Undervoltage
        OpEventResetEventStatus_ResetEventStatus_Event_CodingEventTransactionFailed: RteEventRef=OpEventResetEventStatus_ResetEventStatus_Event_CodingEventTransactionFailed
        OpEventResetEventStatus_ResetEventStatus_Event_FrifENitChA: RteEventRef=OpEventResetEventStatus_ResetEventStatus_Event_FrifENitChA
        OpEventResetEventStatus_ResetEventStatus_Event_CansmEBusLpCanOff: RteEventRef=OpEventResetEventStatus_ResetEventStatus_Event_CansmEBusLpCanOff
        OpEventResetEventStatus_ResetEventStatus_Event_VsmEventOpmode: RteEventRef=OpEventResetEventStatus_ResetEventStatus_Event_VsmEventOpmode
        OpEventResetEventStatus_ResetEventStatus_Event_CantrcvEBusACanError: RteEventRef=OpEventResetEventStatus_ResetEventStatus_Event_CantrcvEBusACanError
        OpEventResetEventStatus_ResetEventStatus_Event_DmTestCom: RteEventRef=OpEventResetEventStatus_ResetEventStatus_Event_DmTestCom
        OpEventResetEventStatus_ResetEventStatus_Event_CodingEventSignatureError: RteEventRef=OpEventResetEventStatus_ResetEventStatus_Event_CodingEventSignatureError
        OpEventResetEventStatus_ResetEventStatus_Event_CodingEventUnqualifiedData: RteEventRef=OpEventResetEventStatus_ResetEventStatus_Event_CodingEventUnqualifiedData
        OpEventResetEventStatus_ResetEventStatus_Event_CodingEventInvalidData: RteEventRef=OpEventResetEventStatus_ResetEventStatus_Event_CodingEventInvalidData
        OpEventResetEventStatus_ResetEventStatus_Event_CansmEBusB2CanOff: RteEventRef=OpEventResetEventStatus_ResetEventStatus_Event_CansmEBusB2CanOff
        OpEventResetEventStatus_ResetEventStatus_Event_Overvoltage: RteEventRef=OpEventResetEventStatus_ResetEventStatus_Event_Overvoltage
        OpEventResetEventStatus_ResetEventStatus_Event_CodingEventNotCoded: RteEventRef=OpEventResetEventStatus_ResetEventStatus_Event_CodingEventNotCoded
        OpEventResetEventStatus_ResetEventStatus_Event_FrifEAcsChA: RteEventRef=OpEventResetEventStatus_ResetEventStatus_Event_FrifEAcsChA
        OpEventResetEventStatus_ResetEventStatus_Event_CantrcvEBusFaCanError: RteEventRef=OpEventResetEventStatus_ResetEventStatus_Event_CantrcvEBusFaCanError
        OpEventResetEventStatus_ResetEventStatus_Event_CantrcvEBusLeCanError: RteEventRef=OpEventResetEventStatus_ResetEventStatus_Event_CantrcvEBusLeCanError
        OpEventResetEventStatus_ResetEventStatus_Event_CantrcvEBusLpCanError: RteEventRef=OpEventResetEventStatus_ResetEventStatus_Event_CantrcvEBusLpCanError
        OpEventResetEventStatus_ResetEventStatus_Event_CantrcvEBusZsgCanError: RteEventRef=OpEventResetEventStatus_ResetEventStatus_Event_CantrcvEBusZsgCanError
        OpEventResetEventStatus_ResetEventStatus_Event_EthSignalQualityLow: RteEventRef=OpEventResetEventStatus_ResetEventStatus_Event_EthSignalQualityLow
        OpEventResetEventDebounceStatus_ResetEventDebounceStatus_Event_FrtrcvEFrErrnTrcv0: RteEventRef=OpEventResetEventDebounceStatus_ResetEventDebounceStatus_Event_FrtrcvEFrErrnTrcv0
        OpEventResetEventDebounceStatus_ResetEventDebounceStatus_Event_CansmEBusIukCanOff: RteEventRef=OpEventResetEventDebounceStatus_ResetEventDebounceStatus_Event_CansmEBusIukCanOff
        OpEventResetEventDebounceStatus_ResetEventDebounceStatus_Event_FrtrcvEFrErrnTrcv2: RteEventRef=OpEventResetEventDebounceStatus_ResetEventDebounceStatus_Event_FrtrcvEFrErrnTrcv2
        OpEventResetEventDebounceStatus_ResetEventDebounceStatus_Event_FrtrcvEFrErrnTrcv1: RteEventRef=OpEventResetEventDebounceStatus_ResetEventDebounceStatus_Event_FrtrcvEFrErrnTrcv1
        OpEventResetEventDebounceStatus_ResetEventDebounceStatus_Event_FrtrcvEFrErrnTrcv4: RteEventRef=OpEventResetEventDebounceStatus_ResetEventDebounceStatus_Event_FrtrcvEFrErrnTrcv4
        OpEventResetEventDebounceStatus_ResetEventDebounceStatus_Event_FrtrcvEFrErrnTrcv3: RteEventRef=OpEventResetEventDebounceStatus_ResetEventDebounceStatus_Event_FrtrcvEFrErrnTrcv3
        OpEventResetEventDebounceStatus_ResetEventDebounceStatus_Event_FrtrcvEFrErrnTrcv6: RteEventRef=OpEventResetEventDebounceStatus_ResetEventDebounceStatus_Event_FrtrcvEFrErrnTrcv6
        OpEventResetEventDebounceStatus_ResetEventDebounceStatus_Event_FrtrcvEFrErrnTrcv5: RteEventRef=OpEventResetEventDebounceStatus_ResetEventDebounceStatus_Event_FrtrcvEFrErrnTrcv5
        OpEventResetEventDebounceStatus_ResetEventDebounceStatus_Event_CansmEBusBodyCanOff: RteEventRef=OpEventResetEventDebounceStatus_ResetEventDebounceStatus_Event_CansmEBusBodyCanOff
        OpEventResetEventDebounceStatus_ResetEventDebounceStatus_Event_CbsReplacementValue: RteEventRef=OpEventResetEventDebounceStatus_ResetEventDebounceStatus_Event_CbsReplacementValue
        OpEventResetEventDebounceStatus_ResetEventDebounceStatus_Event_CansmEBusLeCanOff: RteEventRef=OpEventResetEventDebounceStatus_ResetEventDebounceStatus_Event_CansmEBusLeCanOff
        OpEventResetEventDebounceStatus_ResetEventDebounceStatus_Event_CansmEBusZsgCanOff: RteEventRef=OpEventResetEventDebounceStatus_ResetEventDebounceStatus_Event_CansmEBusZsgCanOff
        OpEventResetEventDebounceStatus_ResetEventDebounceStatus_Event_CodingEventWrongVehicle: RteEventRef=OpEventResetEventDebounceStatus_ResetEventDebounceStatus_Event_CodingEventWrongVehicle
        OpEventResetEventDebounceStatus_ResetEventDebounceStatus_Event_FrsmEClusterStartup: RteEventRef=OpEventResetEventDebounceStatus_ResetEventDebounceStatus_Event_FrsmEClusterStartup
        OpEventResetEventDebounceStatus_ResetEventDebounceStatus_Event_CansmEBusACanOff: RteEventRef=OpEventResetEventDebounceStatus_ResetEventDebounceStatus_Event_CansmEBusACanOff
        OpEventResetEventDebounceStatus_ResetEventDebounceStatus_Event_CansmEBusKCanOff: RteEventRef=OpEventResetEventDebounceStatus_ResetEventDebounceStatus_Event_CansmEBusKCanOff
        OpEventResetEventDebounceStatus_ResetEventDebounceStatus_Event_CantrcvEBusKCanError: RteEventRef=OpEventResetEventDebounceStatus_ResetEventDebounceStatus_Event_CantrcvEBusKCanError
        OpEventResetEventDebounceStatus_ResetEventDebounceStatus_Event_FrtrcvEFrBuserrorTrcv0: RteEventRef=OpEventResetEventDebounceStatus_ResetEventDebounceStatus_Event_FrtrcvEFrBuserrorTrcv0
        OpEventResetEventDebounceStatus_ResetEventDebounceStatus_Event_FrtrcvEFrErrnTrcv7: RteEventRef=OpEventResetEventDebounceStatus_ResetEventDebounceStatus_Event_FrtrcvEFrErrnTrcv7
        OpEventResetEventDebounceStatus_ResetEventDebounceStatus_Event_CansmEBusFaCanOff: RteEventRef=OpEventResetEventDebounceStatus_ResetEventDebounceStatus_Event_CansmEBusFaCanOff
        OpEventResetEventDebounceStatus_ResetEventDebounceStatus_Event_CantrcvEBusB2CanError: RteEventRef=OpEventResetEventDebounceStatus_ResetEventDebounceStatus_Event_CantrcvEBusB2CanError
        OpEventResetEventDebounceStatus_ResetEventDebounceStatus_Event_DtcCd{0605..0607}: RteEventRef=OpEventResetEventDebounceStatus_ResetEventDebounceStatus_Event_DtcCd{0605..0607}
        OpEventResetEventDebounceStatus_ResetEventDebounceStatus_Event_PiaEIoError: RteEventRef=OpEventResetEventDebounceStatus_ResetEventDebounceStatus_Event_PiaEIoError
        OpEventResetEventDebounceStatus_ResetEventDebounceStatus_Event_DtcCd0601: RteEventRef=OpEventResetEventDebounceStatus_ResetEventDebounceStatus_Event_DtcCd0601
        OpEventResetEventDebounceStatus_ResetEventDebounceStatus_Event_SwtExternalCheckFailure: RteEventRef=OpEventResetEventDebounceStatus_ResetEventDebounceStatus_Event_SwtExternalCheckFailure
        OpEventResetEventDebounceStatus_ResetEventDebounceStatus_Event_CantrcvEBusBodyCanError: RteEventRef=OpEventResetEventDebounceStatus_ResetEventDebounceStatus_Event_CantrcvEBusBodyCanError
        OpEventResetEventDebounceStatus_ResetEventDebounceStatus_Event_CantrcvEBusIukError: RteEventRef=OpEventResetEventDebounceStatus_ResetEventDebounceStatus_Event_CantrcvEBusIukError
        OpEventResetEventDebounceStatus_ResetEventDebounceStatus_Event_SwtInternalCheckFailure: RteEventRef=OpEventResetEventDebounceStatus_ResetEventDebounceStatus_Event_SwtInternalCheckFailure
        OpEventResetEventDebounceStatus_ResetEventDebounceStatus_Event_DmTestAppl: RteEventRef=OpEventResetEventDebounceStatus_ResetEventDebounceStatus_Event_DmTestAppl
        OpEventResetEventDebounceStatus_ResetEventDebounceStatus_Event_Dtc000032: RteEventRef=OpEventResetEventDebounceStatus_ResetEventDebounceStatus_Event_Dtc000032
        OpEventResetEventDebounceStatus_ResetEventDebounceStatus_Event_Dtc000031: RteEventRef=OpEventResetEventDebounceStatus_ResetEventDebounceStatus_Event_Dtc000031
        OpEventResetEventDebounceStatus_ResetEventDebounceStatus_Event_FrsmEClusterSyncLoss: RteEventRef=OpEventResetEventDebounceStatus_ResetEventDebounceStatus_Event_FrsmEClusterSyncLoss
        OpEventResetEventDebounceStatus_ResetEventDebounceStatus_Event_Dtc000030: RteEventRef=OpEventResetEventDebounceStatus_ResetEventDebounceStatus_Event_Dtc000030
        OpEventResetEventDebounceStatus_ResetEventDebounceStatus_Event_Dtc000034: RteEventRef=OpEventResetEventDebounceStatus_ResetEventDebounceStatus_Event_Dtc000034
        OpEventResetEventDebounceStatus_ResetEventDebounceStatus_Event_Dtc000033: RteEventRef=OpEventResetEventDebounceStatus_ResetEventDebounceStatus_Event_Dtc000033
        OpEventResetEventDebounceStatus_ResetEventDebounceStatus_Event_Undervoltage: RteEventRef=OpEventResetEventDebounceStatus_ResetEventDebounceStatus_Event_Undervoltage
        OpEventResetEventDebounceStatus_ResetEventDebounceStatus_Event_CodingEventTransactionFailed: RteEventRef=OpEventResetEventDebounceStatus_ResetEventDebounceStatus_Event_CodingEventTransactionFailed
        OpEventResetEventDebounceStatus_ResetEventDebounceStatus_Event_FrifENitChA: RteEventRef=OpEventResetEventDebounceStatus_ResetEventDebounceStatus_Event_FrifENitChA
        OpEventResetEventDebounceStatus_ResetEventDebounceStatus_Event_CansmEBusLpCanOff: RteEventRef=OpEventResetEventDebounceStatus_ResetEventDebounceStatus_Event_CansmEBusLpCanOff
        OpEventResetEventDebounceStatus_ResetEventDebounceStatus_Event_VsmEventOpmode: RteEventRef=OpEventResetEventDebounceStatus_ResetEventDebounceStatus_Event_VsmEventOpmode
        OpEventResetEventDebounceStatus_ResetEventDebounceStatus_Event_CantrcvEBusACanError: RteEventRef=OpEventResetEventDebounceStatus_ResetEventDebounceStatus_Event_CantrcvEBusACanError
        OpEventResetEventDebounceStatus_ResetEventDebounceStatus_Event_DmTestCom: RteEventRef=OpEventResetEventDebounceStatus_ResetEventDebounceStatus_Event_DmTestCom
        OpEventResetEventDebounceStatus_ResetEventDebounceStatus_Event_CodingEventSignatureError: RteEventRef=OpEventResetEventDebounceStatus_ResetEventDebounceStatus_Event_CodingEventSignatureError
        OpEventResetEventDebounceStatus_ResetEventDebounceStatus_Event_CodingEventUnqualifiedData: RteEventRef=OpEventResetEventDebounceStatus_ResetEventDebounceStatus_Event_CodingEventUnqualifiedData
        OpEventResetEventDebounceStatus_ResetEventDebounceStatus_Event_CodingEventInvalidData: RteEventRef=OpEventResetEventDebounceStatus_ResetEventDebounceStatus_Event_CodingEventInvalidData
        OpEventResetEventDebounceStatus_ResetEventDebounceStatus_Event_CansmEBusB2CanOff: RteEventRef=OpEventResetEventDebounceStatus_ResetEventDebounceStatus_Event_CansmEBusB2CanOff
        OpEventResetEventDebounceStatus_ResetEventDebounceStatus_Event_Overvoltage: RteEventRef=OpEventResetEventDebounceStatus_ResetEventDebounceStatus_Event_Overvoltage
        OpEventResetEventDebounceStatus_ResetEventDebounceStatus_Event_CodingEventNotCoded: RteEventRef=OpEventResetEventDebounceStatus_ResetEventDebounceStatus_Event_CodingEventNotCoded
        OpEventResetEventDebounceStatus_ResetEventDebounceStatus_Event_FrifEAcsChA: RteEventRef=OpEventResetEventDebounceStatus_ResetEventDebounceStatus_Event_FrifEAcsChA
        OpEventResetEventDebounceStatus_ResetEventDebounceStatus_Event_CantrcvEBusFaCanError: RteEventRef=OpEventResetEventDebounceStatus_ResetEventDebounceStatus_Event_CantrcvEBusFaCanError
        OpEventResetEventDebounceStatus_ResetEventDebounceStatus_Event_CantrcvEBusLeCanError: RteEventRef=OpEventResetEventDebounceStatus_ResetEventDebounceStatus_Event_CantrcvEBusLeCanError
        OpEventResetEventDebounceStatus_ResetEventDebounceStatus_Event_CantrcvEBusLpCanError: RteEventRef=OpEventResetEventDebounceStatus_ResetEventDebounceStatus_Event_CantrcvEBusLpCanError
        OpEventResetEventDebounceStatus_ResetEventDebounceStatus_Event_CantrcvEBusZsgCanError: RteEventRef=OpEventResetEventDebounceStatus_ResetEventDebounceStatus_Event_CantrcvEBusZsgCanError
        OpEventResetEventDebounceStatus_ResetEventDebounceStatus_Event_EthSignalQualityLow: RteEventRef=OpEventResetEventDebounceStatus_ResetEventDebounceStatus_Event_EthSignalQualityLow
    DemWrapper (RteSwComponentType): RteComponentTypeRef=DemWrapper, RteImplementationRef=DemWrapper_Implementation
      ComponentTypeCalibration (RteComponentTypeCalibration): RteCalibrationSupportEnabled=false
    DemWrapper_EcuSwComposition (RteSwComponentInstance): RteSoftwareComponentInstanceRef=DemWrapper
      6 x RteEventToTaskMapping, all with RteImmediateRestart=false:
        OIT_DemWrapper_ApplicationDTCInfoPort_GetDTCOfEvent_DemWrapper_ApplicationDTCInfoPort_GetDTCOfEvent: RteEventRef=OIT_DemWrapper_ApplicationDTCInfoPort_GetDTCOfEvent_DemWrapper_ApplicationDTCInfoPort_GetDTCOfEvent
        OIT_DemWrapper_NetworkDTCInfoPort_GetDTCOfEvent_DemWrapper_NetworkDTCInfoPort_GetDTCOfEvent: RteEventRef=OIT_DemWrapper_NetworkDTCInfoPort_GetDTCOfEvent_DemWrapper_NetworkDTCInfoPort_GetDTCOfEvent
        DemWrapper_InitEvent: RtePositionInTask=19, RteEventRef=DemWrapper_InitEvent, RteMappedToTaskRef=Default_RTE_Mode_switch_Task
        OIT_DemWrapper_CddIf_ClearDTC_DemWrapper_CddIf_ClearDTC: RteEventRef=OIT_DemWrapper_CddIf_ClearDTC_DemWrapper_CddIf_ClearDTC
        OIT_DemWrapper_Darh_GeneralDiagnosticInfo_GetDTCOfEvent_DemWrapper_Darh_GeneralDiagnosticInfo_GetDTCOfEvent: RteEventRef=OIT_DemWrapper_Darh_GeneralDiagnosticInfo_GetDTCOfEvent_DemWrapper_Darh_GeneralDiagnosticInfo_GetDTCOfEvent
        OIT_DemWrapper_Darh_GeneralDiagnosticInfo_GetEventFreezeFrameData_DemWrapper_Darh_GeneralDiagnosticInfo_GetEventFreezeFrameData: RteEventRef=OIT_DemWrapper_Darh_GeneralDiagnosticInfo_GetEventFreezeFrameData_DemWrapper_Darh_GeneralDiagnosticInfo_GetEventFreezeFrameData
    Dummy (RteSwComponentType): RteComponentTypeRef=Dummy, RteImplementationRef=Dummy_Implementation
      ComponentTypeCalibration (RteComponentTypeCalibration): RteCalibrationSupportEnabled=false
    BMW_Application_Connector_Dummy_EcuSwComposition (RteSwComponentInstance): RteSoftwareComponentInstanceRef=BMW_Application_Connector_Dummy
      21 x RteEventToTaskMapping, all with RteImmediateRestart=false:
        DRT_BMW_Vin_Rx_Wrapper_NO_VECH_7_NO_VECH_7: RtePositionInTask=20, RteEventRef=DRT_BMW_Vin_Rx_Wrapper_NO_VECH_7_NO_VECH_7, RteMappedToTaskRef=Default_RTE_Mode_switch_Task, RteUsedOsEventRef=Rte_Ev_Run_BMW_Application_Connector_Dummy_BMW_Vin_Rx_Wrapper
        DRET_BMW_Vin_Rx_Wrapper_NO_VECH_7_NO_VECH_7: RtePositionInTask=20, RteEventRef=DRET_BMW_Vin_Rx_Wrapper_NO_VECH_7_NO_VECH_7, RteMappedToTaskRef=Default_RTE_Mode_switch_Task, RteUsedOsEventRef=Rte_Ev_Run_BMW_Application_Connector_Dummy_BMW_Vin_Rx_Wrapper
        OIT_CSDataServices_DemDataElementClass_FUwBn_ReadData_CSDataServices_DemDataElementClass_FUwBn_ReadData: RteEventRef=OIT_CSDataServices_DemDataElementClass_FUwBn_ReadData_CSDataServices_DemDataElementClass_FUwBn_ReadData
        OIT_CSDataServices_DemDataElementClass_FUwTn_ReadData_CSDataServices_DemDataElementClass_FUwTn_ReadData: RteEventRef=OIT_CSDataServices_DemDataElementClass_FUwTn_ReadData_CSDataServices_DemDataElementClass_FUwTn_ReadData
        OIT_CSDataServices_DemDataElementClass_KmStand_ReadData_CSDataServices_DemDataElementClass_KmStand_ReadData: RteEventRef=OIT_CSDataServices_DemDataElementClass_KmStand_ReadData_CSDataServices_DemDataElementClass_KmStand_ReadData
        OIT_DataServices_DcmDspData_MileKmEeprom_ConditionCheckRead_DataServices_DcmDspData_MileKmEeprom_ConditionCheckRead: RteEventRef=OIT_DataServices_DcmDspData_MileKmEeprom_ConditionCheckRead_DataServices_DcmDspData_MileKmEeprom_ConditionCheckRead
        OIT_DataServices_DcmDspData_MileKmEeprom_ReadData_DataServices_DcmDspData_MileKmEeprom_ReadData: RteEventRef=OIT_DataServices_DcmDspData_MileKmEeprom_ReadData_DataServices_DcmDspData_MileKmEeprom_ReadData
        OIT_DataServices_DcmDspData_SensorenAnzahlLesen_ConditionCheckRead_DataServices_DcmDspData_SensorenAnzahlLesen_Condition055FF87D: RteEventRef=OIT_DataServices_DcmDspData_SensorenAnzahlLesen_ConditionCheckRead_DataServices_DcmDspData_SensorenAnzahlLesen_Condition055FF87D
        OIT_DataServices_DcmDspData_SensorenAnzahlLesen_ReadData_DataServices_DcmDspData_SensorenAnzahlLesen_ReadData: RteEventRef=OIT_DataServices_DcmDspData_SensorenAnzahlLesen_ReadData_DataServices_DcmDspData_SensorenAnzahlLesen_ReadData
        OIT_DataServices_DcmDspData_SystemSupplierIdentifier_ConditionCheckRead_DataServices_DcmDspData_SystemSupplierIdentifier335977C2: RteEventRef=OIT_DataServices_DcmDspData_SystemSupplierIdentifier_ConditionCheckRead_DataServices_DcmDspData_SystemSupplierIdentifier335977C2
        OIT_DataServices_DcmDspData_SystemSupplierIdentifier_ReadData_DataServices_DcmDspData_SystemSupplierIdentifier_ReadData: RteEventRef=OIT_DataServices_DcmDspData_SystemSupplierIdentifier_ReadData_DataServices_DcmDspData_SystemSupplierIdentifier_ReadData
        MST_Dlog_FirstStart_Dummy_0: RtePositionInTask=26, RteEventRef=MST_Dlog_FirstStart_Dummy_0, RteMappedToTaskRef=Default_RTE_Mode_switch_Task, RteUsedOsEventRef=Rte_Ev_Run_BMW_Application_Connector_Dummy_Dlog_FirstStart_Dummy
        MST_Dlog_FirstStart_Dummy_1: RtePositionInTask=26, RteEventRef=MST_Dlog_FirstStart_Dummy_1, RteMappedToTaskRef=Default_RTE_Mode_switch_Task, RteUsedOsEventRef=Rte_Ev_Run_BMW_Application_Connector_Dummy_Dlog_FirstStart_Dummy
        OIT_DataServices_DcmDspData_Sekundaererfehlerspeicher_ReadData_DataServices_DcmDspData_Sekundaererfehlerspeicher_ReadData: RteEventRef=OIT_DataServices_DcmDspData_Sekundaererfehlerspeicher_ReadData_DataServices_DcmDspData_Sekundaererfehlerspeicher_ReadData
        OIT_DataServices_DcmDspData_Sekundaererfehlerspeicher_ConditionCheckRead_DataServices_DcmDspData_Sekundaererfehlerspeich292DEEC9: RteEventRef=OIT_DataServices_DcmDspData_Sekundaererfehlerspeicher_ConditionCheckRead_DataServices_DcmDspData_Sekundaererfehlerspeich292DEEC9
        OIT_DataServices_Data_DcmDspDid_SensorLesen_1_ReadData_DataServices_Data_DcmDspDid_SensorLesen_1_ReadData: RteEventRef=OIT_DataServices_Data_DcmDspDid_SensorLesen_1_ReadData_DataServices_Data_DcmDspDid_SensorLesen_1_ReadData
        OIT_DataServices_Data_DcmDspDid_SensorLesen_3_ReadData_DataServices_Data_DcmDspDid_SensorLesen_3_ReadData: RteEventRef=OIT_DataServices_Data_DcmDspDid_SensorLesen_3_ReadData_DataServices_Data_DcmDspDid_SensorLesen_3_ReadData
        OIT_DataServices_Data_DcmDspDid_SensorLesen_{1..3}_ConditionCheckRead_DataServices_Data_DcmDspDid_SensorLesen_{1..3}_ConditionCheckRead: RteEventRef=OIT_DataServices_Data_DcmDspDid_SensorLesen_{1..3}_ConditionCheckRead_DataServices_Data_DcmDspDid_SensorLesen_{1..3}_ConditionCheckRead
        OIT_DataServices_Data_DcmDspDid_SensorLesen_2_ReadData_DataServices_Data_DcmDspDid_SensorLesen_2_ReadData: RteEventRef=OIT_DataServices_Data_DcmDspDid_SensorLesen_2_ReadData_DataServices_Data_DcmDspDid_SensorLesen_2_ReadData
    BMW_Application_Main_EcuSwComposition (RteSwComponentInstance): RteSoftwareComponentInstanceRef=BMW_Application_Main
      6 x RteEventToTaskMapping, all with RteImmediateRestart=false, RteMappedToTaskRef=Default_RTE_Mode_switch_Task:
        MST_Dcm_BAC4_EcuReset_0: RtePositionInTask=21, RteEventRef=MST_Dcm_BAC4_EcuReset_0, RteUsedOsEventRef=Rte_Ev_Run_BMW_Application_Main_Dcm_BAC4_EcuReset_Execute
        MST_Dcm_BAC4_EcuReset_Hard_0: RtePositionInTask=22, RteEventRef=MST_Dcm_BAC4_EcuReset_Hard_0, RteUsedOsEventRef=Rte_Ev_Run_BMW_Application_Main_Dcm_BAC4_EcuReset_Hard
        MST_Runnable_0: RtePositionInTask=23, RteEventRef=MST_Runnable_0, RteUsedOsEventRef=Rte_Ev_Run_BMW_Application_Main_Dcm_BAC4_Jump2Boot
        MST_Dcm_BAC4_RapidShutdownDisable_0: RtePositionInTask=24, RteEventRef=MST_Dcm_BAC4_RapidShutdownDisable_0, RteUsedOsEventRef=Rte_Ev_Run_BMW_Application_Main_Dcm_BAC4_RapidShutdownDisable
        MST_Dcm_BAC4_RapidShutdownEnable_0: RtePositionInTask=25, RteEventRef=MST_Dcm_BAC4_RapidShutdownEnable_0, RteUsedOsEventRef=Rte_Ev_Run_BMW_Application_Main_Dcm_BAC4_RapidShutdownEnable
        TMT_Xcp_Event_Runnable: RtePositionInTask=27, RteEventRef=TMT_Xcp_Event_Runnable, RteUsedOsEventRef=Rte_Ev_Run_BMW_Application_Main_Xcp_Event_Runnable, RteUsedOsAlarmRef=Rte_Al_TE_BMW_Application_Main_Xcp_Event_Runnable
    3 x RteSwComponentType:
      BMW_Application_Connector_Dummy: RteComponentTypeRef=BMW_Application_Connector_Dummy, RteImplementationRef=BMW_Application_Connector_Dummy_Implementation
        ComponentTypeCalibration (RteComponentTypeCalibration): RteCalibrationSupportEnabled=false
      BMW_Application_Main: RteComponentTypeRef=BMW_Application_Main, RteImplementationRef=BMW_Application_Main_Implementation
        ComponentTypeCalibration (RteComponentTypeCalibration): RteCalibrationSupportEnabled=false
      Stm: RteComponentTypeRef=Stm, RteImplementationRef=Stm_Implementation
        ComponentTypeCalibration (RteComponentTypeCalibration): RteCalibrationSupportEnabled=false
    Stm_EcuSwComposition (RteSwComponentInstance): RteSoftwareComponentInstanceRef=Stm
      CentralErrorLockReadWrite_EA (RteExclusiveAreaImplementation): RteExclusiveAreaImplMechanism=ALL_INTERRUPT_BLOCKING, RteExclusiveAreaRef=CentralErrorLockReadWrite_EA
      8 x RteEventToTaskMapping, all with RteImmediateRestart=false, RteMappedToTaskRef=Default_RTE_Mode_switch_Task:
        DRET_Runnable_ErrorCentralErrorLock_CentralErrorLockRx_centralErrorLock: RtePositionInTask=28, RteEventRef=DRET_Runnable_ErrorCentralErrorLock_CentralErrorLockRx_centralErrorLock, RteUsedOsEventRef=Rte_Ev_Run_Stm_Runnable_ErrorCentralErrorLock
        DRET_Runnable_ErrorEnergyMode_EnergyModeRx_energyState: RtePositionInTask=29, RteEventRef=DRET_Runnable_ErrorEnergyMode_EnergyModeRx_energyState, RteUsedOsEventRef=Rte_Ev_Run_Stm_Runnable_ErrorEnergyMode
        MST_Runnable_InitialCELSupervision_0: RtePositionInTask=31, RteEventRef=MST_Runnable_InitialCELSupervision_0, RteUsedOsEventRef=Rte_Ev_Run1_Stm_Runnable_InitialCELSupervision
        DRT_Runnable_ReceiveCentralErrorLock_CentralErrorLockRx_centralErrorLock: RtePositionInTask=32, RteEventRef=DRT_Runnable_ReceiveCentralErrorLock_CentralErrorLockRx_centralErrorLock, RteUsedOsEventRef=Rte_Ev_Run_Stm_Runnable_ReceiveCentralErrorLock
        DRT_Runnable_ReceiveEnergyMode_EnergyModeRx_energyState: RtePositionInTask=33, RteEventRef=DRT_Runnable_ReceiveEnergyMode_EnergyModeRx_energyState, RteUsedOsEventRef=Rte_Ev_Run_Stm_Runnable_ReceiveEnergyMode
        MST_Runnable_StopCentralErrorLockSupervision_0: RtePositionInTask=35, RteEventRef=MST_Runnable_StopCentralErrorLockSupervision_0, RteUsedOsEventRef=Rte_Ev_Run1_Stm_Runnable_StopCentralErrorLockSupervision
        DRET_Runnable_ErrorVehicleState_VehicleStateRx_VehicleState: RtePositionInTask=30, RteEventRef=DRET_Runnable_ErrorVehicleState_VehicleStateRx_VehicleState, RteUsedOsEventRef=Rte_Ev_Run_Stm_Runnable_ErrorVehicleState
        DRT_Runnable_ReceiveVehicleState_VehicleStateRx_VehicleState: RtePositionInTask=34, RteEventRef=DRT_Runnable_ReceiveVehicleState_VehicleStateRx_VehicleState, RteUsedOsEventRef=Rte_Ev_Run_Stm_Runnable_ReceiveVehicleState
