AUTOSAR XML (schema 4-3-0)
package /ActiveEcuC
  module config Os: implementation-config-variant=VARIANT-PRE-COMPILE, module-description=Os_Impl
    OsPublishedInformation: OsKernelVersion=7, OsPlatformName=Rh850
      RH850P1M (OsDerivativeInformation):
        OsMpuAlignment = 4
        OsStackAlignment = 4
        OsExceptionVectorTableAlignment = 512
        OsInterruptVectorTableAlignment = 512
        OsHardwareManuals = RH850/P1x Group Users Manual: Hardware Rev.1.00 Jul, 2015 RH850G3M Users Manual: Software Rev.1.30 Jun 2016 RH850/P1M Safety Application Note Rev.2.00 Release May 19, 2016
        3 x OsHardwareTimer, all with OsHardwareTimerUnit=PIT, OsHardwareTimerSize=32, OsHardwareTimerType=TAUJ:
          TAUJ0: OsHardwareTimerBaseAddress=4293197824, OsHardwareTimerId=0
            4 x OsHardwareTimerChannel:
              TAUJ0_CH3: OsHardwareTimerChannelIntSource=136, OsHardwareTimerChannelOffset=3, OsHardwareTimerChannelId=3
              TAUJ0_CH2: OsHardwareTimerChannelIntSource=135, OsHardwareTimerChannelOffset=2, OsHardwareTimerChannelId=2
              TAUJ0_CH1: OsHardwareTimerChannelIntSource=134, OsHardwareTimerChannelOffset=1, OsHardwareTimerChannelId=1
              TAUJ0_CH0: OsHardwareTimerChannelIntSource=133, OsHardwareTimerChannelOffset=0, OsHardwareTimerChannelId=0
          TAUJ1: OsHardwareTimerBaseAddress=4293201920, OsHardwareTimerId=1
            4 x OsHardwareTimerChannel:
              TAUJ1_CH3: OsHardwareTimerChannelIntSource=140, OsHardwareTimerChannelOffset=3, OsHardwareTimerChannelId=3
              TAUJ1_CH0: OsHardwareTimerChannelIntSource=137, OsHardwareTimerChannelOffset=0, OsHardwareTimerChannelId=0
              TAUJ1_CH2: OsHardwareTimerChannelIntSource=139, OsHardwareTimerChannelOffset=2, OsHardwareTimerChannelId=2
              TAUJ1_CH1: OsHardwareTimerChannelIntSource=138, OsHardwareTimerChannelOffset=1, OsHardwareTimerChannelId=1
          TAUJ2: OsHardwareTimerBaseAddress=4293206016, OsHardwareTimerId=2
            4 x OsHardwareTimerChannel:
              TAUJ2_CH1: OsHardwareTimerChannelIntSource=169, OsHardwareTimerChannelOffset=1, OsHardwareTimerChannelId=1
              TAUJ2_CH0: OsHardwareTimerChannelIntSource=168, OsHardwareTimerChannelOffset=0, OsHardwareTimerChannelId=0
              TAUJ2_CH3: OsHardwareTimerChannelIntSource=171, OsHardwareTimerChannelOffset=3, OsHardwareTimerChannelId=3
              TAUJ2_CH2: OsHardwareTimerChannelIntSource=170, OsHardwareTimerChannelOffset=2, OsHardwareTimerChannelId=2
        CORE0 (OsPhysicalCore):
          OsPhysicalCoreId = 0
          OsPhysicalCoreDefaultEntrySymbol = RESET_CORE0
          OsPhysicalCoreType = G3M
          OsPhysicalCoreExceptionSources = 16
          OsPhysicalCoreIsAutostart = true
          OsPhysicalCoreMasterStartAllowed = false
          OsPhysicalCorePrivelegedHwAccess = true
          OsPhysicalCoreStackProtectionUnit = MPU_CORE0
          MPU_CORE0 (OsPhysicalCoreMpu): OsPhysicalCoreMpuId=0, OsPhysicalCoreMpuMaxRegions=12, OsPhysicalCoreMpuType=CoreMpu
        INTC (OsSystemIntCtrl): OsSystemIntCtrlBaseAddress=4294896128, OsSystemIntCtrlMaxPrios=16, OsSystemIntCtrlMaxSources=512, OsSystemIntCtrlPrioOrder=DESC
          5 x OsSystemIntCtrlAddress:
            IPIR: OsSystemIntCtrlAddressValue=0
            INTC2: OsSystemIntCtrlAddressValue=4294946816
            EIBD1: OsSystemIntCtrlAddressValue=0
            INTC1: OsSystemIntCtrlAddressValue=4294896128
            EIBD2: OsSystemIntCtrlAddressValue=0
        OSTM1 (OsHardwareTimer): OsHardwareTimerBaseAddress=4292710400, OsHardwareTimerUnit=FRTPIT, OsHardwareTimerSize=32, OsHardwareTimerId=1, OsHardwareTimerType=OSTM
          OSTM1 (OsHardwareTimerChannel): OsHardwareTimerChannelIntSource=75, OsHardwareTimerChannelOffset=0, OsHardwareTimerChannelId=0
        OSTM0 (OsHardwareTimer): OsHardwareTimerBaseAddress=4292706304, OsHardwareTimerUnit=FRTPIT, OsHardwareTimerSize=32, OsHardwareTimerId=0, OsHardwareTimerType=OSTM
          OSTM0 (OsHardwareTimerChannel): OsHardwareTimerChannelIntSource=74, OsHardwareTimerChannelOffset=0, OsHardwareTimerChannelId=0
        MPAT (OsMemoryRegionSpecifics)
          6 x OsMemoryRegionAccess:
            SW: OsMemoryRegionAccessRights=W, OsMemoryRegionAccessType=SUPERVISOR
            SX: OsMemoryRegionAccessRights=X, OsMemoryRegionAccessType=SUPERVISOR
            UW: OsMemoryRegionAccessRights=W, OsMemoryRegionAccessType=USER
            UX: OsMemoryRegionAccessRights=X, OsMemoryRegionAccessType=USER
            UR: OsMemoryRegionAccessRights=R, OsMemoryRegionAccessType=USER
            SR: OsMemoryRegionAccessRights=R, OsMemoryRegionAccessType=SUPERVISOR
    Fr_IrqTimer0 (OsIsr):  # Os Interrupt Service Routine PLAIN_TEXT ISR that handles Timer0-interrupt for FlexRay.
      OsIsrCategory = CATEGORY_2
      OsIsrInterruptType = EXTERNAL
      OsIsrInterruptSource = 196
      OsIsrInterruptPriority = 11
      OsIsrStackSize = 1024
      OsIsrEnableNesting = false
    OS_APPMODE_ANY (OsAppMode)
    OSDEFAULTAPPMODE (OsAppMode)
    OsOS:
      OsStackMonitoring = true
      OsStatus = EXTENDED
      OsUseGetServiceId = false
      OsUseParameterAccess = false
      OsUseResScheduler = false
      OsForcibleTermination = true
      OsGenerateCalloutStubs = true
      OsGenerateMemMap = COMPLETE
      OsGenerateMemMapForThreads = false
      OsServiceProtection = false
      OsStackUsageMeasurement = false
      OsUseXSignalAsyncApiCalls = false
      OsScalabilityClass = SC3
      OsGenerateMemMapForNearAddressing = false
      OsNumberOfCores = 1
      OsMasterCore = OsCore_CORE0
      OsSystemTimer = SystemTimer
      OsHooks: OsErrorHook=true, OsPostTaskHook=false, OsPreTaskHook=false, OsShutdownHook=true, OsStartupHook=true, OsProtectionHook=false
      OsDebug: OsAssertions=false
    Fr_IrqLine0 (OsIsr):  # Os Interrupt Service Routine PLAIN_TEXT ISR that handles Cyclestart-interrupt for FlexRay.
      OsIsrCategory = CATEGORY_2
      OsIsrInterruptType = EXTERNAL
      OsIsrInterruptSource = 194
      OsIsrInterruptPriority = 10
      OsIsrStackSize = 1024
      OsIsrEnableNesting = false
    SystemTimer (OsCounter):
      OsCounterMaxAllowedValue = 1073741823
      OsCounterMinCycle = 1
      OsCounterType = HARDWARE
      OsSecondsPerTick = 1.25E-8
      OsCounterTicksPerBase = 1
      OsCounterAccessingApplication = SystemApplication_OsCore_CORE0
      OsDriver: OsDriverHighResolution=true, OsDriverHardwareTimerChannelRef=OSTM0/OSTM0, OsDriverIsrRef=Os_TimerPitIsr
    OsCore_CORE0 (OsCore):
      OsCoreIsAutosar = true
      OsCoreIsAutostart = true
      OsCoreEntrySymbol = _usr_init
      OsCorePhysicalCoreRef = CORE0
      OsCoreIdleTask = IdleTask_OsCore_CORE0
      OsCoreSystemApplication = SystemApplication_OsCore_CORE0
      OsCoreEcucCoreRef = EcucCore0
      OsCoreTimingProtectionCounter = TpCounter_OsCore_CORE0
      OsCoreStacks:
        OsCoreKernelStackSize = 1024
        OsCoreStartupStackSize = 1024
        OsCoreShutdownStackSize = 1024
        OsCoreErrorStackSize = 1024
        OsCoreProtectionStackSize = 1024
        OsCoreInitStackSize = 1024
    IdleTask_OsCore_CORE0 (OsTask):
      OsTaskActivation = 1
      OsTaskPriority = 4294967295
      OsTaskSchedule = FULL
      OsTaskStackSharing = false
      OsTaskStackSize = 1024
      OsTaskType = AUTO
      OsTaskAccessingApplication = SystemApplication_OsCore_CORE0
      OsTaskAutostart: OsTaskAppModeRef=OS_APPMODE_ANY
    SystemApplication_OsCore_CORE0 (OsApplication):
      OsTrusted = true
      OsTrustedApplicationDelayTimingViolationCall = false
      OsTrustedApplicationWithProtection = false
      OsApplicationIsPrivileged = true
      OsAppUseTrustedFunctionStubs = false
      OsAppIsrRef = Fr_IrqLine0
      OsAppIsrRef = Fr_IrqTimer0
      OsAppTaskRef = IdleTask_OsCore_CORE0
      OsApplicationCoreRef = EcucCore0
      OsAppIsrRef = Os_TimerPitIsr
      OsAppTaskRef = OsTask_LowPrioNvm
      OsAppIsrRef = WDG_59_DRIVERA_TRIGGERFUNCTION_CAT2_ISR
      OsAppAlarmRef = Rte_Al_TE2_OsTask_LowPrioNvm_0_10ms
      OsAppAlarmRef = Rte_Al_TE_Fee_30_SmallSector_Fee_30_SmallSector_MainFunction
      OsAppCounterRef = TpCounter_OsCore_CORE0
      OsAppIsrRef = CounterIsr_TpCounter_OsCore_CORE0
      OsApplicationHooks: OsAppErrorHook=false, OsAppShutdownHook=false, OsAppStartupHook=false
    OsApplication_QM (OsApplication):
      OsTrusted = false
      OsTrustedApplicationDelayTimingViolationCall = false
      OsTrustedApplicationWithProtection = false
      OsApplicationIsPrivileged = false
      OsAppUseTrustedFunctionStubs = false
      OsApplicationCoreRef = EcucCore0
      OsAppCounterRef = SystemTimer
      OsAppTaskRef = Default_Appl_Init_Task
      OsAppTaskRef = Default_Appl_Task
      OsAppTaskRef = Default_RTE_Mode_switch_Task
      OsAppEcucPartitionRef = EcucPartition_QM
      OsAppTaskRef = Default_BAC_Appl_BMW_Task
      OsAppAlarmRef = Rte_Al_TE_Darh_QueueHandler
      OsAppAlarmRef = Rte_Al_TE_SysTime_MainFunction
      OsAppAlarmRef = Rte_Al_TE_IntegrationSample_IntegrationSampleTimerFunction
      OsAppAlarmRef = Rte_Al_TE_BMW_Application_Main_Xcp_Event_Runnable
      OsApplicationHooks: OsAppErrorHook=false, OsAppShutdownHook=false, OsAppStartupHook=false
    Os_TimerPitIsr (OsIsr):
      OsIsrCategory = CATEGORY_2
      OsIsrInterruptType = EXTERNAL
      OsIsrInterruptSource = 74
      OsIsrInterruptPriority = 1
      OsIsrStackSize = 2048
      OsIsrEnableNesting = false
      OsIsrSpecialFunctionName = Os_TimerHrtIsr
    7 x OsTask, all with OsTaskActivation=1, OsTaskStackSharing=false, OsTaskAccessingApplication=SystemApplication_OsCore_CORE0:
      Default_Init_Task: OsTaskPriority=80, OsTaskSchedule=NON, OsTaskStackSize=1024, OsTaskType=BASIC
        OsTaskAutostart: OsTaskAppModeRef=OSDEFAULTAPPMODE
      Default_BSW_Sync_Task: OsTaskPriority=65, OsTaskSchedule=FULL, OsTaskStackSize=1024, OsTaskType=EXTENDED, OsTaskResourceRef=OsResource, OsTaskAccessingApplication=OsApplication_ASIL, OsTaskAccessingApplication=OsApplication_QM, OsTaskEventRef=Rte_Ev_Cyclic2_Default_BSW_Sync_Task_0_5ms
      Default_RTE_Mode_switch_Task: OsTaskPriority=10, OsTaskSchedule=FULL, OsTaskStackSize=2048, OsTaskType=AUTO, OsTaskEventRef=Rte_Ev_Run_Dlog_Dlog_ModeSwitchAckLifeCycle, OsTaskAccessingApplication=OsApplication_ASIL, OsTaskEventRef=Rte_Ev_MS_Default_RTE_Mode_switch_Task, OsTaskEventRef=Rte_Ev_Run1_SysTime_ReceiveSignal, OsTaskEventRef=Rte_Ev_Run_Stm_Runnable_ErrorCentralErrorLock, OsTaskEventRef=Rte_Ev_Run_Stm_Runnable_ErrorEnergyMode, OsTaskEventRef=Rte_Ev_Run_Stm_Runnable_ReceiveCentralErrorLock, OsTaskEventRef=Rte_Ev_Run_Stm_Runnable_ReceiveEnergyMode, OsTaskEventRef=Rte_Ev_Run_Bs_Bs_LifeCycleModeRequest, OsTaskEventRef=Rte_Ev_Run_Dlog_Dlog_ModeSwitchRequestLifeCycle, OsTaskEventRef=Rte_Ev_Run_IntegrationSample_IntegrationSampleTimerFunction, OsTaskEventRef=Rte_Ev_Run_IntegrationSample_R_IntegrationSample_EcuRunStateHandler, OsTaskEventRef=Rte_Ev_Run_IntegrationSample_R_Receive_SIG_MILE_KM_816_R, OsTaskEventRef=Rte_Ev_Run_IntegrationSample_R_Receive_VehicleStatus, OsTaskEventRef=Rte_Ev_Run_IntegrationSample_R_Timeout_VehicleStatus, OsTaskEventRef=Rte_Ev_Run_Omc_LifeCycleHandler, OsTaskEventRef=Rte_Ev_Run_StdDiag_LifeCycleHandler, OsTaskEventRef=Rte_Ev_Run_Stm_Runnable_ErrorVehicleState, OsTaskEventRef=Rte_Ev_Run_Stm_Runnable_ReceiveVehicleState, OsTaskEventRef=Rte_Ev_Run_SysTime_LifeCycleHandler, OsTaskEventRef=Rte_Ev_Run_IntegrationSample_R_Receive_SGG_Rx_CON_VEH, OsTaskEventRef=Rte_Ev_Run_IntegrationSample_R_Timeout_SGG_Rx_CON_VEH, OsTaskEventRef=Rte_Ev_Run1_Stm_Runnable_InitialCELSupervision, OsTaskEventRef=Rte_Ev_Run1_Stm_Runnable_StopCentralErrorLockSupervision, OsTaskEventRef=Rte_Ev_Run1_StdDiag_SessionChange_DefaultSession, OsTaskEventRef=Rte_Ev_Run1_StdDiag_SessionChange_OtherSession, OsTaskEventRef=Rte_Ev_Run_BMW_Application_Connector_Dummy_BMW_Vin_Rx_Wrapper, OsTaskEventRef=Rte_Ev_Run_BMW_Application_Connector_Dummy_Dlog_FirstStart_Dummy, OsTaskEventRef=Rte_Ev_Run_BMW_Application_Main_Dcm_BAC4_EcuReset_Execute, OsTaskEventRef=Rte_Ev_Run_BMW_Application_Main_Dcm_BAC4_EcuReset_Hard, OsTaskEventRef=Rte_Ev_Run_BMW_Application_Main_Dcm_BAC4_Jump2Boot, OsTaskEventRef=Rte_Ev_Run_BMW_Application_Main_Xcp_Event_Runnable, OsTaskEventRef=Rte_Ev_Run_BMW_Application_Main_Dcm_BAC4_RapidShutdownDisable, OsTaskEventRef=Rte_Ev_Run_BMW_Application_Main_Dcm_BAC4_RapidShutdownEnable
      Default_Appl_Task: OsTaskPriority=5, OsTaskSchedule=FULL, OsTaskStackSize=1024, OsTaskType=AUTO
      Default_Background_Task: OsTaskPriority=0, OsTaskSchedule=FULL, OsTaskStackSize=1024, OsTaskType=BASIC
        OsTaskAutostart: OsTaskAppModeRef=OSDEFAULTAPPMODE
      Default_Appl_Init_Task: OsTaskPriority=45, OsTaskSchedule=NON, OsTaskStackSize=1024, OsTaskType=BASIC
      OsTask_LowPrioNvm: OsTaskPriority=20, OsTaskSchedule=FULL, OsTaskStackSize=1024, OsTaskType=AUTO, OsTaskEventRef=Rte_Ev_Cyclic2_OsTask_LowPrioNvm_0_10ms, OsTaskEventRef=Rte_Ev_Run_Fee_30_SmallSector_Fee_30_SmallSector_MainFunction, OsTaskAccessingApplication=OsApplication_QM, OsTaskAccessingApplication=OsApplication_ASIL
    OsResource:
      OsResourceProperty = STANDARD
      OsResourceAccessingApplication = SystemApplication_OsCore_CORE0
      OsResourceAccessingApplication = OsApplication_QM
      OsResourceAccessingApplication = OsApplication_ASIL
    Rte_Al_TE2_OsTask_LowPrioNvm_0_10ms (OsAlarm):
      OsAlarmCounterRef = SystemTimer
      OsAlarmAccessingApplication = SystemApplication_OsCore_CORE0
      OsAlarmAccessingApplication = OsApplication_ASIL
      OsAlarmAccessingApplication = OsApplication_QM
      OsAlarmAction
        OsAlarmSetEvent: OsAlarmSetEventRef=Rte_Ev_Cyclic2_OsTask_LowPrioNvm_0_10ms, OsAlarmSetEventTaskRef=OsTask_LowPrioNvm
    Rte_Al_TE_Fee_30_SmallSector_Fee_30_SmallSector_MainFunction (OsAlarm):
      OsAlarmCounterRef = SystemTimer
      OsAlarmAccessingApplication = SystemApplication_OsCore_CORE0
      OsAlarmAccessingApplication = OsApplication_ASIL
      OsAlarmAccessingApplication = OsApplication_QM
      OsAlarmAction
        OsAlarmSetEvent: OsAlarmSetEventRef=Rte_Ev_Run_Fee_30_SmallSector_Fee_30_SmallSector_MainFunction, OsAlarmSetEventTaskRef=OsTask_LowPrioNvm
    Rte_Ev_Cyclic2_OsTask_LowPrioNvm_0_10ms (OsEvent)
    Rte_Ev_Run_Fee_30_SmallSector_Fee_30_SmallSector_MainFunction (OsEvent)
    OsApplication_ASIL (OsApplication):
      OsTrusted = true
      OsTrustedApplicationDelayTimingViolationCall = false
      OsTrustedApplicationWithProtection = false
      OsApplicationIsPrivileged = true
      OsAppUseTrustedFunctionStubs = true
      OsApplicationCoreRef = EcucCore0
      OsAppTaskRef = OsTask_BSW_ASIL
      OsAppEcucPartitionRef = EcucPartition_ASIL
      OsAppAlarmRef = Rte_Al_TE2_OsTask_BSW_ASIL_0_10ms
      OsAppAlarmRef = Rte_Al_TE2_OsTask_BSW_ASIL_0_20ms
      OsAppAlarmRef = Rte_Al_TE2_OsTask_BSW_ASIL_0_5ms
      OsAppTaskRef = Default_Init_Task
      OsAppTaskRef = Default_Background_Task
      OsAppAlarmRef = Rte_Al_TE2_OsTask_BSW_ASIL_0_2ms
      OsAppTaskRef = Default_BSW_Sync_Task
      OsAppAlarmRef = Rte_Al_TE2_Default_BSW_Sync_Task_0_5ms
      OsApplicationHooks: OsAppErrorHook=false, OsAppShutdownHook=false, OsAppStartupHook=false
    OsTask_BSW_ASIL (OsTask):
      OsTaskActivation = 1
      OsTaskPriority = 60
      OsTaskSchedule = FULL
      OsTaskStackSharing = false
      OsTaskStackSize = 4096
      OsTaskType = AUTO
      OsTaskAccessingApplication = SystemApplication_OsCore_CORE0
      OsTaskEventRef = Rte_Ev_Cyclic2_OsTask_BSW_ASIL_0_10ms
      OsTaskEventRef = Rte_Ev_Cyclic2_OsTask_BSW_ASIL_0_20ms
      OsTaskEventRef = Rte_Ev_Cyclic2_OsTask_BSW_ASIL_0_5ms
      OsTaskAccessingApplication = OsApplication_QM
      OsTaskEventRef = Rte_Ev_Run_BswM_BswM_Read_SWCModeReq_StdDiag_CommunicationModeDeclarationGroup
      OsTaskEventRef = Rte_Ev_Cyclic2_OsTask_BSW_ASIL_0_2ms
      OsTaskAccessingApplication = OsApplication_ASIL
    WDG_59_DRIVERA_TRIGGERFUNCTION_CAT2_ISR (OsIsr):
      OsIsrCategory = CATEGORY_2
      OsIsrInterruptType = EXTERNAL
      OsIsrInterruptSource = 9
      OsIsrInterruptPriority = 1
      OsIsrStackSize = 512
      OsIsrEnableNesting = false
      OsIsrSpecialFunctionName = WDG_59_DRIVERA_TRIGGERFUNCTION_CAT2_ISR
    OsMemoryProtection
      3 x OsMemoryRegion, all with OsMemoryRegionProtectionUnit=MPU_CORE0, OsMemoryRegionAccessRights=SR, OsMemoryRegionAccessRights=SW, OsMemoryRegionAccessRights=SX, OsMemoryRegionAccessRights=UR, OsMemoryRegionAccessRights=UW, OsMemoryRegionAccessRights=UX:
        OsMemoryRegion_RAM: OsMemoryRegionStartAddress=ram_start, OsMemoryRegionEndAddress=ram_end
        OsMemoryRegion_FLASH: OsMemoryRegionStartAddress=0x0, OsMemoryRegionEndAddress=0x001FFFFF
        OsMemoryRegion_Peripheral: OsMemoryRegionStartAddress=0xFF000000, OsMemoryRegionEndAddress=0xFFFFFFFF
      OsPeripheralRegion_FR (OsPeripheralRegion): OsPeripheralRegionStartAddress=0xFFC72000, OsPeripheralRegionEndAddress=0xFFC72FFF, OsPeripheralRegionAccessingApp=OsApplication_QM
      OsMemoryRegion_FR (OsMemoryRegion):
        OsMemoryRegionStartAddress = 0x10020000
        OsMemoryRegionEndAddress = 0x10020844
        OsMemoryRegionProtectionUnit = MPU_CORE0
        OsMemoryRegionAccessRights = SR
        OsMemoryRegionAccessRights = SW
        OsMemoryRegionAccessRights = SX
        OsMemoryRegionAccessRights = UR
        OsMemoryRegionAccessRights = UW
        OsMemoryRegionAccessRights = UX
    3 x OsAlarm, all with OsAlarmCounterRef=SystemTimer, OsAlarmAccessingApplication=SystemApplication_OsCore_CORE0, OsAlarmAccessingApplication=OsApplication_QM:
      Rte_Al_TE2_OsTask_BSW_ASIL_0_10ms
        OsAlarmAction
          OsAlarmSetEvent: OsAlarmSetEventRef=Rte_Ev_Cyclic2_OsTask_BSW_ASIL_0_10ms, OsAlarmSetEventTaskRef=OsTask_BSW_ASIL
      Rte_Al_TE2_OsTask_BSW_ASIL_0_20ms
        OsAlarmAction
          OsAlarmSetEvent: OsAlarmSetEventRef=Rte_Ev_Cyclic2_OsTask_BSW_ASIL_0_20ms, OsAlarmSetEventTaskRef=OsTask_BSW_ASIL
      Rte_Al_TE2_OsTask_BSW_ASIL_0_5ms
        OsAlarmAction
          OsAlarmSetEvent: OsAlarmSetEventRef=Rte_Ev_Cyclic2_OsTask_BSW_ASIL_0_5ms, OsAlarmSetEventTaskRef=OsTask_BSW_ASIL
    3 x OsEvent:
      Rte_Ev_Cyclic2_OsTask_BSW_ASIL_0_10ms
      Rte_Ev_Cyclic2_OsTask_BSW_ASIL_0_20ms
      Rte_Ev_Cyclic2_OsTask_BSW_ASIL_0_5ms
    TpCounter_OsCore_CORE0 (OsCounter):
      OsCounterMaxAllowedValue = 1073741823
      OsCounterMinCycle = 1
      OsCounterTicksPerBase = 1
      OsCounterType = HARDWARE
      OsSecondsPerTick = 1.25E-8
      OsCounterAccessingApplication = SystemApplication_OsCore_CORE0
      OsDriver: OsDriverHighResolution=true, OsDriverHardwareTimerChannelRef=OSTM1/OSTM1, OsDriverIsrRef=CounterIsr_TpCounter_OsCore_CORE0
    CounterIsr_TpCounter_OsCore_CORE0 (OsIsr):
      OsIsrCategory = CATEGORY_2
      OsIsrInterruptType = EXTERNAL
      OsIsrInterruptSource = 75
      OsIsrInterruptPriority = 0
      OsIsrStackSize = 1024
      OsIsrEnableNesting = false
      OsIsrSpecialFunctionName = Os_TpIsr
    Default_BAC_Appl_BMW_Task (OsTask):
      OsTaskActivation = 1
      OsTaskPriority = 58
      OsTaskSchedule = FULL
      OsTaskStackSharing = false
      OsTaskStackSize = 1024
      OsTaskType = AUTO
      OsTaskAccessingApplication = SystemApplication_OsCore_CORE0
      OsTaskEventRef = Rte_Ev_MS_Default_BAC_Appl_BMW_Task
      OsTaskEventRef = Rte_Ev_Run1_Darh_QueueHandler
      OsTaskEventRef = Rte_Ev_Run_Darh_LifeCycleHandler
      OsTaskAccessingApplication = OsApplication_ASIL
      OsTaskEventRef = Rte_Ev_Run1_SysTime_MainFunction
    Rte_Al_TE_Darh_QueueHandler (OsAlarm): OsAlarmCounterRef=SystemTimer, OsAlarmAccessingApplication=OsApplication_ASIL, OsAlarmAccessingApplication=SystemApplication_OsCore_CORE0
      OsAlarmAction
        OsAlarmSetEvent: OsAlarmSetEventRef=Rte_Ev_Run1_Darh_QueueHandler, OsAlarmSetEventTaskRef=Default_BAC_Appl_BMW_Task
    15 x OsEvent:
      Rte_Ev_MS_Default_BAC_Appl_BMW_Task: OsEventMask=4
      Rte_Ev_Run1_Darh_QueueHandler
      Rte_Ev_Run1_SysTime_ReceiveSignal
      Rte_Ev_Run_BswM_BswM_Read_SWCModeReq_StdDiag_CommunicationModeDeclarationGroup
      Rte_Ev_Run_Darh_LifeCycleHandler
      Rte_Ev_Run_Dlog_Dlog_ModeSwitchAckLifeCycle
      Rte_Ev_Run_Dlog_Dlog_ModeSwitchRequestLifeCycle
      Rte_Ev_Run_Omc_LifeCycleHandler
      Rte_Ev_Run_StdDiag_LifeCycleHandler
      Rte_Ev_Run_Stm_Runnable_ErrorCentralErrorLock
      Rte_Ev_Run_Stm_Runnable_ErrorEnergyMode
      Rte_Ev_Run_Stm_Runnable_ReceiveCentralErrorLock
      Rte_Ev_Run_Stm_Runnable_ReceiveEnergyMode
      Rte_Ev_Run_SysTime_LifeCycleHandler
      Rte_Ev_MS_Default_RTE_Mode_switch_Task: OsEventMask=4
    3 x OsAlarm, all with OsAlarmCounterRef=SystemTimer, OsAlarmAccessingApplication=SystemApplication_OsCore_CORE0:
      Rte_Al_TE_SysTime_MainFunction: OsAlarmAccessingApplication=OsApplication_ASIL
        OsAlarmAction
          OsAlarmSetEvent: OsAlarmSetEventRef=Rte_Ev_Run1_SysTime_MainFunction, OsAlarmSetEventTaskRef=Default_BAC_Appl_BMW_Task
      Rte_Al_TE_IntegrationSample_IntegrationSampleTimerFunction: OsAlarmAccessingApplication=OsApplication_ASIL
        OsAlarmAction
          OsAlarmSetEvent: OsAlarmSetEventRef=Rte_Ev_Run_IntegrationSample_IntegrationSampleTimerFunction, OsAlarmSetEventTaskRef=Default_RTE_Mode_switch_Task
      Rte_Al_TE2_OsTask_BSW_ASIL_0_2ms: OsAlarmAccessingApplication=OsApplication_QM
        OsAlarmAction
          OsAlarmSetEvent: OsAlarmSetEventRef=Rte_Ev_Cyclic2_OsTask_BSW_ASIL_0_2ms, OsAlarmSetEventTaskRef=OsTask_BSW_ASIL
    14 x OsEvent:
      Rte_Ev_Cyclic2_OsTask_BSW_ASIL_0_2ms
      Rte_Ev_Run1_SysTime_MainFunction
      Rte_Ev_Run_Bs_Bs_LifeCycleModeRequest
      Rte_Ev_Run_IntegrationSample_IntegrationSampleTimerFunction
      Rte_Ev_Run_IntegrationSample_R_IntegrationSample_EcuRunStateHandler
      Rte_Ev_Run_IntegrationSample_R_Receive_SIG_MILE_KM_816_R
      Rte_Ev_Run_IntegrationSample_R_Receive_VehicleStatus
      Rte_Ev_Run_IntegrationSample_R_Timeout_VehicleStatus
      Rte_Ev_Run_Stm_Runnable_ErrorVehicleState
      Rte_Ev_Run_Stm_Runnable_ReceiveVehicleState
      Rte_Ev_Run_IntegrationSample_R_Receive_SGG_Rx_CON_VEH
      Rte_Ev_Run_IntegrationSample_R_Timeout_SGG_Rx_CON_VEH
      Rte_Ev_Run1_Stm_Runnable_InitialCELSupervision
      Rte_Ev_Run1_Stm_Runnable_StopCentralErrorLockSupervision
    Rte_Al_TE2_Default_BSW_Sync_Task_0_5ms (OsAlarm): OsAlarmCounterRef=SystemTimer, OsAlarmAccessingApplication=SystemApplication_OsCore_CORE0, OsAlarmAccessingApplication=OsApplication_QM
      OsAlarmAction
        OsAlarmSetEvent: OsAlarmSetEventRef=Rte_Ev_Cyclic2_Default_BSW_Sync_Task_0_5ms, OsAlarmSetEventTaskRef=Default_BSW_Sync_Task
    Rte_Ev_Cyclic2_Default_BSW_Sync_Task_0_5ms (OsEvent)
    Rte_Al_TE_BMW_Application_Main_Xcp_Event_Runnable (OsAlarm): OsAlarmCounterRef=SystemTimer, OsAlarmAccessingApplication=OsApplication_ASIL, OsAlarmAccessingApplication=SystemApplication_OsCore_CORE0
      OsAlarmAction
        OsAlarmSetEvent: OsAlarmSetEventRef=Rte_Ev_Run_BMW_Application_Main_Xcp_Event_Runnable, OsAlarmSetEventTaskRef=Default_RTE_Mode_switch_Task
    10 x OsEvent:
      Rte_Ev_Run1_StdDiag_SessionChange_DefaultSession
      Rte_Ev_Run1_StdDiag_SessionChange_OtherSession
      Rte_Ev_Run_BMW_Application_Connector_Dummy_BMW_Vin_Rx_Wrapper
      Rte_Ev_Run_BMW_Application_Connector_Dummy_Dlog_FirstStart_Dummy
      Rte_Ev_Run_BMW_Application_Main_Dcm_BAC4_EcuReset_Execute
      Rte_Ev_Run_BMW_Application_Main_Dcm_BAC4_EcuReset_Hard
      Rte_Ev_Run_BMW_Application_Main_Dcm_BAC4_Jump2Boot
      Rte_Ev_Run_BMW_Application_Main_Xcp_Event_Runnable
      Rte_Ev_Run_BMW_Application_Main_Dcm_BAC4_RapidShutdownDisable
      Rte_Ev_Run_BMW_Application_Main_Dcm_BAC4_RapidShutdownEnable
