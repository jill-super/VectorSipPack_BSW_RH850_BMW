AUTOSAR XML (schema 4-3-0)
package /ActiveEcuC
  module config StdDiag: implementation-config-variant=VARIANT-PRE-COMPILE
    StdDiagGeneral: StdDiagDevErrorDetect=true, StdDiagUserActiveSessionState=false, StdDiagUserEstablishIntrinsicSafety=false
    CommonPublishedInformation: SwMajorVersion=5, SwMinorVersion=3, SwPatchVersion=0
