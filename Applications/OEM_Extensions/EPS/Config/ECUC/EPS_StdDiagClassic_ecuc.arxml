AUTOSAR XML (schema 4-3-0)
package /ActiveEcuC
  module config StdDiagClassic: implementation-config-variant=VARIANT-PRE-COMPILE
    StdDiagGeneral: StdDiagClearSecondaryErrorMemory=true
    StdDiagSgbdIndex: SgbdIndex=1
    CommonPublishedInformation: SwMajorVersion=5, SwMinorVersion=4, SwPatchVersion=0
    StdDiagUserDefinedMemory: StdDiagUserDefinedMemoryName=BMWSecondaryErrorMemory, StdDiagUserDefinedMemoryId=4
