AUTOSAR XML (schema 4-3-0)
package /ActiveEcuC
  module config IpduM: implementation-config-variant=VARIANT-PRE-COMPILE, module-description=IpduM_Impl
    IPduMGeneral (IpduMGeneral):
      IpduMStaticPartExists = false
      IpduMConfigurationTimeBase = 0.01
      IpduMRxTimeBase = 0.01
      IpduMTxTimeBase = 0.01
      IpduMDevErrorDetect = true
      IpduMHeaderByteOrder = IPDUM_BIG_ENDIAN
      IpduMVersionInfoApi = false
      IpduMSafeBswChecks = false
    IpduMPublishedInformation: IpduMRxDirectComInvocation=true
    IpduMConfig
      pduTr_FR_DBG_EPS_A_FlexRay_7d601c47 (IpduMTxPathway)  # FR_DBG_EPS
        pduTr_FR_DBG_EPS_A_FlexRay_7d601c47 (IpduMTxRequest):
          IpduMByteOrder = LITTLE_ENDIAN
          IpduMTxTriggerMode = DYNAMIC_PART_TRIGGER
          IpduMIPduUnusedAreasDefault = 0
          IpduMTxConfirmationPduId = 0
          IpduMInitialDynamicPart = DBG_EPS_BS_MOD_58_BYTE_23008def
          IpduMOutgoingPduRef = pduTr_FR_DBG_EPS_A_FlexRay_pduPort_EPS_A_FlexRay_OUT_7d601c47_052bff33
          IpduMSelectorFieldPosition: IpduMSelectorFieldLength=8, IpduMSelectorFieldPosition=0
          DBG_EPS_BS_MOD_58_BYTE_23008def (IpduMTxDynamicPart):
            IpduMJitUpdate = true
            IpduMTxDynamicConfirmation = false
            IpduMTxDynamicHandleId = 1
            IpduMTxDynamicPduRef = pduTr_DBG_EPS_BS_MOD_58_BYTE_A_FlexRay_pduPort_EPS_A_FlexRay_OUT_7d601c47_052bff33
            SegmentPosition_0 (IpduMSegment): IpduMSegmentLength=464, IpduMSegmentPosition=0
          DBG_EPS_MOD_EXT_120_BYTE_23008def (IpduMTxDynamicPart):
            IpduMJitUpdate = true
            IpduMTxDynamicConfirmation = false
            IpduMTxDynamicHandleId = 2
            IpduMTxDynamicPduRef = pduTr_DBG_EPS_MOD_EXT_120_BYTE_A_FlexRay_pduPort_EPS_A_FlexRay_OUT_7d601c47_052bff33
            SegmentPosition_0 (IpduMSegment): IpduMSegmentLength=464, IpduMSegmentPosition=0
      pduTr_SVC_A_FlexRay_434514f6_In (IpduMRxPathway)  # SVC
        pduTr_SVC_A_FlexRay_434514f6_In (IpduMRxIndication): IpduMByteOrder=LITTLE_ENDIAN, IpduMRxHandleId=0, IpduMRxIndicationPduRef=SVC_434514f6_In
          SECU_RESP_23008def (IpduMRxDynamicPart): IpduMRxSelectorValue=247, IpduMOutgoingDynamicPduRef=pduTr_SECU_RESP_A_FlexRay_pduPort_EPS_A_FlexRay_IN_7d601c47_052bff33
            SegmentPosition_0 (IpduMSegment): IpduMSegmentLength=64, IpduMSegmentPosition=0
          ANFRAGE_23008def (IpduMRxDynamicPart): IpduMRxSelectorValue=1, IpduMOutgoingDynamicPduRef=ANFRAGE_434514f6_In
            SegmentPosition_0 (IpduMSegment): IpduMSegmentLength=64, IpduMSegmentPosition=0
          IpduMSelectorFieldPosition: IpduMSelectorFieldLength=8, IpduMSelectorFieldPosition=0
      pduTr_SVC_A_FlexRay_434514f6_Out (IpduMTxPathway)  # SVC
        pduTr_SVC_A_FlexRay_434514f6_Out (IpduMTxRequest):
          IpduMByteOrder = LITTLE_ENDIAN
          IpduMTxTriggerMode = DYNAMIC_PART_TRIGGER
          IpduMIPduUnusedAreasDefault = 0
          IpduMTxConfirmationPduId = 1
          IpduMInitialDynamicPart = pduTr_SVC_A_FlexRay_434514f6_Out/ANFRAGE_23008def
          IpduMOutgoingPduRef = SVC_434514f6_Out
          IpduMSelectorFieldPosition: IpduMSelectorFieldLength=8, IpduMSelectorFieldPosition=0
          3 x IpduMTxDynamicPart, all with IpduMJitUpdate=true:
            SECU_CHAL_23008def: IpduMTxDynamicConfirmation=true, IpduMTxDynamicHandleId=4, IpduMTxDynamicPduRef=pduTr_SECU_CHAL_A_FlexRay_pduPort_EPS_A_FlexRay_OUT_7d601c47_052bff33
              SegmentPosition_0 (IpduMSegment): IpduMSegmentLength=64, IpduMSegmentPosition=0
            RQ_STG_EFAN_23008def: IpduMTxDynamicConfirmation=false, IpduMTxDynamicHandleId=3, IpduMTxDynamicPduRef=pduTr_RQ_STG_EFAN_A_FlexRay_pduPort_EPS_A_FlexRay_OUT_7d601c47_052bff33
              SegmentPosition_0 (IpduMSegment): IpduMSegmentLength=64, IpduMSegmentPosition=0
            ANFRAGE_23008def: IpduMTxDynamicConfirmation=true, IpduMTxDynamicHandleId=0, IpduMTxDynamicPduRef=ANFRAGE_434514f6_Out
              SegmentPosition_0 (IpduMSegment): IpduMSegmentLength=64, IpduMSegmentPosition=0
    IpduMGeneration:
      IpduMOutOfBoundsWriteProtectionStrategy = NONE
      IpduMOutOfBoundsWriteSanitizer = false
      IpduMOutOfBoundsReadSanitizer = false
      IpduMReduceConstantData2Define = false
      IpduMBoolDataInArrayOfStructStrategy = BITMASKING
      IpduMDeduplicateIndirectedData = true
      IpduMDataDeduplicationStrategy = WITH_CAST
      IpduMReduceBoolDataByNegationThreshold = 2
      IpduMReduceBoolDataByNumericalComparisonThreshold = 2
      IpduMReduceBoolDataByNumericalRelationThreshold = 2
      IpduMReduceBoolDataByNumericalOperandStrategy = WITH_ANY_VALUE
      IpduMReduceNumericalDataByOffsetThreshold = 2
      IpduMReduceNumericalDataByArraySubtractionThreshold = 2
      IpduMReduceDataByStreaming = false
      IpduMShortSymbols = false
      IpduMInterfacesForDeactivatedData = false
      IpduMReferringKeysInComments = false
