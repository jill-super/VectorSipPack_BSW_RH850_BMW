AUTOSAR XML (schema 4-3-0)
package /ActiveEcuC
  module config Crypto: implementation-config-variant=VARIANT-PRE-COMPILE
    CommonPublishedInformation: SwMajorVersion=5, SwMinorVersion=2, SwPatchVersion=0
    Crypto_Optimization: Enable_ShamirsTrick=false, Enable_SizeSpecificCombaFunction=false, MaxSigSize=RSA_4096
