AUTOSAR XML (schema 4-3-0)
package /Constants
  constant specification C_Bac4_ApplicationState_INIT: value-spec=0
  constant specification NO_VECH_InitValue: value-spec=[0]
