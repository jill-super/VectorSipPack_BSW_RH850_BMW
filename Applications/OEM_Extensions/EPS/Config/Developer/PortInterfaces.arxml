AUTOSAR XML (schema 4-3-0)
package /BMW/Platform/Auth/Dcm/PortInterfaces
  client server interface SecurityAccess_Coding: is-service=true
    operation CompareKey: possible-error=[SecurityAccess_Coding/DCM_E_COMPARE_KEY_FAILED, SecurityAccess_Coding/E_NOT_OK]
      arg Key: type=Dcm_SecKeyCoding_ArrayType, direction=IN, server-argument-impl-policy=USE-ARGUMENT-TYPE
      arg OpStatus: type=Dcm_OpStatusType, direction=IN, server-argument-impl-policy=USE-ARGUMENT-TYPE
      arg ErrorCode: type=Dcm_NegativeResponseCodeType, direction=OUT, server-argument-impl-policy=USE-ARGUMENT-TYPE
    operation GetSeed: possible-error=[SecurityAccess_Coding/E_NOT_OK, SecurityAccess_Coding/DCM_E_PENDING]
      4 x arg, all with server-argument-impl-policy=USE-ARGUMENT-TYPE:
        SecurityAccessDataRecord: type=Dcm_SecAccDataRecCoding_ArrayType, direction=IN
        OpStatus: type=Dcm_OpStatusType, direction=IN
        Seed: type=Dcm_SecSeedCoding_ArrayType, direction=OUT
        ErrorCode: type=Dcm_NegativeResponseCodeType, direction=OUT
    error DCM_E_COMPARE_KEY_FAILED: error-code=11
    error DCM_E_PENDING: error-code=10
    error E_NOT_OK: error-code=1
  client server interface SecurityAccess_Swt: is-service=true
    operation CompareKey: possible-error=[SecurityAccess_Swt/DCM_E_COMPARE_KEY_FAILED, SecurityAccess_Swt/E_NOT_OK]
      arg Key: type=Dcm_SecKeySwt_ArrayType, direction=IN, server-argument-impl-policy=USE-ARGUMENT-TYPE
      arg OpStatus: type=Dcm_OpStatusType, direction=IN, server-argument-impl-policy=USE-ARGUMENT-TYPE
      arg ErrorCode: type=Dcm_NegativeResponseCodeType, direction=OUT, server-argument-impl-policy=USE-ARGUMENT-TYPE
    operation GetSeed: possible-error=[SecurityAccess_Swt/E_NOT_OK, SecurityAccess_Swt/DCM_E_PENDING]
      4 x arg, all with server-argument-impl-policy=USE-ARGUMENT-TYPE:
        SecurityAccessDataRecord: type=Dcm_SecAccDataRecSwt_ArrayType, direction=IN
        OpStatus: type=Dcm_OpStatusType, direction=IN
        Seed: type=Dcm_SecSeedSwt_ArrayType, direction=OUT
        ErrorCode: type=Dcm_NegativeResponseCodeType, direction=OUT
    error DCM_E_COMPARE_KEY_FAILED: error-code=11
    error DCM_E_PENDING: error-code=10
    error E_NOT_OK: error-code=1
package /BMW/Platform/Auth/Dlog/PortInterfaces
  client server interface RandomSeed
    operation Get
      arg seed: type=Dlog_RandomSeedType, direction=OUT, server-argument-impl-policy=USE-ARGUMENT-TYPE
    operation Set: possible-error=[RandomSeed/E_PENDING, RandomSeed/E_NOT_OK]
      arg seed: type=Dlog_RandomSeedType, direction=IN, server-argument-impl-policy=USE-ARGUMENT-TYPE
      arg OpStatus: type=Dcm_OpStatusType, direction=IN, server-argument-impl-policy=USE-ARGUMENT-TYPE
    error E_NOT_OK: error-code=1
    error E_PENDING: error-code=10
  client server interface SweInfo: service-kind=BASIC-SOFTWARE-MODE-MANAGER
    operation GetSgbmId: possible-error=SweInfo/E_NOT_OK
      arg SweId: type=uint8, direction=IN, server-argument-impl-policy=USE-ARGUMENT-TYPE
      arg SgbmId: type=Dlog_SgbmIdArrayType, direction=OUT, server-argument-impl-policy=USE-ARGUMENT-TYPE
    operation IsValid: possible-error=SweInfo/E_NOT_OK
      arg sweId: type=uint8, direction=IN, server-argument-impl-policy=USE-ARGUMENT-TYPE
    error E_NOT_OK: error-code=1
  client server interface SweSignatureAccess
    5 x operation, all with possible-error=SweSignatureAccess/E_NOT_OK:
      GetNumSig
        arg sweId: type=uint8, direction=IN, server-argument-impl-policy=USE-ARGUMENT-TYPE
        arg numSig: type=uint8, direction=OUT, server-argument-impl-policy=USE-ARGUMENT-TYPE
      GetNumSwe
        arg numSwe: type=uint8, direction=OUT, server-argument-impl-policy=USE-ARGUMENT-TYPE
      GetSigLength
        arg sweId: type=uint8, direction=IN, server-argument-impl-policy=USE-ARGUMENT-TYPE
        arg blkNum: type=uint8, direction=IN, server-argument-impl-policy=USE-ARGUMENT-TYPE
        arg length: type=uint32, direction=OUT, server-argument-impl-policy=USE-ARGUMENT-TYPE
      GetSignature
        arg sweId: type=uint8, direction=IN, server-argument-impl-policy=USE-ARGUMENT-TYPE
        arg signature: type=Dlog_SignatureArrayType, direction=OUT, server-argument-impl-policy=USE-ARGUMENT-TYPE
      GetSigStart
        arg sweId: type=uint8, direction=IN, server-argument-impl-policy=USE-ARGUMENT-TYPE
        arg blkNum: type=uint8, direction=IN, server-argument-impl-policy=USE-ARGUMENT-TYPE
        arg address: type=uint32, direction=OUT, server-argument-impl-policy=USE-ARGUMENT-TYPE
    error E_NOT_OK: error-code=1
package /BMW/Platform/Auth/PortInterfaces
  client server interface CheckSignature
    operation CheckSignatureAllSwe: possible-error=[CheckSignature/E_NOT_OK, CheckSignature/E_PENDING]
    operation CheckSignatureCancel: possible-error=CheckSignature/E_NOT_OK
    error E_NOT_OK: error-code=1
    error E_PENDING: error-code=10
package /BMW/Platform/Bs/Csm/PortInterfaces
  5 x client server interface, all with is-service=true:
    CsmHash_SecureToken
      operation Hash: possible-error=[CsmHash_SecureToken/CSM_E_SMALL_BUFFER, CsmHash_SecureToken/E_NOT_OK, CsmHash_SecureToken/CSM_E_BUSY]
        4 x arg:
          dataBuffer: type=Csm_HashDataType_SecureToken, direction=IN, server-argument-impl-policy=USE-ARRAY-BASE-TYPE
          dataLength: type=uint32, direction=IN, server-argument-impl-policy=USE-ARGUMENT-TYPE
          resultBuffer: type=Csm_HashResultType_SecureToken, direction=OUT, server-argument-impl-policy=USE-ARRAY-BASE-TYPE
          resultLength: type=uint32, direction=OUT, server-argument-impl-policy=USE-ARGUMENT-TYPE
      error CSM_E_BUSY: error-code=2
      error CSM_E_SMALL_BUFFER: error-code=3
      error E_NOT_OK: error-code=1
    CsmKeyManagement_Certificate
      4 x operation:
        CertificateParse: possible-error=[CsmKeyManagement_Certificate/CSM_E_BUSY, CsmKeyManagement_Certificate/E_NOT_OK]
        CertificateVerify
          arg verifyKeyId: type=uint32, direction=IN, server-argument-impl-policy=USE-ARGUMENT-TYPE
          arg verifyPtr: type=Crypto_VerifyResultType, direction=OUT, server-argument-impl-policy=USE-ARGUMENT-TYPE
        KeyElementGet: possible-error=[CsmKeyManagement_Certificate/CSM_E_BUSY, CsmKeyManagement_Certificate/CSM_E_KEY_NOT_AVAILABLE, CsmKeyManagement_Certificate/CSM_E_KEY_READ_FAIL, CsmKeyManagement_Certificate/CSM_E_SMALL_BUFFER, CsmKeyManagement_Certificate/E_NOT_OK]
          arg keyElementId: type=uint32, direction=IN, server-argument-impl-policy=USE-ARGUMENT-TYPE
          arg keyPtr: type=RCDataArrayType, direction=OUT, server-argument-impl-policy=USE-ARRAY-BASE-TYPE
          arg keyLength: type=uint32, direction=OUT, server-argument-impl-policy=USE-ARGUMENT-TYPE
        KeyElementSet: possible-error=[CsmKeyManagement_Certificate/CSM_E_BUSY, CsmKeyManagement_Certificate/CSM_E_KEY_SIZE_MISMATCH, CsmKeyManagement_Certificate/CSM_E_KEY_WRITE_FAIL, CsmKeyManagement_Certificate/CSM_E_SMALL_BUFFER, CsmKeyManagement_Certificate/E_NOT_OK]
          arg keyElementId: type=uint32, direction=IN, server-argument-impl-policy=USE-ARGUMENT-TYPE
          arg keyPtr: type=RCDataArrayType, direction=IN, server-argument-impl-policy=USE-ARRAY-BASE-TYPE
          arg keyLength: type=uint32, direction=IN, server-argument-impl-policy=USE-ARGUMENT-TYPE
      7 x error:
        CSM_E_BUSY: error-code=2
        CSM_E_KEY_NOT_AVAILABLE: error-code=8
        CSM_E_KEY_READ_FAIL: error-code=6
        CSM_E_KEY_SIZE_MISMATCH: error-code=10
        CSM_E_KEY_WRITE_FAIL: error-code=7
        CSM_E_SMALL_BUFFER: error-code=3
        E_NOT_OK: error-code=1
    CsmKeyManagement_CsrKey
      operation KeyElementGet: possible-error=[CsmKeyManagement_CsrKey/CSM_E_BUSY, CsmKeyManagement_CsrKey/CSM_E_KEY_NOT_AVAILABLE, CsmKeyManagement_CsrKey/CSM_E_KEY_READ_FAIL, CsmKeyManagement_CsrKey/CSM_E_SMALL_BUFFER, CsmKeyManagement_CsrKey/E_NOT_OK]
        arg keyElementId: type=uint32, direction=IN, server-argument-impl-policy=USE-ARGUMENT-TYPE
        arg keyPtr: type=RCDataArrayType, direction=OUT, server-argument-impl-policy=USE-ARRAY-BASE-TYPE
        arg keyLength: type=uint32, direction=OUT, server-argument-impl-policy=USE-ARGUMENT-TYPE
      operation KeyGenerate: possible-error=[CsmKeyManagement_CsrKey/CSM_E_BUSY, CsmKeyManagement_CsrKey/E_NOT_OK]
      7 x error:
        CSM_E_BUSY: error-code=2
        CSM_E_KEY_NOT_AVAILABLE: error-code=8
        CSM_E_KEY_READ_FAIL: error-code=6
        CSM_E_KEY_SIZE_MISMATCH: error-code=10
        CSM_E_KEY_WRITE_FAIL: error-code=7
        CSM_E_SMALL_BUFFER: error-code=3
        E_NOT_OK: error-code=1
    CsmSignatureGenerate_Csr
      operation SignatureGenerate: possible-error=[CsmSignatureGenerate_Csr/CSM_E_SMALL_BUFFER, CsmSignatureGenerate_Csr/CSM_E_BUSY, CsmSignatureGenerate_Csr/E_NOT_OK]
        4 x arg:
          dataBuffer: type=Csm_SignatureGenerateDataType_Csr, direction=IN, server-argument-impl-policy=USE-ARRAY-BASE-TYPE
          dataLength: type=uint32, direction=IN, server-argument-impl-policy=USE-ARGUMENT-TYPE
          resultBuffer: type=Csm_SignatureGenerateResultType_Csr, direction=OUT, server-argument-impl-policy=USE-ARRAY-BASE-TYPE
          resultLength: type=uint32, direction=INOUT, server-argument-impl-policy=USE-ARGUMENT-TYPE
      error CSM_E_BUSY: error-code=2
      error CSM_E_SMALL_BUFFER: error-code=3
      error E_NOT_OK: error-code=1
    CsmSignatureVerify_SecureToken
      operation SignatureVerify: possible-error=[CsmSignatureVerify_SecureToken/CSM_E_BUSY, CsmSignatureVerify_SecureToken/CSM_E_SMALL_BUFFER, CsmSignatureVerify_SecureToken/E_NOT_OK]
        5 x arg:
          dataBuffer: type=Csm_SignatureVerifyDataType_SecureToken, direction=IN, server-argument-impl-policy=USE-ARRAY-BASE-TYPE
          dataLength: type=uint32, direction=IN, server-argument-impl-policy=USE-ARGUMENT-TYPE
          compareBuffer: type=Csm_SignatureVerifyCompareType_SecureToken, direction=IN, server-argument-impl-policy=USE-ARRAY-BASE-TYPE
          compareLength: type=uint32, direction=IN, server-argument-impl-policy=USE-ARGUMENT-TYPE
          resultBuffer: type=Crypto_VerifyResultType, direction=OUT, server-argument-impl-policy=USE-ARGUMENT-TYPE
      error CSM_E_BUSY: error-code=2
      error CSM_E_SMALL_BUFFER: error-code=3
      error E_NOT_OK: error-code=1
package /BMW/Platform/Bs/Dcm/PortInterfaces
  7 x client server interface, all with is-service=true:
    DataServices_FunctionGroupStatus
      operation ConditionCheckRead: possible-error=[DataServices_FunctionGroupStatus/E_NOT_OK, DataServices_FunctionGroupStatus/DCM_E_PENDING]
        arg OpStatus: type=Dcm_OpStatusType, direction=IN, server-argument-impl-policy=USE-ARGUMENT-TYPE
        arg ErrorCode: type=Dcm_NegativeResponseCodeType, direction=OUT, server-argument-impl-policy=USE-ARGUMENT-TYPE
      operation ReadData: possible-error=[DataServices_FunctionGroupStatus/E_NOT_OK, DataServices_FunctionGroupStatus/DCM_E_PENDING]
        arg OpStatus: type=Dcm_OpStatusType, direction=IN, server-argument-impl-policy=USE-ARGUMENT-TYPE
        arg Data: type=uint8, direction=OUT, server-argument-impl-policy=USE-ARGUMENT-TYPE
      error DCM_E_PENDING: error-code=10
      error E_NOT_OK: error-code=1
    DataServices_ReadWrite
      4 x operation:
        ConditionCheckRead: possible-error=[DataServices_ReadWrite/E_NOT_OK, DataServices_ReadWrite/DCM_E_PENDING]
          arg OpStatus: type=Dcm_OpStatusType, direction=IN, server-argument-impl-policy=USE-ARGUMENT-TYPE
          arg ErrorCode: type=Dcm_NegativeResponseCodeType, direction=OUT, server-argument-impl-policy=USE-ARGUMENT-TYPE
        ReadData: possible-error=[DataServices_ReadWrite/E_NOT_OK, DataServices_ReadWrite/DCM_E_PENDING]
          arg OpStatus: type=Dcm_OpStatusType, direction=IN, server-argument-impl-policy=USE-ARGUMENT-TYPE
          arg Data: type=RCDataArrayType, direction=OUT, server-argument-impl-policy=USE-ARGUMENT-TYPE
        ReadDataLength: possible-error=[DataServices_ReadWrite/E_NOT_OK, DataServices_ReadWrite/DCM_E_PENDING]
          arg OpStatus: type=Dcm_OpStatusType, direction=IN, server-argument-impl-policy=USE-ARGUMENT-TYPE
          arg DataLength: type=uint16, direction=OUT, server-argument-impl-policy=USE-ARGUMENT-TYPE
        WriteData: possible-error=[DataServices_ReadWrite/DCM_E_PENDING, DataServices_ReadWrite/E_NOT_OK]
          4 x arg:
            Data: type=RCDataArrayType, direction=IN, server-argument-impl-policy=USE-ARRAY-BASE-TYPE
            DataLength: type=uint16, direction=IN, server-argument-impl-policy=USE-ARGUMENT-TYPE
            OpStatus: type=Dcm_OpStatusType, direction=IN, server-argument-impl-policy=USE-ARGUMENT-TYPE
            ErrorCode: type=Dcm_NegativeResponseCodeType, direction=OUT, server-argument-impl-policy=USE-ARGUMENT-TYPE
      error DCM_E_PENDING: error-code=10
      error E_NOT_OK: error-code=1
    DataServices_VarLength
      operation ConditionCheckRead: possible-error=[DataServices_VarLength/E_NOT_OK, DataServices_VarLength/DCM_E_PENDING]
        arg OpStatus: type=Dcm_OpStatusType, direction=IN, server-argument-impl-policy=USE-ARGUMENT-TYPE
        arg ErrorCode: type=Dcm_NegativeResponseCodeType, direction=OUT, server-argument-impl-policy=USE-ARGUMENT-TYPE
      operation ReadData: possible-error=[DataServices_VarLength/E_NOT_OK, DataServices_VarLength/DCM_E_PENDING]
        arg OpStatus: type=Dcm_OpStatusType, direction=IN, server-argument-impl-policy=USE-ARGUMENT-TYPE
        arg Data: type=RCDataArrayType, direction=OUT, server-argument-impl-policy=USE-ARGUMENT-TYPE
      operation ReadDataLength: possible-error=[DataServices_VarLength/DCM_E_PENDING, DataServices_VarLength/E_NOT_OK]
        arg OpStatus: type=Dcm_OpStatusType, direction=IN, server-argument-impl-policy=USE-ARGUMENT-TYPE
        arg DataLength: type=uint16, direction=OUT, server-argument-impl-policy=USE-ARGUMENT-TYPE
      error DCM_E_PENDING: error-code=10
      error E_NOT_OK: error-code=1
    RoutineServices_In
      operation Start: possible-error=[RoutineServices_In/E_NOT_OK, RoutineServices_In/DCM_E_PENDING]
        4 x arg, all with server-argument-impl-policy=USE-ARGUMENT-TYPE:
          DataIn: type=RCDataArrayType, direction=IN
          OpStatus: type=Dcm_OpStatusType, direction=IN
          CurrentDataLength: type=uint16, direction=IN
          ErrorCode: type=Dcm_NegativeResponseCodeType, direction=OUT
      error DCM_E_PENDING: error-code=10
      error E_NOT_OK: error-code=1
    RoutineServices_InOut
      operation Start: possible-error=[RoutineServices_InOut/E_NOT_OK, RoutineServices_InOut/DCM_E_PENDING]
        5 x arg, all with server-argument-impl-policy=USE-ARGUMENT-TYPE:
          DataIn: type=RCDataArrayType, direction=IN
          OpStatus: type=Dcm_OpStatusType, direction=IN
          DataOut: type=RCDataArrayType, direction=OUT
          CurrentDataLength: type=uint16, direction=INOUT
          ErrorCode: type=Dcm_NegativeResponseCodeType, direction=OUT
      error DCM_E_PENDING: error-code=10
      error E_NOT_OK: error-code=1
    RoutineServices_NoParam
      operation Start: possible-error=[RoutineServices_NoParam/E_NOT_OK, RoutineServices_NoParam/DCM_E_PENDING]
        arg OpStatus: type=Dcm_OpStatusType, direction=IN, server-argument-impl-policy=USE-ARGUMENT-TYPE
        arg ErrorCode: type=Dcm_NegativeResponseCodeType, direction=OUT, server-argument-impl-policy=USE-ARGUMENT-TYPE
      error DCM_E_PENDING: error-code=10
      error E_NOT_OK: error-code=1
    RoutineServices_Out
      operation Start: possible-error=[RoutineServices_Out/E_NOT_OK, RoutineServices_Out/DCM_E_PENDING]
        4 x arg, all with server-argument-impl-policy=USE-ARGUMENT-TYPE:
          OpStatus: type=Dcm_OpStatusType, direction=IN
          DataOut: type=RCDataArrayType, direction=OUT
          CurrentDataLength: type=uint16, direction=OUT
          ErrorCode: type=Dcm_NegativeResponseCodeType, direction=OUT
      error DCM_E_PENDING: error-code=10
      error E_NOT_OK: error-code=1
package /BMW/Platform/Bs/Dem/PortInterfaces
  client server interface Bs_DiagnosticMonitor: is-service=true
    operation SetEventStatus: possible-error=Bs_DiagnosticMonitor/E_NOT_OK
      arg EventStatus: type=Dem_EventStatusType, direction=IN, server-argument-impl-policy=USE-ARGUMENT-TYPE
    error E_NOT_OK: error-code=1
package /BMW/Platform/Bs/Det/PortInterfaces
  client server interface Bs_DETService: is-service=true
    operation ReportError: possible-error=Bs_DETService/E_OK
      arg InstanceId: type=uint8, direction=IN, server-argument-impl-policy=USE-ARGUMENT-TYPE
      arg ApiId: type=uint8, direction=IN, server-argument-impl-policy=USE-ARGUMENT-TYPE
      arg ErrorId: type=uint8, direction=IN, server-argument-impl-policy=USE-ARGUMENT-TYPE
    error E_OK: error-code=0
package /BMW/Platform/Bs/Dlog/PortInterfaces
  client server interface DataServices_EcuUid: is-service=true
    operation ReadData: possible-error=DataServices_EcuUid/E_NOT_OK
      arg Data: type=Dlog_EcuUidArrayType, direction=OUT, server-argument-impl-policy=USE-ARGUMENT-TYPE
    error E_NOT_OK: error-code=1
package /BMW/Platform/Bs/ModeDeclarationGroups
  mode declaration group Bs_LifeCycle: category=EXPLICIT_ORDER, initial-mode=BS_STOPPED, on-transition-value=3
    mode BS_INITIALIZED: value=0
    mode BS_RUNNING: value=1
    mode BS_STOPPED: value=2
  mode declaration group SecEcuMode: category=EXPLICIT_ORDER, initial-mode=FIELD, on-transition-value=3
    mode ENGINEERING: value=1
    mode FIELD: value=0
    mode PLANT: value=2
package /BMW/Platform/Bs/NvM/PortInterfaces
  4 x client server interface, all with is-service=true:
    Bs_NvMAdmin
      operation SetBlockProtection: possible-error=Bs_NvMAdmin/E_NOT_OK
        arg ProtectionEnabled: type=boolean, direction=IN, server-argument-impl-policy=USE-ARGUMENT-TYPE
      error E_NOT_OK: error-code=1
    Bs_NvMNotifyInitBlock
      operation InitBlock: possible-error=Bs_NvMNotifyInitBlock/E_OK
      error E_OK: error-code=0
    Bs_NvMNotifyJobFinished
      operation JobFinished: possible-error=Bs_NvMNotifyJobFinished/E_OK
        arg ServiceId: type=uint8, direction=IN, server-argument-impl-policy=USE-ARGUMENT-TYPE
        arg JobResult: type=NvM_RequestResultType, direction=IN, server-argument-impl-policy=USE-ARGUMENT-TYPE
      error E_OK: error-code=0
    Bs_NvMService
      4 x operation, all with possible-error=Bs_NvMService/E_NOT_OK:
        GetErrorStatus
          arg RequestResultPtr: type=NvM_RequestResultType, direction=OUT, server-argument-impl-policy=USE-ARGUMENT-TYPE
        ReadBlock
          arg DstPtr: type=NvM_DstPtrType, direction=IN, server-argument-impl-policy=USE-ARGUMENT-TYPE
        SetRamBlockStatus
          arg BlockChanged: type=boolean, direction=IN, server-argument-impl-policy=USE-ARGUMENT-TYPE
        WriteBlock
          arg SrcPtr: type=NvM_SrcPtrType, direction=IN, server-argument-impl-policy=USE-ARGUMENT-TYPE
      error E_NOT_OK: error-code=1
package /BMW/Platform/Bs/PortInterfaces
  client server interface SecureFeature
    operation GetFeatureSpecificField: possible-error=SecureFeature/E_NOT_OK
      4 x arg, all with server-argument-impl-policy=USE-ARGUMENT-TYPE:
        featureId: type=uint32, direction=IN
        fieldIndex: type=uint32, direction=IN
        tag: type=uint16, direction=OUT
        value: type=Bs_SfaFeatureSpecificFieldValueType, direction=OUT
    operation GetNumberOfFeatureSpecificFields: possible-error=SecureFeature/E_NOT_OK
      arg featureId: type=uint32, direction=IN, server-argument-impl-policy=USE-ARGUMENT-TYPE
      arg numberOfFields: type=uint16, direction=OUT, server-argument-impl-policy=USE-ARGUMENT-TYPE
    error E_NOT_OK: error-code=1
  mode switch interface ILifeCycle
    mode group Mode: type=Bs_LifeCycle
  mode switch interface SecEcuMode
    mode group Mode: type=SecEcuMode
  sender receiver interface ActivationState: invalidation-policy{data-element=IsActivated, handle-invalid=DONT-INVALIDATE}
    data IsActivated: type=boolean
  sender receiver interface ILifeCycleRequest: is-service=true, invalidation-policy{data-element=ILifeCycleRequest/requestMode, handle-invalid=DONT-INVALIDATE}
    data requestMode: type=Bs_LifeCycleRequestType
  sender receiver interface LCSState: invalidation-policy{data-element=value, handle-invalid=DONT-INVALIDATE}
    data value: type=uint8
package /BMW/Platform/Bs/SecOC/PortInterfaces
  client server interface FreshnessManagement: is-service=true
    operation GetRxFreshnessAuthData: possible-error=[FreshnessManagement/E_OK, E_BUSY, FreshnessManagement/E_NOT_OK]
      8 x arg:
        freshnessValueId: type=uint16, direction=IN, server-argument-impl-policy=USE-ARGUMENT-TYPE
        truncatedFreshnessValue: type=SecOC_FreshnessArrayType, direction=IN, server-argument-impl-policy=USE-ARRAY-BASE-TYPE
        truncatedFreshnessValueLength: type=uint32, direction=IN, server-argument-impl-policy=USE-ARGUMENT-TYPE
        authenticDataFreshnessValue: type=SecOC_FreshnessArrayType, direction=IN, server-argument-impl-policy=USE-ARRAY-BASE-TYPE
        authenticDataFreshnessValueLength: type=uint16, direction=IN, server-argument-impl-policy=USE-ARGUMENT-TYPE
        authVerifyAttempts: type=uint16, direction=IN, server-argument-impl-policy=USE-ARGUMENT-TYPE
        freshnessValue: type=SecOC_FreshnessArrayType, direction=OUT, server-argument-impl-policy=USE-ARRAY-BASE-TYPE
        freshnessValueLength: type=uint32, direction=INOUT, server-argument-impl-policy=USE-ARGUMENT-TYPE
    operation GetTxFreshnessTruncData: possible-error=[FreshnessManagement/E_OK, E_BUSY, FreshnessManagement/E_NOT_OK]
      5 x arg:
        freshnessValueId: type=uint16, direction=IN, server-argument-impl-policy=USE-ARGUMENT-TYPE
        freshnessValue: type=SecOC_FreshnessArrayType, direction=OUT, server-argument-impl-policy=USE-ARRAY-BASE-TYPE
        freshnessValueLength: type=uint32, direction=INOUT, server-argument-impl-policy=USE-ARGUMENT-TYPE
        truncatedFreshnessValue: type=SecOC_FreshnessArrayType, direction=OUT, server-argument-impl-policy=USE-ARRAY-BASE-TYPE
        truncatedFreshnessValueLength: type=uint32, direction=INOUT, server-argument-impl-policy=USE-ARGUMENT-TYPE
    operation SPduTxConfirmation: possible-error=FreshnessManagement/E_OK
      arg freshnessValueId: type=uint16, direction=IN, server-argument-impl-policy=USE-ARGUMENT-TYPE
    error E_BUSY: error-code=2
    error E_NOT_OK: error-code=1
    error E_OK: error-code=0
package /BMW/Platform/Bs/StdDiag/PortInterfaces
  client server interface StdDiag_Adue
    11 x operation:
      CancelOperation: possible-error=StdDiag_Adue/E_OK
      Download: possible-error=[StdDiag_Adue/E_RUNNING, StdDiag_Adue/E_NOT_OK]
        4 x arg:
          blockSequenceCounter: type=uint8, direction=IN, server-argument-impl-policy=USE-ARGUMENT-TYPE
          data: type=RCDataArrayType, direction=IN, server-argument-impl-policy=USE-ARRAY-BASE-TYPE
          length: type=uint32, direction=IN, server-argument-impl-policy=USE-ARGUMENT-TYPE
          errorCode: type=Dcm_NegativeResponseCodeType, direction=OUT, server-argument-impl-policy=USE-ARGUMENT-TYPE
      DownloadPostprocess: possible-error=[StdDiag_Adue/E_RUNNING, StdDiag_Adue/E_NOT_OK]
        arg parameter: type=RCDataArrayType, direction=IN, server-argument-impl-policy=USE-ARRAY-BASE-TYPE
        arg parameterSize: type=uint16, direction=IN, server-argument-impl-policy=USE-ARGUMENT-TYPE
        arg errorCode: type=Dcm_NegativeResponseCodeType, direction=OUT, server-argument-impl-policy=USE-ARGUMENT-TYPE
      DownloadPreprocess: possible-error=[StdDiag_Adue/E_RUNNING, StdDiag_Adue/E_NOT_OK]
        arg parameter: type=RCDataArrayType, direction=IN, server-argument-impl-policy=USE-ARRAY-BASE-TYPE
        arg parameterSize: type=uint16, direction=IN, server-argument-impl-policy=USE-ARGUMENT-TYPE
        arg errorCode: type=Dcm_NegativeResponseCodeType, direction=OUT, server-argument-impl-policy=USE-ARGUMENT-TYPE
      RequestDownload: possible-error=[StdDiag_Adue/E_RUNNING, StdDiag_Adue/E_NOT_OK]
        4 x arg, all with server-argument-impl-policy=USE-ARGUMENT-TYPE:
          dataFormatIdentifier: type=uint8, direction=IN
          size: type=uint32, direction=IN
          maxBlockLength: type=uint32, direction=OUT
          errorCode: type=Dcm_NegativeResponseCodeType, direction=OUT
      RequestDownloadExit: possible-error=StdDiag_Adue/E_OK
      RequestUpload: possible-error=[StdDiag_Adue/E_RUNNING, StdDiag_Adue/E_NOT_OK]
        4 x arg, all with server-argument-impl-policy=USE-ARGUMENT-TYPE:
          dataFormatIdentifier: type=uint8, direction=IN
          size: type=uint32, direction=IN
          maxBlockLength: type=uint32, direction=OUT
          errorCode: type=Dcm_NegativeResponseCodeType, direction=OUT
      RequestUploadExit: possible-error=StdDiag_Adue/E_OK
      Upload: possible-error=[StdDiag_Adue/E_RUNNING, StdDiag_Adue/E_NOT_OK]
        4 x arg:
          blockSequenceCounter: type=uint8, direction=IN, server-argument-impl-policy=USE-ARGUMENT-TYPE
          data: type=RCDataArrayType, direction=OUT, server-argument-impl-policy=USE-ARRAY-BASE-TYPE
          length: type=uint32, direction=IN, server-argument-impl-policy=USE-ARGUMENT-TYPE
          errorCode: type=Dcm_NegativeResponseCodeType, direction=OUT, server-argument-impl-policy=USE-ARGUMENT-TYPE
      UploadPostprocess: possible-error=[StdDiag_Adue/E_RUNNING, StdDiag_Adue/E_NOT_OK]
        arg parameter: type=RCDataArrayType, direction=IN, server-argument-impl-policy=USE-ARRAY-BASE-TYPE
        arg parameterSize: type=uint16, direction=IN, server-argument-impl-policy=USE-ARGUMENT-TYPE
        arg errorCode: type=Dcm_NegativeResponseCodeType, direction=OUT, server-argument-impl-policy=USE-ARGUMENT-TYPE
      UploadPreprocess: possible-error=[StdDiag_Adue/E_NOT_OK, StdDiag_Adue/E_RUNNING]
        arg parameter: type=RCDataArrayType, direction=IN, server-argument-impl-policy=USE-ARRAY-BASE-TYPE
        arg parameterSize: type=uint16, direction=IN, server-argument-impl-policy=USE-ARGUMENT-TYPE
        arg errorCode: type=Dcm_NegativeResponseCodeType, direction=OUT, server-argument-impl-policy=USE-ARGUMENT-TYPE
    error E_NOT_OK: error-code=1
    error E_OK: error-code=0
    error E_RUNNING: error-code=10
package /BMW/Platform/Common/ModeDeclarationGroups
  mode declaration group SystemCommunicationMode: category=ALPHABETIC_ORDER, initial-mode=SYSTEM_NO_COMM
    mode SYSTEM_ACTIVE_WAKEUP
    mode SYSTEM_NO_COMM
    mode SYSTEM_PASSIVE_WAKEUP
package /BMW/Platform/Common/PortInterfaces
  mode switch interface SystemCommModeInterface: is-service=true
    mode group SystemCommunicationMode: type=SystemCommunicationMode
package /BMW/Platform/Darh/Dcm/ModeDeclarationGroups
  mode declaration group DcmResponseOnEvent: category=ALPHABETIC_ORDER, initial-mode=EVENT_CLEARED
    mode EVENT_CLEARED
    mode EVENT_STARTED
    mode EVENT_STOPPED
package /BMW/Platform/Darh/Dcm/PortInterfaces
  7 x client server interface, all with is-service=true:
    Darh_ServiceRequestNotification
      operation Confirmation: possible-error=Darh_ServiceRequestNotification/E_NOT_OK
        4 x arg, all with direction=IN, server-argument-impl-policy=USE-ARGUMENT-TYPE:
          SID: type=uint8
          ReqType: type=uint8
          SourceAddress: type=uint16
          ConfirmationStatus: type=Dcm_ConfirmationStatusType
      operation Indication: possible-error=[Darh_ServiceRequestNotification/E_NOT_OK, Darh_ServiceRequestNotification/E_REQUEST_NOT_ACCEPTED]
        6 x arg, all with server-argument-impl-policy=USE-ARGUMENT-TYPE:
          SID: type=uint8, direction=IN
          RequestData: type=Dcm_RequestData_ArrayType, direction=IN
          DataSize: type=uint16, direction=IN
          ReqType: type=uint8, direction=IN
          SourceAddress: type=uint16, direction=IN
          ErrorCode: type=Dcm_NegativeResponseCodeType, direction=OUT
      error E_NOT_OK: error-code=1
      error E_REQUEST_NOT_ACCEPTED: error-code=8
    DataServices_ActivelyReportedDtc
      operation ConditionCheckRead: possible-error=DataServices_ActivelyReportedDtc/E_NOT_OK
        arg ErrorCode: type=Dcm_NegativeResponseCodeType, direction=OUT, server-argument-impl-policy=USE-ARGUMENT-TYPE
      operation ReadData: possible-error=DataServices_ActivelyReportedDtc/E_NOT_OK
        arg Data: type=Darh_ActivelyReportedErrorListType, direction=OUT, server-argument-impl-policy=USE-ARGUMENT-TYPE
      operation ReadDataLength: possible-error=DataServices_ActivelyReportedDtc/E_NOT_OK
        arg DataLength: type=uint16, direction=OUT, server-argument-impl-policy=USE-ARGUMENT-TYPE
      error DCM_E_PENDING: error-code=10
      error E_NOT_OK: error-code=1
    DataServices_ErrorQueue
      operation ConditionCheckRead: possible-error=DataServices_ErrorQueue/E_NOT_OK
        arg ErrorCode: type=Dcm_NegativeResponseCodeType, direction=OUT, server-argument-impl-policy=USE-ARGUMENT-TYPE
      operation ReadData: possible-error=DataServices_ErrorQueue/E_NOT_OK
        arg data: type=Darh_ErrorQueueDataType, direction=OUT, server-argument-impl-policy=USE-ARGUMENT-TYPE
      operation ReadDataLength: possible-error=DataServices_ErrorQueue/E_NOT_OK
        arg DataLength: type=uint16, direction=OUT, server-argument-impl-policy=USE-ARGUMENT-TYPE
      error DCM_E_PENDING: error-code=10
      error E_NOT_OK: error-code=1
    DataServices_RoeState
      operation ConditionCheckRead: possible-error=DataServices_RoeState/E_NOT_OK
        arg ErrorCode: type=Dcm_NegativeResponseCodeType, direction=OUT, server-argument-impl-policy=USE-ARGUMENT-TYPE
      operation ReadData: possible-error=DataServices_RoeState/E_NOT_OK
        arg Data: type=Darh_RoeState_ReadData_Data_ArrayType, direction=OUT, server-argument-impl-policy=USE-ARGUMENT-TYPE
      error E_NOT_OK: error-code=1
    DCM_Roe
      operation TriggerOnEvent: possible-error=DCM_Roe/E_NOT_OK
      error E_NOT_OK: error-code=1
    RoutineServices_StartStopRoutineDiagnoseMaster
      operation Start: possible-error=[RoutineServices_StartStopRoutineDiagnoseMaster/E_NOT_OK, RoutineServices_StartStopRoutineDiagnoseMaster/DCM_E_PENDING, RoutineServices_StartStopRoutineDiagnoseMaster/DCM_E_FORCE_RCRRP]
        arg OpStatus: type=Dcm_OpStatusType, direction=IN, server-argument-impl-policy=USE-ARGUMENT-TYPE
        arg ErrorCode: type=Dcm_NegativeResponseCodeType, direction=OUT, server-argument-impl-policy=USE-ARGUMENT-TYPE
      operation Stop: possible-error=[RoutineServices_StartStopRoutineDiagnoseMaster/DCM_E_FORCE_RCRRP, RoutineServices_StartStopRoutineDiagnoseMaster/DCM_E_PENDING, RoutineServices_StartStopRoutineDiagnoseMaster/E_NOT_OK]
        arg OpStatus: type=Dcm_OpStatusType, direction=IN, server-argument-impl-policy=USE-ARGUMENT-TYPE
        arg ErrorCode: type=Dcm_NegativeResponseCodeType, direction=OUT, server-argument-impl-policy=USE-ARGUMENT-TYPE
      error DCM_E_FORCE_RCRRP: error-code=12
      error DCM_E_PENDING: error-code=10
      error E_NOT_OK: error-code=1
    RoutineServices_TriggerDTC
      operation Start: possible-error=[RoutineServices_TriggerDTC/E_NOT_OK, RoutineServices_TriggerDTC/DCM_E_PENDING, RoutineServices_TriggerDTC/DCM_E_FORCE_RCRRP]
        7 x arg, all with server-argument-impl-policy=USE-ARGUMENT-TYPE:
          DTCType: type=uint8, direction=IN
          OpStatus: type=Dcm_OpStatusType, direction=IN
          DTCTypeOut: type=uint8, direction=OUT
          DTCByte{1..3}: type=uint8, direction=OUT
          ErrorCode: type=Dcm_NegativeResponseCodeType, direction=OUT
      error DCM_E_FORCE_RCRRP: error-code=12
      error DCM_E_PENDING: error-code=10
      error E_NOT_OK: error-code=1
  mode switch interface DcmResponseOnEvent: is-service=true
    mode group currentMode: type=DcmResponseOnEvent
package /BMW/Platform/Darh/Dem/PortInterfaces
  4 x client server interface, all with is-service=true:
    Darh_DiagnosticInfo
      operation GetDTCOfEvent: possible-error=[Darh_DiagnosticInfo/E_NOT_OK, Darh_DiagnosticInfo/DEM_E_NO_DTC_AVAILABLE]
        arg DTCFormat: type=Dem_DTCFormatType, direction=IN, server-argument-impl-policy=USE-ARGUMENT-TYPE
        arg DTCOfEvent: type=uint32, direction=OUT, server-argument-impl-policy=USE-ARGUMENT-TYPE
      error DEM_E_NO_DTC_AVAILABLE: error-code=2
      error E_NOT_OK: error-code=1
    Darh_DiagnosticMonitor
      operation ResetEventStatus: possible-error=Darh_DiagnosticMonitor/E_NOT_OK
      operation SetEventStatus: possible-error=Darh_DiagnosticMonitor/E_NOT_OK
        arg EventStatus: type=Dem_EventStatusType, direction=IN, server-argument-impl-policy=USE-ARGUMENT-TYPE
      error E_NOT_OK: error-code=1
    Darh_GeneralDiagnosticInfo
      operation GetDTCOfEvent: possible-error=[Darh_GeneralDiagnosticInfo/E_NOT_OK, Darh_GeneralDiagnosticInfo/DEM_E_NO_DTC_AVAILABLE]
        arg EventId: type=Dem_EventIdType, direction=IN, server-argument-impl-policy=USE-ARGUMENT-TYPE
        arg DTCFormat: type=Dem_DTCFormatType, direction=IN, server-argument-impl-policy=USE-ARGUMENT-TYPE
        arg DTCOfEvent: type=uint32, direction=OUT, server-argument-impl-policy=USE-ARGUMENT-TYPE
      operation GetEventFreezeFrameData: possible-error=[Darh_GeneralDiagnosticInfo/E_NOT_OK, DEM_E_NODATAAVAILABLE, DEM_E_WRONG_RECORDNUMBER, DEM_E_WRONG_DIDNUMBER]
        5 x arg, all with server-argument-impl-policy=USE-ARGUMENT-TYPE:
          EventId: type=Dem_EventIdType, direction=IN
          RecordNumber: type=uint8, direction=IN
          ReportTotalRecord: type=boolean, direction=IN
          DataId: type=uint16, direction=IN
          DestBuffer: type=Dem_MaxDataValueType, direction=OUT
      5 x error:
        DEM_E_NO_DTC_AVAILABLE: error-code=2
        DEM_E_NODATAAVAILABLE: error-code=48
        DEM_E_WRONG_DIDNUMBER: error-code=50
        DEM_E_WRONG_RECORDNUMBER: error-code=49
        E_NOT_OK: error-code=1
    GeneralCallbackEventDataChanged
      operation EventDataChanged
        arg EventId: type=Dem_EventIdType, direction=IN, server-argument-impl-policy=USE-ARGUMENT-TYPE
package /BMW/Platform/Darh/Det/PortInterfaces
  client server interface DETService: is-service=true
    operation ReportError
      arg InstanceId: type=uint8, direction=IN, server-argument-impl-policy=USE-ARGUMENT-TYPE
      arg ApiId: type=uint8, direction=IN, server-argument-impl-policy=USE-ARGUMENT-TYPE
      arg ErrorId: type=uint8, direction=IN, server-argument-impl-policy=USE-ARGUMENT-TYPE
package /BMW/Platform/Darh/ModeDeclarationGroups
  mode declaration group Darh_LifeCycle: category=EXPLICIT_ORDER, initial-mode=DARH_STOPPED, on-transition-value=3
    mode DARH_INITIALIZED: value=0
    mode DARH_RUNNING: value=1
    mode DARH_STOPPED: value=2
  mode declaration group DarhReportErrorMode: category=ALPHABETIC_ORDER, initial-mode=DARH_REPORT_ERROR_INACTIVE
    mode DARH_REPORT_ERROR_ACTIVE
    mode DARH_REPORT_ERROR_INACTIVE
package /BMW/Platform/Darh/NvM/PortInterfaces
  client server interface Darh_NvMService: is-service=true
    operation SetRamBlockStatus: possible-error=Darh_NvMService/E_NOT_OK
      arg BlockChanged: type=boolean, direction=IN, server-argument-impl-policy=USE-ARGUMENT-TYPE
    operation WriteBlock: possible-error=Darh_NvMService/E_NOT_OK
      arg SrcPtr: type=NvM_SrcPtrType, direction=IN, server-argument-impl-policy=USE-ARGUMENT-TYPE
    error E_NOT_OK: error-code=1
  client server interface NvMNotifyJobFinished: is-service=true
    operation JobFinished: possible-error=NvMNotifyJobFinished/E_OK
      arg ServiceId: type=uint8, direction=IN, server-argument-impl-policy=USE-ARGUMENT-TYPE
      arg JobResult: type=NvM_RequestResultType, direction=IN, server-argument-impl-policy=USE-ARGUMENT-TYPE
    error E_OK: error-code=0
package /BMW/Platform/Darh/PortInterfaces
  4 x client server interface:
    DarhControlInterface
      operation SetRoeSuspended: possible-error=DarhControlInterface/E_NOT_OK
        arg suspended: type=boolean, direction=IN, server-argument-impl-policy=USE-ARGUMENT-TYPE
      error E_NOT_OK: error-code=1
    DarhReportDynamicallyEvent
      operation EventIdx2EventId: possible-error=DarhReportDynamicallyEvent/E_NOT_OK
        arg eventIdx: type=uint16, direction=IN, server-argument-impl-policy=USE-ARGUMENT-TYPE
        arg eventId: type=Dem_EventIdType, direction=OUT, server-argument-impl-policy=USE-ARGUMENT-TYPE
      operation EventToReport: possible-error=DarhReportDynamicallyEvent/E_NOT_OK
        arg event: type=Dem_EventIdType, direction=IN, server-argument-impl-policy=USE-ARGUMENT-TYPE
        arg toReport: type=boolean, direction=OUT, server-argument-impl-policy=USE-ARGUMENT-TYPE
      operation EventToReportCount: possible-error=DarhReportDynamicallyEvent/E_NOT_OK
        arg eventCount: type=uint16, direction=OUT, server-argument-impl-policy=USE-ARGUMENT-TYPE
      error E_NOT_OK: error-code=1
    GeneralCallbackEventDataChanged: is-service=true
      operation EventDataChanged
        arg EventId: type=Dem_EventIdType, direction=IN, server-argument-impl-policy=USE-ARGUMENT-TYPE
    RoeStateInterface
      operation GetRoeState: possible-error=RoeStateInterface/E_NOT_OK
        arg RoeState: type=Darh_RoeStateType, direction=OUT, server-argument-impl-policy=USE-ARGUMENT-TYPE
      error E_NOT_OK: error-code=1
  mode switch interface DarhReportErrorModeInterface: is-service=true
    mode group DarhReportErrorMode: type=DarhReportErrorMode
  mode switch interface ILifeCycle
    mode group Mode: type=Darh_LifeCycle
  sender receiver interface ILifeCycleRequest: is-service=true, invalidation-policy{data-element=ILifeCycleRequest/requestMode, handle-invalid=DONT-INVALIDATE}
    data requestMode: type=Darh_LifeCycleRequestType
package /BMW/Platform/Darh/Tp/PortInterfaces
  sender receiver interface Darh_Com: is-service=true, invalidation-policy{data-element=Darh_Com/data, handle-invalid=DONT-INVALIDATE}
    data data: type=Darh_TransmissionArrayType
  sender receiver interface Darh_TpCom: is-service=true, invalidation-policy{data-element=Darh_TpCom/data, handle-invalid=DONT-INVALIDATE}
    data data: type=Darh_TransmissionArrayType
package /BMW/Platform/Dlog/Coding/PortInterfaces
  client server interface Coding_SVKInterface
    operation GetCafIds: possible-error=Coding_SVKInterface/E_NOT_OK
      arg cafIds: type=Coding_CafIdArrayType, direction=OUT, server-argument-impl-policy=USE-ARRAY-BASE-TYPE
      arg numberOfCafIds: type=uint16, direction=OUT, server-argument-impl-policy=USE-ARGUMENT-TYPE
    error E_NOT_OK: error-code=1
package /BMW/Platform/Dlog/Dcm/PortInterfaces
  13 x client server interface, all with is-service=true:
    DataServices_EcuSerialNumber
      operation ReadData: possible-error=DataServices_EcuSerialNumber/E_NOT_OK
        arg Data: type=SerialNumberArrayType, direction=OUT, server-argument-impl-policy=USE-ARGUMENT-TYPE
      error E_NOT_OK: error-code=1
    DataServices_EcuUid
      operation ReadData: possible-error=DataServices_EcuUid/E_NOT_OK
        arg Data: type=Dlog_EcuUidArrayType, direction=OUT, server-argument-impl-policy=USE-ARGUMENT-TYPE
      error E_NOT_OK: error-code=1
    DataServices_FlashTimingParameter
      operation ReadData: possible-error=DataServices_FlashTimingParameter/E_NOT_OK
        arg Data: type=TimingParametersArrayType, direction=OUT, server-argument-impl-policy=USE-ARGUMENT-TYPE
      error E_NOT_OK: error-code=1
    DataServices_HWModificationIndex
      operation ReadData: possible-error=DataServices_HWModificationIndex/E_NOT_OK
        arg Data: type=Dlog_HWModificationIndexArrayType, direction=OUT, server-argument-impl-policy=USE-ARGUMENT-TYPE
      error E_NOT_OK: error-code=1
    DataServices_ManufacturingDate
      operation ReadData: possible-error=DataServices_ManufacturingDate/E_NOT_OK
        arg Data: type=ManufacturingDataArrayType, direction=OUT, server-argument-impl-policy=USE-ARGUMENT-TYPE
      error E_NOT_OK: error-code=1
    DataServices_ProgCounter
      operation ReadData: possible-error=DataServices_ProgCounter/E_NOT_OK
        arg Data: type=ProgCounterArrayType, direction=OUT, server-argument-impl-policy=USE-ARGUMENT-TYPE
      error E_NOT_OK: error-code=1
    DataServices_ProgCounterMaxValue
      operation ReadData: possible-error=DataServices_ProgCounterMaxValue/E_NOT_OK
        arg Data: type=ProgCounterMaxArrayType, direction=OUT, server-argument-impl-policy=USE-ARGUMENT-TYPE
      error E_NOT_OK: error-code=1
    DataServices_SgbdIdx
      operation ReadData: possible-error=DataServices_SgbdIdx/E_NOT_OK
        arg Data: type=SgbdIdArrayType, direction=OUT, server-argument-impl-policy=USE-ARGUMENT-TYPE
      error E_NOT_OK: error-code=1
    DataServices_Svk
      operation ConditionCheckRead: possible-error=[DataServices_Svk/E_NOT_OK, DataServices_Svk/DCM_E_PENDING]
        arg OpStatus: type=Dcm_OpStatusType, direction=IN, server-argument-impl-policy=USE-ARGUMENT-TYPE
        arg ErrorCode: type=Dcm_NegativeResponseCodeType, direction=OUT, server-argument-impl-policy=USE-ARGUMENT-TYPE
      operation ReadData: possible-error=[DataServices_Svk/E_NOT_OK, DataServices_Svk/DCM_E_PENDING]
        arg OpStatus: type=Dcm_OpStatusType, direction=IN, server-argument-impl-policy=USE-ARGUMENT-TYPE
        arg Data: type=SvkDataArrayType, direction=OUT, server-argument-impl-policy=USE-ARGUMENT-TYPE
      operation ReadDataLength: possible-error=[DataServices_Svk/DCM_E_PENDING, DataServices_Svk/E_NOT_OK]
        arg OpStatus: type=Dcm_OpStatusType, direction=IN, server-argument-impl-policy=USE-ARGUMENT-TYPE
        arg DataLength: type=uint16, direction=OUT, server-argument-impl-policy=USE-ARGUMENT-TYPE
      error DCM_E_PENDING: error-code=10
      error E_NOT_OK: error-code=1
    DataServices_SvkHistory
      operation ConditionCheckRead: possible-error=[DataServices_SvkHistory/E_NOT_OK, DataServices_SvkHistory/DCM_E_PENDING]
        arg OpStatus: type=Dcm_OpStatusType, direction=IN, server-argument-impl-policy=USE-ARGUMENT-TYPE
        arg ErrorCode: type=Dcm_NegativeResponseCodeType, direction=OUT, server-argument-impl-policy=USE-ARGUMENT-TYPE
      operation ReadData: possible-error=[DataServices_SvkHistory/E_NOT_OK, DataServices_SvkHistory/DCM_E_PENDING]
        arg OpStatus: type=Dcm_OpStatusType, direction=IN, server-argument-impl-policy=USE-ARGUMENT-TYPE
        arg Data: type=SvkHistoryDataArrayType, direction=OUT, server-argument-impl-policy=USE-ARGUMENT-TYPE
      error DCM_E_PENDING: error-code=10
      error E_NOT_OK: error-code=1
    DataServices_SwfkDeleteSupported: service-kind=BASIC-SOFTWARE-MODE-MANAGER
      operation ReadData: possible-error=DataServices_SwfkDeleteSupported/E_NOT_OK
        arg Data: type=Dlog_SwfkDeleteSupportedArrayType, direction=OUT, server-argument-impl-policy=USE-ARRAY-BASE-TYPE
      error E_NOT_OK: error-code=1
    DataServices_Vin
      operation ConditionCheckRead: possible-error=[DataServices_Vin/E_NOT_OK, DataServices_Vin/DCM_E_PENDING]
        arg OpStatus: type=Dcm_OpStatusType, direction=IN, server-argument-impl-policy=USE-ARGUMENT-TYPE
        arg ErrorCode: type=Dcm_NegativeResponseCodeType, direction=OUT, server-argument-impl-policy=USE-ARGUMENT-TYPE
      operation ReadData: possible-error=DataServices_Vin/E_NOT_OK
        arg OpStatus: type=Dcm_OpStatusType, direction=IN, server-argument-impl-policy=USE-ARGUMENT-TYPE
        arg Data: type=Dlog_VinArrayType, direction=OUT, server-argument-impl-policy=USE-ARGUMENT-TYPE
      error DCM_E_PENDING: error-code=10
      error E_NOT_OK: error-code=1
    RoutineService_DevInfo
      operation Start: possible-error=[RoutineService_DevInfo/E_NOT_OK, RoutineService_DevInfo/DCM_E_PENDING]
        5 x arg, all with server-argument-impl-policy=USE-ARGUMENT-TYPE:
          DataIn: type=RSInputArrayType, direction=IN
          OpStatus: type=Dcm_OpStatusType, direction=IN
          DataOut: type=DevInfoArrayType, direction=OUT
          CurrentDataLength: type=uint16, direction=INOUT
          ErrorCode: type=Dcm_NegativeResponseCodeType, direction=OUT
      error DCM_E_PENDING: error-code=10
      error E_NOT_OK: error-code=1
package /BMW/Platform/Dlog/Det/PortInterfaces
  client server interface Dlog_DETService: is-service=true
    operation ReportError: possible-error=Dlog_DETService/E_OK
      arg InstanceId: type=uint8, direction=IN, server-argument-impl-policy=USE-ARGUMENT-TYPE
      arg ApiId: type=uint8, direction=IN, server-argument-impl-policy=USE-ARGUMENT-TYPE
      arg ErrorId: type=uint8, direction=IN, server-argument-impl-policy=USE-ARGUMENT-TYPE
    error E_OK: error-code=0
package /BMW/Platform/Dlog/ModeDeclarationGroups
  mode declaration group Dlog_LifeCycle: category=EXPLICIT_ORDER, initial-mode=DLOG_STOPPED, on-transition-value=3
    mode DLOG_INITIALIZED: value=0
    mode DLOG_RUNNING: value=1
    mode DLOG_STOPPED: value=2
  mode declaration group DlogFirstStartMDG: category=EXPLICIT_ORDER, initial-mode=DLOG_UNINIT, on-transition-value=3
    mode DLOG_FIRSTSTART: value=0
    mode DLOG_NORMALSTART: value=1
    mode DLOG_UNINIT: value=2
package /BMW/Platform/Dlog/NvM/PortInterfaces
  6 x client server interface, all with is-service=true:
    Dlog_NvMAdmin
      operation SetBlockProtection: possible-error=Dlog_NvMAdmin/E_NOT_OK
        arg ProtectionEnabled: type=boolean, direction=IN, server-argument-impl-policy=USE-ARGUMENT-TYPE
      error E_NOT_OK: error-code=1
    Dlog_NvMNotifyInitBlock
      operation InitBlock: possible-error=Dlog_NvMNotifyInitBlock/E_OK
      error E_OK: error-code=0
    Dlog_NvMNotifyJobFinished
      operation JobFinished: possible-error=Dlog_NvMNotifyJobFinished/E_OK
        arg ServiceId: type=uint8, direction=IN, server-argument-impl-policy=USE-ARGUMENT-TYPE
        arg JobResult: type=NvM_RequestResultType, direction=IN, server-argument-impl-policy=USE-ARGUMENT-TYPE
      error E_OK: error-code=0
    Dlog_NvMService
      4 x operation, all with possible-error=Dlog_NvMService/E_NOT_OK:
        GetErrorStatus
          arg RequestResultPtr: type=NvM_RequestResultType, direction=OUT, server-argument-impl-policy=USE-ARGUMENT-TYPE
        ReadBlock
          arg DstPtr: type=NvM_DstPtrType, direction=IN, server-argument-impl-policy=USE-ARGUMENT-TYPE
        SetRamBlockStatus
          arg BlockChanged: type=boolean, direction=IN, server-argument-impl-policy=USE-ARGUMENT-TYPE
        WriteBlock
          arg SrcPtr: type=NvM_SrcPtrType, direction=IN, server-argument-impl-policy=USE-ARGUMENT-TYPE
      error E_NOT_OK: error-code=1
    NvMService
      5 x operation, all with possible-error=NvMService/E_NOT_OK:
        GetErrorStatus
          arg RequestResultPtr: type=NvM_RequestResultType, direction=OUT, server-argument-impl-policy=USE-ARGUMENT-TYPE
        ReadBlock
          arg DstPtr: type=NvM_DstPtrType, direction=IN, server-argument-impl-policy=USE-ARGUMENT-TYPE
        RestoreBlockDefaults
          arg DstPtr: type=NvM_DstPtrType, direction=IN, server-argument-impl-policy=USE-VOID
        SetRamBlockStatus
          arg BlockChanged: type=boolean, direction=IN, server-argument-impl-policy=USE-ARGUMENT-TYPE
        WriteBlock
          arg SrcPtr: type=NvM_SrcPtrType, direction=IN, server-argument-impl-policy=USE-VOID
      error E_NOT_OK: error-code=1
    NvMServiceSvkEntry
      5 x operation, all with possible-error=NvMServiceSvkEntry/E_NOT_OK:
        GetErrorStatus
          arg RequestResultPtr: type=NvM_RequestResultType, direction=OUT, server-argument-impl-policy=USE-ARGUMENT-TYPE
        ReadBlock
          arg DstPtr: type=NvM_DstPtrType, direction=IN, server-argument-impl-policy=USE-ARGUMENT-TYPE
        SetDataIndex
          arg DataIndex: type=uint8, direction=IN, server-argument-impl-policy=USE-ARGUMENT-TYPE
        SetRamBlockStatus
          arg BlockChanged: type=boolean, direction=IN, server-argument-impl-policy=USE-ARGUMENT-TYPE
        WriteBlock
          arg SrcPtr: type=NvM_SrcPtrType, direction=IN, server-argument-impl-policy=USE-ARGUMENT-TYPE
      error E_NOT_OK: error-code=1
package /BMW/Platform/Dlog/PortInterfaces
  4 x client server interface:
    EcuInfo
      operation GetEcuId: possible-error=EcuInfo/E_NOT_OK
        arg ecuId: type=uint8, direction=OUT, server-argument-impl-policy=USE-ARGUMENT-TYPE
      operation GetVin: possible-error=EcuInfo/E_NOT_OK
        arg Vin: type=Dlog_VinArrayType, direction=OUT, server-argument-impl-policy=USE-ARRAY-BASE-TYPE
      error E_NOT_OK: error-code=1
    RandomSeed
      operation Get
        arg seed: type=Dlog_RandomSeedType, direction=OUT, server-argument-impl-policy=USE-ARGUMENT-TYPE
      operation Set: possible-error=[RandomSeed/E_PENDING, RandomSeed/E_NOT_OK]
        arg seed: type=Dlog_RandomSeedType, direction=IN, server-argument-impl-policy=USE-ARGUMENT-TYPE
        arg OpStatus: type=Dcm_OpStatusType, direction=IN, server-argument-impl-policy=USE-ARGUMENT-TYPE
      error E_NOT_OK: error-code=1
      error E_PENDING: error-code=10
    SweInfo: service-kind=BASIC-SOFTWARE-MODE-MANAGER
      operation GetSgbmId: possible-error=SweInfo/E_NOT_OK
        arg SweId: type=uint8, direction=IN, server-argument-impl-policy=USE-ARGUMENT-TYPE
        arg SgbmId: type=Dlog_SgbmIdArrayType, direction=OUT, server-argument-impl-policy=USE-ARGUMENT-TYPE
      operation GetSweId: possible-error=SweInfo/E_NOT_OK
        arg SgbmId: type=Dlog_SgbmIdArrayType, direction=IN, server-argument-impl-policy=USE-ARGUMENT-TYPE
        arg SweId: type=uint8, direction=OUT, server-argument-impl-policy=USE-ARGUMENT-TYPE
      operation IsValid: possible-error=SweInfo/E_NOT_OK
        arg sweId: type=uint8, direction=IN, server-argument-impl-policy=USE-ARGUMENT-TYPE
      error E_NOT_OK: error-code=1
    SweSignatureAccess
      5 x operation, all with possible-error=SweSignatureAccess/E_NOT_OK:
        GetNumSig
          arg sweId: type=uint8, direction=IN, server-argument-impl-policy=USE-ARGUMENT-TYPE
          arg numSig: type=uint8, direction=OUT, server-argument-impl-policy=USE-ARGUMENT-TYPE
        GetNumSwe
          arg numSwe: type=uint8, direction=OUT, server-argument-impl-policy=USE-ARGUMENT-TYPE
        GetSigLength
          arg sweId: type=uint8, direction=IN, server-argument-impl-policy=USE-ARGUMENT-TYPE
          arg blkNum: type=uint8, direction=IN, server-argument-impl-policy=USE-ARGUMENT-TYPE
          arg length: type=uint32, direction=OUT, server-argument-impl-policy=USE-ARGUMENT-TYPE
        GetSignature
          arg sweId: type=uint8, direction=IN, server-argument-impl-policy=USE-ARGUMENT-TYPE
          arg signature: type=Dlog_SignatureArrayType, direction=OUT, server-argument-impl-policy=USE-ARGUMENT-TYPE
        GetSigStart
          arg sweId: type=uint8, direction=IN, server-argument-impl-policy=USE-ARGUMENT-TYPE
          arg blkNum: type=uint8, direction=IN, server-argument-impl-policy=USE-ARGUMENT-TYPE
          arg address: type=uint32, direction=OUT, server-argument-impl-policy=USE-ARGUMENT-TYPE
      error E_NOT_OK: error-code=1
  mode switch interface DlogFirstStartMode
    mode group DlogFirstStartMode: type=DlogFirstStartMDG
  mode switch interface ILifeCycle
    mode group Mode: type=Dlog_LifeCycle
  sender receiver interface ILifeCycleRequest: is-service=true, invalidation-policy{data-element=ILifeCycleRequest/requestMode, handle-invalid=DONT-INVALIDATE}
    data requestMode: type=Dlog_LifeCycleRequestType
  sender receiver interface ProgId: invalidation-policy{data-element=progId, handle-invalid=DONT-INVALIDATE}
    data progId: type=Dlog_ProgIdArrayType
package /BMW/Platform/IntegrationSample/Dcm/PortInterfaces
  client server interface IntegrationSample_ServiceRequestNotification: is-service=true
    operation Confirmation: possible-error=[IntegrationSample_ServiceRequestNotification/E_NOT_OK, IntegrationSample_ServiceRequestNotification/E_OK]
      4 x arg, all with direction=IN, server-argument-impl-policy=USE-ARGUMENT-TYPE:
        SID: type=uint8
        ReqType: type=uint8
        SourceAddress: type=uint16
        ConfirmationStatus: type=IntegrationSample_Dcm_ConfirmationStatusType
    operation Indication: possible-error=[IntegrationSample_ServiceRequestNotification/E_REQUEST_NOT_ACCEPTED, IntegrationSample_ServiceRequestNotification/E_NOT_OK, IntegrationSample_ServiceRequestNotification/E_OK]
      6 x arg, all with server-argument-impl-policy=USE-ARGUMENT-TYPE:
        SID: type=uint8, direction=IN
        RequestData: type=IntegrationSample_RequestDataArray, direction=IN
        DataSize: type=uint16, direction=IN
        ReqType: type=uint8, direction=IN
        SourceAddress: type=uint16, direction=IN
        ErrorCode: type=IntegrationSample_Dcm_NegativeResponseCodeType, direction=OUT
    error E_NOT_OK: error-code=1
    error E_OK: error-code=0  # Operation successful
    error E_REQUEST_NOT_ACCEPTED: error-code=8  # no response will be sent
package /BMW/Platform/IntegrationSample/Dem/PortInterfaces
  client server interface IntegrationSample_CSDataServices_DemDataElementClass_FUNCPN_STATE: is-service=true
    operation ReadData: possible-error=[IntegrationSample_CSDataServices_DemDataElementClass_FUNCPN_STATE/E_NOT_OK, IntegrationSample_CSDataServices_DemDataElementClass_FUNCPN_STATE/E_OK]
      arg Data: type=IntegrationSample_Dem_DataDemDataElementClass_FUNCPN_STATE_ArrayType, direction=OUT, server-argument-impl-policy=USE-ARGUMENT-TYPE
    error E_NOT_OK: error-code=1
    error E_OK: error-code=0  # Operation successful
  client server interface IntegrationSample_CSDataServices_DemDataElementClass_KILOMETER: is-service=true
    operation ReadData: possible-error=[IntegrationSample_CSDataServices_DemDataElementClass_KILOMETER/E_NOT_OK, IntegrationSample_CSDataServices_DemDataElementClass_KILOMETER/E_OK]
      arg Data: type=IntegrationSample_Dem_DataDemDataElementClass_KILOMETER_ArrayType, direction=OUT, server-argument-impl-policy=USE-ARGUMENT-TYPE
    error E_NOT_OK: error-code=1
    error E_OK: error-code=0  # Operation successful
  client server interface IntegrationSample_CSDataServices_DemDataElementClass_PWF_AND_PN: is-service=true
    operation ReadData: possible-error=[IntegrationSample_CSDataServices_DemDataElementClass_PWF_AND_PN/E_OK, IntegrationSample_CSDataServices_DemDataElementClass_PWF_AND_PN/E_NOT_OK]
      arg Data: type=IntegrationSample_Dem_DataDemDataElementClass_PWF_AND_PN_ArrayType, direction=OUT, server-argument-impl-policy=USE-ARGUMENT-TYPE
    error E_NOT_OK: error-code=1
    error E_OK: error-code=0  # Operation successful
package /BMW/Platform/IntegrationSample/ModeDeclarationGroups
  mode declaration group IntegrationSample_EcuRunState: category=EXPLICIT_ORDER, initial-mode=IntegrationSample_BSW_START, on-transition-value=5
    5 x mode:
      IntegrationSample_BSW_START: value=1
      IntegrationSample_INVALID_STATE: value=0
      IntegrationSample_NORMAL_OPERATION: value=3
      IntegrationSample_SHUTDOWN: value=4
      IntegrationSample_STARTUP: value=2
  mode declaration group IntegrationSample_SimpleTimerState: category=EXPLICIT_ORDER, initial-mode=IntegrationSample_Timer_IDLE, on-transition-value=3
    mode IntegrationSample_Timer_FIRE: value=2
    mode IntegrationSample_Timer_IDLE: value=0
    mode IntegrationSample_Timer_RUNNING: value=1
package /BMW/Platform/IntegrationSample/PortInterfaces
  mode switch interface IEcuRunState: is-service=true
    mode group EcuRunStateMode: type=IntegrationSample_EcuRunState
  mode switch interface ISimpleTimer
    mode group SimpleTimerMode: type=IntegrationSample_SimpleTimerState
  6 x sender receiver interface:
    IEcuRunStateRequest: is-service=true, invalidation-policy{data-element=IntegrationSample_EcuRunStateRequestMode, handle-invalid=DONT-INVALIDATE}
      data IntegrationSample_EcuRunStateRequestMode: type=IntegrationSample_EcuRunStateModeRequestType
    IntegrationSample_Signal_ST_CON_VEH: invalidation-policy{data-element=IntegrationSample_Signal_ST_CON_VEH/VehicleState, handle-invalid=DONT-INVALIDATE}
      data VehicleState: type=IS_ST_CON_VEH_Type
    SRI_FieldNotifierVehicleCondition: invalidation-policy{data-element=SRI_FieldNotifierVehicleCondition/Notifier, handle-invalid=DONT-INVALIDATE}
      data Notifier: type=IntegrationSample_VehicleCondition_TYPE
    SRI_FieldNotifierVehicleStatus: invalidation-policy{data-element=SRI_FieldNotifierVehicleStatus/Notifier, handle-invalid=DONT-INVALIDATE}
      data Notifier: type=VehicleState_Type
    SRI_SA_Kilometer_R: invalidation-policy{data-element=SRI_SA_Kilometer_R/Notifier, handle-invalid=DONT-INVALIDATE}
      data Notifier: type=MileageKilometreType
    SRI_SGG_CON_VEH_R: invalidation-policy{data-element=IntegrationSample_IDT_CON_VEH, handle-invalid=DONT-INVALIDATE}
      data IntegrationSample_IDT_CON_VEH: type=IntegrationSample_CON_VEH_Type
package /BMW/Platform/IntegrationSample/Stm/PortInterfaces
  sender receiver interface IntegrationSample_CentralErrorLockSignalInterface: invalidation-policy{data-element=IntegrationSample_CentralErrorLockSignalInterface/centralErrorLock, handle-invalid=DONT-INVALIDATE}
    data centralErrorLock: type=IntegrationSample_Stm_CentralErrorLockType
package /BMW/Platform/Omc/Dcm/PortInterfaces
  4 x client server interface, all with is-service=true:
    DataServices_ExtendedOperatingMode
      operation ConditionCheckRead: possible-error=DataServices_ExtendedOperatingMode/E_NOT_OK
        arg ErrorCode: type=Dcm_NegativeResponseCodeType, direction=OUT, server-argument-impl-policy=USE-ARGUMENT-TYPE
      operation ReadData: possible-error=DataServices_ExtendedOperatingMode/E_NOT_OK
        arg Data: type=UInt8_Array1, direction=OUT, server-argument-impl-policy=USE-ARRAY-BASE-TYPE
      error E_NOT_OK: error-code=1
    DataServices_OperatingMode
      operation ConditionCheckRead: possible-error=DataServices_OperatingMode/E_NOT_OK
        arg ErrorCode: type=Dcm_NegativeResponseCodeType, direction=OUT, server-argument-impl-policy=USE-ARGUMENT-TYPE
      operation ReadData: possible-error=DataServices_OperatingMode/E_NOT_OK
        arg Data: type=UInt8_Array1, direction=OUT, server-argument-impl-policy=USE-ARRAY-BASE-TYPE
      error E_NOT_OK: error-code=1
    RoutineServices_ExtendedOperatingModeControl
      operation Start: possible-error=[RoutineServices_ExtendedOperatingModeControl/DCM_E_FORCE_RCRRP, RoutineServices_ExtendedOperatingModeControl/DCM_E_PENDING, RoutineServices_ExtendedOperatingModeControl/E_NOT_OK]
        arg ExtendedOperatingMode: type=uint8, direction=IN, server-argument-impl-policy=USE-ARGUMENT-TYPE
        arg OpStatus: type=OpStatusType, direction=IN, server-argument-impl-policy=USE-ARGUMENT-TYPE
        arg ErrorCode: type=Dcm_NegativeResponseCodeType, direction=OUT, server-argument-impl-policy=USE-ARGUMENT-TYPE
      error DCM_E_FORCE_RCRRP: error-code=12
      error DCM_E_PENDING: error-code=10
      error E_NOT_OK: error-code=1
    RoutineServices_OperatingModeControl
      operation Start: possible-error=[RoutineServices_OperatingModeControl/DCM_E_PENDING, RoutineServices_OperatingModeControl/E_NOT_OK, RoutineServices_OperatingModeControl/DCM_E_FORCE_RCRRP]
        arg OperatingMode: type=uint8, direction=IN, server-argument-impl-policy=USE-ARGUMENT-TYPE
        arg OpStatus: type=OpStatusType, direction=IN, server-argument-impl-policy=USE-ARGUMENT-TYPE
        arg ErrorCode: type=Dcm_NegativeResponseCodeType, direction=OUT, server-argument-impl-policy=USE-ARGUMENT-TYPE
      error DCM_E_FORCE_RCRRP: error-code=12
      error DCM_E_PENDING: error-code=10
      error E_NOT_OK: error-code=1
package /BMW/Platform/Omc/Dem/PortInterfaces
  client server interface CallbackClearEventAllowed: is-service=true
    operation ClearEventAllowed: possible-error=CallbackClearEventAllowed/E_NOT_OK
      arg Allowed: type=boolean, direction=OUT, server-argument-impl-policy=USE-ARGUMENT-TYPE
    error E_NOT_OK: error-code=1
  client server interface EnableCondition: is-service=true
    operation SetEnableCondition: possible-error=EnableCondition/E_NOT_OK
      arg ConditionFulfilled: type=boolean, direction=IN, server-argument-impl-policy=USE-ARGUMENT-TYPE
    error E_NOT_OK: error-code=1
  client server interface Omc_DiagnosticMonitor: is-service=true
    operation ResetEventStatus: possible-error=Omc_DiagnosticMonitor/E_NOT_OK
    operation SetEventStatus: possible-error=Omc_DiagnosticMonitor/E_NOT_OK
      arg EventStatus: type=Dem_EventStatusType, direction=IN, server-argument-impl-policy=USE-ARGUMENT-TYPE
    error E_NOT_OK: error-code=1
package /BMW/Platform/Omc/Det/PortInterfaces
  client server interface DETService: is-service=true
    operation ReportError: possible-error=DETService/E_NOT_OK
      arg InstanceId: type=uint8, direction=IN, server-argument-impl-policy=USE-ARGUMENT-TYPE
      arg ApiId: type=uint8, direction=IN, server-argument-impl-policy=USE-ARGUMENT-TYPE
      arg ErrorId: type=uint8, direction=IN, server-argument-impl-policy=USE-ARGUMENT-TYPE
    error E_NOT_OK: error-code=1
package /BMW/Platform/Omc/ModeDeclarationGroups
  mode declaration group Omc_LifeCycle: category=ALPHABETIC_ORDER, initial-mode=OMC_STOPPED
    mode OMC_INITIALIZED
    mode OMC_RUNNING
    mode OMC_STOPPED
  mode declaration group OmcExtendedOperatingMode: category=EXPLICIT_ORDER, initial-mode=OmcExtendedOperatingMode/OMC_MODE_EXTENSION_NORMAL, on-transition-value=254
    17 x mode:
      OMC_MODE_EXTENSION_1: value=1
      OMC_MODE_EXTENSION_{10..14}: value={10..14}
      OMC_MODE_EXTENSION_{2..9}: value={2..9}
      OMC_MODE_EXTENSION_INVALID: value=255
      OMC_MODE_EXTENSION_NORMAL: value=0
      OMC_MODE_EXTENSION_SAVE_ENERGY: value=15
  mode declaration group OmcOperatingMode: category=EXPLICIT_ORDER, initial-mode=OmcOperatingMode/OMC_MODE_NORMAL, on-transition-value=255
    4 x mode:
      OMC_MODE_ASSEMBLY: value=1
      OMC_MODE_BMW_FLASH: value=3
      OMC_MODE_NORMAL: value=0
      OMC_MODE_TRANSPORT: value=2
package /BMW/Platform/Omc/NvM/PortInterfaces
  client server interface NvMNotifyJobFinished: is-service=true
    operation JobFinished: possible-error=NvMNotifyJobFinished/E_OK
      arg ServiceId: type=uint8, direction=IN, server-argument-impl-policy=USE-ARGUMENT-TYPE
      arg JobResult: type=RequestResultType, direction=IN, server-argument-impl-policy=USE-ARGUMENT-TYPE
    error E_OK: error-code=0
  client server interface NvMService_OMC: is-service=true
    operation GetErrorStatus: possible-error=NvMService_OMC/E_NOT_OK
      arg RequestResultPtr: type=RequestResultType, direction=OUT, server-argument-impl-policy=USE-ARGUMENT-TYPE
    operation SetRamBlockStatus: possible-error=NvMService_OMC/E_NOT_OK
      arg BlockChanged: type=boolean, direction=IN, server-argument-impl-policy=USE-ARGUMENT-TYPE
    operation WriteBlock: possible-error=NvMService_OMC/E_NOT_OK
      arg SrcPtr: type=SrcPtrType, direction=IN, server-argument-impl-policy=USE-ARGUMENT-TYPE
    error E_NOT_OK: error-code=1
package /BMW/Platform/Omc/PortInterfaces
  client server interface OmcModesCallouts
    operation AllowOpModeSwitch: possible-error=[OmcModesCallouts/E_NOT_OK, OmcModesCallouts/E_RUNNING]
      4 x arg, all with direction=IN, server-argument-impl-policy=USE-ARGUMENT-TYPE:
        OperatingMode: type=Omc_OperatingModeType
        ExtendedOperatingMode: type=Omc_ExtendedOperatingModeType
        NewOperatingMode: type=Omc_OperatingModeType
        NewExtendedOperatingMode: type=Omc_ExtendedOperatingModeType
    operation OpModeSwitchCancelled: possible-error=[OmcModesCallouts/E_OK, OmcModesCallouts/E_RUNNING]
      4 x arg, all with direction=IN, server-argument-impl-policy=USE-ARGUMENT-TYPE:
        OperatingMode: type=Omc_OperatingModeType
        ExtendedOperatingMode: type=Omc_ExtendedOperatingModeType
        RequestedOperatingMode: type=Omc_OperatingModeType
        RequestedExtendedOperatingMode: type=Omc_ExtendedOperatingModeType
    error E_NOT_OK: error-code=1
    error E_OK: error-code=0
    error E_RUNNING: error-code=10
  client server interface OmcModesCalloutsResult
    operation OpModeSwitchAllowedResult: possible-error=OmcModesCalloutsResult/E_OK
      arg Result: type=boolean, direction=IN, server-argument-impl-policy=USE-ARGUMENT-TYPE
    operation OpModeSwitchCancelledAck: possible-error=OmcModesCalloutsResult/E_OK
    error E_OK: error-code=0
  mode switch interface ExtendedOperatingModeNotification
    mode group currentExtendedOperatingMode: type=ModeDeclarationGroups/OmcExtendedOperatingMode
  mode switch interface ILifeCycle
    mode group Mode: type=Omc_LifeCycle
  mode switch interface OperatingModeNotification
    mode group currentOperatingMode: type=ModeDeclarationGroups/OmcOperatingMode
  sender receiver interface ILifeCycleRequest: is-service=true, invalidation-policy{data-element=ILifeCycleRequest/requestMode, handle-invalid=DONT-INVALIDATE}
    data requestMode: type=Omc_LifeCycleRequestType
package /BMW/Platform/StdDiag/Darh/PortInterfaces
  client server interface DarhControlInterface
    operation SetRoeSuspended: possible-error=DarhControlInterface/E_NOT_OK
      arg suspended: type=boolean, direction=IN, server-argument-impl-policy=USE-ARGUMENT-TYPE
    error E_NOT_OK: error-code=1
  client server interface RoeStateInterface
    operation GetRoeState: possible-error=RoeStateInterface/E_NOT_OK
      arg RoeState: type=Darh_RoeStateType, direction=OUT, server-argument-impl-policy=USE-ARGUMENT-TYPE
    error E_NOT_OK: error-code=1
package /BMW/Platform/StdDiag/Dcm/PortInterfaces
  9 x client server interface, all with is-service=true:
    DataServices_ActiveDiagSession
      operation ConditionCheckRead: possible-error=[DataServices_ActiveDiagSession/E_NOT_OK, DataServices_ActiveDiagSession/E_OK]
        arg ErrorCode: type=Dcm_NegativeResponseCodeType, direction=OUT, server-argument-impl-policy=USE-ARGUMENT-TYPE
      operation ReadData: possible-error=[DataServices_ActiveDiagSession/E_OK, DataServices_ActiveDiagSession/E_NOT_OK]
        arg Data: type=ActiveDiagSession_ArrayType, direction=OUT, server-argument-impl-policy=USE-ARGUMENT-TYPE
      error E_NOT_OK: error-code=1
      error E_OK: error-code=0
    DataServices_ActiveSessionState
      operation ConditionCheckRead: possible-error=[DataServices_ActiveSessionState/E_NOT_OK, DataServices_ActiveSessionState/E_OK]
        arg ErrorCode: type=Dcm_NegativeResponseCodeType, direction=OUT, server-argument-impl-policy=USE-ARGUMENT-TYPE
      operation ReadData: possible-error=[DataServices_ActiveSessionState/E_NOT_OK, DataServices_ActiveSessionState/E_OK]
        arg Data: type=ActiveSessionState_ArrayType, direction=OUT, server-argument-impl-policy=USE-ARGUMENT-TYPE
      error E_NOT_OK: error-code=1
      error E_OK: error-code=0
    DataServices_SgbdIndex
      operation ReadData: possible-error=[DataServices_SgbdIndex/E_OK, DataServices_SgbdIndex/E_NOT_OK]
        arg Data: type=SgbdIndex_ArrayType, direction=OUT, server-argument-impl-policy=USE-ARGUMENT-TYPE
      error E_NOT_OK: error-code=1
      error E_OK: error-code=0
    RoutineServices_CheckProgrammingPreconditions
      operation Start: possible-error=[RoutineServices_CheckProgrammingPreconditions/E_NOT_OK, RoutineServices_CheckProgrammingPreconditions/DCM_E_FORCE_RCRRP, RoutineServices_CheckProgrammingPreconditions/E_OK, RoutineServices_CheckProgrammingPreconditions/DCM_E_PENDING]
        4 x arg, all with server-argument-impl-policy=USE-ARGUMENT-TYPE:
          OpStatus: type=Dcm_OpStatusType, direction=IN
          dataOut: type=CheckProgrammingPreconditions_ArrayType, direction=OUT
          currentDataLength: type=uint16, direction=OUT
          ErrorCode: type=Dcm_NegativeResponseCodeType, direction=OUT
      4 x error:
        DCM_E_FORCE_RCRRP: error-code=12
        DCM_E_PENDING: error-code=10
        E_NOT_OK: error-code=1
        E_OK: error-code=0
    RoutineServices_ClearDTCSecondaryErrorMemory
      operation Start: possible-error=[RoutineServices_ClearDTCSecondaryErrorMemory/DCM_E_PENDING, RoutineServices_ClearDTCSecondaryErrorMemory/E_NOT_OK, RoutineServices_ClearDTCSecondaryErrorMemory/DCM_E_FORCE_RCRRP]
        arg OpStatus: type=Dcm_OpStatusType, direction=IN, server-argument-impl-policy=USE-ARGUMENT-TYPE
        arg ErrorCode: type=Dcm_NegativeResponseCodeType, direction=OUT, server-argument-impl-policy=USE-ARGUMENT-TYPE
      error DCM_E_FORCE_RCRRP: error-code=12
      error DCM_E_PENDING: error-code=10
      error E_NOT_OK: error-code=1
    RoutineServices_DiagCommLoopback
      operation Start: possible-error=[RoutineServices_DiagCommLoopback/DCM_E_PENDING, RoutineServices_DiagCommLoopback/E_NOT_OK, RoutineServices_DiagCommLoopback/DCM_E_FORCE_RCRRP, RoutineServices_DiagCommLoopback/E_OK]
        5 x arg, all with server-argument-impl-policy=USE-ARGUMENT-TYPE:
          dataIn: type=DiagCommLoopback_ArrayType, direction=IN
          OpStatus: type=Dcm_OpStatusType, direction=IN
          dataOut: type=DiagCommLoopback_ArrayType, direction=OUT
          currentDataLength: type=uint16, direction=INOUT
          ErrorCode: type=Dcm_NegativeResponseCodeType, direction=OUT
      4 x error:
        DCM_E_FORCE_RCRRP: error-code=12
        DCM_E_PENDING: error-code=10
        E_NOT_OK: error-code=1
        E_OK: error-code=0
    RoutineServices_UpDownloadPrePostProcessing
      operation Start: possible-error=[RoutineServices_UpDownloadPrePostProcessing/DCM_E_PENDING, RoutineServices_UpDownloadPrePostProcessing/E_NOT_OK, RoutineServices_UpDownloadPrePostProcessing/DCM_E_FORCE_RCRRP]
        5 x arg:
          Data: type=UpDownloadPrePostProcessing_ArrayType, direction=IN, server-argument-impl-policy=USE-ARRAY-BASE-TYPE
          OpStatus: type=Dcm_OpStatusType, direction=IN, server-argument-impl-policy=USE-ARGUMENT-TYPE
          Result: type=uint8, direction=OUT, server-argument-impl-policy=USE-ARRAY-BASE-TYPE
          currentDataLength: type=uint16, direction=IN, server-argument-impl-policy=USE-ARGUMENT-TYPE
          ErrorCode: type=Dcm_NegativeResponseCodeType, direction=OUT, server-argument-impl-policy=USE-ARGUMENT-TYPE
      error DCM_E_FORCE_RCRRP: error-code=12
      error DCM_E_PENDING: error-code=10
      error E_NOT_OK: error-code=1
    ServiceRequestNotification
      operation Confirmation: possible-error=[ServiceRequestNotification/E_NOT_OK, ServiceRequestNotification/E_OK]
        4 x arg, all with direction=IN, server-argument-impl-policy=USE-ARGUMENT-TYPE:
          SID: type=uint8
          ReqType: type=uint8
          SourceAddress: type=uint16
          ConfirmationStatus: type=Dcm_ConfirmationStatusType
      operation Indication: possible-error=[ServiceRequestNotification/E_NOT_OK, ServiceRequestNotification/E_REQUEST_NOT_ACCEPTED, ServiceRequestNotification/E_OK]
        6 x arg, all with server-argument-impl-policy=USE-ARGUMENT-TYPE:
          SID: type=uint8, direction=IN
          RequestData: type=RequestDataArray, direction=IN
          DataSize: type=uint16, direction=IN
          ReqType: type=uint8, direction=IN
          SourceAddress: type=uint16, direction=IN
          ErrorCode: type=Dcm_NegativeResponseCodeType, direction=OUT
      error E_NOT_OK: error-code=1
      error E_OK: error-code=0
      error E_REQUEST_NOT_ACCEPTED: error-code=8
    StdDiagDCMServices
      operation GetSesCtrlType: possible-error=[StdDiagDCMServices/E_NOT_OK, StdDiagDCMServices/E_OK]
        arg SesCtrlType: type=Dcm_SesCtrlType, direction=OUT, server-argument-impl-policy=USE-ARGUMENT-TYPE
      error E_NOT_OK: error-code=1
      error E_OK: error-code=0
package /BMW/Platform/StdDiag/Dem/PortInterfaces
  client server interface CddIf: is-service=true
    operation ClearDTC: possible-error=[DEM_CLEAR_MEMORY_ERROR, CddIf/E_OK, DEM_CLEAR_WRONG_DTC, DEM_CLEAR_WRONG_DTCORIGIN, DEM_CLEAR_FAILED, DEM_CLEAR_PENDING, DEM_CLEAR_BUSY]
      arg DTC: type=uint32, direction=IN, server-argument-impl-policy=USE-ARGUMENT-TYPE
      arg DTCFormat: type=Dem_DTCFormatType, direction=IN, server-argument-impl-policy=USE-ARGUMENT-TYPE
      arg DTCOrigin: type=Dem_DTCOriginType, direction=IN, server-argument-impl-policy=USE-ARGUMENT-TYPE
    7 x error:
      DEM_CLEAR_BUSY: error-code=5
      DEM_CLEAR_FAILED: error-code=3
      DEM_CLEAR_MEMORY_ERROR: error-code=6
      DEM_CLEAR_PENDING: error-code=4
      DEM_CLEAR_WRONG_DTC: error-code=1
      DEM_CLEAR_WRONG_DTCORIGIN: error-code=2
      E_OK: error-code=0
  client server interface EnableCondition: is-service=true
    operation SetEnableCondition: possible-error=[EnableCondition/E_OK, EnableCondition/E_NOT_OK]
      arg ConditionFulfilled: type=boolean, direction=IN, server-argument-impl-policy=USE-ARGUMENT-TYPE
    error E_NOT_OK: error-code=1
    error E_OK: error-code=0
package /BMW/Platform/StdDiag/Det/PortInterfaces
  client server interface DETService: is-service=true
    operation ReportError: possible-error=DETService/E_OK
      arg InstanceId: type=uint8, direction=IN, server-argument-impl-policy=USE-ARGUMENT-TYPE
      arg ApiId: type=uint8, direction=IN, server-argument-impl-policy=USE-ARGUMENT-TYPE
      arg ErrorId: type=uint8, direction=IN, server-argument-impl-policy=USE-ARGUMENT-TYPE
    error E_OK: error-code=0
package /BMW/Platform/StdDiag/ModeDeclarationGroups
  mode declaration group StdDiag_LifeCycle: category=EXPLICIT_ORDER, initial-mode=STDDIAG_STOPPED, on-transition-value=3
    mode STDDIAG_INITIALIZED: value=0
    mode STDDIAG_RUNNING: value=1
    mode STDDIAG_STOPPED: value=2
  mode declaration group StdDiag_NormalCommunicationModeGroup: category=EXPLICIT_ORDER, initial-mode=ENABLE_RX_AND_TX_NORMAL, on-transition-value=4
    4 x mode:
      DISABLE_RX_AND_TX_NORMAL: value=0
      DISABLE_RX_ENABLE_TX_NORMAL: value=1
      ENABLE_RX_AND_TX_NORMAL: value=2
      ENABLE_RX_DISABLE_TX_NORMAL: value=3
  mode declaration group StdDiag_SessionModeGroup: category=ALPHABETIC_ORDER, initial-mode=STDDIAG_DEFAULT_SESSION
    mode STDDIAG_DEFAULT_SESSION
    mode STDDIAG_OTHER_SESSION
package /BMW/Platform/StdDiag/Omc/ModeDeclarationGroups
  mode declaration group OmcExtendedOperatingMode: category=EXPLICIT_ORDER, initial-mode=OmcExtendedOperatingMode/OMC_MODE_EXTENSION_NORMAL, on-transition-value=254
    17 x mode:
      OMC_MODE_EXTENSION_1: value=1
      OMC_MODE_EXTENSION_{10..14}: value={10..14}
      OMC_MODE_EXTENSION_{2..9}: value={2..9}
      OMC_MODE_EXTENSION_INVALID: value=255
      OMC_MODE_EXTENSION_NORMAL: value=0
      OMC_MODE_EXTENSION_SAVE_ENERGY: value=15
  mode declaration group OmcOperatingMode: category=EXPLICIT_ORDER, initial-mode=OmcOperatingMode/OMC_MODE_NORMAL, on-transition-value=255
    4 x mode:
      OMC_MODE_ASSEMBLY: value=1
      OMC_MODE_BMW_FLASH: value=3
      OMC_MODE_NORMAL: value=0
      OMC_MODE_TRANSPORT: value=2
package /BMW/Platform/StdDiag/Omc/PortInterfaces
  client server interface OmcModesCallouts
    operation AllowOpModeSwitch: possible-error=[OmcModesCallouts/E_NOT_OK, OmcModesCallouts/E_RUNNING]
      4 x arg, all with direction=IN, server-argument-impl-policy=USE-ARGUMENT-TYPE:
        OperatingMode: type=Omc_OperatingModeType
        ExtendedOperatingMode: type=Omc_ExtendedOperatingModeType
        NewOperatingMode: type=Omc_OperatingModeType
        NewExtendedOperatingMode: type=Omc_ExtendedOperatingModeType
    operation OpModeSwitchCancelled: possible-error=[OmcModesCallouts/E_OK, OmcModesCallouts/E_RUNNING]
      4 x arg, all with direction=IN, server-argument-impl-policy=USE-ARGUMENT-TYPE:
        OperatingMode: type=Omc_OperatingModeType
        ExtendedOperatingMode: type=Omc_ExtendedOperatingModeType
        RequestedOperatingMode: type=Omc_OperatingModeType
        RequestedExtendedOperatingMode: type=Omc_ExtendedOperatingModeType
    error E_NOT_OK: error-code=1
    error E_OK: error-code=0
    error E_RUNNING: error-code=10
  client server interface OmcModesCalloutsResult
    operation OpModeSwitchAllowedResult: possible-error=OmcModesCalloutsResult/E_OK
      arg Result: type=boolean, direction=IN, server-argument-impl-policy=USE-ARGUMENT-TYPE
    operation OpModeSwitchCancelledAck: possible-error=OmcModesCalloutsResult/E_OK
    error E_OK: error-code=0
  mode switch interface ExtendedOperatingModeNotification
    mode group currentExtendedOperatingMode: type=ModeDeclarationGroups/OmcExtendedOperatingMode
  mode switch interface OperatingModeNotification
    mode group currentOperatingMode: type=ModeDeclarationGroups/OmcOperatingMode
package /BMW/Platform/StdDiag/PortInterfaces
  client server interface ApplicationDataTransfer
    11 x operation:
      CancelOperation: possible-error=ApplicationDataTransfer/E_OK
      Download: possible-error=[ApplicationDataTransfer/E_RUNNING, ApplicationDataTransfer/E_NOT_OK]
        4 x arg:
          blockSequenceCounter: type=uint8, direction=IN, server-argument-impl-policy=USE-ARGUMENT-TYPE
          data: type=UpDownload_ArrayType, direction=IN, server-argument-impl-policy=USE-ARRAY-BASE-TYPE
          length: type=uint32, direction=IN, server-argument-impl-policy=USE-ARGUMENT-TYPE
          errorCode: type=Dcm_NegativeResponseCodeType, direction=OUT, server-argument-impl-policy=USE-ARGUMENT-TYPE
      DownloadPostprocess: possible-error=[ApplicationDataTransfer/E_RUNNING, ApplicationDataTransfer/E_NOT_OK]
        arg parameter: type=AdtApplicationParameter_ArrayType, direction=IN, server-argument-impl-policy=USE-ARRAY-BASE-TYPE
        arg parameterSize: type=uint16, direction=IN, server-argument-impl-policy=USE-ARGUMENT-TYPE
        arg errorCode: type=Dcm_NegativeResponseCodeType, direction=OUT, server-argument-impl-policy=USE-ARGUMENT-TYPE
      DownloadPreprocess: possible-error=[ApplicationDataTransfer/E_RUNNING, ApplicationDataTransfer/E_NOT_OK]
        arg parameter: type=AdtApplicationParameter_ArrayType, direction=IN, server-argument-impl-policy=USE-ARRAY-BASE-TYPE
        arg parameterSize: type=uint16, direction=IN, server-argument-impl-policy=USE-ARGUMENT-TYPE
        arg errorCode: type=Dcm_NegativeResponseCodeType, direction=OUT, server-argument-impl-policy=USE-ARGUMENT-TYPE
      RequestDownload: possible-error=[ApplicationDataTransfer/E_RUNNING, ApplicationDataTransfer/E_NOT_OK]
        4 x arg, all with server-argument-impl-policy=USE-ARGUMENT-TYPE:
          dataFormatIdentifier: type=uint8, direction=IN
          size: type=uint32, direction=IN
          maxBlockLength: type=uint32, direction=OUT
          errorCode: type=Dcm_NegativeResponseCodeType, direction=OUT
      RequestDownloadExit: possible-error=ApplicationDataTransfer/E_OK
      RequestUpload: possible-error=[ApplicationDataTransfer/E_RUNNING, ApplicationDataTransfer/E_NOT_OK]
        4 x arg, all with server-argument-impl-policy=USE-ARGUMENT-TYPE:
          dataFormatIdentifier: type=uint8, direction=IN
          size: type=uint32, direction=IN
          maxBlockLength: type=uint32, direction=OUT
          errorCode: type=Dcm_NegativeResponseCodeType, direction=OUT
      RequestUploadExit: possible-error=ApplicationDataTransfer/E_OK
      Upload: possible-error=[ApplicationDataTransfer/E_RUNNING, ApplicationDataTransfer/E_NOT_OK]
        4 x arg:
          blockSequenceCounter: type=uint8, direction=IN, server-argument-impl-policy=USE-ARGUMENT-TYPE
          data: type=UpDownload_ArrayType, direction=OUT, server-argument-impl-policy=USE-ARRAY-BASE-TYPE
          length: type=uint32, direction=IN, server-argument-impl-policy=USE-ARGUMENT-TYPE
          errorCode: type=Dcm_NegativeResponseCodeType, direction=OUT, server-argument-impl-policy=USE-ARGUMENT-TYPE
      UploadPostprocess: possible-error=[ApplicationDataTransfer/E_RUNNING, ApplicationDataTransfer/E_NOT_OK]
        arg parameter: type=AdtApplicationParameter_ArrayType, direction=IN, server-argument-impl-policy=USE-ARRAY-BASE-TYPE
        arg parameterSize: type=uint16, direction=IN, server-argument-impl-policy=USE-ARGUMENT-TYPE
        arg errorCode: type=Dcm_NegativeResponseCodeType, direction=OUT, server-argument-impl-policy=USE-ARGUMENT-TYPE
      UploadPreprocess: possible-error=[ApplicationDataTransfer/E_RUNNING, ApplicationDataTransfer/E_NOT_OK]
        arg parameter: type=AdtApplicationParameter_ArrayType, direction=IN, server-argument-impl-policy=USE-ARRAY-BASE-TYPE
        arg parameterSize: type=uint16, direction=IN, server-argument-impl-policy=USE-ARGUMENT-TYPE
        arg errorCode: type=Dcm_NegativeResponseCodeType, direction=OUT, server-argument-impl-policy=USE-ARGUMENT-TYPE
    error E_NOT_OK: error-code=1
    error E_OK: error-code=0
    error E_RUNNING: error-code=10
  client server interface ApplicationDataTransferCbk
    operation OperationFinished: possible-error=ApplicationDataTransferCbk/E_OK
      arg result: type=boolean, direction=IN, server-argument-impl-policy=USE-ARGUMENT-TYPE
    error E_OK: error-code=0
  mode switch interface ComControlNormalNotificationInterface: is-service=true
    mode group CommunicationModeDeclarationGroup: type=StdDiag_NormalCommunicationModeGroup
  mode switch interface ILifeCycle
    mode group Mode: type=StdDiag_LifeCycle
  mode switch interface SessionChangeIndicationInterface: is-service=true
    mode group SessionModeDeclarationGroup: type=StdDiag_SessionModeGroup
  sender receiver interface ComControlModeRequestInterface: is-service=true, invalidation-policy{data-element=requestedMode, handle-invalid=DONT-INVALIDATE}
    data requestedMode: type=NormalCommunicationModeType
  sender receiver interface ILifeCycleRequest: is-service=true, invalidation-policy{data-element=ILifeCycleRequest/requestMode, handle-invalid=DONT-INVALIDATE}
    data requestMode: type=StdDiag_LifeCycleRequestType
package /BMW/Platform/StdDiag/Stm/ModeDeclarationGroups
  mode declaration group Stm_VehicleStateMode: category=ALPHABETIC_ORDER, initial-mode=Stm_VehicleStateMode/STM_VEHICLE_STATE_UNAVAILABLE
    10 x mode:
      STM_VEHICLE_STATE_CHECK_ANALYS_DIAGNOSTICS
      STM_VEHICLE_STATE_CUSTOMER_ABSENT
      STM_VEHICLE_STATE_DRIVE
      STM_VEHICLE_STATE_INVALID
      STM_VEHICLE_STATE_LIVING
      STM_VEHICLE_STATE_PARKING_BN_NOK
      STM_VEHICLE_STATE_PARKING_BN_OK
      STM_VEHICLE_STATE_READINESS_TO_DRIVE_INIT
      STM_VEHICLE_STATE_READINESS_TO_DRIVE_STOP
      STM_VEHICLE_STATE_UNAVAILABLE
package /BMW/Platform/StdDiag/Stm/PortInterfaces
  mode switch interface VehicleStateModeInterface
    mode group currentVehicleStateMode: type=ModeDeclarationGroups/Stm_VehicleStateMode
package /BMW/Platform/Stm/Dem/PortInterfaces
  client server interface EnableCondition: is-service=true
    operation SetEnableCondition: possible-error=[EnableCondition/E_NOT_OK, EnableCondition/E_OK]
      arg ConditionFulfilled: type=boolean, direction=IN, server-argument-impl-policy=USE-ARGUMENT-TYPE
    error E_NOT_OK: error-code=1
    error E_OK: error-code=0
package /BMW/Platform/Stm/ModeDeclarationGroups
  5 x mode declaration group, all with category=ALPHABETIC_ORDER:
    ErrorMemoryLockSignalReceptionMode: initial-mode=EM_LOCK_NOT_RECEIVABLE
      mode EM_LOCK_NOT_RECEIVABLE
      mode EM_LOCK_RECEIVABLE
    Stm_CentralErrorLockMode: initial-mode=STM_CEL_INVALID
      mode STM_CEL_INVALID
      mode STM_CEL_LOCKED
      mode STM_CEL_UNLOCKED
    Stm_EnergyStateMode: initial-mode=STM_ENERGY_INVALID
      5 x mode:
        STM_ENERGY_GOOD
        STM_ENERGY_INVALID
        STM_ENERGY_OK
        STM_ENERGY_SEVERE_SHORTAGE
        STM_ENERGY_SHORTAGE
    Stm_VehicleStateMode: initial-mode=Stm_VehicleStateMode/STM_VEHICLE_STATE_UNAVAILABLE
      10 x mode:
        STM_VEHICLE_STATE_CHECK_ANALYS_DIAGNOSTICS
        STM_VEHICLE_STATE_CUSTOMER_ABSENT
        STM_VEHICLE_STATE_DRIVE
        STM_VEHICLE_STATE_INVALID
        STM_VEHICLE_STATE_LIVING
        STM_VEHICLE_STATE_PARKING_BN_NOK
        STM_VEHICLE_STATE_PARKING_BN_OK
        STM_VEHICLE_STATE_READINESS_TO_DRIVE_INIT
        STM_VEHICLE_STATE_READINESS_TO_DRIVE_STOP
        STM_VEHICLE_STATE_UNAVAILABLE
    Stm_VehicleStateSP2015Mode: initial-mode=STM_VEHICLE_STATE_SP2015_UNAVAILABLE
      10 x mode:
        STM_VEHICLE_STATE_SP2015_CHECK_ANALYS_DIAGNOSTICS
        STM_VEHICLE_STATE_SP2015_CUSTOMER_ABSENT
        STM_VEHICLE_STATE_SP2015_DRIVE
        STM_VEHICLE_STATE_SP2015_INVALID
        STM_VEHICLE_STATE_SP2015_LIVING
        STM_VEHICLE_STATE_SP2015_PARKING_BN_NOK
        STM_VEHICLE_STATE_SP2015_PARKING_BN_OK
        STM_VEHICLE_STATE_SP2015_READINESS_TO_DRIVE_INIT
        STM_VEHICLE_STATE_SP2015_READINESS_TO_DRIVE_STOP
        STM_VEHICLE_STATE_SP2015_UNAVAILABLE
package /BMW/Platform/Stm/PortInterfaces
  5 x mode switch interface:
    CentralErrorLockModeInterface
      mode group currentCentralErrorLockMode: type=Stm_CentralErrorLockMode
    EMLockSignalReceptionModeInterface: is-service=true
      mode group currentEMLockSignalReceptionMode: type=ErrorMemoryLockSignalReceptionMode
    EnergyStateModeInterface
      mode group currentEnergyMode: type=Stm_EnergyStateMode
    VehicleStateModeInterface
      mode group currentVehicleStateMode: type=ModeDeclarationGroups/Stm_VehicleStateMode
    VehicleStateSP2015ModeInterface
      mode group currentVehicleStateSP2015Mode: type=Stm_VehicleStateSP2015Mode
  4 x sender receiver interface:
    CentralErrorLockSignalInterface: invalidation-policy{data-element=CentralErrorLockSignalInterface/centralErrorLock, handle-invalid=DONT-INVALIDATE}
      data centralErrorLock: type=Stm_CentralErrorLockType
    EnergyStateSignalInterface: invalidation-policy{data-element=energyState, handle-invalid=DONT-INVALIDATE}
      data energyState: type=Stm_EnergyStateType
    VehicleStateSignalInterface: invalidation-policy{data-element=VehicleStateSignalInterface/VehicleState, handle-invalid=DONT-INVALIDATE}
      data VehicleState: type=Stm_VehicleStateType
    VehicleStateSP2015SignalInterface: invalidation-policy{data-element=vehicleStateSP2015, handle-invalid=DONT-INVALIDATE}
      data vehicleStateSP2015: type=Stm_VehicleStateSP2015Type
package /BMW/Platform/SysTime/Dcm/PortInterfaces
  client server interface DataServices_SystemTime: is-service=true
    operation ReadData: possible-error=DataServices_SystemTime/E_NOT_OK
      arg Data: type=Array4, direction=OUT, server-argument-impl-policy=USE-ARGUMENT-TYPE
    error E_NOT_OK: error-code=1
package /BMW/Platform/SysTime/Det/PortInterfaces
  client server interface DETService: is-service=true
    operation ReportError: possible-error=DETService/E_OK
      arg InstanceId: type=uint8, direction=IN, server-argument-impl-policy=USE-ARGUMENT-TYPE
      arg ApiId: type=uint8, direction=IN, server-argument-impl-policy=USE-ARGUMENT-TYPE
      arg ErrorId: type=uint8, direction=IN, server-argument-impl-policy=USE-ARGUMENT-TYPE
    error E_OK: error-code=0
package /BMW/Platform/SysTime/ModeDeclarationGroups
  mode declaration group SysTime_LifeCycle: category=EXPLICIT_ORDER, initial-mode=SYSTIME_STOPPED, on-transition-value=3
    mode SYSTIME_INITIALIZED: value=0
    mode SYSTIME_RUNNING: value=1
    mode SYSTIME_STOPPED: value=2
package /BMW/Platform/SysTime/PortInterfaces
  client server interface GetSysTime
    operation GetTime: possible-error=GetSysTime/E_NOT_OK
      arg currentTime: type=uint32, direction=OUT, server-argument-impl-policy=USE-ARGUMENT-TYPE
    error E_NOT_OK: error-code=1
  mode switch interface ILifeCycle
    mode group Mode: type=SysTime_LifeCycle
  sender receiver interface ILifeCycleRequest: is-service=true, invalidation-policy{data-element=ILifeCycleRequest/requestMode, handle-invalid=DONT-INVALIDATE}
    data requestMode: type=SysTime_LifeCycleRequestType
  sender receiver interface SysTimeRx: invalidation-policy{data-element=timeSignal, handle-invalid=DONT-INVALIDATE}
    data timeSignal: type=uint32
package /BMW/Platform/Vin/PortInterfaces
  sender receiver interface ComVin: invalidation-policy{data-element=ComVin, handle-invalid=DONT-INVALIDATE}
    data ComVin: type=Vin_ComVinType
package /BMW/SystemDescription/ModeDeclarationGroups/BasePartialNetworks
  9 x mode declaration group, all with category=ALPHABETIC_ORDER:
    KOM_FAHRBEREITSCHAFT_BEENDEN: initial-mode=KOM_FAHRBEREITSCHAFT_BEENDEN_OFF
      mode KOM_FAHRBEREITSCHAFT_BEENDEN_OFF
      mode KOM_FAHRBEREITSCHAFT_BEENDEN_ON
    KOM_FAHRBEREITSCHAFT_HERSTELLEN: initial-mode=KOM_FAHRBEREITSCHAFT_HERSTELLEN_OFF
      mode KOM_FAHRBEREITSCHAFT_HERSTELLEN_OFF
      mode KOM_FAHRBEREITSCHAFT_HERSTELLEN_ON
    KOM_FAHREN: initial-mode=KOM_FAHREN_OFF
      mode KOM_FAHREN_OFF
      mode KOM_FAHREN_ON
    KOM_PARKEN_BN_IO: initial-mode=KOM_PARKEN_BN_IO_OFF
      mode KOM_PARKEN_BN_IO_OFF
      mode KOM_PARKEN_BN_IO_ON
    KOM_PARKEN_BN_NIO: initial-mode=KOM_PARKEN_BN_NIO_OFF
      mode KOM_PARKEN_BN_NIO_OFF
      mode KOM_PARKEN_BN_NIO_ON
    KOM_PRUEFEN_ANALYSE_DIAGNOSE: initial-mode=KOM_PRUEFEN_ANALYSE_DIAGNOSE_OFF
      mode KOM_PRUEFEN_ANALYSE_DIAGNOSE_OFF
      mode KOM_PRUEFEN_ANALYSE_DIAGNOSE_ON
    KOM_STANDFUNKTIONEN_KUNDE_NICHT_IM_FZG: initial-mode=KOM_STANDFUNKTIONEN_KUNDE_NICHT_IM_FZG_OFF
      mode KOM_STANDFUNKTIONEN_KUNDE_NICHT_IM_FZG_OFF
      mode KOM_STANDFUNKTIONEN_KUNDE_NICHT_IM_FZG_ON
    KOM_WOHNEN: initial-mode=KOM_WOHNEN_OFF
      mode KOM_WOHNEN_OFF
      mode KOM_WOHNEN_ON
    PWFVehicleState: initial-mode=PWFVehicleState/KEINE_KOMMUNIKATION
      9 x mode:
        KEINE_KOMMUNIKATION
        KOM_FAHRBEREITSCHAFT_BEENDEN
        KOM_FAHRBEREITSCHAFT_HERSTELLEN
        KOM_FAHREN
        KOM_PARKEN_BN_IO
        KOM_PARKEN_BN_NIO
        KOM_PRUEFEN_ANALYSE_DIAGNOSE
        KOM_STANDFUNKTIONEN_KUNDE_NICHT_IM_FZG
        KOM_WOHNEN
package /BMW/SystemDescription/ModeDeclarationGroups/FunctionalPartialNetworks
  4 x mode declaration group, all with category=ALPHABETIC_ORDER:
    AssistenzParkenHigh: initial-mode=ASSISTENZ_PARKEN_HIGH_OFF
      mode ASSISTENZ_PARKEN_HIGH_OFF
      mode ASSISTENZ_PARKEN_HIGH_ON
    Entertainmentbetrieb: initial-mode=ENTERTAINMENTBETRIEB_OFF
      mode ENTERTAINMENTBETRIEB_OFF
      mode ENTERTAINMENTBETRIEB_ON
    Laden: initial-mode=LADEN_OFF
      mode LADEN_OFF
      mode LADEN_ON
    Licht: initial-mode=LICHT_OFF
      mode LICHT_OFF
      mode LICHT_ON
package /MICROSAR_SWCS_DEV/Dcm_swc
  mode declaration group DcmEcuReset: category=ALPHABETIC_ORDER, initial-mode=NONE
    7 x mode:
      EXECUTE
      HARD
      JUMPTOBOOTLOADER
      JUMPTOSYSSUPPLIERBOOTLOADER
      KEYONOFF
      NONE
      SOFT
package /MICROSAR_SWCS_DEV/Dcm_swc/Interfaces
  mode switch interface DcmEcuReset: is-service=true
    mode group DcmEcuReset: type=DcmEcuReset
package /MICROSAR_SWCS_DEV/Dem_swc/Interfaces
  client server interface GeneralDiagnosticInfo: is-service=true, service-kind=DIAGNOSTIC-EVENT-MANAGER
    11 x operation:
      GetDebouncingOfEvent: possible-error=GeneralDiagnosticInfo/E_NOT_OK
        arg EventId: type=Dem_EventIdType, direction=IN, server-argument-impl-policy=USE-ARGUMENT-TYPE
        arg DebouncingState: type=Dem_DebouncingStateType, direction=OUT, server-argument-impl-policy=USE-ARGUMENT-TYPE
      GetDTCOfEvent: possible-error=[GeneralDiagnosticInfo/E_NOT_OK, GeneralDiagnosticInfo/DEM_E_NO_DTC_AVAILABLE]
        arg EventId: type=Dem_EventIdType, direction=IN, server-argument-impl-policy=USE-ARGUMENT-TYPE
        arg DTCFormat: type=Dem_DTCFormatType, direction=IN, server-argument-impl-policy=USE-ARGUMENT-TYPE
        arg DTCOfEvent: type=uint32, direction=OUT, server-argument-impl-policy=USE-ARGUMENT-TYPE
      GetEventEnableCondition: possible-error=GeneralDiagnosticInfo/E_NOT_OK
        arg EventId: type=Dem_EventIdType, direction=IN, server-argument-impl-policy=USE-ARGUMENT-TYPE
        arg ConditionFullfilled: type=boolean, direction=OUT, server-argument-impl-policy=USE-ARGUMENT-TYPE
      GetEventExtendedDataRecordEx: possible-error=[GeneralDiagnosticInfo/E_NOT_OK, DEM_BUFFER_TOO_SMALL, DEM_NO_SUCH_ELEMENT]
        4 x arg, all with server-argument-impl-policy=USE-ARGUMENT-TYPE:
          EventId: type=Dem_EventIdType, direction=IN
          RecordNumber: type=uint8, direction=IN
          DestBuffer: type=Dem_MaxDataValueType, direction=OUT
          BufSize: type=uint16, direction=INOUT
      GetEventFailed: possible-error=GeneralDiagnosticInfo/E_NOT_OK
        arg EventId: type=Dem_EventIdType, direction=IN, server-argument-impl-policy=USE-ARGUMENT-TYPE
        arg EventFailed: type=boolean, direction=OUT, server-argument-impl-policy=USE-ARGUMENT-TYPE
      GetEventFreezeFrameDataEx: possible-error=[GeneralDiagnosticInfo/E_NOT_OK, DEM_BUFFER_TOO_SMALL, DEM_NO_SUCH_ELEMENT]
        5 x arg, all with server-argument-impl-policy=USE-ARGUMENT-TYPE:
          EventId: type=Dem_EventIdType, direction=IN
          RecordNumber: type=uint8, direction=IN
          DataId: type=uint16, direction=IN
          DestBuffer: type=Dem_MaxDataValueType, direction=OUT
          BufSize: type=uint16, direction=INOUT
      GetEventStatus: possible-error=GeneralDiagnosticInfo/E_NOT_OK
        arg EventId: type=Dem_EventIdType, direction=IN, server-argument-impl-policy=USE-ARGUMENT-TYPE
        arg UDSStatusByte: type=Dem_UdsStatusByteType, direction=OUT, server-argument-impl-policy=USE-ARGUMENT-TYPE
      GetEventTested: possible-error=GeneralDiagnosticInfo/E_NOT_OK
        arg EventId: type=Dem_EventIdType, direction=IN, server-argument-impl-policy=USE-ARGUMENT-TYPE
        arg EventTested: type=boolean, direction=OUT, server-argument-impl-policy=USE-ARGUMENT-TYPE
      GetEventUdsStatus: possible-error=GeneralDiagnosticInfo/E_NOT_OK
        arg EventId: type=Dem_EventIdType, direction=IN, server-argument-impl-policy=USE-ARGUMENT-TYPE
        arg UDSStatusByte: type=Dem_UdsStatusByteType, direction=OUT, server-argument-impl-policy=USE-ARGUMENT-TYPE
      GetFaultDetectionCounter: possible-error=[GeneralDiagnosticInfo/E_NOT_OK, DEM_E_NO_FDC_AVAILABLE]
        arg EventId: type=Dem_EventIdType, direction=IN, server-argument-impl-policy=USE-ARGUMENT-TYPE
        arg FaultDetectionCounter: type=sint8, direction=OUT, server-argument-impl-policy=USE-ARGUMENT-TYPE
      GetMonitorStatus: possible-error=GeneralDiagnosticInfo/E_NOT_OK
        arg EventId: type=Dem_EventIdType, direction=IN, server-argument-impl-policy=USE-ARGUMENT-TYPE
        arg MonitorStatus: type=Dem_MonitorStatusType, direction=OUT, server-argument-impl-policy=USE-ARGUMENT-TYPE
    5 x error:
      DEM_BUFFER_TOO_SMALL: error-code=21
      DEM_E_NO_DTC_AVAILABLE: error-code=10
      DEM_E_NO_FDC_AVAILABLE: error-code=14
      DEM_NO_SUCH_ELEMENT: error-code=48
      E_NOT_OK: error-code=1
package /MICROSAR_SWCS_DEV/WdgM_swc
  mode declaration group WdgMMode: category=ALPHABETIC_ORDER, initial-mode=SUPERVISION_OK, on-transition-value=255
    5 x mode:
      SUPERVISION_DEACTIVATED: value=4
      SUPERVISION_EXPIRED: value=2
      SUPERVISION_FAILED: value=1
      SUPERVISION_OK: value=0
      SUPERVISION_STOPPED: value=3
package /MICROSAR_SWCS_DEV/WdgM_swc/Interfaces
  client server interface WdgM_AliveSupervision: is-service=true  # The WdgM_AliveSupervision client server interface.
    operation CheckpointReached: possible-error=WdgM_AliveSupervision/E_NOT_OK  # Gives alive indications to the Watchdog Manager.
      arg checkpointId: type=WdgM_CheckpointIdType, direction=IN, server-argument-impl-policy=USE-ARGUMENT-TYPE
    operation UpdateAliveCounter: possible-error=WdgM_AliveSupervision/E_NOT_OK  # Gives alive indications to the Watchdog Manager.
    error E_NOT_OK: error-code=1
  mode switch interface WdgM_GlobalMode: is-service=true
    mode group currentMode: type=WdgMMode
  mode switch interface WdgM_IndividualMode: is-service=true
    mode group currentMode: type=WdgMMode
package /ModeDclrGroups
  mode declaration group Bac4_ApplicationState: category=ALPHABETIC_ORDER, initial-mode=INIT, on-transition-value=255
    4 x mode:
      INIT: value=0
      POST_RUN: value=2
      RUN: value=1
      SHUTDOWN: value=3
package /PortInterfaces
  mode switch interface PI_BAC4_ApplicationModeState
    mode group Bac4_ApplicationMode: type=Bac4_ApplicationState
  10 x sender receiver interface:
    MILE_KM: invalidation-policy{data-element=MILE_KM, handle-invalid=DONT-INVALIDATE}
      data MILE_KM: type=MILE_KM
    NO_VECH_1: invalidation-policy{data-element=NO_VECH_1, handle-invalid=DONT-INVALIDATE}
      data NO_VECH_1: type=NO_VECH_1
    NO_VECH_2: invalidation-policy{data-element=NO_VECH_2, handle-invalid=DONT-INVALIDATE}
      data NO_VECH_2: type=NO_VECH_2
    NO_VECH_3: invalidation-policy{data-element=NO_VECH_3, handle-invalid=DONT-INVALIDATE}
      data NO_VECH_3: type=NO_VECH_3
    NO_VECH_4: invalidation-policy{data-element=NO_VECH_4, handle-invalid=DONT-INVALIDATE}
      data NO_VECH_4: type=NO_VECH_4
    NO_VECH_5: invalidation-policy{data-element=NO_VECH_5, handle-invalid=DONT-INVALIDATE}
      data NO_VECH_5: type=NO_VECH_5
    NO_VECH_6: invalidation-policy{data-element=NO_VECH_6, handle-invalid=DONT-INVALIDATE}
      data NO_VECH_6: type=NO_VECH_6
    NO_VECH_7: invalidation-policy{data-element=NO_VECH_7, handle-invalid=DONT-INVALIDATE}
      data NO_VECH_7: type=NO_VECH_7
    PI_Bac4_ApplicationState_Request: invalidation-policy{data-element=Bac4_ApplicationState, handle-invalid=DONT-INVALIDATE}
      data Bac4_ApplicationState: type=Bac4_ApplicationStateType
    sigGroup_CON_VEH: invalidation-policy{data-element=sigGroup_CON_VEH, handle-invalid=DONT-INVALIDATE}
      data sigGroup_CON_VEH: type=sigGroup_CON_VEH
package /Predefined_DEV/PortInterfaces
  43 x client server interface:
    CallbackDTCStatusChange: is-service=true, service-kind=DIAGNOSTIC-EVENT-MANAGER
      operation DTCStatusChanged: possible-error=CallbackDTCStatusChange/E_NOT_OK
        arg DTC: type=uint32, direction=IN, server-argument-impl-policy=USE-ARGUMENT-TYPE
        arg DTCStatusOld: type=Dem_UdsStatusByteType, direction=IN, server-argument-impl-policy=USE-ARGUMENT-TYPE
        arg DTCStatusNew: type=Dem_UdsStatusByteType, direction=IN, server-argument-impl-policy=USE-ARGUMENT-TYPE
      error E_NOT_OK: error-code=1
    NvMAdministration: is-service=true
      operation SetBlockProtection: possible-error=NvMAdministration/E_NOT_OK
        arg ProtectionEnabled: type=boolean, direction=IN, server-argument-impl-policy=USE-ARGUMENT-TYPE
      error E_NOT_OK: error-code=1
    NvMNotifyInitBlock: is-service=true
      operation InitBlock
    NvMNotifyJobFinished: is-service=true
      operation JobFinished
        arg ServiceId: type=NvM_ServiceIdType, direction=IN, server-argument-impl-policy=USE-ARGUMENT-TYPE
        arg JobResult: type=NvM_RequestResultType, direction=IN, server-argument-impl-policy=USE-ARGUMENT-TYPE
    NvMService: is-service=true
      operation GetErrorStatus: possible-error=NvMService/E_NOT_OK
        arg ErrorStatus: type=NvM_RequestResultType, direction=OUT, server-argument-impl-policy=USE-ARGUMENT-TYPE
      error E_NOT_OK: error-code=1
    NvMService_AC2: is-service=true
      operation GetErrorStatus: possible-error=NvMService_AC2/E_NOT_OK
        arg ErrorStatus: type=NvM_RequestResultType, direction=OUT, server-argument-impl-policy=USE-ARGUMENT-TYPE
      operation ReadBlock: possible-error=NvMService_AC2/E_NOT_OK
        arg DstPtr: type=dtRef_VOID, direction=IN, server-argument-impl-policy=USE-ARGUMENT-TYPE
      operation WriteBlock: possible-error=NvMService_AC2/E_NOT_OK
        arg SrcPtr: type=dtRef_const_VOID, direction=IN, server-argument-impl-policy=USE-ARGUMENT-TYPE
      error E_NOT_OK: error-code=1
    NvMService_AC2_Defs: is-service=true
      4 x operation, all with possible-error=NvMService_AC2_Defs/E_NOT_OK:
        GetErrorStatus
          arg ErrorStatus: type=NvM_RequestResultType, direction=OUT, server-argument-impl-policy=USE-ARGUMENT-TYPE
        ReadBlock
          arg DstPtr: type=dtRef_VOID, direction=IN, server-argument-impl-policy=USE-ARGUMENT-TYPE
        RestoreBlockDefaults
          arg DstPtr: type=dtRef_VOID, direction=IN, server-argument-impl-policy=USE-ARGUMENT-TYPE
        WriteBlock
          arg SrcPtr: type=dtRef_const_VOID, direction=IN, server-argument-impl-policy=USE-ARGUMENT-TYPE
      error E_NOT_OK: error-code=1
    NvMService_AC2_DS: is-service=true
      5 x operation, all with possible-error=NvMService_AC2_DS/E_NOT_OK:
        GetDataIndex
          arg DataIndex: type=uint8, direction=OUT, server-argument-impl-policy=USE-ARGUMENT-TYPE
        GetErrorStatus
          arg ErrorStatus: type=NvM_RequestResultType, direction=OUT, server-argument-impl-policy=USE-ARGUMENT-TYPE
        ReadBlock
          arg DstPtr: type=dtRef_VOID, direction=IN, server-argument-impl-policy=USE-ARGUMENT-TYPE
        SetDataIndex
          arg DataIndex: type=uint8, direction=IN, server-argument-impl-policy=USE-ARGUMENT-TYPE
        WriteBlock
          arg SrcPtr: type=dtRef_const_VOID, direction=IN, server-argument-impl-policy=USE-ARGUMENT-TYPE
      error E_NOT_OK: error-code=1
    NvMService_AC2_DS_Defs: is-service=true
      6 x operation, all with possible-error=NvMService_AC2_DS_Defs/E_NOT_OK:
        GetDataIndex
          arg DataIndex: type=uint8, direction=OUT, server-argument-impl-policy=USE-ARGUMENT-TYPE
        GetErrorStatus
          arg ErrorStatus: type=NvM_RequestResultType, direction=OUT, server-argument-impl-policy=USE-ARGUMENT-TYPE
        ReadBlock
          arg DstPtr: type=dtRef_VOID, direction=IN, server-argument-impl-policy=USE-ARGUMENT-TYPE
        RestoreBlockDefaults
          arg DstPtr: type=dtRef_VOID, direction=IN, server-argument-impl-policy=USE-ARGUMENT-TYPE
        SetDataIndex
          arg DataIndex: type=uint8, direction=IN, server-argument-impl-policy=USE-ARGUMENT-TYPE
        WriteBlock
          arg SrcPtr: type=dtRef_const_VOID, direction=IN, server-argument-impl-policy=USE-ARGUMENT-TYPE
      error E_NOT_OK: error-code=1
    NvMService_AC2_SRBS: is-service=true
      4 x operation, all with possible-error=NvMService_AC2_SRBS/E_NOT_OK:
        GetErrorStatus
          arg ErrorStatus: type=NvM_RequestResultType, direction=OUT, server-argument-impl-policy=USE-ARGUMENT-TYPE
        ReadBlock
          arg DstPtr: type=dtRef_VOID, direction=IN, server-argument-impl-policy=USE-ARGUMENT-TYPE
        SetRamBlockStatus
          arg RamBlockStatus: type=boolean, direction=IN, server-argument-impl-policy=USE-ARGUMENT-TYPE
        WriteBlock
          arg SrcPtr: type=dtRef_const_VOID, direction=IN, server-argument-impl-policy=USE-ARGUMENT-TYPE
      error E_NOT_OK: error-code=1
    NvMService_AC2_SRBS_Defs: is-service=true
      5 x operation, all with possible-error=NvMService_AC2_SRBS_Defs/E_NOT_OK:
        GetErrorStatus
          arg ErrorStatus: type=NvM_RequestResultType, direction=OUT, server-argument-impl-policy=USE-ARGUMENT-TYPE
        ReadBlock
          arg DstPtr: type=dtRef_VOID, direction=IN, server-argument-impl-policy=USE-ARGUMENT-TYPE
        RestoreBlockDefaults
          arg DstPtr: type=dtRef_VOID, direction=IN, server-argument-impl-policy=USE-ARGUMENT-TYPE
        SetRamBlockStatus
          arg RamBlockStatus: type=boolean, direction=IN, server-argument-impl-policy=USE-ARGUMENT-TYPE
        WriteBlock
          arg SrcPtr: type=dtRef_const_VOID, direction=IN, server-argument-impl-policy=USE-ARGUMENT-TYPE
      error E_NOT_OK: error-code=1
    NvMService_AC2_SRBS_DS: is-service=true
      6 x operation, all with possible-error=NvMService_AC2_SRBS_DS/E_NOT_OK:
        GetDataIndex
          arg DataIndex: type=uint8, direction=OUT, server-argument-impl-policy=USE-ARGUMENT-TYPE
        GetErrorStatus
          arg ErrorStatus: type=NvM_RequestResultType, direction=OUT, server-argument-impl-policy=USE-ARGUMENT-TYPE
        ReadBlock
          arg DstPtr: type=dtRef_VOID, direction=IN, server-argument-impl-policy=USE-ARGUMENT-TYPE
        SetDataIndex
          arg DataIndex: type=uint8, direction=IN, server-argument-impl-policy=USE-ARGUMENT-TYPE
        SetRamBlockStatus
          arg RamBlockStatus: type=boolean, direction=IN, server-argument-impl-policy=USE-ARGUMENT-TYPE
        WriteBlock
          arg SrcPtr: type=dtRef_const_VOID, direction=IN, server-argument-impl-policy=USE-ARGUMENT-TYPE
      error E_NOT_OK: error-code=1
    NvMService_AC2_SRBS_DS_Defs: is-service=true
      7 x operation, all with possible-error=NvMService_AC2_SRBS_DS_Defs/E_NOT_OK:
        GetDataIndex
          arg DataIndex: type=uint8, direction=OUT, server-argument-impl-policy=USE-ARGUMENT-TYPE
        GetErrorStatus
          arg ErrorStatus: type=NvM_RequestResultType, direction=OUT, server-argument-impl-policy=USE-ARGUMENT-TYPE
        ReadBlock
          arg DstPtr: type=dtRef_VOID, direction=IN, server-argument-impl-policy=USE-ARGUMENT-TYPE
        RestoreBlockDefaults
          arg DstPtr: type=dtRef_VOID, direction=IN, server-argument-impl-policy=USE-ARGUMENT-TYPE
        SetDataIndex
          arg DataIndex: type=uint8, direction=IN, server-argument-impl-policy=USE-ARGUMENT-TYPE
        SetRamBlockStatus
          arg RamBlockStatus: type=boolean, direction=IN, server-argument-impl-policy=USE-ARGUMENT-TYPE
        WriteBlock
          arg SrcPtr: type=dtRef_const_VOID, direction=IN, server-argument-impl-policy=USE-ARGUMENT-TYPE
      error E_NOT_OK: error-code=1
    NvMService_AC3: is-service=true
      5 x operation, all with possible-error=NvMService_AC3/E_NOT_OK:
        EraseBlock
        GetErrorStatus
          arg ErrorStatus: type=NvM_RequestResultType, direction=OUT, server-argument-impl-policy=USE-ARGUMENT-TYPE
        InvalidateNvBlock
        ReadBlock
          arg DstPtr: type=dtRef_VOID, direction=IN, server-argument-impl-policy=USE-ARGUMENT-TYPE
        WriteBlock
          arg SrcPtr: type=dtRef_const_VOID, direction=IN, server-argument-impl-policy=USE-ARGUMENT-TYPE
      error E_NOT_OK: error-code=1
    NvMService_AC3_Defs: is-service=true
      6 x operation, all with possible-error=NvMService_AC3_Defs/E_NOT_OK:
        EraseBlock
        GetErrorStatus
          arg ErrorStatus: type=NvM_RequestResultType, direction=OUT, server-argument-impl-policy=USE-ARGUMENT-TYPE
        InvalidateNvBlock
        ReadBlock
          arg DstPtr: type=dtRef_VOID, direction=IN, server-argument-impl-policy=USE-ARGUMENT-TYPE
        RestoreBlockDefaults
          arg DstPtr: type=dtRef_VOID, direction=IN, server-argument-impl-policy=USE-ARGUMENT-TYPE
        WriteBlock
          arg SrcPtr: type=dtRef_const_VOID, direction=IN, server-argument-impl-policy=USE-ARGUMENT-TYPE
      error E_NOT_OK: error-code=1
    NvMService_AC3_DS: is-service=true
      7 x operation, all with possible-error=NvMService_AC3_DS/E_NOT_OK:
        EraseBlock
        GetDataIndex
          arg DataIndex: type=uint8, direction=OUT, server-argument-impl-policy=USE-ARGUMENT-TYPE
        GetErrorStatus
          arg ErrorStatus: type=NvM_RequestResultType, direction=OUT, server-argument-impl-policy=USE-ARGUMENT-TYPE
        InvalidateNvBlock
        ReadBlock
          arg DstPtr: type=dtRef_VOID, direction=IN, server-argument-impl-policy=USE-ARGUMENT-TYPE
        SetDataIndex
          arg DataIndex: type=uint8, direction=IN, server-argument-impl-policy=USE-ARGUMENT-TYPE
        WriteBlock
          arg SrcPtr: type=dtRef_const_VOID, direction=IN, server-argument-impl-policy=USE-ARGUMENT-TYPE
      error E_NOT_OK: error-code=1
    NvMService_AC3_DS_Defs: is-service=true
      8 x operation, all with possible-error=NvMService_AC3_DS_Defs/E_NOT_OK:
        EraseBlock
        GetDataIndex
          arg DataIndex: type=uint8, direction=OUT, server-argument-impl-policy=USE-ARGUMENT-TYPE
        GetErrorStatus
          arg ErrorStatus: type=NvM_RequestResultType, direction=OUT, server-argument-impl-policy=USE-ARGUMENT-TYPE
        InvalidateNvBlock
        ReadBlock
          arg DstPtr: type=dtRef_VOID, direction=IN, server-argument-impl-policy=USE-ARGUMENT-TYPE
        RestoreBlockDefaults
          arg DstPtr: type=dtRef_VOID, direction=IN, server-argument-impl-policy=USE-ARGUMENT-TYPE
        SetDataIndex
          arg DataIndex: type=uint8, direction=IN, server-argument-impl-policy=USE-ARGUMENT-TYPE
        WriteBlock
          arg SrcPtr: type=dtRef_const_VOID, direction=IN, server-argument-impl-policy=USE-ARGUMENT-TYPE
      error E_NOT_OK: error-code=1
    NvMService_AC3_SRBS: is-service=true
      6 x operation, all with possible-error=NvMService_AC3_SRBS/E_NOT_OK:
        EraseBlock
        GetErrorStatus
          arg ErrorStatus: type=NvM_RequestResultType, direction=OUT, server-argument-impl-policy=USE-ARGUMENT-TYPE
        InvalidateNvBlock
        ReadBlock
          arg DstPtr: type=dtRef_VOID, direction=IN, server-argument-impl-policy=USE-ARGUMENT-TYPE
        SetRamBlockStatus
          arg RamBlockStatus: type=boolean, direction=IN, server-argument-impl-policy=USE-ARGUMENT-TYPE
        WriteBlock
          arg SrcPtr: type=dtRef_const_VOID, direction=IN, server-argument-impl-policy=USE-ARGUMENT-TYPE
      error E_NOT_OK: error-code=1
    NvMService_AC3_SRBS_Defs: is-service=true
      7 x operation, all with possible-error=NvMService_AC3_SRBS_Defs/E_NOT_OK:
        EraseBlock
        GetErrorStatus
          arg ErrorStatus: type=NvM_RequestResultType, direction=OUT, server-argument-impl-policy=USE-ARGUMENT-TYPE
        InvalidateNvBlock
        ReadBlock
          arg DstPtr: type=dtRef_VOID, direction=IN, server-argument-impl-policy=USE-ARGUMENT-TYPE
        RestoreBlockDefaults
          arg DstPtr: type=dtRef_VOID, direction=IN, server-argument-impl-policy=USE-ARGUMENT-TYPE
        SetRamBlockStatus
          arg RamBlockStatus: type=boolean, direction=IN, server-argument-impl-policy=USE-ARGUMENT-TYPE
        WriteBlock
          arg SrcPtr: type=dtRef_const_VOID, direction=IN, server-argument-impl-policy=USE-ARGUMENT-TYPE
      error E_NOT_OK: error-code=1
    NvMService_AC3_SRBS_DS: is-service=true
      8 x operation, all with possible-error=NvMService_AC3_SRBS_DS/E_NOT_OK:
        EraseBlock
        GetDataIndex
          arg DataIndex: type=uint8, direction=OUT, server-argument-impl-policy=USE-ARGUMENT-TYPE
        GetErrorStatus
          arg ErrorStatus: type=NvM_RequestResultType, direction=OUT, server-argument-impl-policy=USE-ARGUMENT-TYPE
        InvalidateNvBlock
        ReadBlock
          arg DstPtr: type=dtRef_VOID, direction=IN, server-argument-impl-policy=USE-ARGUMENT-TYPE
        SetDataIndex
          arg DataIndex: type=uint8, direction=IN, server-argument-impl-policy=USE-ARGUMENT-TYPE
        SetRamBlockStatus
          arg RamBlockStatus: type=boolean, direction=IN, server-argument-impl-policy=USE-ARGUMENT-TYPE
        WriteBlock
          arg SrcPtr: type=dtRef_const_VOID, direction=IN, server-argument-impl-policy=USE-ARGUMENT-TYPE
      error E_NOT_OK: error-code=1
    NvMService_AC3_SRBS_DS_Defs: is-service=true
      9 x operation, all with possible-error=NvMService_AC3_SRBS_DS_Defs/E_NOT_OK:
        EraseBlock
        GetDataIndex
          arg DataIndex: type=uint8, direction=OUT, server-argument-impl-policy=USE-ARGUMENT-TYPE
        GetErrorStatus
          arg ErrorStatus: type=NvM_RequestResultType, direction=OUT, server-argument-impl-policy=USE-ARGUMENT-TYPE
        InvalidateNvBlock
        ReadBlock
          arg DstPtr: type=dtRef_VOID, direction=IN, server-argument-impl-policy=USE-ARGUMENT-TYPE
        RestoreBlockDefaults
          arg DstPtr: type=dtRef_VOID, direction=IN, server-argument-impl-policy=USE-ARGUMENT-TYPE
        SetDataIndex
          arg DataIndex: type=uint8, direction=IN, server-argument-impl-policy=USE-ARGUMENT-TYPE
        SetRamBlockStatus
          arg RamBlockStatus: type=boolean, direction=IN, server-argument-impl-policy=USE-ARGUMENT-TYPE
        WriteBlock
          arg SrcPtr: type=dtRef_const_VOID, direction=IN, server-argument-impl-policy=USE-ARGUMENT-TYPE
      error E_NOT_OK: error-code=1
    NvMService_SRBS: is-service=true
      operation GetErrorStatus: possible-error=NvMService_SRBS/E_NOT_OK
        arg ErrorStatus: type=NvM_RequestResultType, direction=OUT, server-argument-impl-policy=USE-ARGUMENT-TYPE
      operation SetRamBlockStatus: possible-error=NvMService_SRBS/E_NOT_OK
        arg RamBlockStatus: type=boolean, direction=IN, server-argument-impl-policy=USE-ARGUMENT-TYPE
      error E_NOT_OK: error-code=1
    NvSWC_NvMAdministration
      operation SetBlockProtection: possible-error=NvSWC_NvMAdministration/E_NOT_OK
        arg ProtectionEnabled: type=boolean, direction=IN, server-argument-impl-policy=USE-ARGUMENT-TYPE
      error E_NOT_OK: error-code=1
    NvSWC_NvMNotifyInitBlock
      operation InitBlock
    NvSWC_NvMNotifyJobFinished
      operation JobFinished
        arg ServiceId: type=NvM_ServiceIdType, direction=IN, server-argument-impl-policy=USE-ARGUMENT-TYPE
        arg JobResult: type=NvM_RequestResultType, direction=IN, server-argument-impl-policy=USE-ARGUMENT-TYPE
    NvSWC_NvMService
      operation GetErrorStatus: possible-error=NvSWC_NvMService/E_NOT_OK
        arg ErrorStatus: type=NvM_RequestResultType, direction=OUT, server-argument-impl-policy=USE-ARGUMENT-TYPE
      error E_NOT_OK: error-code=1
    NvSWC_NvMService_AC2
      operation GetErrorStatus: possible-error=NvSWC_NvMService_AC2/E_NOT_OK
        arg ErrorStatus: type=NvM_RequestResultType, direction=OUT, server-argument-impl-policy=USE-ARGUMENT-TYPE
      operation ReadBlock: possible-error=NvSWC_NvMService_AC2/E_NOT_OK
        arg DstPtr: type=dtRef_VOID, direction=IN, server-argument-impl-policy=USE-ARGUMENT-TYPE
      operation WriteBlock: possible-error=NvSWC_NvMService_AC2/E_NOT_OK
        arg SrcPtr: type=dtRef_const_VOID, direction=IN, server-argument-impl-policy=USE-ARGUMENT-TYPE
      error E_NOT_OK: error-code=1
    NvSWC_NvMService_AC2_Defs
      4 x operation, all with possible-error=NvSWC_NvMService_AC2_Defs/E_NOT_OK:
        GetErrorStatus
          arg ErrorStatus: type=NvM_RequestResultType, direction=OUT, server-argument-impl-policy=USE-ARGUMENT-TYPE
        ReadBlock
          arg DstPtr: type=dtRef_VOID, direction=IN, server-argument-impl-policy=USE-ARGUMENT-TYPE
        RestoreBlockDefaults
          arg DstPtr: type=dtRef_VOID, direction=IN, server-argument-impl-policy=USE-ARGUMENT-TYPE
        WriteBlock
          arg SrcPtr: type=dtRef_const_VOID, direction=IN, server-argument-impl-policy=USE-ARGUMENT-TYPE
      error E_NOT_OK: error-code=1
    NvSWC_NvMService_AC2_DS
      5 x operation, all with possible-error=NvSWC_NvMService_AC2_DS/E_NOT_OK:
        GetDataIndex
          arg DataIndex: type=uint8, direction=OUT, server-argument-impl-policy=USE-ARGUMENT-TYPE
        GetErrorStatus
          arg ErrorStatus: type=NvM_RequestResultType, direction=OUT, server-argument-impl-policy=USE-ARGUMENT-TYPE
        ReadBlock
          arg DstPtr: type=dtRef_VOID, direction=IN, server-argument-impl-policy=USE-ARGUMENT-TYPE
        SetDataIndex
          arg DataIndex: type=uint8, direction=IN, server-argument-impl-policy=USE-ARGUMENT-TYPE
        WriteBlock
          arg SrcPtr: type=dtRef_const_VOID, direction=IN, server-argument-impl-policy=USE-ARGUMENT-TYPE
      error E_NOT_OK: error-code=1
    NvSWC_NvMService_AC2_DS_Defs
      6 x operation, all with possible-error=NvSWC_NvMService_AC2_DS_Defs/E_NOT_OK:
        GetDataIndex
          arg DataIndex: type=uint8, direction=OUT, server-argument-impl-policy=USE-ARGUMENT-TYPE
        GetErrorStatus
          arg ErrorStatus: type=NvM_RequestResultType, direction=OUT, server-argument-impl-policy=USE-ARGUMENT-TYPE
        ReadBlock
          arg DstPtr: type=dtRef_VOID, direction=IN, server-argument-impl-policy=USE-ARGUMENT-TYPE
        RestoreBlockDefaults
          arg DstPtr: type=dtRef_VOID, direction=IN, server-argument-impl-policy=USE-ARGUMENT-TYPE
        SetDataIndex
          arg DataIndex: type=uint8, direction=IN, server-argument-impl-policy=USE-ARGUMENT-TYPE
        WriteBlock
          arg SrcPtr: type=dtRef_const_VOID, direction=IN, server-argument-impl-policy=USE-ARGUMENT-TYPE
      error E_NOT_OK: error-code=1
    NvSWC_NvMService_AC2_SRBS
      4 x operation, all with possible-error=NvSWC_NvMService_AC2_SRBS/E_NOT_OK:
        GetErrorStatus
          arg ErrorStatus: type=NvM_RequestResultType, direction=OUT, server-argument-impl-policy=USE-ARGUMENT-TYPE
        ReadBlock
          arg DstPtr: type=dtRef_VOID, direction=IN, server-argument-impl-policy=USE-ARGUMENT-TYPE
        SetRamBlockStatus
          arg RamBlockStatus: type=boolean, direction=IN, server-argument-impl-policy=USE-ARGUMENT-TYPE
        WriteBlock
          arg SrcPtr: type=dtRef_const_VOID, direction=IN, server-argument-impl-policy=USE-ARGUMENT-TYPE
      error E_NOT_OK: error-code=1
    NvSWC_NvMService_AC2_SRBS_Defs
      5 x operation, all with possible-error=NvSWC_NvMService_AC2_SRBS_Defs/E_NOT_OK:
        GetErrorStatus
          arg ErrorStatus: type=NvM_RequestResultType, direction=OUT, server-argument-impl-policy=USE-ARGUMENT-TYPE
        ReadBlock
          arg DstPtr: type=dtRef_VOID, direction=IN, server-argument-impl-policy=USE-ARGUMENT-TYPE
        RestoreBlockDefaults
          arg DstPtr: type=dtRef_VOID, direction=IN, server-argument-impl-policy=USE-ARGUMENT-TYPE
        SetRamBlockStatus
          arg RamBlockStatus: type=boolean, direction=IN, server-argument-impl-policy=USE-ARGUMENT-TYPE
        WriteBlock
          arg SrcPtr: type=dtRef_const_VOID, direction=IN, server-argument-impl-policy=USE-ARGUMENT-TYPE
      error E_NOT_OK: error-code=1
    NvSWC_NvMService_AC2_SRBS_DS
      6 x operation, all with possible-error=NvSWC_NvMService_AC2_SRBS_DS/E_NOT_OK:
        GetDataIndex
          arg DataIndex: type=uint8, direction=OUT, server-argument-impl-policy=USE-ARGUMENT-TYPE
        GetErrorStatus
          arg ErrorStatus: type=NvM_RequestResultType, direction=OUT, server-argument-impl-policy=USE-ARGUMENT-TYPE
        ReadBlock
          arg DstPtr: type=dtRef_VOID, direction=IN, server-argument-impl-policy=USE-ARGUMENT-TYPE
        SetDataIndex
          arg DataIndex: type=uint8, direction=IN, server-argument-impl-policy=USE-ARGUMENT-TYPE
        SetRamBlockStatus
          arg RamBlockStatus: type=boolean, direction=IN, server-argument-impl-policy=USE-ARGUMENT-TYPE
        WriteBlock
          arg SrcPtr: type=dtRef_const_VOID, direction=IN, server-argument-impl-policy=USE-ARGUMENT-TYPE
      error E_NOT_OK: error-code=1
    NvSWC_NvMService_AC2_SRBS_DS_Defs
      7 x operation, all with possible-error=NvSWC_NvMService_AC2_SRBS_DS_Defs/E_NOT_OK:
        GetDataIndex
          arg DataIndex: type=uint8, direction=OUT, server-argument-impl-policy=USE-ARGUMENT-TYPE
        GetErrorStatus
          arg ErrorStatus: type=NvM_RequestResultType, direction=OUT, server-argument-impl-policy=USE-ARGUMENT-TYPE
        ReadBlock
          arg DstPtr: type=dtRef_VOID, direction=IN, server-argument-impl-policy=USE-ARGUMENT-TYPE
        RestoreBlockDefaults
          arg DstPtr: type=dtRef_VOID, direction=IN, server-argument-impl-policy=USE-ARGUMENT-TYPE
        SetDataIndex
          arg DataIndex: type=uint8, direction=IN, server-argument-impl-policy=USE-ARGUMENT-TYPE
        SetRamBlockStatus
          arg RamBlockStatus: type=boolean, direction=IN, server-argument-impl-policy=USE-ARGUMENT-TYPE
        WriteBlock
          arg SrcPtr: type=dtRef_const_VOID, direction=IN, server-argument-impl-policy=USE-ARGUMENT-TYPE
      error E_NOT_OK: error-code=1
    NvSWC_NvMService_AC3
      5 x operation, all with possible-error=NvSWC_NvMService_AC3/E_NOT_OK:
        EraseBlock
        GetErrorStatus
          arg ErrorStatus: type=NvM_RequestResultType, direction=OUT, server-argument-impl-policy=USE-ARGUMENT-TYPE
        InvalidateNvBlock
        ReadBlock
          arg DstPtr: type=dtRef_VOID, direction=IN, server-argument-impl-policy=USE-ARGUMENT-TYPE
        WriteBlock
          arg SrcPtr: type=dtRef_const_VOID, direction=IN, server-argument-impl-policy=USE-ARGUMENT-TYPE
      error E_NOT_OK: error-code=1
    NvSWC_NvMService_AC3_Defs
      6 x operation, all with possible-error=NvSWC_NvMService_AC3_Defs/E_NOT_OK:
        EraseBlock
        GetErrorStatus
          arg ErrorStatus: type=NvM_RequestResultType, direction=OUT, server-argument-impl-policy=USE-ARGUMENT-TYPE
        InvalidateNvBlock
        ReadBlock
          arg DstPtr: type=dtRef_VOID, direction=IN, server-argument-impl-policy=USE-ARGUMENT-TYPE
        RestoreBlockDefaults
          arg DstPtr: type=dtRef_VOID, direction=IN, server-argument-impl-policy=USE-ARGUMENT-TYPE
        WriteBlock
          arg SrcPtr: type=dtRef_const_VOID, direction=IN, server-argument-impl-policy=USE-ARGUMENT-TYPE
      error E_NOT_OK: error-code=1
    NvSWC_NvMService_AC3_DS
      7 x operation, all with possible-error=NvSWC_NvMService_AC3_DS/E_NOT_OK:
        EraseBlock
        GetDataIndex
          arg DataIndex: type=uint8, direction=OUT, server-argument-impl-policy=USE-ARGUMENT-TYPE
        GetErrorStatus
          arg ErrorStatus: type=NvM_RequestResultType, direction=OUT, server-argument-impl-policy=USE-ARGUMENT-TYPE
        InvalidateNvBlock
        ReadBlock
          arg DstPtr: type=dtRef_VOID, direction=IN, server-argument-impl-policy=USE-ARGUMENT-TYPE
        SetDataIndex
          arg DataIndex: type=uint8, direction=IN, server-argument-impl-policy=USE-ARGUMENT-TYPE
        WriteBlock
          arg SrcPtr: type=dtRef_const_VOID, direction=IN, server-argument-impl-policy=USE-ARGUMENT-TYPE
      error E_NOT_OK: error-code=1
    NvSWC_NvMService_AC3_DS_Defs
      8 x operation, all with possible-error=NvSWC_NvMService_AC3_DS_Defs/E_NOT_OK:
        EraseBlock
        GetDataIndex
          arg DataIndex: type=uint8, direction=OUT, server-argument-impl-policy=USE-ARGUMENT-TYPE
        GetErrorStatus
          arg ErrorStatus: type=NvM_RequestResultType, direction=OUT, server-argument-impl-policy=USE-ARGUMENT-TYPE
        InvalidateNvBlock
        ReadBlock
          arg DstPtr: type=dtRef_VOID, direction=IN, server-argument-impl-policy=USE-ARGUMENT-TYPE
        RestoreBlockDefaults
          arg DstPtr: type=dtRef_VOID, direction=IN, server-argument-impl-policy=USE-ARGUMENT-TYPE
        SetDataIndex
          arg DataIndex: type=uint8, direction=IN, server-argument-impl-policy=USE-ARGUMENT-TYPE
        WriteBlock
          arg SrcPtr: type=dtRef_const_VOID, direction=IN, server-argument-impl-policy=USE-ARGUMENT-TYPE
      error E_NOT_OK: error-code=1
    NvSWC_NvMService_AC3_SRBS
      6 x operation, all with possible-error=NvSWC_NvMService_AC3_SRBS/E_NOT_OK:
        EraseBlock
        GetErrorStatus
          arg ErrorStatus: type=NvM_RequestResultType, direction=OUT, server-argument-impl-policy=USE-ARGUMENT-TYPE
        InvalidateNvBlock
        ReadBlock
          arg DstPtr: type=dtRef_VOID, direction=IN, server-argument-impl-policy=USE-ARGUMENT-TYPE
        SetRamBlockStatus
          arg RamBlockStatus: type=boolean, direction=IN, server-argument-impl-policy=USE-ARGUMENT-TYPE
        WriteBlock
          arg SrcPtr: type=dtRef_const_VOID, direction=IN, server-argument-impl-policy=USE-ARGUMENT-TYPE
      error E_NOT_OK: error-code=1
    NvSWC_NvMService_AC3_SRBS_Defs
      7 x operation, all with possible-error=NvSWC_NvMService_AC3_SRBS_Defs/E_NOT_OK:
        EraseBlock
        GetErrorStatus
          arg ErrorStatus: type=NvM_RequestResultType, direction=OUT, server-argument-impl-policy=USE-ARGUMENT-TYPE
        InvalidateNvBlock
        ReadBlock
          arg DstPtr: type=dtRef_VOID, direction=IN, server-argument-impl-policy=USE-ARGUMENT-TYPE
        RestoreBlockDefaults
          arg DstPtr: type=dtRef_VOID, direction=IN, server-argument-impl-policy=USE-ARGUMENT-TYPE
        SetRamBlockStatus
          arg RamBlockStatus: type=boolean, direction=IN, server-argument-impl-policy=USE-ARGUMENT-TYPE
        WriteBlock
          arg SrcPtr: type=dtRef_const_VOID, direction=IN, server-argument-impl-policy=USE-ARGUMENT-TYPE
      error E_NOT_OK: error-code=1
    NvSWC_NvMService_AC3_SRBS_DS
      8 x operation, all with possible-error=NvSWC_NvMService_AC3_SRBS_DS/E_NOT_OK:
        EraseBlock
        GetDataIndex
          arg DataIndex: type=uint8, direction=OUT, server-argument-impl-policy=USE-ARGUMENT-TYPE
        GetErrorStatus
          arg ErrorStatus: type=NvM_RequestResultType, direction=OUT, server-argument-impl-policy=USE-ARGUMENT-TYPE
        InvalidateNvBlock
        ReadBlock
          arg DstPtr: type=dtRef_VOID, direction=IN, server-argument-impl-policy=USE-ARGUMENT-TYPE
        SetDataIndex
          arg DataIndex: type=uint8, direction=IN, server-argument-impl-policy=USE-ARGUMENT-TYPE
        SetRamBlockStatus
          arg RamBlockStatus: type=boolean, direction=IN, server-argument-impl-policy=USE-ARGUMENT-TYPE
        WriteBlock
          arg SrcPtr: type=dtRef_const_VOID, direction=IN, server-argument-impl-policy=USE-ARGUMENT-TYPE
      error E_NOT_OK: error-code=1
    NvSWC_NvMService_AC3_SRBS_DS_Defs
      9 x operation, all with possible-error=NvSWC_NvMService_AC3_SRBS_DS_Defs/E_NOT_OK:
        EraseBlock
        GetDataIndex
          arg DataIndex: type=uint8, direction=OUT, server-argument-impl-policy=USE-ARGUMENT-TYPE
        GetErrorStatus
          arg ErrorStatus: type=NvM_RequestResultType, direction=OUT, server-argument-impl-policy=USE-ARGUMENT-TYPE
        InvalidateNvBlock
        ReadBlock
          arg DstPtr: type=dtRef_VOID, direction=IN, server-argument-impl-policy=USE-ARGUMENT-TYPE
        RestoreBlockDefaults
          arg DstPtr: type=dtRef_VOID, direction=IN, server-argument-impl-policy=USE-ARGUMENT-TYPE
        SetDataIndex
          arg DataIndex: type=uint8, direction=IN, server-argument-impl-policy=USE-ARGUMENT-TYPE
        SetRamBlockStatus
          arg RamBlockStatus: type=boolean, direction=IN, server-argument-impl-policy=USE-ARGUMENT-TYPE
        WriteBlock
          arg SrcPtr: type=dtRef_const_VOID, direction=IN, server-argument-impl-policy=USE-ARGUMENT-TYPE
      error E_NOT_OK: error-code=1
    NvSWC_NvMService_SRBS
      operation GetErrorStatus: possible-error=NvSWC_NvMService_SRBS/E_NOT_OK
        arg ErrorStatus: type=NvM_RequestResultType, direction=OUT, server-argument-impl-policy=USE-ARGUMENT-TYPE
      operation SetRamBlockStatus: possible-error=NvSWC_NvMService_SRBS/E_NOT_OK
        arg RamBlockStatus: type=boolean, direction=IN, server-argument-impl-policy=USE-ARGUMENT-TYPE
      error E_NOT_OK: error-code=1
package /Systems/ModeDeclarationGroups/BasePartialNetworks
  mode declaration group PWFVehicleState: category=ALPHABETIC_ORDER, initial-mode=PWFVehicleState/KEINE_KOMMUNIKATION
    mode KEINE_KOMMUNIKATION
    mode UNGUELTIG
  mode declaration group UNGUELTIG: category=ALPHABETIC_ORDER, initial-mode=UNGUELTIG/UNGUELTIG_OFF
    mode UNGUELTIG_OFF
    mode UNGUELTIG_ON
package /Systems/ModeDeclarationGroups/FunctionalPartialNetworks
  mode declaration group Ungueltig: category=ALPHABETIC_ORDER, initial-mode=Ungueltig/UNGUELTIG_OFF
    mode UNGUELTIG_OFF
    mode UNGUELTIG_ON
