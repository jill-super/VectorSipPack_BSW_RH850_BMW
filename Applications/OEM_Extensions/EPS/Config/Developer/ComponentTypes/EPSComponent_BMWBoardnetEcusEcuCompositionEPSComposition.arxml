AUTOSAR XML (schema 4-3-0)
package /BMW/Boardnet/Ecus/EcuComposition/EPSComposition
  composition sw component type EPSComponent
