AUTOSAR XML (schema 4-3-0)
package /BMW/Platform/Auth/SwcImplementations
  swc implementation ImplAuth: behavior=SwcAuthInternalBehavior
    code-descriptors:
      code Default: artifact-descriptors=autosar-engineering-object={short-label=Default, category=SWSRC}
package /BMW/Platform/Auth/SwComponentTypes
  application sw component type Auth
    behavior SwcAuthInternalBehavior
