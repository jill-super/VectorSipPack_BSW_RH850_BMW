AUTOSAR XML (schema 4-3-0)
package /ComponentTypes
  composition sw component type OEM_Extension_BMW
    component BMW_Application_Connector_Dummy: type=BMW_Application_Connector_Dummy
    component BMW_Application_Main: type=BMW_Application_Main
