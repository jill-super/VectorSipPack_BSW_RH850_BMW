AUTOSAR XML (schema 4-3-0)
package /ComponentTypes
  composition sw component type BMW_Core_Modules
    provide port FirstStartMode: mode-switch-sender-com-spec{enhanced-mode-api=false, mode-group=DlogFirstStartMode, mode-switched-ack=timeout=0, queue-length=1}, provided-interface=DlogFirstStartMode
    6 x component:
      Darh: type=Darh
      Dlog: type=Dlog
      Omc: type=Omc
      StdDiag: type=StdDiag
      Stm: type=Stm
      SysTime: type=SysTime
    connect Darh.ControlPort -> StdDiag.DarhControlPort
    connect Omc.LifeCycle -> Omc.LifeCycleLoopback
    connect Omc.extendedOperatingModeSwitchPort -> StdDiag.ExtendedOperatingModeControlModeAccessPort
    connect Omc.operatingModeSwitchPort -> StdDiag.OperatingModeControlModeAccessPort
    delegate Dlog.FirstStartMode <-> outer port FirstStartMode
