AUTOSAR XML (schema 4-3-0)
package /BMW/SystemComposition
  composition sw component type SystemComponent
    component OEM_Extension_BMW: type=OEM_Extension_BMW
package /BMW/SystemDescription/EndtoEndProtections
  end to end protection set EndToEndProtectionSet
    18 x end to end protection:
      e2e_ACLNY_MASSCNTR: end-to-end-profile={category=PROFILE_01, data-ids=[31, 31, 31, 31, 31, 31, 31, 31, 31, 31, 31, 31, 31, 31, 31, 31, 31, 31, 31, 31, 31, 31, 31, 31, 31, 31, 31, 31, 31], data-id-mode=0, data-length=48, max-delta-counter-init=14, crc-offset=0, counter-offset=8, data-id-nibble-offset=0}, end-to-end-protection-i-signal-i-pdu{data-offset=0, i-signal-group=e2eGrp_ACLNY_MASSCNTR, i-signal-i-pdu=ACLNY_MASSCNTR}
      e2e_AVL_FORC_GRD: end-to-end-profile={category=PROFILE_01, data-ids=[190, 190, 190, 190, 190, 190, 190, 190, 190, 190, 190, 190, 190, 190, 190, 190, 190, 190, 190, 190, 190, 190, 190, 190, 190, 190, 190, 190, 190], data-id-mode=0, data-length=40, max-delta-counter-init=14, crc-offset=0, counter-offset=8, data-id-nibble-offset=0}, end-to-end-protection-i-signal-i-pdu{data-offset=0, i-signal-group=e2eGrp_AVL_FORC_GRD, i-signal-i-pdu=AVL_FORC_GRD}
      e2e_AVL_PO_EPS: end-to-end-profile={category=PROFILE_01, data-ids=[186, 186, 186, 186, 186, 186, 186, 186, 186, 186, 186, 186, 186, 186, 186, 186, 186, 186, 186, 186, 186, 186, 186, 186, 186, 186, 186, 186, 186], data-id-mode=0, data-length=64, max-delta-counter-init=14, crc-offset=0, counter-offset=8, data-id-nibble-offset=0}, end-to-end-protection-i-signal-i-pdu{data-offset=0, i-signal-group=e2eGrp_AVL_PO_EPS, i-signal-i-pdu=AVL_PO_EPS}
      e2e_AVL_RPM_WHL: end-to-end-profile={category=PROFILE_01, data-ids=[17, 17, 17, 17, 17, 17, 17, 17, 17, 17, 17, 17, 17, 17, 17, 17, 17, 17, 17, 17, 17, 17, 17, 17, 17, 17, 17, 17, 17], data-id-mode=0, data-length=96, max-delta-counter-init=14, crc-offset=0, counter-offset=8, data-id-nibble-offset=0}, end-to-end-protection-i-signal-i-pdu{data-offset=0, i-signal-group=e2eGrp_AVL_RPM_WHL, i-signal-i-pdu=AVL_RPM_WHL}
      e2e_AVL_STMOM_DV_ACT: end-to-end-profile={category=PROFILE_01, data-ids=[108, 108, 108, 108, 108, 108, 108, 108, 108, 108, 108, 108, 108, 108, 108, 108, 108, 108, 108, 108, 108, 108, 108, 108, 108, 108, 108, 108, 108], data-id-mode=0, data-length=32, max-delta-counter-init=14, crc-offset=0, counter-offset=8, data-id-nibble-offset=0}, end-to-end-protection-i-signal-i-pdu{data-offset=0, i-signal-group=e2eGrp_AVL_STMOM_DV_ACT, i-signal-i-pdu=AVL_STMOM_DV_ACT}
      e2e_CON_VEH: end-to-end-profile={category=PROFILE_01, data-ids=[197, 197, 197, 197, 197, 197, 197, 197, 197, 197, 197, 197, 197, 197, 197, 197, 197, 197, 197, 197, 197, 197, 197, 197, 197, 197, 197, 197, 197], data-id-mode=0, data-length=64, max-delta-counter-init=14, crc-offset=0, counter-offset=8, data-id-nibble-offset=0}, end-to-end-protection-i-signal-i-pdu{data-offset=0, i-signal-group=e2eGrp_CON_VEH, i-signal-i-pdu=CON_VEH}
      e2e_DISP_CC_EPS: end-to-end-profile={category=PROFILE_01, data-ids=[3148, 3148, 3148, 3148, 3148, 3148, 3148, 3148, 3148, 3148, 3148, 3148, 3148, 3148, 3148, 3148, 3148, 3148, 3148, 3148, 3148, 3148, 3148, 3148, 3148, 3148, 3148, 3148, 3148], data-id-mode=3, data-length=40, max-delta-counter-init=14, crc-offset=0, counter-offset=8, data-id-nibble-offset=12}, end-to-end-protection-i-signal-i-pdu{data-offset=0, i-signal-group=e2eGrp_DISP_CC_EPS, i-signal-i-pdu=DISP_CC_EPS}
      e2e_DT_EST: end-to-end-profile={category=PROFILE_01, data-ids=[230, 230, 230, 230, 230, 230, 230, 230, 230, 230, 230, 230, 230, 230, 230, 230, 230, 230, 230, 230, 230, 230, 230, 230, 230, 230, 230, 230, 230], data-id-mode=0, data-length=128, max-delta-counter-init=14, crc-offset=0, counter-offset=8, data-id-nibble-offset=0}, end-to-end-protection-i-signal-i-pdu{data-offset=0, i-signal-group=e2eGrp_DT_EST, i-signal-i-pdu=DT_EST}
      e2e_ENERG_DGR_DRDY: end-to-end-profile={category=PROFILE_01, data-ids=[56, 56, 56, 56, 56, 56, 56, 56, 56, 56, 56, 56, 56, 56, 56, 56, 56, 56, 56, 56, 56, 56, 56, 56, 56, 56, 56, 56, 56], data-id-mode=0, data-length=64, max-delta-counter-init=14, crc-offset=56, counter-offset=52, data-id-nibble-offset=0}, end-to-end-protection-i-signal-i-pdu{data-offset=0, i-signal-group=e2eGrp_ENERG_DGR_DRDY, i-signal-i-pdu=ENERG_DGR_DRDY}
      e2e_ENSU_SFY: end-to-end-profile={category=PROFILE_01, data-ids=[628, 628, 628, 628, 628, 628, 628, 628, 628, 628, 628, 628, 628, 628, 628, 628, 628, 628, 628, 628, 628, 628, 628, 628, 628, 628, 628, 628, 628], data-id-mode=3, data-length=64, max-delta-counter-init=14, crc-offset=0, counter-offset=8, data-id-nibble-offset=12}, end-to-end-protection-i-signal-i-pdu{data-offset=0, i-signal-group=e2eGrp_ENSU_SFY, i-signal-i-pdu=ENSU_SFY}
      e2e_OFFS_QUAD_EPS: end-to-end-profile={category=PROFILE_01, data-ids=[229, 229, 229, 229, 229, 229, 229, 229, 229, 229, 229, 229, 229, 229, 229, 229, 229, 229, 229, 229, 229, 229, 229, 229, 229, 229, 229, 229, 229], data-id-mode=0, data-length=40, max-delta-counter-init=14, crc-offset=0, counter-offset=8, data-id-nibble-offset=0}, end-to-end-protection-i-signal-i-pdu{data-offset=0, i-signal-group=e2eGrp_OFFS_QUAD_EPS, i-signal-i-pdu=OFFS_QUAD_EPS}
      e2e_ST_EST: end-to-end-profile={category=PROFILE_01, data-ids=[112, 112, 112, 112, 112, 112, 112, 112, 112, 112, 112, 112, 112, 112, 112, 112, 112, 112, 112, 112, 112, 112, 112, 112, 112, 112, 112, 112, 112], data-id-mode=0, data-length=40, max-delta-counter-init=14, crc-offset=0, counter-offset=8, data-id-nibble-offset=0}, end-to-end-protection-i-signal-i-pdu{data-offset=0, i-signal-group=e2eGrp_ST_EST, i-signal-i-pdu=ST_EST}
      e2e_SU_EPS: end-to-end-profile={category=PROFILE_01, data-ids=[131, 131, 131, 131, 131, 131, 131, 131, 131, 131, 131, 131, 131, 131, 131, 131, 131, 131, 131, 131, 131, 131, 131, 131, 131, 131, 131, 131, 131], data-id-mode=0, data-length=64, max-delta-counter-init=14, crc-offset=56, counter-offset=52, data-id-nibble-offset=0}, end-to-end-protection-i-signal-i-pdu{data-offset=0, i-signal-group=e2eGrp_SU_EPS, i-signal-i-pdu=SU_EPS}
      e2e_TAR_ESTP_VIRT_FTAX: end-to-end-profile={category=PROFILE_01, data-ids=[52, 52, 52, 52, 52, 52, 52, 52, 52, 52, 52, 52, 52, 52, 52, 52, 52, 52, 52, 52, 52, 52, 52, 52, 52, 52, 52, 52, 52], data-id-mode=0, data-length=64, max-delta-counter-init=14, crc-offset=0, counter-offset=8, data-id-nibble-offset=0}, end-to-end-protection-i-signal-i-pdu{data-offset=0, i-signal-group=e2eGrp_TAR_ESTP_VIRT_FTAX, i-signal-i-pdu=TAR_ESTP_VIRT_FTAX}
      e2e_TAR_QTA_STRMOM_DV: end-to-end-profile={category=PROFILE_01, data-ids=[109, 109, 109, 109, 109, 109, 109, 109, 109, 109, 109, 109, 109, 109, 109, 109, 109, 109, 109, 109, 109, 109, 109, 109, 109, 109, 109, 109, 109], data-id-mode=0, data-length=64, max-delta-counter-init=14, crc-offset=0, counter-offset=8, data-id-nibble-offset=0}, end-to-end-protection-i-signal-i-pdu{data-offset=0, i-signal-group=e2eGrp_TAR_QTA_STRMOM_DV, i-signal-i-pdu=TAR_QTA_STRMOM_DV}
      e2e_TAR_STMOM_DV_ACT: end-to-end-profile={category=PROFILE_01, data-ids=[179, 179, 179, 179, 179, 179, 179, 179, 179, 179, 179, 179, 179, 179, 179, 179, 179, 179, 179, 179, 179, 179, 179, 179, 179, 179, 179, 179, 179], data-id-mode=0, data-length=64, max-delta-counter-init=14, crc-offset=0, counter-offset=8, data-id-nibble-offset=0}, end-to-end-protection-i-signal-i-pdu{data-offset=0, i-signal-group=e2eGrp_TAR_STMOM_DV_ACT, i-signal-i-pdu=TAR_STMOM_DV_ACT}
      e2e_V_VEH: end-to-end-profile={category=PROFILE_01, data-ids=[12, 12, 12, 12, 12, 12, 12, 12, 12, 12, 12, 12, 12, 12, 12, 12, 12, 12, 12, 12, 12, 12, 12, 12, 12, 12, 12, 12, 12], data-id-mode=0, data-length=40, max-delta-counter-init=14, crc-offset=0, counter-offset=8, data-id-nibble-offset=0}, end-to-end-protection-i-signal-i-pdu{data-offset=0, i-signal-group=e2eGrp_V_VEH, i-signal-i-pdu=V_VEH}
      e2e_VYAW_VEH: end-to-end-profile={category=PROFILE_01, data-ids=[14, 14, 14, 14, 14, 14, 14, 14, 14, 14, 14, 14, 14, 14, 14, 14, 14, 14, 14, 14, 14, 14, 14, 14, 14, 14, 14, 14, 14], data-id-mode=0, data-length=48, max-delta-counter-init=14, crc-offset=0, counter-offset=8, data-id-nibble-offset=0}, end-to-end-protection-i-signal-i-pdu{data-offset=0, i-signal-group=e2eGrp_VYAW_VEH, i-signal-i-pdu=VYAW_VEH}
package /BMW/SystemDescription/Systems
  system Systems_SOLITAER_A_FlexRay_EPS: category=SYSTEM_EXTRACT
    system mapping Systems_SOLITAER_A_FlexRay_EPS_MPPNG
    root-software-compositions:
      root sw composition prototype SystemComponentPrototype: software-composition=SystemComponent
