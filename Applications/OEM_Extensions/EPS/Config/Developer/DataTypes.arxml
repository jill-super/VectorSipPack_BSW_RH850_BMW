AUTOSAR XML (schema 4-3-0)
standard types defined: void, UINT32
package /AUTOSAR_Platform/DataContr
  range booleanDataContr: raw 0..1
  range float32DataContr: raw >-INF..<INF
  range float64DataContr: raw >-INF..<INF
  range sint16DataContr: raw -32768..32767
  range sint32DataContr: raw -2147483648..2147483647
  range sint8DataContr: raw -128..127
  range uint16DataContr: raw 0..65535
  range uint32DataContr: raw 0..4294967295
  range uint8DataContr: raw 0..255
package /BMW/Boardnet/CodingDatatypes/CompuMethodsForBoardnet
  compu method ACLNY_COG: phys=raw*0.002-65 for raw 32500..32532500  # Codierung zu überarbeiten. Transp.MOST-GW-Migration, 01.09.2006: Zusammenführung der Signalklasse Querbeschleunigung_Schwerpunkt [1] mit den Parametern LateralAccelerationMassCenter [1].
  compu method ACLNY_COG_ERR_AMP: phys=raw*0.005 for raw 0..800000
  compu method ACTVN_FN_ESTP_VIRT_FTAX: 0=FunktionVirtuellerEndanschlagDeaktivieren (ACTVN_FN_ESTP_VIRT_FTAX_FunktionVirtuellerEndanschlagDeaktivieren) (BNE original name: Funktion virtueller Endanschlag deaktivieren), 1=FunktionVirtuellerEndanschlagAktivieren (ACTVN_FN_ESTP_VIRT_FTAX_FunktionVirtuellerEndanschlagAktivieren) (BNE original name: Funktion virtueller Endanschlag aktivieren), 13=Funktionsschnittstelle_ist_nicht_verfuegbar (ACTVN_FN_ESTP_VIRT_FTAX_Funktionsschnittstelle_ist_nicht_verfuegbar) (Sendefunktion in Betrieb, Werte nicht verfügbar), 14=Funktion_meldet_Fehler (ACTVN_FN_ESTP_VIRT_FTAX_Funktion_meldet_Fehler) (Sendefunktion in Betrieb, meldet Fehler), 15=Signal_unbefuellt (ACTVN_FN_ESTP_VIRT_FTAX_Signal_unbefuellt) (Sendefunktion nicht in Betrieb)
  compu method ALIV_4_BIT_UInt: identical
  compu method ALIV_COU_4: 0=Zaehlerstand0DotDotE (ALIV_COU_4_Zaehlerstand0DotDotE) (BNE original name: Zählerstand 0..E), 15=SignalUngueltig (ALIV_COU_4_SignalUngueltig) (BNE original name: Signal ungültig)
  compu method ALIV_COU_V: 0=Zaehlerstand0DotDotE (ALIV_COU_V_Zaehlerstand0DotDotE) (BNE original name: Zählerstand 0..E), 15=SignalUngueltig (ALIV_COU_V_SignalUngueltig) (BNE original name: Signal ungültig)  # Transp.MOST-GW-Migration, 01.09.2006: Zusammenführung der Signalklasse Alive_Zähler_Geschwindigkeit [1] mit den Parametern AliveSpeed [1].
  compu method AVL_FORC_GRD: phys=raw*0.0084-17 for raw 2023.8095238095239..483883.2199546486; unit kN
  compu method AVL_PINA_EPS: phys=raw*0.0439453125-1439.956055 for raw 32767..1524029.5777777778
  compu method AVL_PINA_IDX_ICM: phys=raw*0.0439453125-1439.956055 for raw 32767..1524029.5777777778
  compu method AVL_PWR_EL: phys=raw*0.1-12 for raw 120..2520; unit kW
  compu method AVL_RPM_WHL: phys=raw/64-511.984375 for raw 491455..3768255
  compu method AVL_STEA_PNI_OFFS: phys=raw*0.021994-45 for raw 2046.0125488769665..188097.8947783001, 4093=Funktionsschnittstelle_ist_nicht_verfuegbar (AVL_STEA_PNI_OFFS_Funktionsschnittstelle_ist_nicht_verfuegbar) (Signal Tag - Schnittstelle ist nicht verfügbar), 4094=Funktion_meldet_Fehler (AVL_STEA_PNI_OFFS_Funktion_meldet_Fehler) (Signal Tag - Funktion meldet Fehler), 4095=Signal_unbefuellt (AVL_STEA_PNI_OFFS_Signal_unbefuellt) (Signal Tag - Signal ist unbefüllt)
  compu method CHL_4_UInt: identical
  compu method COU_BS_RESP: identical
  compu method CRC_V_VEH: identical  # Standartabsicherung Apllikations-CRC. Transp.MOST-GW-Migration, 01.09.2006: Zusammenführung der Signalklasse CRC_Geschwindigkeit_Fahrzeug [1] mit den Parametern ChecksumSpeedCRC [1].
  compu method CTR_DEAC_EPS_FNS: mask 15: 0=Keine_Deaktivierung_EPS_Funktionen (CTR_DEAC_EPS_FNS_Keine_Deaktivierung_EPS_Funktionen) (Es besteht keine Anforderung zur Deaktivierung von Funktionen auf der EPS.), mask 15: 13=Funktionsschnittstelle_ist_nicht_verfuegbar (CTR_DEAC_EPS_FNS_Funktionsschnittstelle_ist_nicht_verfuegbar) (Sendefunktion in Betrieb, Werte nicht verfügbar), mask 15: 14=Funktion_meldet_Fehler (CTR_DEAC_EPS_FNS_Funktion_meldet_Fehler) (Sendefunktion in Betrieb, meldet Fehler), mask 15: 15=Signal_unbefuellt (CTR_DEAC_EPS_FNS_Signal_unbefuellt) (Wird nicht aktiv gesetzt), mask 9: 1=Deaktivierung_EPS_Funktionen_Funktionsgruppe_1 (CTR_DEAC_EPS_FNS_Deaktivierung_EPS_Funktionen_Funktionsgruppe_1) (BNE original name: Deaktivierung_EPS_Funktionen_ Funktionsgruppe_1), mask 10: 2=Deaktivierung_EPS_Funktionen_Funktionsgruppe_2 (CTR_DEAC_EPS_FNS_Deaktivierung_EPS_Funktionen_Funktionsgruppe_2) (BNE original name: Deaktivierung_EPS_Funktionen_ Funktionsgruppe_2)
  compu method CTR_ERRM_BN_U: mask 33: 0=KeineUnterspannungNormalbetrieb (CTR_ERRM_BN_U_KeineUnterspannungNormalbetrieb) (BNE original name: Keine Unterspannung Normalbetrieb), mask 33: 1=UnterspannungNormalbetrieb (CTR_ERRM_BN_U_UnterspannungNormalbetrieb) (BNE original name: Unterspannung Normalbetrieb), mask 34: 0=KeineUnterspannungMSA_Start (CTR_ERRM_BN_U_KeineUnterspannungMSA_Start) (BNE original name: Keine Unterspannung MSA-Start), mask 34: 2=UnterspannungMSA_Start (CTR_ERRM_BN_U_UnterspannungMSA_Start) (BNE original name: Unterspannung MSA-Start), mask 36: 0=KeineUeberspannung (CTR_ERRM_BN_U_KeineUeberspannung) (BNE original name: Keine Überspannung), mask 36: 4=Ueberspannung (CTR_ERRM_BN_U_Ueberspannung) (BNE original name: Überspannung), mask 63: 61=Funktionsschnittstelle_ist_nicht_verfuegbar (CTR_ERRM_BN_U_Funktionsschnittstelle_ist_nicht_verfuegbar) (Sendefunktion in Betrieb, Werte nicht verfügbar), mask 63: 62=Funktion_meldet_Fehler (CTR_ERRM_BN_U_Funktion_meldet_Fehler) (Sendefunktion in Betrieb, meldet Fehler), mask 63: 63=Signal_unbefuellt (CTR_ERRM_BN_U_Signal_unbefuellt) (Sendefunktion nicht in Betrieb)
  compu method CTR_WARN_DIR_VIB_EPS: 0=Keine_Richtung (CTR_WARN_DIR_VIB_EPS_Keine_Richtung) (Ungerichteter Impuls Diese Codierung wird auch versendet, wenn keine haptische Warnung erfolgt.), 1=Richtung_links (CTR_WARN_DIR_VIB_EPS_Richtung_links) (Impuls Richtung links), 2=Richtung_rechts (CTR_WARN_DIR_VIB_EPS_Richtung_rechts) (Impuls Richtung rechts), 3=Signal_unbefuellt (CTR_WARN_DIR_VIB_EPS_Signal_unbefuellt) (Sendefunktion nicht in Betrieb)
  compu method CTR_WARN_ILVL_VIB_EPS: 0=Intensitaetsstufe_0 (CTR_WARN_ILVL_VIB_EPS_Intensitaetsstufe_0) (Diese Codierung wird auch verwendet, wenn keine haptische Warnung erfolgt.), 1=Intensitaetsstufe_1 (CTR_WARN_ILVL_VIB_EPS_Intensitaetsstufe_1), 2=Intensitaetsstufe_2 (CTR_WARN_ILVL_VIB_EPS_Intensitaetsstufe_2), 3=Intensitaetsstufe_3 (CTR_WARN_ILVL_VIB_EPS_Intensitaetsstufe_3), 4=Intensitaetsstufe_4 (CTR_WARN_ILVL_VIB_EPS_Intensitaetsstufe_4), 5=Intensitaetsstufe_5 (CTR_WARN_ILVL_VIB_EPS_Intensitaetsstufe_5), 6=Intensitaetsstufe_6 (CTR_WARN_ILVL_VIB_EPS_Intensitaetsstufe_6), 7=Intensitaetsstufe_7 (CTR_WARN_ILVL_VIB_EPS_Intensitaetsstufe_7), 8=Intensitaetsstufe_8 (CTR_WARN_ILVL_VIB_EPS_Intensitaetsstufe_8), 9=Intensitaetsstufe_9 (CTR_WARN_ILVL_VIB_EPS_Intensitaetsstufe_9), 10=Intensitaetsstufe_10 (CTR_WARN_ILVL_VIB_EPS_Intensitaetsstufe_10), 11=Intensitaetsstufe_11 (CTR_WARN_ILVL_VIB_EPS_Intensitaetsstufe_11), 12=Intensitaetsstufe_12 (CTR_WARN_ILVL_VIB_EPS_Intensitaetsstufe_12), 13=Reserviert (CTR_WARN_ILVL_VIB_EPS_Reserviert) (Hinweis: Reserviert für funktionale Kennung Signal-Tag.), 14=Reserviert_bne_F5E488CE22EB4069AA18D5B18C674FB7_14 (CTR_WARN_ILVL_VIB_EPS_Reserviert_bne_F5E488CE22EB4069AA18D5B18C674FB7_14) (BNE original name: Reserviert), 15=Signal_unbefuellt (CTR_WARN_ILVL_VIB_EPS_Signal_unbefuellt) (Sendefunktion nicht in Betrieb)
  compu method CTR_WARN_PTRN_VIB_EPS: 0=Keine_haptische_Warnung (CTR_WARN_PTRN_VIB_EPS_Keine_haptische_Warnung), 1=Muster_1 (CTR_WARN_PTRN_VIB_EPS_Muster_1), 2=Muster_2 (CTR_WARN_PTRN_VIB_EPS_Muster_2), 3=Muster_3 (CTR_WARN_PTRN_VIB_EPS_Muster_3), 4=Muster_4 (CTR_WARN_PTRN_VIB_EPS_Muster_4), 5=Muster_5 (CTR_WARN_PTRN_VIB_EPS_Muster_5), 6=Muster_6 (CTR_WARN_PTRN_VIB_EPS_Muster_6), 7=Muster_7 (CTR_WARN_PTRN_VIB_EPS_Muster_7), 8=Muster_8 (CTR_WARN_PTRN_VIB_EPS_Muster_8), 9=Muster_9 (CTR_WARN_PTRN_VIB_EPS_Muster_9), 10=Muster_10 (CTR_WARN_PTRN_VIB_EPS_Muster_10), 13=Funktionsschnittstelle_ist_nicht_verfuegbar (CTR_WARN_PTRN_VIB_EPS_Funktionsschnittstelle_ist_nicht_verfuegbar) (Sendefunktion in Betrieb, Werte nicht verfügbar), 14=Funktion_meldet_Fehler (CTR_WARN_PTRN_VIB_EPS_Funktion_meldet_Fehler) (Sendefunktion in Betrieb, meldet Fehler), 15=Signal_unbefuellt (CTR_WARN_PTRN_VIB_EPS_Signal_unbefuellt) (Sendefunktion nicht in Betrieb)
  compu method DBG_8Bit: identical
  compu method DIAG_ST_OBD: identical
  compu method DVCO_VEH: 0=FahrzeugSteht (DVCO_VEH_FahrzeugSteht) (BNE original name: Fahrzeug steht), 1=FahrzeugFaehrtVorwaerts (DVCO_VEH_FahrzeugFaehrtVorwaerts) (BNE original name: Fahrzeug fährt vorwärts), 2=FahrzeugFaehrtRueckwaerts (DVCO_VEH_FahrzeugFaehrtRueckwaerts) (BNE original name: Fahrzeug fährt rückwärts), 3=FahrzeugFaehrt (DVCO_VEH_FahrzeugFaehrt) (BNE original name: Fahrzeug fährt), 4=FahrzeugStehtHinterachseAufRollenpruefstandErkannt (DVCO_VEH_FahrzeugStehtHinterachseAufRollenpruefstandErkannt) (BNE original name: Fahrzeug steht, Hinterachse auf Rollenprüfstand erkannt), 5=FahrzeugStehtZwei_Achs_RollenbetriebGesetzt (DVCO_VEH_FahrzeugStehtZwei_Achs_RollenbetriebGesetzt) (BNE original name: Fahrzeug steht, Zwei-Achs-Rollenbetrieb gesetzt), 6=FahrzeugStehtVorderachseAufRollenpruefstandErkannt (DVCO_VEH_FahrzeugStehtVorderachseAufRollenpruefstandErkannt) (BNE original name: Fahrzeug steht, Vorderachse auf Rollenprüfstand erkannt), 7=SignalUngueltig (DVCO_VEH_SignalUngueltig) (BNE original name: Signal ungültig)
  compu method FACT_ASS_STMOM_FTAX: phys=raw/256+1 for raw -256..64768
  compu method FACT_CTRR_STMOM_FTAX: phys=raw/256+0.0078125 for raw -2..65022
  compu method FACT_DMPNG_ADDON_STMOM_FTAX: phys=raw/64 for raw 0..8192, 253=Reserviert (FACT_DMPNG_ADDON_STMOM_FTAX_Reserviert) (Hinweis: Reserviert für funktionale Kennung Signal-Tag.), 254=Reserviert_bne_5B8A124DE2884D68A663388C50F241EF_254 (FACT_DMPNG_ADDON_STMOM_FTAX_Reserviert_bne_5B8A124DE2884D68A663388C50F241EF_254) (BNE original name: Reserviert), 255=Signal_unbefuellt (FACT_DMPNG_ADDON_STMOM_FTAX_Signal_unbefuellt) (Sendefunktion nicht in Betrieb)
  compu method FACT_MO_STE_SO_DXP: phys=raw*0.02 for raw 0..12500, 253=Funktionsschnittstelle_ist_nicht_verfuegbar (FACT_MO_STE_SO_DXP_Funktionsschnittstelle_ist_nicht_verfuegbar) (Sendefunktion in Betrieb, Werte nicht verfügbar), 254=Funktion_meldet_Fehler (FACT_MO_STE_SO_DXP_Funktion_meldet_Fehler) (Sendefunktion in Betrieb, meldet Fehler), 255=Signal_unbefuellt (FACT_MO_STE_SO_DXP_Signal_unbefuellt) (Sendefunktion nicht in Betrieb)
  compu method I_SPEC_ARS: phys=raw for raw 0..252, 253=Funktionsschnittstelle_ist_nicht_verfuegbar (I_SPEC_ARS_Funktionsschnittstelle_ist_nicht_verfuegbar) (Sendefunktion in Betrieb, Werte nicht verfügbar), 254=Funktion_meldet_Fehler (I_SPEC_ARS_Funktion_meldet_Fehler) (Nutzsignal kann nicht berechnet werden), 255=Signal_unbefuellt (I_SPEC_ARS_Signal_unbefuellt) (Sendefunktion nicht in Betrieb); unit A
  compu method ID_FN_INQY: 41216=BedienungTastenEntertainment (ID_FN_INQY_BedienungTastenEntertainment) (BNE original name: Bedienung Tasten Entertainment), 62976=SteuerungAussenspiegel (ID_FN_INQY_SteuerungAussenspiegel) (BNE original name: Steuerung Außenspiegel), 57857=SicherFahrgestellnummer (ID_FN_INQY_SicherFahrgestellnummer) (BNE original name: Sicher Fahrgestellnummer), 9730=Regensensor_Wischergeschwindigkeit (ID_FN_INQY_Regensensor_Wischergeschwindigkeit) (BNE original name: Regensensor-Wischergeschwindigkeit), 14850=StatusFunkschluessel (ID_FN_INQY_StatusFunkschluessel) (BNE original name: Status Funkschlüssel), 26370=BedienungTastgeberBedienelementFront (ID_FN_INQY_BedienungTastgeberBedienelementFront) (BNE original name: Bedienung Tastgeber Bedienelement Front), 32258=StatusVerdeckCabrio (ID_FN_INQY_StatusVerdeckCabrio) (BNE original name: Status Verdeck Cabrio), 36866=StatusSchluesselSuche (ID_FN_INQY_StatusSchluesselSuche) (BNE original name: Status Schlüssel Suche), 58882=StatusKlimaLuftverteilungFA (ID_FN_INQY_StatusKlimaLuftverteilungFA) (BNE original name: Status Klima Luftverteilung FA), 59906=StatusKlimaLuftverteilungBF (ID_FN_INQY_StatusKlimaLuftverteilungBF) (BNE original name: Status Klima Luftverteilung BF), 60418=StatusKlimaSHSlashZHZusatzwasserpumpe (ID_FN_INQY_StatusKlimaSHSlashZHZusatzwasserpumpe) (BNE original name: Status Klima SH/ZH Zusatzwasserpumpe), 60930=StatusKlimaZusatzprogramme (ID_FN_INQY_StatusKlimaZusatzprogramme) (BNE original name: Status Klima Zusatzprogramme), 61442=StatusKlimaStandfunktionen (ID_FN_INQY_StatusKlimaStandfunktionen) (BNE original name: Status Klima Standfunktionen), 63234=EinheitenBN2020 (ID_FN_INQY_EinheitenBN2020) (BNE original name: Einheiten BN2020), 63490=UhrzeitSlashDatum (ID_FN_INQY_UhrzeitSlashDatum) (BNE original name: Uhrzeit/Datum), 3843=StatusServiceCallTeleX (ID_FN_INQY_StatusServiceCallTeleX) (BNE original name: Status Service Call TeleX), 4867=StatusServiceCallTeleservice (ID_FN_INQY_StatusServiceCallTeleservice) (BNE original name: Status Service Call Teleservice), 12803=VerbrauchInformationDaten (ID_FN_INQY_VerbrauchInformationDaten) (BNE original name: Verbrauch Information Daten), 13827=AnzeigeCheckcontrol_Meldung_Rolle_ (ID_FN_INQY_AnzeigeCheckcontrol_Meldung_Rolle_) (BNE original name: Anzeige Checkcontrol-Meldung (Rolle)), 14851=StatusMonitorFront (ID_FN_INQY_StatusMonitorFront) (BNE original name: Status Monitor Front), 16643=StatusKartendaten (ID_FN_INQY_StatusKartendaten) (BNE original name: Status Kartendaten), 23555=StatusBordcomputerBN2020 (ID_FN_INQY_StatusBordcomputerBN2020) (BNE original name: Status Bordcomputer BN2020), 24579=DatenBordcomputer_Fahrtbeginn_ (ID_FN_INQY_DatenBordcomputer_Fahrtbeginn_) (BNE original name: Daten Bordcomputer (Fahrtbeginn)), 32771=Fahrgestellnummer (ID_FN_INQY_Fahrgestellnummer), 33027=ElektronischerMotoroelmessstab (ID_FN_INQY_ElektronischerMotoroelmessstab) (BNE original name: Elektronischer Motorölmessstab), 34819=Fahrzeugtyp (ID_FN_INQY_Fahrzeugtyp), 38147=CodierungPowermanagement (ID_FN_INQY_CodierungPowermanagement) (BNE original name: Codierung Powermanagement), 40451=Bedienung_Uhrzeit_Datum (ID_FN_INQY_Bedienung_Uhrzeit_Datum), 43523=Bedienung_Uhrzeit_Datum_UTC (ID_FN_INQY_Bedienung_Uhrzeit_Datum_UTC), 43779=Bedienung_Datum_Winterzeit_Sommerzeit (ID_FN_INQY_Bedienung_Datum_Winterzeit_Sommerzeit), 46595=PositionFensterheberFAT (ID_FN_INQY_PositionFensterheberFAT) (BNE original name: Position Fensterheber FAT), 46851=PositionFensterheberFATH (ID_FN_INQY_PositionFensterheberFATH) (BNE original name: Position Fensterheber FATH), 47107=PositionFensterheberBFT (ID_FN_INQY_PositionFensterheberBFT) (BNE original name: Position Fensterheber BFT), 47363=PositionFensterheberBFTH (ID_FN_INQY_PositionFensterheberBFTH) (BNE original name: Position Fensterheber BFTH), 47619=PositionSHD (ID_FN_INQY_PositionSHD) (BNE original name: Position SHD), 48131=PositionFensterheberSicherheitsfahrzeug (ID_FN_INQY_PositionFensterheberSicherheitsfahrzeug) (BNE original name: Position Fensterheber Sicherheitsfahrzeug), 48899=PositionFensterheberHeckscheibe (ID_FN_INQY_PositionFensterheberHeckscheibe) (BNE original name: Position Fensterheber Heckscheibe), 49155=KonfigurationFAS (ID_FN_INQY_KonfigurationFAS) (BNE original name: Konfiguration FAS), 49411=KonfigurationBFS (ID_FN_INQY_KonfigurationBFS) (BNE original name: Konfiguration BFS), 49667=KonfigurationFASH (ID_FN_INQY_KonfigurationFASH) (BNE original name: Konfiguration FASH), 49923=KonfigurationBFSH (ID_FN_INQY_KonfigurationBFSH) (BNE original name: Konfiguration BFSH), 53251=StatusSpurverlassenswarnsystemCKM (ID_FN_INQY_StatusSpurverlassenswarnsystemCKM) (BNE original name: Status Spurverlassenswarnsystem CKM), 54531=StatusZentralverriegelungCKM (ID_FN_INQY_StatusZentralverriegelungCKM) (BNE original name: Status Zentralverriegelung CKM), 55043=StatusDWACKM (ID_FN_INQY_StatusDWACKM) (BNE original name: Status DWA CKM), 56067=StatusMemorypositionenCKM (ID_FN_INQY_StatusMemorypositionenCKM) (BNE original name: Status Memorypositionen CKM), 56579=StatusLichtCKM (ID_FN_INQY_StatusLichtCKM) (BNE original name: Status Licht CKM), 57603=StatusALCCKM (ID_FN_INQY_StatusALCCKM) (BNE original name: Status ALC CKM), 58115=StatusHeckklappeCKM (ID_FN_INQY_StatusHeckklappeCKM) (BNE original name: Status Heckklappe CKM), 60163=GrenzwerteSchwenkLinks (ID_FN_INQY_GrenzwerteSchwenkLinks) (BNE original name: Grenzwerte Schwenk Links), 60419=GrenzwerteSchwenkRechts (ID_FN_INQY_GrenzwerteSchwenkRechts) (BNE original name: Grenzwerte Schwenk Rechts), 61699=StatusLichtErweitertCKM (ID_FN_INQY_StatusLichtErweitertCKM) (BNE original name: Status Licht Erweitert CKM), 9731=WirkungsgradInformationData (ID_FN_INQY_WirkungsgradInformationData) (BNE original name: Wirkungsgrad Information Data), 10243=RelativzeitBN2020 (ID_FN_INQY_RelativzeitBN2020) (BNE original name: Relativzeit BN2020), 3588=GPS_Datum_CAN (ID_FN_INQY_GPS_Datum_CAN), 3844=GPS_Uhrzeit_CAN (ID_FN_INQY_GPS_Uhrzeit_CAN), 6660=StatusKonfigurationKombi4 (ID_FN_INQY_StatusKonfigurationKombi4) (BNE original name: Status Konfiguration Kombi 4), 9220=StatusKonfigurationKombi (ID_FN_INQY_StatusKonfigurationKombi) (BNE original name: Status Konfiguration Kombi), 9988=KonfigurationDSC (ID_FN_INQY_KonfigurationDSC) (BNE original name: Konfiguration DSC), 11780=StatusM_Drive2 (ID_FN_INQY_StatusM_Drive2) (BNE original name: Status M-Drive 2), 13316=KonfigurationEPS (ID_FN_INQY_KonfigurationEPS) (BNE original name: Konfiguration EPS), 13572=MessungMotoroel (ID_FN_INQY_MessungMotoroel) (BNE original name: Messung Motoröl), 16132=IdentifikationsnummerSensorcluster (ID_FN_INQY_IdentifikationsnummerSensorcluster) (BNE original name: Identifikationsnummer Sensorcluster), 16642=Status_Hindernis_Tuer (ID_FN_INQY_Status_Hindernis_Tuer), 65535=Signal_unbefuellt (ID_FN_INQY_Signal_unbefuellt), 65533=Reserviert_nicht_verfuegbar (ID_FN_INQY_Reserviert_nicht_verfuegbar) (Hinweis: Reserviert für funktionale Kennung Signal-Tag "Funktionsschnittstelle_ist_nicht_verfuegbar"), 65534=Reserviert_Fehler (ID_FN_INQY_Reserviert_Fehler) (Hinweis: Reserviert für funktionale Kennung Signal-Tag "Funktion_meldet_Fehler")  # Enthält den Identifier der angefragten Nachricht. Es sind nur die Identifier erlaubt, die als anfragbare Nachrichten definiert sind.
  compu method ID_FN_RQ_STG_EFAN: 1=AFS_Anforderung (ID_FN_RQ_STG_EFAN_AFS_Anforderung) (BNE original name: AFS-Anforderung), 2=EPS_Anforderung (ID_FN_RQ_STG_EFAN_EPS_Anforderung) (BNE original name: EPS-Anforderung), 3=DSC_Anforderung (ID_FN_RQ_STG_EFAN_DSC_Anforderung) (BNE original name: DSC-Anforderung), 4=Servotronic_Anforderung (ID_FN_RQ_STG_EFAN_Servotronic_Anforderung) (BNE original name: Servotronic-Anforderung), 255=SignalUngueltig (ID_FN_RQ_STG_EFAN_SignalUngueltig) (BNE original name: Signal ungültig)  # Automatisch generiert (Migration 2004-10-30)
  compu method ID_TEMP_CPO_HET_MNG: 1=EPS_Motortemperatur (ID_TEMP_CPO_HET_MNG_EPS_Motortemperatur) (BNE original name: EPS-Motortemperatur), 13=Reserviert (ID_TEMP_CPO_HET_MNG_Reserviert) (Hinweis: Reserviert für funktionale Kennung Signal-Tag.), 14=Reserviert_bne_FCE0E84AD43C48B79F8D9B411125541C_14 (ID_TEMP_CPO_HET_MNG_Reserviert_bne_FCE0E84AD43C48B79F8D9B411125541C_14) (BNE original name: Reserviert), 15=Signal_unbefuellt (ID_TEMP_CPO_HET_MNG_Signal_unbefuellt) (Sendefunktion nicht in Betrieb)
  compu method IDX_TORQ_SEN: 0=Initialisierung (IDX_TORQ_SEN_Initialisierung), 1=KeineIndexFlanke (IDX_TORQ_SEN_KeineIndexFlanke) (BNE original name: Keine Index Flanke), 2=IndexFlanke (IDX_TORQ_SEN_IndexFlanke) (BNE original name: Index Flanke), 3=SignalUngueltig (IDX_TORQ_SEN_SignalUngueltig) (BNE original name: Signal ungültig)
  compu method MAX_I_SPEC_SFY: phys=raw for raw 0..252, 253=Reserviert_nicht_verfuegbar (MAX_I_SPEC_SFY_Reserviert_nicht_verfuegbar) (Hinweis: Reserviert für funktionale Kennung Signal-Tag.), 254=Reserviert_Fehler (MAX_I_SPEC_SFY_Reserviert_Fehler) (Hinweis: Reserviert für funktionale Kennung Signal-Tag.), 255=Signal_unbefuellt (MAX_I_SPEC_SFY_Signal_unbefuellt) (Sendefunktion nicht in Betrieb); unit A
  compu method NO_CC_EPS: identical
  compu method NO_VECH_{1..7}: identical
  compu method OFFS_GRD_MID_EPS: phys=raw*0.0439453125-89.95605469 for raw 2047..95208.24444444444
  compu method OFFS_QUAD_PINA_EPS: phys=raw-127 for raw 127..381
  compu method QU_ACLNY_COG: 8=Initialisierung (QU_ACLNY_COG_Initialisierung) (Tritt während der Initialisierungsphase auf bis Ist-Wert verfügbar (Vorbefüllung). Nutzsignal wird permanent mit Nutzwert 0 befüllt.), 1=SignalwertIstGueltigUndAbgesichertUndPlausibilisiert (QU_ACLNY_COG_SignalwertIstGueltigUndAbgesichertUndPlausibilisiert) (BNE original name: Signalwert ist gültig und abgesichert und plausibilisiert), 9=SignalwertIstGueltigUndAbgesichertZustandSlashStatusTemporaer (QU_ACLNY_COG_SignalwertIstGueltigUndAbgesichertZustandSlashStatusTemporaer) (BNE original name: Signalwert ist gültig und abgesichert, Zustand/Status temporär), 2=SignalwertIstGueltig (QU_ACLNY_COG_SignalwertIstGueltig) (BNE original name: Signalwert ist gültig), 10=SignalwertIstGueltigZustandSlashStatusTemporaer (QU_ACLNY_COG_SignalwertIstGueltigZustandSlashStatusTemporaer) (BNE original name: Signalwert ist gültig, Zustand/Status temporär), 3=SignalqualitaetBzwDotUeberwachungEingeschraenkt (QU_ACLNY_COG_SignalqualitaetBzwDotUeberwachungEingeschraenkt) (BNE original name: Signalqualität bzw. Überwachung eingeschränkt), 11=SignalqualitaetBzwDotUeberwachungEingeschraenktZustandSlashStatusTemporaer (QU_ACLNY_COG_SignalqualitaetBzwDotUeberwachungEingeschraenktZustandSlashStatusTemporaer) (BNE original name: Signalqualität bzw. Überwachung eingeschränkt, Zustand/Status temporär), 4=Reserved (QU_ACLNY_COG_Reserved), 12=ErsatzwertIstImNutzsignalGesetztZustandSlashStatusTemporaer (QU_ACLNY_COG_ErsatzwertIstImNutzsignalGesetztZustandSlashStatusTemporaer) (BNE original name: Ersatzwert ist im Nutzsignal gesetzt, Zustand/Status temporär), 6=SignalwertIstUngueltig (QU_ACLNY_COG_SignalwertIstUngueltig) (BNE original name: Signalwert ist ungültig), 14=SignalwertIstUngueltigZustandSlashStatusTemporaer (QU_ACLNY_COG_SignalwertIstUngueltigZustandSlashStatusTemporaer) (BNE original name: Signalwert ist ungültig, Zustand/Status temporär), 7=Reserved_bne_18ACE6A1DACA4F44BAB0F4D6BBE8870D_7 (QU_ACLNY_COG_Reserved_bne_18ACE6A1DACA4F44BAB0F4D6BBE8870D_7) (BNE original name: Reserved), 15=SignalUngueltig (QU_ACLNY_COG_SignalUngueltig) (BNE original name: Signal ungültig)
  compu method QU_AVL_FORC_GRD: 8=Initialisierung (QU_AVL_FORC_GRD_Initialisierung) (At the startup of the TSU driver. Nutzsignal wird permanent mit 0,0016 befüllt.), 2=SignalwertIstGueltig (QU_AVL_FORC_GRD_SignalwertIstGueltig) (BNE original name: Signalwert ist gültig), 14=SignalwertIstUngueltigZustandSlashStatusTemporaer (QU_AVL_FORC_GRD_SignalwertIstUngueltigZustandSlashStatusTemporaer) (BNE original name: Signalwert ist ungültig, Zustand/Status temporär), 15=SignalUngueltig (QU_AVL_FORC_GRD_SignalUngueltig) (BNE original name: Signal ungültig)
  compu method QU_AVL_PINA_EPS: 8=Initialisierung (QU_AVL_PINA_EPS_Initialisierung) (Nach jedem Reset und Aufstarten des EPS-Steuergeräts. Nutzsignal wird permanent mit Nutzwert 0 befüllt.), 1=SignalwertIstGueltigUndAbgesichertUndPlausibilisiert (QU_AVL_PINA_EPS_SignalwertIstGueltigUndAbgesichertUndPlausibilisiert) (BNE original name: Signalwert ist gültig und abgesichert und plausibilisiert), 2=SignalwertIstGueltig (QU_AVL_PINA_EPS_SignalwertIstGueltig) (BNE original name: Signalwert ist gültig), 4=ErsatzwertIstImNutzsignalGesetzt (QU_AVL_PINA_EPS_ErsatzwertIstImNutzsignalGesetzt) (BNE original name: Ersatzwert ist im Nutzsignal gesetzt), 9=SignalwertIstGueltigZustandSlashStatusTemporaer_mittlereSignalqualitaet_ (QU_AVL_PINA_EPS_SignalwertIstGueltigZustandSlashStatusTemporaer_mittlereSignalqualitaet_) (BNE original name: Signalwert ist gültig, Zustand/Status temporär (mittlere Signalqualität)), 10=SignalwertIstGueltigZustandSlashStatusTemporaer_geringeSignalqualitaet_ (QU_AVL_PINA_EPS_SignalwertIstGueltigZustandSlashStatusTemporaer_geringeSignalqualitaet_) (BNE original name: Signalwert ist gültig, Zustand/Status temporär (geringe Signalqualität)), 12=AbgleichwertIstImNutzsignalGesetztZustandSlashStatusTemporaer (QU_AVL_PINA_EPS_AbgleichwertIstImNutzsignalGesetztZustandSlashStatusTemporaer) (BNE original name: Abgleichwert ist im Nutzsignal gesetzt, Zustand/Status temporär), 14=SignalwertIstUngueltigZustandSlashStatusTemporaer (QU_AVL_PINA_EPS_SignalwertIstUngueltigZustandSlashStatusTemporaer) (BNE original name: Signalwert ist ungültig, Zustand/Status temporär), 15=SignalUngueltig (QU_AVL_PINA_EPS_SignalUngueltig) (BNE original name: Signal ungültig)
  compu method QU_AVL_RPM_WHL: 8=Initialisierung (QU_AVL_RPM_WHL_Initialisierung) (Wird gelegt solange aufgrund des Aufstartvorgangs (und der dazu gehörenden Sensorprüfung) für den zugehörigen Raddrehzahlsensor kein Wert ermittelt werden kann. Nutzsignal wird permanent mit der Ungültigkeitskennung befüllt.), 1=SignalwertIstGueltigUndAbgesichertUndPlausibilisiert (QU_AVL_RPM_WHL_SignalwertIstGueltigUndAbgesichertUndPlausibilisiert) (BNE original name: Signalwert ist gültig und abgesichert und plausibilisiert), 9=Reserved (QU_AVL_RPM_WHL_Reserved), 2=Reserved_bne_BFE56DC998394BD9A8FED9E096CC9242_2 (QU_AVL_RPM_WHL_Reserved_bne_BFE56DC998394BD9A8FED9E096CC9242_2) (BNE original name: Reserved), 10=Reserved_bne_BFE56DC998394BD9A8FED9E096CC9242_10 (QU_AVL_RPM_WHL_Reserved_bne_BFE56DC998394BD9A8FED9E096CC9242_10) (BNE original name: Reserved), 3=Reserved_bne_BFE56DC998394BD9A8FED9E096CC9242_3 (QU_AVL_RPM_WHL_Reserved_bne_BFE56DC998394BD9A8FED9E096CC9242_3) (BNE original name: Reserved), 11=SignalqualitaetBzwDotUeberwachungEingeschraenktZustandSlashStatusTemporaer (QU_AVL_RPM_WHL_SignalqualitaetBzwDotUeberwachungEingeschraenktZustandSlashStatusTemporaer) (BNE original name: Signalqualität bzw. Überwachung eingeschränkt, Zustand/Status temporär), 4=ErsatzwertIstImNutzsignalGesetzt (QU_AVL_RPM_WHL_ErsatzwertIstImNutzsignalGesetzt) (BNE original name: Ersatzwert ist im Nutzsignal gesetzt), 12=ErsatzwertIstImNutzsignalGesetztZustandSlashStatusTemporaer (QU_AVL_RPM_WHL_ErsatzwertIstImNutzsignalGesetztZustandSlashStatusTemporaer) (BNE original name: Ersatzwert ist im Nutzsignal gesetzt Zustand / Status Temporär), 6=Wert_nicht_verfuegbar_Fehler_elektrisch (QU_AVL_RPM_WHL_Wert_nicht_verfuegbar_Fehler_elektrisch) (Im Fehlerfall wird abhängig von der Ursache entweder 0110 (Schwerpunkt: elektrische Fehler mit Reparaturbedarf) oder 1110 (Schwerpunkt: Plausibilitätsfehler ohne Reparaturbedarf) gesendet. Die Umsetzung ist produktlinienspezifisch unterschiedlich. Nutzsignal wird permanent mit der Ungültigkeitskennung befüllt.), 14=Wert_nicht_verfuegbar_Plausibilitaetsfehler (QU_AVL_RPM_WHL_Wert_nicht_verfuegbar_Plausibilitaetsfehler) (Im Fehlerfall wird abhängig von der Ursache entweder 0110 (Schwerpunkt: elektrische Fehler mit Reparaturbedarf) oder 1110 (Schwerpunkt: Plausibilitätsfehler ohne Reparaturbedarf) gesendet. Die Umsetzung ist produktlinienspezifisch unterschiedlich. Nutzsignal wird permanent mit der Ungültigkeitskennung befüllt.), 7=Reserved_bne_BFE56DC998394BD9A8FED9E096CC9242_7 (QU_AVL_RPM_WHL_Reserved_bne_BFE56DC998394BD9A8FED9E096CC9242_7) (BNE original name: Reserved), 15=SignalUngueltig (QU_AVL_RPM_WHL_SignalUngueltig) (BNE original name: Signal ungültig)
  compu method QU_AVL_STMOM_DV_ACT: 8=Initialisierung (QU_AVL_STMOM_DV_ACT_Initialisierung) (Tritt während der Initialisierungsphase auf (Vorbefüllung). Nutzsignal wird permanent mit Nutzwert 0 befüllt.), 1=SignalwertIstGueltigUndAbgesichertUndPlausibilisiert (QU_AVL_STMOM_DV_ACT_SignalwertIstGueltigUndAbgesichertUndPlausibilisiert) (BNE original name: Signalwert ist gültig und abgesichert und plausibilisiert), 14=SignalwertIstUngueltigZustandSlashStatusTemporaer (QU_AVL_STMOM_DV_ACT_SignalwertIstUngueltigZustandSlashStatusTemporaer) (BNE original name: Signalwert ist ungültig, Zustand/Status temporär), 6=SignalwertIstUngueltig (QU_AVL_STMOM_DV_ACT_SignalwertIstUngueltig) (BNE original name: Signalwert ist ungültig), 15=SignalUngueltig (QU_AVL_STMOM_DV_ACT_SignalUngueltig) (BNE original name: Signal ungültig)
  compu method QU_FN_ENSU_SFY: mask 240: 144=Sichere_Energieversorgung_aktiv (QU_FN_ENSU_SFY_Sichere_Energieversorgung_aktiv) (Zustand der sicheren Energieversorgung: Die sichere Energieversorgung ist aktiv, es liegt kein Fehler oder Vorwarnung vor.), mask 240: 176=Sichere_Energieversorgung_aktiv_Vorwarnung (QU_FN_ENSU_SFY_Sichere_Energieversorgung_aktiv_Vorwarnung) (Zustand der sicheren Energieversorgung: Die sichere Energieversorgung ist aktiv, es liegt eine Vorwarnung vor. Der Zustand kann wieder in _aktiv zurückwechseln oder in _nicht_verfügbar_Fehler wechseln.), mask 240: 96=Sichere_Energieversorgung_nicht_verfuegbar_Fehler (QU_FN_ENSU_SFY_Sichere_Energieversorgung_nicht_verfuegbar_Fehler) (Zustand der sicheren Energieversorgung: Die sichere Energieversorgung ist nicht verfügbar, weil ein Fehler vorliegt.), mask 15: 0=Sichere_Energieversorgung_Klasse_0 (QU_FN_ENSU_SFY_Sichere_Energieversorgung_Klasse_0) (Zusätzlich zum Zustand die Klasse der sicheren Energieversorgung: Es ist keine spezielle Ausprägung der sicheren Energieversorgung angefordert und umgesetzt. Die Klassen sind weder pauschal disjunkt noch pauschal überschneidend oder pauschal inkludierend.), mask 15: 1=Sichere_Energieversorgung_Klasse_1 (QU_FN_ENSU_SFY_Sichere_Energieversorgung_Klasse_1) (Zusätzlich zum Zustand die Klasse der sicheren Energieversorgung: Es ist eine spezielle Ausprägung der sicheren Energieversorgung angefordert und umgesetzt. Die Klassen sind weder pauschal disjunkt noch pauschal überschneidend oder pauschal inkludierend.), mask 15: 2=Sichere_Energieversorgung_Klasse_2 (QU_FN_ENSU_SFY_Sichere_Energieversorgung_Klasse_2) (Zusätzlich zum Zustand die Klasse der sicheren Energieversorgung: Es ist eine spezielle Ausprägung der sicheren Energieversorgung angefordert und umgesetzt. Die Klassen sind weder pauschal disjunkt noch pauschal überschneidend oder pauschal inkludierend.), mask 15: 3=Sichere_Energieversorgung_Klasse_3 (QU_FN_ENSU_SFY_Sichere_Energieversorgung_Klasse_3) (Zusätzlich zum Zustand die Klasse der sicheren Energieversorgung: Es ist eine spezielle Ausprägung der sicheren Energieversorgung angefordert und umgesetzt. Die Klassen sind weder pauschal disjunkt noch pauschal überschneidend oder pauschal inkludierend.), mask 15: 4=Sichere_Energieversorgung_Klasse_4 (QU_FN_ENSU_SFY_Sichere_Energieversorgung_Klasse_4) (Zusätzlich zum Zustand die Klasse der sicheren Energieversorgung: Es ist eine spezielle Ausprägung der sicheren Energieversorgung angefordert und umgesetzt. Die Klassen sind weder pauschal disjunkt noch pauschal überschneidend oder pauschal inkludierend.), mask 15: 5=Sichere_Energieversorgung_Klasse_5 (QU_FN_ENSU_SFY_Sichere_Energieversorgung_Klasse_5) (Zusätzlich zum Zustand die Klasse der sicheren Energieversorgung: Es ist eine spezielle Ausprägung der sicheren Energieversorgung angefordert und umgesetzt. Die Klassen sind weder pauschal disjunkt noch pauschal überschneidend oder pauschal inkludierend.), mask 255: 254=Funktion_meldet_Fehler (QU_FN_ENSU_SFY_Funktion_meldet_Fehler) (Sendefunktion in Betrieb, meldet Fehler), mask 255: 255=Signal_unbefuellt (QU_FN_ENSU_SFY_Signal_unbefuellt) (Sendefunktion nicht in Betrieb)
  compu method QU_FN_EST: 128=Initialisierung (QU_FN_EST_Initialisierung) (EPS Initialisierungszustand), 160=FunktionVerfuegbar_Aktiv12VEPS (QU_FN_EST_FunktionVerfuegbar_Aktiv12VEPS) (BNE original name: Funktion verfügbar - Aktiv, 12V EPS), 164=FunktionVerfuegbar_Aktiv12VEAS (QU_FN_EST_FunktionVerfuegbar_Aktiv12VEAS) (BNE original name: Funktion verfügbar - Aktiv, 12V EAS), 168=FunktionVerfuegbar_Aktiv24VEAS (QU_FN_EST_FunktionVerfuegbar_Aktiv24VEAS) (BNE original name: Funktion verfügbar - Aktiv, 24V EAS), 162=FunktionVerfuegbar_AktivNotfallfunktionUmwelteinfluesse_Aktiv (QU_FN_EST_FunktionVerfuegbar_AktivNotfallfunktionUmwelteinfluesse_Aktiv) (BNE original name: Funktion verfügbar - Aktiv, Notfallfunktion Umwelteinflüsse - Aktiv), 49=FunktionInRueckfallebene (QU_FN_EST_FunktionInRueckfallebene) (BNE original name: Funktion in Rückfallebene), 51=FunktionInRueckfallebeneNotfallfunktionUmwelteinfluesse_Aktiv (QU_FN_EST_FunktionInRueckfallebeneNotfallfunktionUmwelteinfluesse_Aktiv) (BNE original name: Funktion in Rückfallebene, Notfallfunktion Umwelteinflüsse- Aktiv), 176=FunktionTemporaerInRueckfallebene (QU_FN_EST_FunktionTemporaerInRueckfallebene) (BNE original name: Funktion temporär in Rückfallebene), 178=FunktionTemporaerInRueckfallebeneNotfallfunktionUmwelteinfluesse_Aktiv (QU_FN_EST_FunktionTemporaerInRueckfallebeneNotfallfunktionUmwelteinfluesse_Aktiv) (BNE original name: Funktion temporär in Rückfallebene, Notfallfunktion Umwelteinflüsse- Aktiv), 96=FunktionNichtVerfuegbar_Fehler (QU_FN_EST_FunktionNichtVerfuegbar_Fehler) (BNE original name: Funktion nicht verfügbar - Fehler), 224=FunktionNichtVerfuegbar_Ausgeschaltet (QU_FN_EST_FunktionNichtVerfuegbar_Ausgeschaltet) (BNE original name: Funktion nicht verfügbar - ausgeschaltet), 255=SignalUngueltig (QU_FN_EST_SignalUngueltig) (BNE original name: Signal ungültig)
  compu method QU_FN_FDR: mask 3848: 512=FunktionVerfuegbarUndBereitNichtAktivSchlupfschwellenNormal (QU_FN_FDR_FunktionVerfuegbarUndBereitNichtAktivSchlupfschwellenNormal) (BNE original name: Funktion verfügbar und bereit, nicht aktiv, Schlupfschwellen normal), mask 3848: 520=FunktionVerfuegbarUndBereitNichtAktivSchlupfschwellenAufgeweitet (QU_FN_FDR_FunktionVerfuegbarUndBereitNichtAktivSchlupfschwellenAufgeweitet) (BNE original name: Funktion verfügbar und bereit, nicht aktiv, Schlupfschwellen aufgeweitet), mask 3848: 2560=FunktionVerfuegbarUndAktivSchlupfschwellenNormal (QU_FN_FDR_FunktionVerfuegbarUndAktivSchlupfschwellenNormal) (BNE original name: Funktion verfügbar und aktiv, Schlupfschwellen normal), mask 3848: 2568=FunktionVerfuegbarUndAktivSchlupfschwellenAufgeweitet (QU_FN_FDR_FunktionVerfuegbarUndAktivSchlupfschwellenAufgeweitet) (BNE original name: Funktion verfügbar und aktiv, Schlupfschwellen aufgeweitet), mask 3848: 768=reserviert (QU_FN_FDR_reserviert_DUPLICATE4275619181), mask 3848: 776=reserviert_bne_13C341D8A98349C2A0E5CFC9373CD7D4_776 (QU_FN_FDR_reserviert_bne_13C341D8A98349C2A0E5CFC9373CD7D4_776) (BNE original name: reserviert), mask 3856: 2576=FunktionVerfuegbarUndAktivFDRRegeleingriffVL (QU_FN_FDR_FunktionVerfuegbarUndAktivFDRRegeleingriffVL) (BNE original name: Funktion verfügbar und aktiv, FDR Regeleingriff VL), mask 3872: 2592=FunktionVerfuegbarUndAktivFDRRegeleingriffVR (QU_FN_FDR_FunktionVerfuegbarUndAktivFDRRegeleingriffVR) (BNE original name: Funktion verfügbar und aktiv, FDR Regeleingriff VR), mask 3904: 2624=FunktionVerfuegbarUndAktivFDRRegeleingriffHL (QU_FN_FDR_FunktionVerfuegbarUndAktivFDRRegeleingriffHL) (BNE original name: Funktion verfügbar und aktiv, FDR Regeleingriff HL), mask 3968: 2688=FunktionVerfuegbarUndAktivFDRRegeleingriffHR (QU_FN_FDR_FunktionVerfuegbarUndAktivFDRRegeleingriffHR) (BNE original name: Funktion verfügbar und aktiv, FDR Regeleingriff HR), mask 3840: 1536=FunktionNichtVerfuegbarColonFehler (QU_FN_FDR_FunktionNichtVerfuegbarColonFehler) (BNE original name: Funktion nicht verfügbar: Fehler), mask 3840: 3584=FunktionNichtVerfuegbarColonAusgeschaltet (QU_FN_FDR_FunktionNichtVerfuegbarColonAusgeschaltet) (BNE original name: Funktion nicht verfügbar: Ausgeschaltet), mask 3840: 2048=reserviert (QU_FN_FDR_reserviert_DUPLICATE1945092900), mask 3840: 512=reserviert_bne_13C341D8A98349C2A0E5CFC9373CD7D4_512 (QU_FN_FDR_reserviert_bne_13C341D8A98349C2A0E5CFC9373CD7D4_512) (BNE original name: reserviert), mask 4095: 4095=SignalUngueltig (QU_FN_FDR_SignalUngueltig) (BNE original name: Signal ungültig)
  compu method QU_FN_VIB_EPS: 1=Funktion_verfuegbar_nicht_aktiv (QU_FN_VIB_EPS_Funktion_verfuegbar_nicht_aktiv), 9=Funktion_verfuegbar_aktiv (QU_FN_VIB_EPS_Funktion_verfuegbar_aktiv), 14=Funktion_nicht_verfuegbar (QU_FN_VIB_EPS_Funktion_nicht_verfuegbar), 6=Fehler (QU_FN_VIB_EPS_Fehler), 15=Signal_unbefuellt (QU_FN_VIB_EPS_Signal_unbefuellt)
  compu method QU_SER_STMOM_STMOM_DV_ACT: 128=SchnittstelleWirdInitialisiert (QU_SER_STMOM_STMOM_DV_ACT_SchnittstelleWirdInitialisiert) (BNE original name: Schnittstelle wird initialisiert), 32=SchnittstelleVerfuegbarSlashFunktionsbereitOhneZusatzdaempfung (QU_SER_STMOM_STMOM_DV_ACT_SchnittstelleVerfuegbarSlashFunktionsbereitOhneZusatzdaempfung) (BNE original name: Schnittstelle verfügbar / funktionsbereit ohne Zusatzdämpfung), 34=SchnittstelleVerfuegbarSlashFunktionsbereitMitZusatzdaempfung (QU_SER_STMOM_STMOM_DV_ACT_SchnittstelleVerfuegbarSlashFunktionsbereitMitZusatzdaempfung) (BNE original name: Schnittstelle verfügbar / funktionsbereit mit Zusatzdämpfung), 33=SchnittstelleAktiv_ZusatzdaempfungNichtVerfuegbar (QU_SER_STMOM_STMOM_DV_ACT_SchnittstelleAktiv_ZusatzdaempfungNichtVerfuegbar) (BNE original name: Schnittstelle aktiv - Zusatzdämpfung nicht verfügbar), 35=SchnittstelleAktiv_ZusatzdaempfungVerfuegbar (QU_SER_STMOM_STMOM_DV_ACT_SchnittstelleAktiv_ZusatzdaempfungVerfuegbar) (BNE original name: Schnittstelle aktiv - Zusatzdämpfung verfügbar), 96=ServiceNichtVerfuegbar_Fehler (QU_SER_STMOM_STMOM_DV_ACT_ServiceNichtVerfuegbar_Fehler) (BNE original name: Service nicht verfügbar - Fehler), 224=ServiceNichtVerfuegbar_Standby_PMA (QU_SER_STMOM_STMOM_DV_ACT_ServiceNichtVerfuegbar_Standby_PMA) (BNE original name: Service nicht verfügbar - Standby - PMA), 225=ServiceNichtVerfuegbar_Standby_EPSStatus (QU_SER_STMOM_STMOM_DV_ACT_ServiceNichtVerfuegbar_Standby_EPSStatus) (BNE original name: Service nicht verfügbar - Standby - EPS Status), 255=SignalUngueltig (QU_SER_STMOM_STMOM_DV_ACT_SignalUngueltig) (BNE original name: Signal ungültig)
  compu method QU_SUM_AVL_I_DRDY_SFY: 1=Wert_gueltig_abgesichert (QU_SUM_AVL_I_DRDY_SFY_Wert_gueltig_abgesichert) (Stromwert gueltig und abgesichert), 3=Wert_gueltig_eingeschraenkt (QU_SUM_AVL_I_DRDY_SFY_Wert_gueltig_eingeschraenkt) (Stromwert nicht abgesichert), 6=Wert_nicht_verfuegbar_Fehler (QU_SUM_AVL_I_DRDY_SFY_Wert_nicht_verfuegbar_Fehler) (Sendefunktion in Betrieb, Werte nicht verfügbar), 14=Wert_nicht_verfuegbar (QU_SUM_AVL_I_DRDY_SFY_Wert_nicht_verfuegbar) (Sendefunktion in Betrieb, meldet Fehler), 15=Signal_unbefuellt (QU_SUM_AVL_I_DRDY_SFY_Signal_unbefuellt) (Sendefunktion nicht in Betrieb)
  compu method QU_TAR_DMPNG_ADDON_STMOM_FTAX: 1=SollwertZusatzdaempfungNichtUmsetzen (QU_TAR_DMPNG_ADDON_STMOM_FTAX_SollwertZusatzdaempfungNichtUmsetzen) (BNE original name: Sollwert Zusatzdämpfung nicht umsetzen), 2=SollwertZusatzdaempfungUmsetzen (QU_TAR_DMPNG_ADDON_STMOM_FTAX_SollwertZusatzdaempfungUmsetzen) (BNE original name: Sollwert Zusatzdämpfung umsetzen), 15=SignalUnbefuellt (QU_TAR_DMPNG_ADDON_STMOM_FTAX_SignalUnbefuellt) (BNE original name: Signal unbefüllt)
  compu method QU_TAR_FACT_STMOM_FTAX: 2=SollwerteUmsetzen (QU_TAR_FACT_STMOM_FTAX_SollwerteUmsetzen) (BNE original name: Sollwerte umsetzen), 7=SollwerteNichtVorhanden (QU_TAR_FACT_STMOM_FTAX_SollwerteNichtVorhanden) (BNE original name: Sollwerte nicht vorhanden), 14=StandbyColonSollwerteNichtUmsetzen (QU_TAR_FACT_STMOM_FTAX_StandbyColonSollwerteNichtUmsetzen) (BNE original name: Standby: Sollwerte nicht umsetzen), 15=SignalUngueltig (QU_TAR_FACT_STMOM_FTAX_SignalUngueltig) (BNE original name: Signal ungültig)
  compu method QU_TAR_QTA_STMOM_DV: 2=SollwerteUmsetzen (QU_TAR_QTA_STMOM_DV_SollwerteUmsetzen) (BNE original name: Sollwerte umsetzen), 7=SollwerteNichtVorhanden (QU_TAR_QTA_STMOM_DV_SollwerteNichtVorhanden) (BNE original name: Sollwerte nicht vorhanden), 14=SollwerteNichtUmsetzen_Standby (QU_TAR_QTA_STMOM_DV_SollwerteNichtUmsetzen_Standby) (BNE original name: Sollwerte nicht umsetzen - Standby), 15=SignalUngueltig (QU_TAR_QTA_STMOM_DV_SignalUngueltig) (BNE original name: Signal ungültig)
  compu method QU_TAR_STMOM_DV_ACT: 2=SollwerteUmsetzen (QU_TAR_STMOM_DV_ACT_SollwerteUmsetzen) (BNE original name: Sollwerte umsetzen), 7=SollwerteNichtVorhanden (QU_TAR_STMOM_DV_ACT_SollwerteNichtVorhanden) (BNE original name: Sollwerte nicht vorhanden), 14=StandbyColonSollwerteNichtUmsetzen (QU_TAR_STMOM_DV_ACT_StandbyColonSollwerteNichtUmsetzen) (BNE original name: Standby: Sollwerte nicht umsetzen), 15=SignalUngueltig (QU_TAR_STMOM_DV_ACT_SignalUngueltig) (BNE original name: Signal ungültig)
  compu method QU_V_VEH_COG: 8=Initialisierung (QU_V_VEH_COG_Initialisierung) (Tritt während der Initialisierungsphase auf bis Ist-Wert verfügbar (Vorbefüllung). Nutzsignal wird permanent mit Nutzwert 0 befüllt.), 1=SignalwertIstGueltigUndAbgesichertUndPlausibilisiert (QU_V_VEH_COG_SignalwertIstGueltigUndAbgesichertUndPlausibilisiert) (BNE original name: Signalwert ist gültig und abgesichert und plausibilisiert), 9=Reserved (QU_V_VEH_COG_Reserved), 2=Reserved_bne_C9CB853E97D84E34ADF2107B01966081_2 (QU_V_VEH_COG_Reserved_bne_C9CB853E97D84E34ADF2107B01966081_2) (BNE original name: Reserved), 10=SignalwertIstGueltigZustandSlashStatusTemporaer (QU_V_VEH_COG_SignalwertIstGueltigZustandSlashStatusTemporaer) (BNE original name: Signalwert ist gültig, Zustand/Status temporär), 3=Reserved_bne_C9CB853E97D84E34ADF2107B01966081_3 (QU_V_VEH_COG_Reserved_bne_C9CB853E97D84E34ADF2107B01966081_3) (BNE original name: Reserved), 11=SignalqualitaetBzwDotUeberwachungEingeschraenktZustandSlashStatusTemporaer (QU_V_VEH_COG_SignalqualitaetBzwDotUeberwachungEingeschraenktZustandSlashStatusTemporaer) (BNE original name: Signalqualität bzw. Überwachung eingeschränkt, Zustand/Status temporär), 4=Reserved_bne_C9CB853E97D84E34ADF2107B01966081_4 (QU_V_VEH_COG_Reserved_bne_C9CB853E97D84E34ADF2107B01966081_4) (BNE original name: Reserved), 12=Reserved_bne_C9CB853E97D84E34ADF2107B01966081_12 (QU_V_VEH_COG_Reserved_bne_C9CB853E97D84E34ADF2107B01966081_12) (BNE original name: Reserved), 6=Reserved_bne_C9CB853E97D84E34ADF2107B01966081_6 (QU_V_VEH_COG_Reserved_bne_C9CB853E97D84E34ADF2107B01966081_6) (BNE original name: Reserved), 14=SignalwertIstUngueltigZustandSlashStatusTemporaer (QU_V_VEH_COG_SignalwertIstUngueltigZustandSlashStatusTemporaer) (BNE original name: Signalwert ist ungültig, Zustand/Status temporär), 7=Reserved_bne_C9CB853E97D84E34ADF2107B01966081_7 (QU_V_VEH_COG_Reserved_bne_C9CB853E97D84E34ADF2107B01966081_7) (BNE original name: Reserved), 15=SignalUngueltig (QU_V_VEH_COG_SignalUngueltig) (BNE original name: Signal ungültig)
  compu method QU_VYAW_VEH: 8=Initialisierung (QU_VYAW_VEH_Initialisierung) (Tritt während der Initialisierungsphase auf bis Ist-Wert verfügbar (Vorbefüllung). Nutzsignal wird permanent mit Nutzwert 0 befüllt.), 1=SignalwertIstGueltigUndAbgesichertUndPlausibilisiert (QU_VYAW_VEH_SignalwertIstGueltigUndAbgesichertUndPlausibilisiert) (BNE original name: Signalwert ist gültig und abgesichert und plausibilisiert), 9=SignalwertIstGueltigUndAbgesichertZustandSlashStatusTemporaer (QU_VYAW_VEH_SignalwertIstGueltigUndAbgesichertZustandSlashStatusTemporaer) (BNE original name: Signalwert ist gültig und abgesichert, Zustand/Status temporär), 2=SignalwertIstGueltig (QU_VYAW_VEH_SignalwertIstGueltig) (BNE original name: Signalwert ist gültig), 10=SignalwertIstGueltigZustandSlashStatusTemporaer (QU_VYAW_VEH_SignalwertIstGueltigZustandSlashStatusTemporaer) (BNE original name: Signalwert ist gültig, Zustand/Status temporär), 3=SignalqualitaetBzwDotUeberwachungEingeschraenkt (QU_VYAW_VEH_SignalqualitaetBzwDotUeberwachungEingeschraenkt) (BNE original name: Signalqualität bzw. Überwachung eingeschränkt), 11=SignalqualitaetBzwDotUeberwachungEingeschraenktZustandSlashStatusTemporaer (QU_VYAW_VEH_SignalqualitaetBzwDotUeberwachungEingeschraenktZustandSlashStatusTemporaer) (BNE original name: Signalqualität bzw. Überwachung eingeschränkt, Zustand/Status temporär), 4=Reserved (QU_VYAW_VEH_Reserved), 12=ErsatzwertColonAbgleichwertIstImNutzsignalGesetztZustandSlashStatusTemporaer (QU_VYAW_VEH_ErsatzwertColonAbgleichwertIstImNutzsignalGesetztZustandSlashStatusTemporaer) (BNE original name: Ersatzwert: Abgleichwert ist im Nutzsignal gesetzt, Zustand/Status temporär), 6=SignalwertIstUngueltig (QU_VYAW_VEH_SignalwertIstUngueltig) (BNE original name: Signalwert ist ungültig), 14=SignalwertIstUngueltigZustandSlashStatusTemporaer (QU_VYAW_VEH_SignalwertIstUngueltigZustandSlashStatusTemporaer) (BNE original name: Signalwert ist ungültig, Zustand/Status temporär), 7=Reserved_bne_7C322122A3AD4C1BBA9012320D4729F1_7 (QU_VYAW_VEH_Reserved_bne_7C322122A3AD4C1BBA9012320D4729F1_7) (BNE original name: Reserved), 15=SignalUngueltig (QU_VYAW_VEH_SignalUngueltig) (BNE original name: Signal ungültig)
  compu method RQ_CULI_SFY: 0=Keine_Strombegrenzung (RQ_CULI_SFY_Keine_Strombegrenzung), 10=Maximale_Strombegrenzung (RQ_CULI_SFY_Maximale_Strombegrenzung), 13=Reserviert_nicht_verfuegbar (RQ_CULI_SFY_Reserviert_nicht_verfuegbar) (Hinweis: Reserviert für funktionale Kennung Signal-Tag.), 14=Reserviert_Fehler (RQ_CULI_SFY_Reserviert_Fehler) (Hinweis: Reserviert für funktionale Kennung Signal-Tag.), 15=Signal_unbefuellt (RQ_CULI_SFY_Signal_unbefuellt) (Sendefunktion nicht in Betrieb)
  compu method RQ_RST_OBD_DIAG: 0=KeineAnforderungResetOBD_Diagnose (RQ_RST_OBD_DIAG_KeineAnforderungResetOBD_Diagnose) (BNE original name: Keine Anforderung Reset OBD_Diagnose), 2=AnforderungResetOBD_Diagnose (RQ_RST_OBD_DIAG_AnforderungResetOBD_Diagnose) (BNE original name: Anforderung Reset OBD_Diagnose), 3=SignalUngueltig (RQ_RST_OBD_DIAG_SignalUngueltig) (BNE original name: Signal ungültig)
  compu method RQ_STG_EFAN: 0=AUS (RQ_STG_EFAN_AUS), 1=Stufe (RQ_STG_EFAN_Stufe), 15=SignalUngueltig (RQ_STG_EFAN_SignalUngueltig) (BNE original name: Signal ungültig)  # Automatisch generiert (Migration 2004-10-30)
  compu method SECU_CHAL: identical
  compu method SSS_IDENT: 0=ZGWVIN (SSS_IDENT_ZGWVIN) (BNE original name: ZGW VIN), 255=SignalUngueltig (SSS_IDENT_SignalUngueltig) (BNE original name: Signal ungültig)
  compu method SSV_IDENT: 0=REF_BAC4CAN_VIN (SSV_IDENT_REF_BAC4CAN_VIN), 1=DME1VIN (SSV_IDENT_DME1VIN) (BNE original name: DME1 VIN), 2=DME2VIN (SSV_IDENT_DME2VIN) (BNE original name: DME2 VIN), 3=RSEVIN (SSV_IDENT_RSEVIN) (BNE original name: RSE VIN), 4=KAFASVIN (SSV_IDENT_KAFASVIN) (BNE original name: KAFAS, VIN), 5=DSC_ModulVIN (SSV_IDENT_DSC_ModulVIN) (BNE original name: DSC_Modul VIN), 6=VDPVIN (SSV_IDENT_VDPVIN) (BNE original name: VDP VIN), 7=SASVIN (SSV_IDENT_SASVIN) (BNE original name: SAS VIN), 8=NiViVIN (SSV_IDENT_NiViVIN) (BNE original name: NiVi VIN), 9=HU_VIN (SSV_IDENT_HU_VIN) (Alle HUs), 10=EPS_VIN (SSV_IDENT_EPS_VIN) (Vorhalt), 11=REF_BAC4_FR_VIN (SSV_IDENT_REF_BAC4_FR_VIN), 19=MRR_VIN (SSV_IDENT_MRR_VIN), 20=ATM2_VIN (SSV_IDENT_ATM2_VIN), 21=Kombi_VIN (SSV_IDENT_Kombi_VIN), 255=SignalUngueltig (SSV_IDENT_SignalUngueltig) (BNE original name: Signal ungültig)
  compu method ST_ANO_MSA_ENG_STOP: 0=KeinAnkuendigung (ST_ANO_MSA_ENG_STOP_KeinAnkuendigung) (BNE original name: Kein Ankündigung), 1=AnkuendigungMSA_Motorstopp (ST_ANO_MSA_ENG_STOP_AnkuendigungMSA_Motorstopp) (BNE original name: Ankündigung MSA-Motorstopp), 3=SignalUngueltig (ST_ANO_MSA_ENG_STOP_SignalUngueltig) (BNE original name: Signal ungültig)
  compu method ST_CC_EPS: 0=Ruecksetzen (ST_CC_EPS_Ruecksetzen) (BNE original name: Rücksetzen), 1=Setzen (ST_CC_EPS_Setzen) (CC-message display), 3=SignalUngueltig (ST_CC_EPS_SignalUngueltig) (BNE original name: Signal ungültig)
  compu method ST_CENG_DRV: 0=MotorSteht (ST_CENG_DRV_MotorSteht) (BNE original name: Motor steht), 1=MotorStartet (ST_CENG_DRV_MotorStartet) (BNE original name: Motor startet), 2=MotorLaeuft (ST_CENG_DRV_MotorLaeuft) (BNE original name: Motor läuft), 3=MotorImAuslauf (ST_CENG_DRV_MotorImAuslauf) (BNE original name: Motor im Auslauf), 13=Funktionsschnittstelle_ist_nicht_verfuegbar (ST_CENG_DRV_Funktionsschnittstelle_ist_nicht_verfuegbar) (DME in der Initialisierung (z.B. nach Reset)), 14=Reserviert (ST_CENG_DRV_Reserviert) (Hinweis: Reserviert für funktionale Kennung Signal-Tag.), 15=Signal_unbefuellt (ST_CENG_DRV_Signal_unbefuellt) (Sendefunktion nicht in Betrieb)
  compu method ST_DCSW: 0=TrennelementAuf24V (ST_DCSW_TrennelementAuf24V) (BNE original name: Trennelement auf 24V), 1=TrennelementWirdAuf12VUmgeschaltetWerden (ST_DCSW_TrennelementWirdAuf12VUmgeschaltetWerden) (BNE original name: Trennelement wird auf 12V umgeschaltet werden), 2=TrennelementAuf12V (ST_DCSW_TrennelementAuf12V) (BNE original name: Trennelement auf 12V), 3=SignalUngueltig (ST_DCSW_SignalUngueltig) (BNE original name: Signal ungültig)
  compu method ST_DIAG_OBD_MUX_IMME: phys=raw for raw 4..60, 1=Cal_ID_softwareCalibrationIdentification_ (ST_DIAG_OBD_MUX_IMME_Cal_ID_softwareCalibrationIdentification_) (BNE original name: Cal-ID (software calibration identification)), 2=CVN_softwareCalibrationVerificationNumber_ (ST_DIAG_OBD_MUX_IMME_CVN_softwareCalibrationVerificationNumber_) (BNE original name: CVN (software calibration verification number)), 63=Ungueltig (ST_DIAG_OBD_MUX_IMME_Ungueltig) (BNE original name: Ungültig)
  compu method ST_DIAG_OBD_MUX_MAX: identical
  compu method ST_ENERG_FZM: 0=ENSTATE_GOOD (ST_ENERG_FZM_ENSTATE_GOOD), 1=ENSTATE_OK (ST_ENERG_FZM_ENSTATE_OK), 2=ENSTATE_SHORTAGE (ST_ENERG_FZM_ENSTATE_SHORTAGE), 3=ENSTATE_SEVERE_SHORTAGE (ST_ENERG_FZM_ENSTATE_SEVERE_SHORTAGE), 15=SignalUngueltig (ST_ENERG_FZM_SignalUngueltig) (BNE original name: Signal ungültig)  # Transp.MOST-GW-Migration, 01.09.2006: Zusammenführung der Signalklasse Status_Energie_FZM [1] mit den Parametern EnergyStatus [2].
  compu method ST_ENERG_SUPY: mask 255: 0=KeinSpannungseinbruch (ST_ENERG_SUPY_KeinSpannungseinbruch) (BNE original name: Kein Spannungseinbruch), mask 255: 253=Reserviert (ST_ENERG_SUPY_Reserviert) (Hinweis: Reserviert für funktionale Kennung Signal-Tag), mask 255: 254=Reserviert_bne_D985F50C03774E8D88B7B0039518781F_254 (ST_ENERG_SUPY_Reserviert_bne_D985F50C03774E8D88B7B0039518781F_254) (BNE original name: Reserviert), mask 255: 255=Signal_unbefuellt (ST_ENERG_SUPY_Signal_unbefuellt) (Sendefunktion nicht in Betrieb), mask 129: 1=StartspannungseinbruchAufVersorgungszweig1 (ST_ENERG_SUPY_StartspannungseinbruchAufVersorgungszweig1) (BNE original name: Startspannungseinbruch auf Versorgungszweig 1), mask 130: 2=StartspannungseinbruchAufVersorgungszweig2 (ST_ENERG_SUPY_StartspannungseinbruchAufVersorgungszweig2) (BNE original name: Startspannungseinbruch auf Versorgungszweig 2), mask 132: 4=Spannungsversorgung48Volt (ST_ENERG_SUPY_Spannungsversorgung48Volt) (BNE original name: Spannungsversorgung 48 Volt)
  compu method ST_IDC_CC_EPS: 0=KeinBlinken (ST_IDC_CC_EPS_KeinBlinken) (BNE original name: Kein Blinken), 1=LangsamesBlinken (ST_IDC_CC_EPS_LangsamesBlinken) (BNE original name: Langsames Blinken), 2=SchnellesBlinken (ST_IDC_CC_EPS_SchnellesBlinken) (BNE original name: Schnelles Blinken), 3=SignalUngueltig (ST_IDC_CC_EPS_SignalUngueltig) (BNE original name: Signal ungültig)
  compu method ST_ILK_ERRM_FZM: 0=Fehlerspeicherfreigabe (ST_ILK_ERRM_FZM_Fehlerspeicherfreigabe) (Eintrag von Fehlern uneingeschränkt), 1=Fehlerspeichersperre (ST_ILK_ERRM_FZM_Fehlerspeichersperre) (Bereich Netzwerkfehler ist zu sperren), 2=Reserve (ST_ILK_ERRM_FZM_Reserve) (reserviert für zukünftige Erweiterungen), 3=SignalUngueltig (ST_ILK_ERRM_FZM_SignalUngueltig) (BNE original name: Signal ungültig)  # Automatisch generiert (Migration 2004-10-30) Transp.MOST-GW-Migration, 01.09.2006: Zusammenführung der Signalklasse Status_Sperre_Fehlerspeicher_FZM [2] mit den Parametern ErrorMemoryLock [1].
  compu method ST_LDREL_GEN: 0=KeineEntlastungsfktDotAktivSlashRuecknahme (ST_LDREL_GEN_KeineEntlastungsfktDotAktivSlashRuecknahme) (BNE original name: Keine Entlastungsfkt. Aktiv / Rücknahme), 1=iGR_High (ST_LDREL_GEN_iGR_High) (BNE original name: iGR-High), 2=SULEV_Fkt (ST_LDREL_GEN_SULEV_Fkt) (BNE original name: SULEV-Fkt), 3=EntlastungNachMotorstart (ST_LDREL_GEN_EntlastungNachMotorstart) (BNE original name: Entlastung nach Motorstart), 4=RennstartMitOderOhneAGMBatterie (ST_LDREL_GEN_RennstartMitOderOhneAGMBatterie) (BNE original name: Rennstart mit oder ohne AGM Batterie), 5=ELMOTENTLHitze (ST_LDREL_GEN_ELMOTENTLHitze) (BNE original name: ELMOTENTL Hitze), 6=ELMOTENTLKaelte (ST_LDREL_GEN_ELMOTENTLKaelte) (BNE original name: ELMOTENTL Kälte), 7=EntlastungAnfahrschwaecheWieP66P85 (ST_LDREL_GEN_EntlastungAnfahrschwaecheWieP66P85) (BNE original name: Entlastung Anfahrschwäche wie P66,P85), 8=UebertemperaturGenerator (ST_LDREL_GEN_UebertemperaturGenerator) (BNE original name: Übertemperatur Generator), 9=EntlastungAusSicherheitsgruenden (ST_LDREL_GEN_EntlastungAusSicherheitsgruenden) (BNE original name: Entlastung aus Sicherheitsgründen), 10=EntlastungBegrenzungLagerkraefte (ST_LDREL_GEN_EntlastungBegrenzungLagerkraefte) (BNE original name: Entlastung Begrenzung Lagerkräfte), 11=EntlastungAusKomfortgruenden (ST_LDREL_GEN_EntlastungAusKomfortgruenden) (BNE original name: Entlastung aus Komfortgründen), 12=EntlastungAusFunktionalenGruenden (ST_LDREL_GEN_EntlastungAusFunktionalenGruenden) (BNE original name: Entlastung aus funktionalen Gründen), 15=SignalUngueltig (ST_LDREL_GEN_SignalUngueltig) (BNE original name: Signal ungültig)
  compu method ST_MOT_DRV: 0=KeinE_MaschineVerfuegbar (ST_MOT_DRV_KeinE_MaschineVerfuegbar) (BNE original name: Kein E-Maschine verfügbar), 1=E_MaschineIstElektrischFahrbereitOderBereitsAktiv (ST_MOT_DRV_E_MaschineIstElektrischFahrbereitOderBereitsAktiv) (BNE original name: E-Maschine ist elektrisch fahrbereit oder bereits aktiv), 3=SignalUngueltig (ST_MOT_DRV_SignalUngueltig) (BNE original name: Signal ungültig)
  compu method ST_OBD_CYC: mask 9: 0=Warm_Up_ZyklusNichtAktiv (ST_OBD_CYC_Warm_Up_ZyklusNichtAktiv) (BNE original name: Warm-Up-Zyklus nicht aktiv), mask 9: 1=Warm_Up_ZyklusAktiv (ST_OBD_CYC_Warm_Up_ZyklusAktiv) (BNE original name: Warm-Up-Zyklus aktiv), mask 10: 0=Driving_ZyklusNichtAktiv (ST_OBD_CYC_Driving_ZyklusNichtAktiv) (BNE original name: Driving-Zyklus nicht aktiv), mask 10: 2=Driving_ZyklusAktiv (ST_OBD_CYC_Driving_ZyklusAktiv) (BNE original name: Driving-Zyklus aktiv), mask 44: 0=RBM_ZyklusNichtAktiv (ST_OBD_CYC_RBM_ZyklusNichtAktiv) (BNE original name: RBM-Zyklus nicht aktiv), mask 44: 4=RBM_ZyklusAktiv (ST_OBD_CYC_RBM_ZyklusAktiv) (BNE original name: RBM-Zyklus aktiv), mask 44: 32=RBM_ZyklusNichtErfuellbar (ST_OBD_CYC_RBM_ZyklusNichtErfuellbar) (BNE original name: RBM-Zyklus nicht erfüllbar), mask 24: 0=KeinPFC_Zyklus (ST_OBD_CYC_KeinPFC_Zyklus) (BNE original name: Kein PFC-Zyklus), mask 24: 16=PFC_ZyklusErfuellt (ST_OBD_CYC_PFC_ZyklusErfuellt) (BNE original name: PFC-Zyklus erfüllt), mask 63: 63=SignalUngueltig (ST_OBD_CYC_SignalUngueltig) (BNE original name: Signal ungültig)
  compu method ST_OFFS_QUAD_PINA_EPS: 0=Algorithmus_Funktion_ImSleep_Modus (ST_OFFS_QUAD_PINA_EPS_Algorithmus_Funktion_ImSleep_Modus) (BNE original name: Algorithmus (Funktion) im Sleep-Modus), 1=OffsetWirdErmittelt (ST_OFFS_QUAD_PINA_EPS_OffsetWirdErmittelt) (BNE original name: Offset wird ermittelt), 2=OffsetUebernehmenAufsetzenUeberIndex (ST_OFFS_QUAD_PINA_EPS_OffsetUebernehmenAufsetzenUeberIndex) (BNE original name: Offset übernehmen, Aufsetzen über Index), 3=OffsetUebernehmenAufsetzenUeberModelvergleich (ST_OFFS_QUAD_PINA_EPS_OffsetUebernehmenAufsetzenUeberModelvergleich) (BNE original name: Offset übernehmen, Aufsetzen über Modelvergleich), 4=OffsetUebernehmenAufsetzenUeberAnschlag_Anschlag (ST_OFFS_QUAD_PINA_EPS_OffsetUebernehmenAufsetzenUeberAnschlag_Anschlag) (BNE original name: Offset übernehmen, Aufsetzen über Anschlag-Anschlag), 5=OffsetUebernehmenAufsetzenUeberSummenlenkwinkel_imAFS_Fall_ (ST_OFFS_QUAD_PINA_EPS_OffsetUebernehmenAufsetzenUeberSummenlenkwinkel_imAFS_Fall_) (BNE original name: Offset übernehmen, Aufsetzen über Summenlenkwinkel (im AFS-Fall)), 6=OffsetInPruefung (ST_OFFS_QUAD_PINA_EPS_OffsetInPruefung) (BNE original name: Offset in Prüfung), 7=OffsetKorrigieren (ST_OFFS_QUAD_PINA_EPS_OffsetKorrigieren) (BNE original name: Offset korrigieren), 8=Initialisierung (ST_OFFS_QUAD_PINA_EPS_Initialisierung) (wird im aller ersten Rechenzyklus gesetzt (10ms)), 9=RestoffsetWirdErmittelt (ST_OFFS_QUAD_PINA_EPS_RestoffsetWirdErmittelt) (BNE original name: Restoffset wird ermittelt), 11=OffsetUebernehmenGroboffsetUeberModell (ST_OFFS_QUAD_PINA_EPS_OffsetUebernehmenGroboffsetUeberModell) (BNE original name: Offset übernehmen, Groboffset über Modell), 15=SignalUngueltig (ST_OFFS_QUAD_PINA_EPS_SignalUngueltig) (BNE original name: Signal ungültig)
  compu method ST_UDP: 0=KeinSpannungseinbruch (ST_UDP_KeinSpannungseinbruch) (BNE original name: Kein Spannungseinbruch), 1=StartspannungseinbruchBisMaximalSpannungsschwelle1 (ST_UDP_StartspannungseinbruchBisMaximalSpannungsschwelle1) (BNE original name: Startspannungseinbruch bis maximal Spannungsschwelle 1), 2=StartspannungseinbruchBisMaximalSpannungsschwelle2 (ST_UDP_StartspannungseinbruchBisMaximalSpannungsschwelle2) (BNE original name: Startspannungseinbruch bis maximal Spannungsschwelle 2), 13=Funktionsschnittstelle_ist_nicht_verfuegbar (ST_UDP_Funktionsschnittstelle_ist_nicht_verfuegbar) (DME in der Initialisierung (z.B. nach Reset)), 14=Reserviert (ST_UDP_Reserviert) (Hinweis: Reserviert für funktionale Kennung Signal-Tag.), 15=Signal_unbefuellt (ST_UDP_Signal_unbefuellt) (Sendefunktion nicht in Betrieb)
  compu method ST_V_VEH_NSS: 12=FahrzeugImStillstandsnahenBereich (ST_V_VEH_NSS_FahrzeugImStillstandsnahenBereich) (BNE original name: Fahrzeug im stillstandsnahen Bereich), 13=FahrzeugNichtImStillstandsnahenBereich (ST_V_VEH_NSS_FahrzeugNichtImStillstandsnahenBereich) (BNE original name: Fahrzeug nicht im stillstandsnahen Bereich), 15=SignalUngueltig (ST_V_VEH_NSS_SignalUngueltig) (BNE original name: Signal ungültig)
  compu method STMOM_QTA_DV: phys=raw*0.005-10 for raw 2000..802000
  compu method STU_8_BYTE: identical
  compu method STU_RESP: identical
  compu method SU_CLU_STMOM_SFE_DXP: 1=Ultrahart (SU_CLU_STMOM_SFE_DXP_Ultrahart), 2=SportlichAusgewogen (SU_CLU_STMOM_SFE_DXP_SportlichAusgewogen) (BNE original name: Sportlich ausgewogen), 3=Ausgewogen (SU_CLU_STMOM_SFE_DXP_Ausgewogen), 4=Weich (SU_CLU_STMOM_SFE_DXP_Weich), 13=Funktionsschnittstelle_ist_nicht_verfuegbar (SU_CLU_STMOM_SFE_DXP_Funktionsschnittstelle_ist_nicht_verfuegbar) (Sendefunktion in Betrieb, Werte nicht verfügbar), 14=Funktion_meldet_Fehler (SU_CLU_STMOM_SFE_DXP_Funktion_meldet_Fehler) (Sendefunktion in Betrieb, meldet Fehler), 15=Signal_unbefuellt (SU_CLU_STMOM_SFE_DXP_Signal_unbefuellt) (Sendefunktion nicht in Betrieb)
  compu method TAR_STMOM_DV_ACT: phys=raw*0.006-12 for raw 2000..668666.6666666666
  compu method TEMP_CPO_HET_MNG: phys=raw-48 for raw 48..300, 253=Reserviert (TEMP_CPO_HET_MNG_Reserviert) (Hinweis: Reserviert für funktionale Kennung Signal-Tag.), 254=Reserviert_bne_13E59F6816364760A116813207E86FA4_254 (TEMP_CPO_HET_MNG_Reserviert_bne_13E59F6816364760A116813207E86FA4_254) (BNE original name: Reserviert), 255=Signal_unbefuellt (TEMP_CPO_HET_MNG_Signal_unbefuellt) (Sendefunktion nicht in Betrieb)
  compu method TOT_STR_EPS: phys=raw*0.012213 for raw 0..335216.4250094811
  compu method TRANF_CC_EPS: identical
  compu method TRGG_ENGTORQ_EPS: phys=raw*0.01-10 for raw 1000..201000, 4093=Funktionsschnittstelle_ist_nicht_verfuegbar (TRGG_ENGTORQ_EPS_Funktionsschnittstelle_ist_nicht_verfuegbar) (Sendefunktion in Betrieb, Werte nicht verfügbar), 4094=Funktion_meldet_Fehler (TRGG_ENGTORQ_EPS_Funktion_meldet_Fehler) (Sendefunktion in Betrieb, meldet Fehler), 4095=Signal_unbefuellt (TRGG_ENGTORQ_EPS_Signal_unbefuellt) (Sendefunktion nicht in Betrieb)
  compu method UI_32_noIniVal_noDflVal_4294967295_1_0_noEnc_hasRng: identical  # Automatisch generiert (Migration 2004-10-30)
  compu method UI_8_noIniVal_noDflVal_255_0_50s_MI_40_noEnc_hasRng: phys=raw*0.5-40 for raw 80..580  # Automatisch generiert (Migration 2004-10-30) Transp.MOST-GW-Migration, 01.09.2006: Zusammenführung der Signalklasse UI_8_noIniVal_noDflVal_255_0.50s_-40_noEnc_hasRng [1] mit den Parametern TemperatureExterior [2].
  compu method UINT1: identical
  compu method UINT20: identical
  compu method UINT24: identical
  compu method UINT28: identical
  compu method UINT4: identical
  compu method UINT6: identical
  compu method UN_PO_EPS: 0=Ritzelschnittstelle (UN_PO_EPS_Ritzelschnittstelle) (Die Position wird in Grad übertragen.), 1=Zahnstangenhubschnittstelle (UN_PO_EPS_Zahnstangenhubschnittstelle) (Die Position wird in Millimeter übertragen (Einheit=0.2mm).), 3=SignalUngueltig (UN_PO_EPS_SignalUngueltig) (BNE original name: Signal ungültig)
  compu method UN_TOT_STR_EPS: 0=Ritzelschnittstelle (UN_TOT_STR_EPS_Ritzelschnittstelle) (Die Position wird in Grad übertragen), 1=Zahnstangenhubschnittstelle (UN_TOT_STR_EPS_Zahnstangenhubschnittstelle) (Die Position wird in Millimeter übertragen (Einheit: 0.2mm)), 3=SignalUngueltig (UN_TOT_STR_EPS_SignalUngueltig) (BNE original name: Signal ungültig)
  compu method V_VEH_COG: phys=raw/64 for raw 0..1433600; unit km/h  # Transp.MOST-GW-Migration, 01.09.2006: Zusammenführung der Signalklasse Geschwindigkeit_Fahrzeug_Schwerpunkt [2] mit den Parametern CarSpeedExt [1].
  compu method VYAW_VEH: phys=raw*0.005-163.84 for raw 32768..13139568; unit °/s  # Transp.MOST-GW-Migration, 01.09.2006: Zusammenführung der Signalklasse Giergeschwindigkeit_Fahrzeug [1] mit den Parametern YawVelocityVehicle [1].
  compu method VYAW_VEH_ERR_AMP: phys=raw*0.0125 for raw 0..320000; unit °/s  # Quantisierung ist temporär
package /BMW/Boardnet/CodingDatatypes/DataConstraints
  range ACLNY_COG: phys 0..65000  # Codierung zu überarbeiten. Transp.MOST-GW-Migration, 01.09.2006: Zusammenführung der Signalklasse Querbeschleunigung_Schwerpunkt [1] mit den Parametern LateralAccelerationMassCenter [1].
  range ACLNY_COG_ERR_AMP: phys 0..4000
  range ALIV_4_BIT_UInt: phys 0..14
  range AVL_FORC_GRD: phys 0..4047.619
  range AVL_PINA_EPS: phys 0..65534
  range AVL_PINA_IDX_ICM: phys 0..65534
  range AVL_PWR_EL: phys 0..240
  range AVL_RPM_WHL: phys 7167..58367
  range AVL_STEA_PNI_OFFS: phys 0..4092.025
  range CHL_4_UInt: phys 0..14
  range COU_BS_RESP: phys 0..16777214
  range CRC_V_VEH: phys 0..255  # Standartabsicherung Apllikations-CRC. Transp.MOST-GW-Migration, 01.09.2006: Zusammenführung der Signalklasse CRC_Geschwindigkeit_Fahrzeug [1] mit den Parametern ChecksumSpeedCRC [1].
  range DBG_8Bit: phys 0..255
  range DIAG_ST_OBD: phys 0..63
  range FACT_ASS_STMOM_FTAX: phys 0..254
  range FACT_CTRR_STMOM_FTAX: phys 0..254
  range FACT_DMPNG_ADDON_STMOM_FTAX: phys 0..128
  range FACT_MO_STE_SO_DXP: phys 0..250
  range I_SPEC_ARS: phys 0..252
  range MAX_I_SPEC_SFY: phys 0..252
  range NO_CC_EPS: phys 0..65534
  range OFFS_GRD_MID_EPS: phys 0..4094
  range OFFS_QUAD_PINA_EPS: phys 0..254
  range SECU_CHAL: phys 0..1099511627775
  range ST_DIAG_OBD_MUX_IMME: phys 4..60
  range ST_DIAG_OBD_MUX_MAX: phys 4..60
  range STMOM_QTA_DV: phys 0..4000
  range STU_8_BYTE: phys 0..18446744073709551615
  range STU_RESP: phys 0..16777215
  range TAR_STMOM_DV_ACT: phys 0..4000
  range TEMP_CPO_HET_MNG: phys 0..252
  range TOT_STR_EPS: phys 0..4093.998
  range TRANF_CC_EPS: phys 0..14
  range TRGG_ENGTORQ_EPS: phys 0..2000
  range UI_32_noIniVal_noDflVal_4294967295_1_0_noEnc_hasRng: phys 0..4294967294  # Automatisch generiert (Migration 2004-10-30)
  range UI_8_noIniVal_noDflVal_255_0_50s_MI_40_noEnc_hasRng: phys 0..250  # Automatisch generiert (Migration 2004-10-30) Transp.MOST-GW-Migration, 01.09.2006: Zusammenführung der Signalklasse UI_8_noIniVal_noDflVal_255_0.50s_-40_noEnc_hasRng [1] mit den Parametern TemperatureExterior [2].
  range UINT1: phys 0..1
  range UINT20: phys 0..1048575
  range UINT24: phys 0..16777215
  range UINT28: phys 0..268435455
  range UINT4: phys 0..15
  range UINT6: phys 0..63
  range V_VEH_COG: phys 0..22400  # Transp.MOST-GW-Migration, 01.09.2006: Zusammenführung der Signalklasse Geschwindigkeit_Fahrzeug_Schwerpunkt [2] mit den Parametern CarSpeedExt [1].
  range VYAW_VEH: phys 0..65534  # Transp.MOST-GW-Migration, 01.09.2006: Zusammenführung der Signalklasse Giergeschwindigkeit_Fahrzeug [1] mit den Parametern YawVelocityVehicle [1].
  range VYAW_VEH_ERR_AMP: phys 0..4000  # Quantisierung ist temporär
package /BMW/Boardnet/CodingDatatypes/SwBaseTypes
  base type ascii8: category=FIXED_LENGTH, base-type-size=8, base-type-encoding=ISO-8859-1, mem-alignment=8, byte-order=big-endian, native-declaration=unsigned char
package /BMW/Platform/Auth/Dcm/ImplementationDataTypes
  8 x impl type:
    Dcm_NegativeResponseCodeType: compu {0=DCM_E_POSITIVERESPONSE, 16=DCM_E_GENERALREJECT, 17=DCM_E_SERVICENOTSUPPORTED, 18=DCM_E_SUBFUNCTIONNOTSUPPORTED, 20=DCM_E_RESPONSETOOLONG, 19=DCM_E_INCORRECTMESSAGELENGTHORINVALIDFORMAT, 33=DCM_E_BUSYREPEATREQUEST, 34=DCM_E_CONDITIONSNOTCORRECT, 36=DCM_E_REQUESTSEQUENCEERROR, 37=DCM_E_NORESPONSEFROMSUBNETCOMPONENT, 38=DCM_E_FAILUREPREVENTSEXECUTIONOFREQUESTEDACTION, 49=DCM_E_REQUESTOUTOFRANGE, 51=DCM_E_SECURITYACCESSDENIED, 53=DCM_E_INVALIDKEY, 54=DCM_E_EXCEEDNUMBEROFATTEMPTS, 55=DCM_E_REQUIREDTIMEDELAYNOTEXPIRED, 112=DCM_E_UPLOADDOWNLOADNOTACCEPTED, 113=DCM_E_TRANSFERDATASUSPENDED, 114=DCM_E_GENERALPROGRAMMINGFAILURE, 115=DCM_E_WRONGBLOCKSEQUENCECOUNTER, 120=DCM_E_REQUESTCORRECTLYRECEIVEDRESPONSEPENDING, 126=DCM_E_SUBFUNCTIONNOTSUPPORTEDINACTIVESESSION, 127=DCM_E_SERVICENOTSUPPORTEDINACTIVESESSION, 129=DCM_E_RPMTOOHIGH, 130=DCM_E_RPMTOOLOW, 131=DCM_E_ENGINEISRUNNING, 132=DCM_E_ENGINEISNOTRUNNING, 133=DCM_E_ENGINERUNTIMETOOLOW, 134=DCM_E_TEMPERATURETOOHIGH, 135=DCM_E_TEMPERATURETOOLOW, 136=DCM_E_VEHICLESPEEDTOOHIGH, 137=DCM_E_VEHICLESPEEDTOOLOW, 138=DCM_E_THROTTLE_PEDALTOOHIGH, 139=DCM_E_THROTTLE_PEDALTOOLOW, 140=DCM_E_TRANSMISSIONRANGENOTINNEUTRAL, 141=DCM_E_TRANSMISSIONRANGENOTINGEAR, 143=DCM_E_BRAKESWITCH_NOTCLOSED, 144=DCM_E_SHIFTERLEVERNOTINPARK, 145=DCM_E_TORQUECONVERTERCLUTCHLOCKED, 146=DCM_E_VOLTAGETOOHIGH, 147=DCM_E_VOLTAGETOOLOW}, implementation-data-type=uint8
    Dcm_OpStatusType: compu {0=DCM_INITIAL, 1=DCM_PENDING, 2=DCM_CANCEL, 3=DCM_FORCE_RCRRP_OK}, implementation-data-type=uint8
    Dcm_SecAccDataRecCoding_ArrayType: category=ARRAY
      element AuxU8_Dcm_SecAccDataRecCoding_ArrayType: array-size=4, array-size-semantics=FIXED-SIZE, implementation-data-type=uint8
    Dcm_SecAccDataRecSwt_ArrayType: category=ARRAY
      element AuxU8_Dcm_SecAccDataRecSwt_ArrayType: array-size=4, array-size-semantics=FIXED-SIZE, implementation-data-type=uint8
    Dcm_SecKeyCoding_ArrayType: category=ARRAY
      element AuxU8_Dcm_SecKeyCoding_ArrayType: array-size=132, array-size-semantics=FIXED-SIZE, implementation-data-type=uint8
    Dcm_SecKeySwt_ArrayType: category=ARRAY
      element AuxU8_Dcm_SecKeySwt_ArrayType: array-size=132, array-size-semantics=FIXED-SIZE, implementation-data-type=uint8
    Dcm_SecSeedCoding_ArrayType: category=ARRAY
      element AuxU8_Dcm_SecSeedCoding_ArrayType: array-size=8, array-size-semantics=FIXED-SIZE, implementation-data-type=uint8
    Dcm_SecSeedSwt_ArrayType: category=ARRAY
      element AuxU8_Dcm_SecSeedSwt_ArrayType: array-size=8, array-size-semantics=FIXED-SIZE, implementation-data-type=uint8
package /BMW/Platform/Auth/Dlog/ImplementationDataTypes
  4 x impl type, all with category=ARRAY:
    Dlog_RandomSeedType
      element Dlog_RandomSeedSubType: array-size=4, array-size-semantics=FIXED-SIZE, implementation-data-type=uint32
    Dlog_SgbmIdArrayType
      element SubSgbmIdType: array-size=8, array-size-semantics=FIXED-SIZE, implementation-data-type=uint8
    Dlog_SignatureArrayType
      element SubSignatureArrayType: array-size=260, array-size-semantics=FIXED-SIZE, implementation-data-type=uint8
    DlogUser_SgbmIdType
      element SubSgbmIdType: array-size=8, array-size-semantics=FIXED-SIZE, implementation-data-type=uint8
package /BMW/Platform/Bs/Csm/ImplementationDataTypes
  7 x impl type:
    Crypto_VerifyResultType: compu {0=CRYPTO_E_VER_OK, 1=CRYPTO_E_VER_NOT_OK}, implementation-data-type=uint8
    Csm_HashDataType_SecureToken: category=ARRAY
      element SubCsm_HashDataType_SecureToken: array-size=260, array-size-semantics=FIXED-SIZE, implementation-data-type=uint8
    Csm_HashResultType_SecureToken: category=ARRAY
      element SubCsm_HashResultType_SecureToken: array-size=32, array-size-semantics=FIXED-SIZE, implementation-data-type=uint8
    Csm_SignatureGenerateDataType_Csr: category=ARRAY
      element SubCsm_SignatureGenerateDataType_Csr: array-size=32, array-size-semantics=FIXED-SIZE, implementation-data-type=uint8
    Csm_SignatureGenerateResultType_Csr: category=ARRAY
      element SubCsm_SignatureGenerateResultType_Csr: array-size=32, array-size-semantics=FIXED-SIZE, implementation-data-type=uint8
    Csm_SignatureVerifyCompareType_SecureToken: category=ARRAY
      element SubCsm_SignatureVerifyCompareType_SecureToken: array-size=32, array-size-semantics=FIXED-SIZE, implementation-data-type=uint8
    Csm_SignatureVerifyDataType_SecureToken: category=ARRAY
      element SubCsm_SignatureVerifyDataType_SecureToken: array-size=32, array-size-semantics=FIXED-SIZE, implementation-data-type=uint8
package /BMW/Platform/Bs/DataTypeMappingSets
  data type mapping set BsTypeMappings
    mode-request-type-maps:
      implementation-data-type=uint8, mode-group=SecEcuMode
      implementation-data-type=Bs_LifeCycleRequestType, mode-group=Bs_LifeCycle
package /BMW/Platform/Bs/Dcm/ImplementationDataTypes
  impl type Dcm_NegativeResponseCodeType: compu {16=DCM_E_GENERALREJECT, 19=DCM_E_INCORRECTMESSAGELENGTHORINVALIDFORMAT, 33=DCM_E_BUSYREPEATREQUEST, 34=DCM_E_CONDITIONSNOTCORRECT, 36=DCM_E_REQUESTSEQUENCEERROR, 49=DCM_E_REQUESTOUTOFRANGE, 51=DCM_E_SECURITYACCESSDENIED, 114=DCM_E_GENERALPROGRAMMINGFAILURE, 126=DCM_E_SUBFUNCTIONNOTSUPPORTEDINACTIVESESSION, 129=DCM_E_RPMTOOHIGH, 130=DCM_E_RPMTOOLOW, 131=DCM_E_ENGINEISRUNNING, 132=DCM_E_ENGINEISNOTRUNNING, 133=DCM_E_ENGINERUNTIMETOOLOW, 134=DCM_E_TEMPERATURETOOHIGH, 135=DCM_E_TEMPERATURETOOLOW, 136=DCM_E_VEHICLESPEEDTOOHIGH, 137=DCM_E_VEHICLESPEEDTOOLOW, 138=DCM_E_THROTTLE_PEDALTOOHIGH, 139=DCM_E_THROTTLE_PEDALTOOLOW, 140=DCM_E_TRANSMISSIONRANGENOTINNEUTRAL, 141=DCM_E_TRANSMISSIONRANGENOTINGEAR, 143=DCM_E_BRAKESWITCH_NOTCLOSED, 144=DCM_E_SHIFTERLEVERNOTINPARK, 145=DCM_E_TORQUECONVERTERCLUTCHLOCKED, 146=DCM_E_VOLTAGETOOHIGH, 147=DCM_E_VOLTAGETOOLOW}, implementation-data-type=uint8
  impl type Dcm_OpStatusType: compu {0=DCM_INITIAL, 1=DCM_PENDING, 2=DCM_CANCEL, 3=DCM_FORCE_RCRRP_OK}, implementation-data-type=uint8
  impl type RCDataArrayType: category=ARRAY
    element SubRCDataArrayType: array-size=260, array-size-semantics=FIXED-SIZE, implementation-data-type=uint8
package /BMW/Platform/Bs/Dem/ImplementationDataTypes
  impl type Dem_EventStatusType: compu {0=DEM_EVENT_STATUS_PASSED, 1=DEM_EVENT_STATUS_FAILED, 2=DEM_EVENT_STATUS_PREPASSED, 3=DEM_EVENT_STATUS_PREFAILED, 4=DEM_EVENT_STATUS_FDC_THRESHOLD_REACHED}, range raw 0..4, implementation-data-type=uint8
package /BMW/Platform/Bs/Dlog/ImplementationDataTypes
  impl type Dlog_EcuUidArrayType: category=ARRAY
    element Dlog_EcuUidSubArrayType: array-size=16, array-size-semantics=FIXED-SIZE, implementation-data-type=uint8
package /BMW/Platform/Bs/ImplementationDataTypes
  impl type Bs_LifeCycleRequestType: compu {0=BS_INITIALIZED, 1=BS_RUNNING, 2=BS_STOPPED}, implementation-data-type=uint8
  impl type Bs_SfaFeatureSpecificFieldValueType: category=STRUCTURE, dynamic-array-size-profile=VSA_LINEAR
    element size: implementation-data-type=uint32
    element payload: category=ARRAY
      element PayloadType: array-size=256, array-size-handling=ALL-INDICES-SAME-ARRAY-SIZE, array-size-semantics=VARIABLE-SIZE, implementation-data-type=uint8
package /BMW/Platform/Bs/NvM/ImplementationDataTypes
  impl type NvM_DstPtrType: category=DATA_REFERENCE, sw-pointer-target-props={target-category=VALUE, base-type=void}
  impl type NvM_RequestResultType: compu {0=NVM_REQ_OK, 1=NVM_REQ_NOT_OK, 2=NVM_REQ_PENDING, 3=NVM_REQ_INTEGRITY_FAILED, 4=NVM_REQ_BLOCK_SKIPPED, 5=NVM_REQ_NV_INVALIDATED, 6=NVM_REQ_CANCELED, 7=NVM_REQ_REDUNDANCY_FAILED, 8=NVM_REQ_RESTORED_FROM_ROM}, implementation-data-type=uint8
  impl type NvM_SrcPtrType: category=DATA_REFERENCE, sw-pointer-target-props={target-category=VALUE, base-type=void, sw-impl-policy=CONST}
package /BMW/Platform/Bs/SecOC/ImplementationDataTypes
  impl type SecOC_FreshnessArrayType: category=ARRAY
    element SecOC_FreshnessSubArrayType: array-size=8, array-size-semantics=FIXED-SIZE, implementation-data-type=uint8
package /BMW/Platform/Common/DataTypeMappingSets
  data type mapping set SystemCommunicationModeMappingSet: mode-request-type-map{implementation-data-type=uint8, mode-group=SystemCommunicationMode}
package /BMW/Platform/Darh/DataTypeMappingSets
  data type mapping set Darh_ModeRequestTypeMappings
    mode-request-type-maps:
      implementation-data-type=uint8, mode-group=DarhReportErrorMode
      implementation-data-type=Darh_LifeCycleRequestType, mode-group=Darh_LifeCycle
package /BMW/Platform/Darh/Dcm/DataTypeMappingSets
  data type mapping set Dcm_ModeRequestTypeMappings: mode-request-type-map{implementation-data-type=uint8, mode-group=DcmResponseOnEvent}
package /BMW/Platform/Darh/Dcm/ImplementationDataTypes
  7 x impl type:
    Darh_ActivelyReportedErrorListType: category=ARRAY
      element AuxU8_Darh_ActivelyReportedError: array-size=6, array-size-semantics=FIXED-SIZE, implementation-data-type=uint8
    Darh_ErrorQueueDataType: category=ARRAY
      element AuxU8_Darh_ErrorQueueDataType: array-size=21, array-size-semantics=FIXED-SIZE, implementation-data-type=uint8
    Darh_RoeState_ReadData_Data_ArrayType: category=ARRAY
      element AuxU8_Darh_RoeState_ReadData_Data_ArrayType: array-size=1, array-size-semantics=FIXED-SIZE, implementation-data-type=uint8
    Dcm_ConfirmationStatusType: compu {0=DCM_RES_POS_OK, 1=DCM_RES_POS_NOT_OK, 2=DCM_RES_NEG_OK, 3=DCM_RES_NEG_NOT_OK}, range raw 0..3, implementation-data-type=uint8
    Dcm_NegativeResponseCodeType:
      compu {143=DCM_E_BRAKESWITCH_NOTCLOSED, 33=DCM_E_BUSYREPEATREQUEST, 34=DCM_E_CONDITIONSNOTCORRECT, 132=DCM_E_ENGINEISNOTRUNNING, 131=DCM_E_ENGINEISRUNNING, 133=DCM_E_ENGINERUNTIMETOOLOW, 54=DCM_E_EXCEEDNUMBEROFATTEMPTS, 38=DCM_E_FAILUREPREVENTSEXECUTIONOFREQUESTEDACTION, 114=DCM_E_GENERALPROGRAMMINGFAILURE, 16=DCM_E_GENERALREJECT, 19=DCM_E_INCORRECTMESSAGELENGTHORINVALIDFORMAT, 53=DCM_E_INVALIDKEY, 37=DCM_E_NORESPONSEFROMSUBNETCOMPONENT, 49=DCM_E_REQUESTOUTOFRANGE, 36=DCM_E_REQUESTSEQUENCEERROR, 55=DCM_E_REQUIREDTIMEDELAYNOTEXPIRED, 20=DCM_E_RESPONSETOOLONG, 129=DCM_E_RPMTOOHIGH, 130=DCM_E_RPMTOOLOW, 51=DCM_E_SECURITYACCESSDENIED, 17=DCM_E_SERVICENOTSUPPORTED, 127=DCM_E_SERVICENOTSUPPORTEDINACTIVESESSION, 144=DCM_E_SHIFTERLEVERNOTINPARK, 18=DCM_E_SUBFUNCTIONNOTSUPPORTED, 126=DCM_E_SUBFUNCTIONNOTSUPPORTEDINACTIVESESSION, 134=DCM_E_TEMPERATURETOOHIGH, 135=DCM_E_TEMPERATURETOOLOW, 138=DCM_E_THROTTLE_PEDALTOOHIGH, 139=DCM_E_THROTTLE_PEDALTOOLOW, 145=DCM_E_TORQUECONVERTERCLUTCHLOCKED, 113=DCM_E_TRANSFERDATASUSPENDED, 141=DCM_E_TRANSMISSIONRANGENOTINGEAR, 140=DCM_E_TRANSMISSIONRANGENOTINNEUTRAL, 112=DCM_E_UPLOADDOWNLOADNOTACCEPTED, 136=DCM_E_VEHICLESPEEDTOOHIGH, 137=DCM_E_VEHICLESPEEDTOOLOW, 146=DCM_E_VOLTAGETOOHIGH, 147=DCM_E_VOLTAGETOOLOW, 115=DCM_E_WRONGBLOCKSEQUENCECOUNTER, 240..249=DCM_E_VMSCNC_0..DCM_E_VMSCNC_9, 250=DCM_E_VMSCNC_A, 251=DCM_E_VMSCNC_B, 252=DCM_E_VMSCNC_C, 253=DCM_E_VMSCNC_D, 254=DCM_E_VMSCNC_E}
      range raw 16..254
      implementation-data-type=uint8
    Dcm_OpStatusType: compu {0=DCM_INITIAL, 1=DCM_PENDING, 2=DCM_CANCEL, 3=DCM_FORCE_RCRRP_OK}, range raw 0..3, implementation-data-type=uint8
    Dcm_RequestData_ArrayType: category=ARRAY
      element AuxU8_Dcm_RequestData_ArrayType: array-size=1024, array-size-semantics=FIXED-SIZE, implementation-data-type=uint8
package /BMW/Platform/Darh/Dem/ImplementationDataTypes
  4 x impl type:
    Dem_DTCFormatType: compu {0=DEM_DTC_FORMAT_OBD, 1=DEM_DTC_FORMAT_UDS, 2=DEM_DTC_FORMAT_J1939}, range raw 0..2, implementation-data-type=uint8
    Dem_EventIdType: range raw 1..72, implementation-data-type=uint16
    Dem_EventStatusType: compu {0=DEM_EVENT_STATUS_PASSED, 1=DEM_EVENT_STATUS_FAILED, 2=DEM_EVENT_STATUS_PREPASSED, 3=DEM_EVENT_STATUS_PREFAILED, 4=DEM_EVENT_STATUS_FDC_THRESHOLD_REACHED}, range raw 0..4, implementation-data-type=uint8
    Dem_MaxDataValueType: category=ARRAY
      element Dem_MaxDataValueElement: array-size=18, array-size-semantics=FIXED-SIZE, implementation-data-type=uint8
package /BMW/Platform/Darh/ImplementationDataTypes
  4 x impl type, all with category=TYPE_REFERENCE, implementation-data-type=uint8:
    Darh_DcmIndicationType: compu {0=DARH_DCM_NOINDICATION, 1=DARH_DCM_ACTIVATED, 2=DARH_DCM_STOPPED}
    Darh_LifeCycleRequestType: compu {0=DARH_INITIALIZED, 1=DARH_RUNNING, 2=DARH_STOPPED}
    Darh_RoeStateType: compu {0=DARH_ROE_STOPPED, 1=DARH_ROE_STARTED, 2=DARH_ROE_UNKNOWN}
    Darh_SuspendedStateType: compu {0=DARH_NOT_SUSPENDED, 1=DARH_SUSPENDED}
package /BMW/Platform/Darh/NvM/ImplementationDataTypes
  impl type ErrorQueueType: category=STRUCTURE, dynamic-array-size-profile=None
    element queue: category=ARRAY
      element Darh_QueueElementType: category=STRUCTURE, array-size=5, array-size-semantics=FIXED-SIZE
        element timestamp: implementation-data-type=uint32
        element EventId: implementation-data-type=uint32
    element first: implementation-data-type=uint16
    element size: implementation-data-type=uint16
  impl type NvM_RequestResultType: compu {0=NVM_REQ_OK, 1=NVM_REQ_NOT_OK, 2=NVM_REQ_PENDING, 3=NVM_REQ_INTEGRITY_FAILED, 4=NVM_REQ_BLOCK_SKIPPED, 5=NVM_REQ_NV_INVALIDATED, 6=NVM_REQ_CANCELED, 7=NVM_REQ_REDUNDANCY_FAILED, 8=NVM_REQ_RESTORED_FROM_ROM}, range raw 0..8, implementation-data-type=uint8
  impl type NvM_SrcPtrType: category=DATA_REFERENCE, sw-pointer-target-props={target-category=VALUE, base-type=void, sw-impl-policy=CONST}
package /BMW/Platform/Darh/Tp/ImplementationDataTypes
  impl type Darh_TransmissionArrayType: category=STRUCTURE, dynamic-array-size-profile=VSA_LINEAR
    element size: implementation-data-type=uint16
    element payload: category=ARRAY
      element payloadArray: array-size=23, array-size-handling=ALL-INDICES-SAME-ARRAY-SIZE, array-size-semantics=VARIABLE-SIZE, implementation-data-type=uint8
package /BMW/Platform/Dlog/Coding/PortInterfaces
  impl type Coding_CafIdArrayType: category=ARRAY
    element Coding_CafIdSubarrayType: array-size=8, array-size-semantics=FIXED-SIZE, implementation-data-type=uint8
package /BMW/Platform/Dlog/CompuMethods
  compu method CM_DlogHistoryType: 0=DLOG_HISTORY_SYSTEMSUPPLIER, 1=DLOG_HISTORY_PLANT, 2=DLOG_HISTORY_BACKUP_01, 3=DLOG_HISTORY_BACKUP_02, 4=DLOG_HISTORY_BACKUP_03, else DLOG_HISTORY_SYSTEMSUPPLIER
package /BMW/Platform/Dlog/DataTypeMappingSets
  data type mapping set DlogTypeMappings: mode-request-type-map{implementation-data-type=Dlog_LifeCycleRequestType, mode-group=Dlog_LifeCycle}
package /BMW/Platform/Dlog/Dcm/ImplementationDataTypes
  17 x impl type:
    Dcm_NegativeResponseCodeType: compu {16=DCM_E_GENERALREJECT, 19=DCM_E_INCORRECTMESSAGELENGTHORINVALIDFORMAT, 33=DCM_E_BUSYREPEATREQUEST, 34=DCM_E_CONDITIONSNOTCORRECT, 36=DCM_E_REQUESTSEQUENCEERROR, 49=DCM_E_REQUESTOUTOFRANGE, 51=DCM_E_SECURITYACCESSDENIED, 114=DCM_E_GENERALPROGRAMMINGFAILURE, 126=DCM_E_SUBFUNCTIONNOTSUPPORTEDINACTIVESESSION, 129=DCM_E_RPMTOOHIGH, 130=DCM_E_RPMTOOLOW, 131=DCM_E_ENGINEISRUNNING, 132=DCM_E_ENGINEISNOTRUNNING, 133=DCM_E_ENGINERUNTIMETOOLOW, 134=DCM_E_TEMPERATURETOOHIGH, 135=DCM_E_TEMPERATURETOOLOW, 136=DCM_E_VEHICLESPEEDTOOHIGH, 137=DCM_E_VEHICLESPEEDTOOLOW, 138=DCM_E_THROTTLE_PEDALTOOHIGH, 139=DCM_E_THROTTLE_PEDALTOOLOW, 140=DCM_E_TRANSMISSIONRANGENOTINNEUTRAL, 141=DCM_E_TRANSMISSIONRANGENOTINGEAR, 143=DCM_E_BRAKESWITCH_NOTCLOSED, 144=DCM_E_SHIFTERLEVERNOTINPARK, 145=DCM_E_TORQUECONVERTERCLUTCHLOCKED, 146=DCM_E_VOLTAGETOOHIGH, 147=DCM_E_VOLTAGETOOLOW}, implementation-data-type=uint8
    Dcm_OpStatusType: compu {0=DCM_INITIAL, 1=DCM_PENDING, 2=DCM_CANCEL, 3=DCM_FORCE_RCRRP_OK}, implementation-data-type=uint8
    DevInfoArrayType: category=ARRAY
      element SubDevInfoArrayType: array-size=17, array-size-semantics=FIXED-SIZE, implementation-data-type=uint8
    Dlog_EcuUidArrayType: category=ARRAY
      element Dlog_EcuUidSubArrayType: array-size=16, array-size-semantics=FIXED-SIZE, implementation-data-type=uint8
    Dlog_HWModificationIndexArrayType: category=ARRAY
      element Dlog_HWModificationIndexSubArrayType: array-size=2, array-size-semantics=FIXED-SIZE, implementation-data-type=uint8
    Dlog_SwfkDeleteSupportedArrayType: category=ARRAY
      element Dlog_SwfkDeleteSupportedSubArrayType: array-size=1, array-size-semantics=FIXED-SIZE, implementation-data-type=uint8
    Dlog_VinArrayType: category=ARRAY
      element SubVinArrayType: array-size=17, array-size-semantics=FIXED-SIZE, implementation-data-type=uint8
    ManufacturingDataArrayType: category=ARRAY
      element SubManufacturingDataArrayType: array-size=3, array-size-semantics=FIXED-SIZE, implementation-data-type=uint8
    ProgCounterArrayType: category=ARRAY
      element SubProgCounterArrayType: array-size=4, array-size-semantics=FIXED-SIZE, implementation-data-type=uint8
    ProgCounterMaxArrayType: category=ARRAY
      element SubProgCounterMaxArrayType: array-size=2, array-size-semantics=FIXED-SIZE, implementation-data-type=uint8
    RSInputArrayType: category=ARRAY
      element SubRSInputArrayType: array-size=8, array-size-semantics=FIXED-SIZE, implementation-data-type=uint8
    RSOutputArrayType: category=ARRAY
      element SubRSOutputArrayType: array-size=8, array-size-semantics=FIXED-SIZE, implementation-data-type=uint8
    SerialNumberArrayType: category=ARRAY
      element SubSerialNumberArrayType: array-size=10, array-size-semantics=FIXED-SIZE, implementation-data-type=uint8
    SgbdIdArrayType: category=ARRAY
      element SubSgbdIdArrayType: array-size=3, array-size-semantics=FIXED-SIZE, implementation-data-type=uint8
    SvkDataArrayType: category=ARRAY
      element SubSvkDataArrayType: array-size=100, array-size-semantics=FIXED-SIZE, implementation-data-type=uint8
    SvkHistoryDataArrayType: category=ARRAY
      element SubSvkHistoryDataArrayType: array-size=32, array-size-semantics=FIXED-SIZE, implementation-data-type=uint8
    TimingParametersArrayType: category=ARRAY
      element SubTimingParametersArrayType: array-size=12, array-size-semantics=FIXED-SIZE, implementation-data-type=uint8
package /BMW/Platform/Dlog/ImplementationDataTypes
  7 x impl type:
    Coding_SgbmIdType: category=ARRAY
      element SubSgbmIdType: array-size=8, array-size-semantics=FIXED-SIZE, implementation-data-type=uint8
    Dlog_LifeCycleRequestType: compu {0=DLOG_INITIALIZED, 1=DLOG_RUNNING, 2=DLOG_STOPPED}, implementation-data-type=uint8
    Dlog_ProgIdArrayType: category=ARRAY
      element Dlog_ProgIdSubArrayType: array-size=8, array-size-semantics=FIXED-SIZE, implementation-data-type=uint8
    Dlog_RandomSeedType: category=ARRAY
      element Dlog_RandomSeedSubType: array-size=4, array-size-semantics=FIXED-SIZE, implementation-data-type=uint32
    Dlog_SgbmIdArrayType: category=ARRAY
      element SubSgbmIdType: array-size=8, array-size-semantics=FIXED-SIZE, implementation-data-type=uint8
    Dlog_SignatureArrayType: category=ARRAY
      element SubSignatureArrayType: array-size=260, array-size-semantics=FIXED-SIZE, implementation-data-type=uint8
    SignatureArrayType: category=ARRAY
      element SubSignatureArrayType: array-size=132, array-size-semantics=FIXED-SIZE, implementation-data-type=uint8
package /BMW/Platform/Dlog/NvM/ImplementationDataTypes
  impl type NvM_DstPtrType: category=DATA_REFERENCE, sw-pointer-target-props={target-category=VALUE, base-type=void}
  impl type NvM_RequestResultType: compu {0=NVM_REQ_OK, 1=NVM_REQ_NOT_OK, 2=NVM_REQ_PENDING, 3=NVM_REQ_INTEGRITY_FAILED, 4=NVM_REQ_BLOCK_SKIPPED, 5=NVM_REQ_NV_INVALIDATED, 6=NVM_REQ_CANCELED, 7=NVM_REQ_REDUNDANCY_FAILED, 8=NVM_REQ_RESTORED_FROM_ROM}, implementation-data-type=uint8
  impl type NvM_SrcPtrType: category=DATA_REFERENCE, sw-pointer-target-props={target-category=VALUE, base-type=void, sw-impl-policy=CONST}
package /BMW/Platform/IntegrationSample/CompuMethods
  compu method CM_StatusEnergyFZM: 1=ENSTATE_OK (StatusEnergyFZM_ENSTATE_OK), 0=ENSTATE_GOOD (StatusEnergyFZM_ENSTATE_GOOD), 2=ENSTATE_SHORTAGE (StatusEnergyFZM_ENSTATE_SHORTAGE), 255=signal_Unfilled (StatusEnergyFZM_signal_Unfilled), 3=ENSTATE_SEVERE_SHORTAGE (StatusEnergyFZM_ENSTATE_SEVERE_SHORTAGE)
package /BMW/Platform/IntegrationSample/DataTypeMappingSets
  data type mapping set IntegrationSampleModemappingEcuRunState: mode-request-type-map{implementation-data-type=IntegrationSample_EcuRunStateModeRequestType, mode-group=IntegrationSample_EcuRunState}
  data type mapping set IntegrationSampleModemappingSimpleTimerMode: mode-request-type-map{implementation-data-type=IntegrationSample_SimpleTimerStateType, mode-group=IntegrationSample_SimpleTimerState}
package /BMW/Platform/IntegrationSample/Dcm/ImplementationDataTypes
  impl type IntegrationSample_Dcm_ConfirmationStatusType: compu {0=DCM_RES_POS_OK, 1=DCM_RES_POS_NOT_OK, 2=DCM_RES_NEG_OK, 3=DCM_RES_NEG_NOT_OK}, range raw 0..3, implementation-data-type=uint8
  impl type IntegrationSample_Dcm_NegativeResponseCodeType:
    compu {143=DCM_E_BRAKESWITCH_NOTCLOSED, 33=DCM_E_BUSYREPEATREQUEST, 34=DCM_E_CONDITIONSNOTCORRECT, 132=DCM_E_ENGINEISNOTRUNNING, 131=DCM_E_ENGINEISRUNNING, 133=DCM_E_ENGINERUNTIMETOOLOW, 54=DCM_E_EXCEEDNUMBEROFATTEMPTS, 38=DCM_E_FAILUREPREVENTSEXECUTIONOFREQUESTEDACTION, 114=DCM_E_GENERALPROGRAMMINGFAILURE, 16=DCM_E_GENERALREJECT, 19=DCM_E_INCORRECTMESSAGELENGTHORINVALIDFORMAT, 53=DCM_E_INVALIDKEY, 37=DCM_E_NORESPONSEFROMSUBNETCOMPONENT, 49=DCM_E_REQUESTOUTOFRANGE, 36=DCM_E_REQUESTSEQUENCEERROR, 55=DCM_E_REQUIREDTIMEDELAYNOTEXPIRED, 20=DCM_E_RESPONSETOOLONG, 129=DCM_E_RPMTOOHIGH, 130=DCM_E_RPMTOOLOW, 51=DCM_E_SECURITYACCESSDENIED, 17=DCM_E_SERVICENOTSUPPORTED, 127=DCM_E_SERVICENOTSUPPORTEDINACTIVESESSION, 144=DCM_E_SHIFTERLEVERNOTINPARK, 18=DCM_E_SUBFUNCTIONNOTSUPPORTED, 126=DCM_E_SUBFUNCTIONNOTSUPPORTEDINACTIVESESSION, 134=DCM_E_TEMPERATURETOOHIGH, 135=DCM_E_TEMPERATURETOOLOW, 138=DCM_E_THROTTLE_PEDALTOOHIGH, 139=DCM_E_THROTTLE_PEDALTOOLOW, 145=DCM_E_TORQUECONVERTERCLUTCHLOCKED, 113=DCM_E_TRANSFERDATASUSPENDED, 141=DCM_E_TRANSMISSIONRANGENOTINGEAR, 140=DCM_E_TRANSMISSIONRANGENOTINNEUTRAL, 112=DCM_E_UPLOADDOWNLOADNOTACCEPTED, 136=DCM_E_VEHICLESPEEDTOOHIGH, 137=DCM_E_VEHICLESPEEDTOOLOW, 146=DCM_E_VOLTAGETOOHIGH, 147=DCM_E_VOLTAGETOOLOW, 115=DCM_E_WRONGBLOCKSEQUENCECOUNTER, 240..249=DCM_E_VMSCNC_0..DCM_E_VMSCNC_9, 250=DCM_E_VMSCNC_A, 251=DCM_E_VMSCNC_B, 252=DCM_E_VMSCNC_C, 253=DCM_E_VMSCNC_D, 254=DCM_E_VMSCNC_E}
    range raw 16..254
    implementation-data-type=uint8
  impl type IntegrationSample_RequestDataArray: category=ARRAY
    element RequestDataArray: array-size=1024, array-size-semantics=FIXED-SIZE, implementation-data-type=uint8
package /BMW/Platform/IntegrationSample/Dem/ImplementationDataTypes
  impl type IntegrationSample_Dem_DataDemDataElementClass_FUNCPN_STATE_ArrayType: category=ARRAY
    element DataArrayType: array-size=3, array-size-semantics=FIXED-SIZE, implementation-data-type=uint8
  impl type IntegrationSample_Dem_DataDemDataElementClass_KILOMETER_ArrayType: category=ARRAY
    element DataArrayType: array-size=3, array-size-semantics=FIXED-SIZE, implementation-data-type=uint8
  impl type IntegrationSample_Dem_DataDemDataElementClass_PWF_AND_PN_ArrayType: category=ARRAY
    element DataArrayType: array-size=1, array-size-semantics=FIXED-SIZE, implementation-data-type=uint8
package /BMW/Platform/IntegrationSample/ImplementationDataTypes
  9 x impl type:
    IntegrationSample_CON_VEH_Type: category=STRUCTURE, dynamic-array-size-profile=None
      element IntegrationSample_ST_CON_VEH: implementation-data-type=uint8
      element IntegrationSample_CTR_FKTN_PRTNT: implementation-data-type=uint32
      element IntegrationSample_CTR_BS_PRTNT: implementation-data-type=uint8
    IntegrationSample_EcuRunStateModeRequestType: compu {0=IntegrationSample_INVALID_STATE, 1=IntegrationSample_BSW_START, 2=IntegrationSample_STARTUP, 3=IntegrationSample_NORMAL_OPERATION, 4=IntegrationSample_SHUTDOWN}, implementation-data-type=uint8
    IntegrationSample_SimpleTimerStateType: compu {0=IntegrationSample_Timer_FIRE, 1=IntegrationSample_Timer_IDLE, 2=IntegrationSample_Timer_RUNNING}, implementation-data-type=uint8
    IntegrationSample_VehicleCondition_TYPE: category=STRUCTURE, dynamic-array-size-profile=None
      7 x element, all with category=TYPE_REFERENCE:
        cRCConditionVehicle: implementation-data-type=uint8
        aliveConditionVehicle: implementation-data-type=uint8
        controlBasePartialNetworks: implementation-data-type=uint8
        controlFunctionalPartialNetworks: implementation-data-type=uint32
        statusConditionVehicle: implementation-data-type=uint8
        qualifierStatusConditionVehicle: implementation-data-type=uint8
        dummy: implementation-data-type=uint8
    IS_ST_CON_VEH_Type: compu {1=IS_VEHICLE_STATE__PARKING_BN_NOK, 2=IS_VEHICLE_STATE__PARKING_BN_OK, 3=IS_VEHICLE_STATE__CUSTOMER_ABSENT, 5=IS_VEHICLE_STATE__LIVING, 7=IS_VEHICLE_STATE__CHECK_ANALYS_DIAGNOSTICS, 8=IS_VEHICLE_STATE__READINESS_TO_DRIVE_INIT, 10=IS_VEHICLE_STATE__DRIVE, 12=IS_VEHICLE_STATE__READINESS_TO_DRIVE_STOP, 14=IS_VEHICLE_STATE__UNAVAILABLE, 15=IS_VEHICLE_STATE__INVALID}, implementation-data-type=uint8
    MileageKilometreType: category=STRUCTURE, dynamic-array-size-profile=None
      element mileageKilometre: implementation-data-type=uint32
    StatusEnergyFZM_Type: compu-method=CM_StatusEnergyFZM, implementation-data-type=uint8
    StatusInterlockErrorMemoryFZM_Type: compu {0=ErrorMemoryUnlock (StatusInterlockErrorMemoryFZM_ErrorMemoryUnlock), 1=ErrorMemoryLock (StatusInterlockErrorMemoryFZM_ErrorMemoryLock), 2=Reserved (StatusInterlockErrorMemoryFZM_Reserved), 255=Signal_Unfilled (StatusInterlockErrorMemoryFZM_Signal_Unfilled)}, implementation-data-type=uint8
    VehicleState_Type: category=STRUCTURE, dynamic-array-size-profile=None
      element statusEnergyFZM: compu-method=CM_StatusEnergyFZM, implementation-data-type=StatusEnergyFZM_Type
      element statusInterlockErrorMemoryFZM: implementation-data-type=StatusInterlockErrorMemoryFZM_Type
package /BMW/Platform/IntegrationSample/Stm/ImplementationDataTypes
  impl type IntegrationSample_Stm_CentralErrorLockType: compu {0=STM_CEL_UNLOCKED, 1=STM_CEL_LOCKED, 3=STM_CEL_INVALID}, implementation-data-type=uint8
package /BMW/Platform/Omc/DataTypeMappingSets
  data type mapping set Omc_DataTypeMappingSets
    mode-request-type-maps:
      implementation-data-type=ImplementationDataTypes/Omc_ExtendedOperatingModeType, mode-group=OmcExtendedOperatingMode
      implementation-data-type=Omc_LifeCycleRequestType, mode-group=Omc_LifeCycle
      implementation-data-type=ImplementationDataTypes/Omc_OperatingModeType, mode-group=OmcOperatingMode
package /BMW/Platform/Omc/Dcm/CompuMethods
  compu method CM_NegativeResponseType: 16=DCM_E_GENERALREJECT, 33=DCM_E_BUSYREPEATREQUEST, 34=DCM_E_CONDITIONSNOTCORRECT, 36=DCM_E_REQUESTSEQUENCEERROR, 49=DCM_E_REQUESTOUTOFRANGE, 51=DCM_E_SECURITYACCESSDENIED, 114=DCM_E_GENERALPROGRAMMINGFAILURE, 126=DCM_E_SUBFUNCTIONNOTSUPPORTEDINACTIVESESSION, 129=DCM_E_RPMTOOHIGH, 130=DCM_E_RPMTOOLOW, 131=DCM_E_ENGINEISRUNNING, 132=DCM_E_ENGINEISNOTRUNNING, 133=DCM_E_ENGINERUNTIMETOOLOW, 134=DCM_E_TEMPERATURETOOHIGH, 135=DCM_E_TEMPERATURETOOLOW, 136=DCM_E_VEHICLESPEEDTOOHIGH, 137=DCM_E_VEHICLESPEEDTOOLOW, 138=DCM_E_THROTTLE_PEDALTOOHIGH, 139=DCM_E_THROTTLE_PEDALTOOLOW, 140=DCM_E_TRANSMISSIONRANGENOTINNEUTRAL, 141=DCM_E_TRANSMISSIONRANGENOTINGEAR, 143=DCM_E_BRAKESWITCH_NOTCLOSED, 144=DCM_E_SHIFTERLEVERNOTINPARK, 145=DCM_E_TORQUECONVERTERCLUTCHLOCKED, 146=DCM_E_VOLTAGETOOHIGH, 147=DCM_E_VOLTAGETOOLOW
package /BMW/Platform/Omc/Dcm/ImplementationDataTypes
  4 x impl type:
    Dcm_NegativeResponseCodeType: compu-method=CM_NegativeResponseType, implementation-data-type=uint8
    NegativeResponseCodeType: compu-method=CM_NegativeResponseType, implementation-data-type=uint8
    OpStatusType: compu {0=DCM_INITIAL, 1=DCM_PENDING, 2=DCM_CANCEL, 3=DCM_FORCE_RCRRP_OK}, implementation-data-type=uint8
    UInt8_Array1: category=ARRAY
      element data: array-size=1, array-size-semantics=FIXED-SIZE, implementation-data-type=uint8
package /BMW/Platform/Omc/Dem/ImplementationDataTypes
  impl type Dem_EventStatusType: compu {0=DEM_EVENT_STATUS_PASSED, 1=DEM_EVENT_STATUS_FAILED, 2=DEM_EVENT_STATUS_PREPASSED, 3=DEM_EVENT_STATUS_PREFAILED, 4=DEM_EVENT_STATUS_FDC_THRESHOLD_REACHED}, implementation-data-type=uint8
package /BMW/Platform/Omc/ImplementationDataTypes
  impl type Omc_ExtendedOperatingModeType: compu {0=OMC_MODE_EXTENSION_NORMAL, 1..14=OMC_MODE_EXTENSION_1..OMC_MODE_EXTENSION_14, 15=OMC_MODE_EXTENSION_SAVE_ENERGY, 255=OMC_MODE_EXTENSION_INVALID}, implementation-data-type=uint8
  impl type Omc_LifeCycleRequestType: compu {0=OMC_INITIALIZED, 1=OMC_RUNNING, 2=OMC_STOPPED}, implementation-data-type=uint8
  impl type Omc_OperatingModeType: compu {0=OMC_MODE_NORMAL, 1=OMC_MODE_ASSEMBLY, 2=OMC_MODE_TRANSPORT, 3=OMC_MODE_BMW_FLASH}, implementation-data-type=uint8
package /BMW/Platform/Omc/NvM/ImplementationDataTypes
  impl type DstPtrType: category=DATA_REFERENCE, sw-pointer-target-props={target-category=VALUE, base-type=void}
  impl type RequestResultType: compu {0=NVM_REQ_OK, 1=NVM_REQ_NOT_OK, 2=NVM_REQ_PENDING, 3=NVM_REQ_INTEGRITY_FAILED, 4=NVM_REQ_BLOCK_SKIPPED, 5=NVM_REQ_NV_INVALIDATED, 6=NVM_REQ_CANCELED, 7=NVM_REQ_REDUNDANCY_FAILED, 8=NVM_REQ_RESTORED_FROM_ROM}, implementation-data-type=uint8
  impl type SrcPtrType: category=DATA_REFERENCE, sw-pointer-target-props={target-category=VALUE, base-type=void, sw-impl-policy=CONST}
package /BMW/Platform/StdDiag/Darh/ImplementationDataTypes
  impl type Darh_RoeStateType: compu {0=DARH_ROE_STOPPED, 1=DARH_ROE_STARTED, 2=DARH_ROE_UNKNOWN}, implementation-data-type=uint8
package /BMW/Platform/StdDiag/DataTypeMappingSets
  data type mapping set StdDiag_DataTypeMappingSet
    mode-request-type-maps:
      implementation-data-type=uint8, mode-group=StdDiag_SessionModeGroup
      implementation-data-type=NormalCommunicationModeType, mode-group=StdDiag_NormalCommunicationModeGroup
      implementation-data-type=StdDiag_LifeCycleRequestType, mode-group=StdDiag_LifeCycle
package /BMW/Platform/StdDiag/Dcm/ImplementationDataTypes
  12 x impl type:
    ActiveDiagSession_ArrayType: category=ARRAY
      element data: array-size=1, array-size-semantics=FIXED-SIZE, implementation-data-type=uint8
    ActiveSessionState_ArrayType: category=ARRAY
      element data: array-size=4, array-size-semantics=FIXED-SIZE, implementation-data-type=uint8
    CheckProgrammingPreconditions_ArrayType: category=ARRAY
      element data: array-size=256, array-size-semantics=FIXED-SIZE, implementation-data-type=uint8
    Dcm_ConfirmationStatusType: compu {0=DCM_RES_POS_OK, 1=DCM_RES_POS_NOT_OK, 2=DCM_RES_NEG_OK, 3=DCM_RES_NEG_NOT_OK}, range raw 0..3, implementation-data-type=uint8
    Dcm_NegativeResponseCodeType:
      compu {143=DCM_E_BRAKESWITCH_NOTCLOSED, 33=DCM_E_BUSYREPEATREQUEST, 34=DCM_E_CONDITIONSNOTCORRECT, 132=DCM_E_ENGINEISNOTRUNNING, 131=DCM_E_ENGINEISRUNNING, 133=DCM_E_ENGINERUNTIMETOOLOW, 54=DCM_E_EXCEEDNUMBEROFATTEMPTS, 38=DCM_E_FAILUREPREVENTSEXECUTIONOFREQUESTEDACTION, 114=DCM_E_GENERALPROGRAMMINGFAILURE, 16=DCM_E_GENERALREJECT, 19=DCM_E_INCORRECTMESSAGELENGTHORINVALIDFORMAT, 53=DCM_E_INVALIDKEY, 37=DCM_E_NORESPONSEFROMSUBNETCOMPONENT, 49=DCM_E_REQUESTOUTOFRANGE, 36=DCM_E_REQUESTSEQUENCEERROR, 55=DCM_E_REQUIREDTIMEDELAYNOTEXPIRED, 20=DCM_E_RESPONSETOOLONG, 129=DCM_E_RPMTOOHIGH, 130=DCM_E_RPMTOOLOW, 51=DCM_E_SECURITYACCESSDENIED, 17=DCM_E_SERVICENOTSUPPORTED, 127=DCM_E_SERVICENOTSUPPORTEDINACTIVESESSION, 144=DCM_E_SHIFTERLEVERNOTINPARK, 18=DCM_E_SUBFUNCTIONNOTSUPPORTED, 126=DCM_E_SUBFUNCTIONNOTSUPPORTEDINACTIVESESSION, 134=DCM_E_TEMPERATURETOOHIGH, 135=DCM_E_TEMPERATURETOOLOW, 138=DCM_E_THROTTLE_PEDALTOOHIGH, 139=DCM_E_THROTTLE_PEDALTOOLOW, 145=DCM_E_TORQUECONVERTERCLUTCHLOCKED, 113=DCM_E_TRANSFERDATASUSPENDED, 141=DCM_E_TRANSMISSIONRANGENOTINGEAR, 140=DCM_E_TRANSMISSIONRANGENOTINNEUTRAL, 112=DCM_E_UPLOADDOWNLOADNOTACCEPTED, 136=DCM_E_VEHICLESPEEDTOOHIGH, 137=DCM_E_VEHICLESPEEDTOOLOW, 146=DCM_E_VOLTAGETOOHIGH, 147=DCM_E_VOLTAGETOOLOW, 115=DCM_E_WRONGBLOCKSEQUENCECOUNTER, 240..249=DCM_E_VMSCNC_0..DCM_E_VMSCNC_9, 250=DCM_E_VMSCNC_A, 251=DCM_E_VMSCNC_B, 252=DCM_E_VMSCNC_C, 253=DCM_E_VMSCNC_D, 254=DCM_E_VMSCNC_E}
      range raw 16..254
      implementation-data-type=uint8
    Dcm_OpStatusType: compu {0=DCM_INITIAL, 1=DCM_PENDING, 2=DCM_CANCEL, 3=DCM_FORCE_RCRRP_OK}, range raw 0..3, implementation-data-type=uint8
    Dcm_SecLevelType: compu {0=DCM_SEC_LEV_LOCKED, 1=DcmDspSecurityRow_Coding}, range raw 0..1, implementation-data-type=uint8
    Dcm_SesCtrlType: compu {1=DCM_DEFAULT_SESSION, 2=DCM_PROGRAMMING_SESSION, 3=DCM_EXTENDED_DIAGNOSTIC_SESSION, 4=DCM_SAFETY_SYSTEM_DIAGNOSTIC_SESSION, 65=DCM_CODING_SESSION, 66=DCM_SWT_SESSION}, range raw 1..66, implementation-data-type=uint8
    DiagCommLoopback_ArrayType: category=ARRAY
      element data: array-size=1024, array-size-semantics=FIXED-SIZE, implementation-data-type=uint8
    RequestDataArray: category=ARRAY
      element RequestDataArray: array-size=1024, array-size-semantics=FIXED-SIZE, implementation-data-type=uint8
    SgbdIndex_ArrayType: category=ARRAY
      element data: array-size=3, array-size-semantics=FIXED-SIZE, implementation-data-type=uint8
    UpDownloadPrePostProcessing_ArrayType: category=ARRAY
      element data: array-size=273, array-size-semantics=FIXED-SIZE, implementation-data-type=uint8
package /BMW/Platform/StdDiag/Dem/ImplementationDataTypes
  impl type Dem_DTCFormatType: compu {0=DEM_DTC_FORMAT_OBD, 1=DEM_DTC_FORMAT_UDS, 2=DEM_DTC_FORMAT_J1939}, range raw 0..2, implementation-data-type=uint8
  impl type Dem_DTCOriginType: compu {1=DEM_DTC_ORIGIN_PRIMARY_MEMORY, 2=DEM_DTC_ORIGIN_MIRROR_MEMORY, 3=DEM_DTC_ORIGIN_PERMANENT_MEMORY, 4=DEM_DTC_ORIGIN_USERDEFINED_MEMORY_BMWSecondaryErrorMemory}, range raw 1..4, implementation-data-type=uint8
package /BMW/Platform/StdDiag/ImplementationDataTypes
  4 x impl type:
    AdtApplicationParameter_ArrayType: category=ARRAY
      element data: array-size=255, array-size-semantics=FIXED-SIZE, implementation-data-type=uint8
    NormalCommunicationModeType: compu {0=DISABLE_RX_AND_TX_NORMAL, 1=DISABLE_RX_ENABLE_TX_NORMAL, 2=ENABLE_RX_AND_TX_NORMAL, 3=ENABLE_RX_DISABLE_TX_NORMAL}, implementation-data-type=uint8
    StdDiag_LifeCycleRequestType: compu {0=STDDIAG_INITIALIZED, 1=STDDIAG_RUNNING, 2=STDDIAG_STOPPED}, implementation-data-type=uint8
    UpDownload_ArrayType: category=ARRAY
      element data: array-size=4096, array-size-semantics=FIXED-SIZE, implementation-data-type=uint8
package /BMW/Platform/StdDiag/Omc/DataTypeMappingSets
  data type mapping set Omc_DataTypeMappingSets
    mode-request-type-maps:
      implementation-data-type=ImplementationDataTypes/Omc_ExtendedOperatingModeType, mode-group=OmcExtendedOperatingMode
      implementation-data-type=ImplementationDataTypes/Omc_OperatingModeType, mode-group=OmcOperatingMode
package /BMW/Platform/StdDiag/Omc/ImplementationDataTypes
  impl type Omc_ExtendedOperatingModeType: compu {0=OMC_MODE_EXTENSION_NORMAL, 1..14=OMC_MODE_EXTENSION_1..OMC_MODE_EXTENSION_14, 15=OMC_MODE_EXTENSION_SAVE_ENERGY, 255=OMC_MODE_EXTENSION_INVALID}, implementation-data-type=uint8
  impl type Omc_OperatingModeType: compu {0=OMC_MODE_NORMAL, 1=OMC_MODE_ASSEMBLY, 2=OMC_MODE_TRANSPORT, 3=OMC_MODE_BMW_FLASH}, implementation-data-type=uint8
package /BMW/Platform/StdDiag/Stm/DataTypeMappingSets
  data type mapping set Stm_VehicleStatModeRequestTypeMap: mode-request-type-map{implementation-data-type=ImplementationDataTypes/Stm_VehicleStateType, mode-group=Stm_VehicleStateMode}
package /BMW/Platform/StdDiag/Stm/ImplementationDataTypes
  impl type Stm_VehicleStateType: compu {1=STM_VEHICLE_STATE_PARKING_BN_NOK, 2=STM_VEHICLE_STATE_PARKING_BN_OK, 3=STM_VEHICLE_STATE_CUSTOMER_ABSENT, 5=STM_VEHICLE_STATE_LIVING, 7=STM_VEHICLE_STATE_CHECK_ANALYS_DIAGNOSTICS, 8=STM_VEHICLE_STATE_READINESS_TO_DRIVE_INIT, 10=STM_VEHICLE_STATE_DRIVE, 12=STM_VEHICLE_STATE_READINESS_TO_DRIVE_STOP, 14=STM_VEHICLE_STATE_UNAVAILABLE, 15=STM_VEHICLE_STATE_INVALID}, implementation-data-type=uint8
package /BMW/Platform/Stm/DataTypeMappingSets
  5 x data type mapping set:
    Stm_CentralErrorLockModeRequestTypeMap: mode-request-type-map{implementation-data-type=Stm_CentralErrorLockType, mode-group=Stm_CentralErrorLockMode}
    Stm_EMLS_Mapping: mode-request-type-map{implementation-data-type=uint8, mode-group=ErrorMemoryLockSignalReceptionMode}
    Stm_EnergyStateModeRequestTypeMap: mode-request-type-map{implementation-data-type=Stm_EnergyStateType, mode-group=Stm_EnergyStateMode}
    Stm_VehicleStatModeRequestTypeMap: mode-request-type-map{implementation-data-type=ImplementationDataTypes/Stm_VehicleStateType, mode-group=Stm_VehicleStateMode}
    Stm_VehicleStatSP2015ModeRequestTypeMap: mode-request-type-map{implementation-data-type=Stm_VehicleStateSP2015Type, mode-group=Stm_VehicleStateSP2015Mode}
package /BMW/Platform/Stm/ImplementationDataTypes
  4 x impl type, all with category=TYPE_REFERENCE, implementation-data-type=uint8:
    Stm_CentralErrorLockType: compu {0=STM_CEL_UNLOCKED, 1=STM_CEL_LOCKED, 3=STM_CEL_INVALID}
    Stm_EnergyStateType: compu {0=STM_ENERGY_GOOD, 1=STM_ENERGY_OK, 2=STM_ENERGY_SHORTAGE, 3=STM_ENERGY_SEVERE_SHORTAGE, 15=STM_ENERGY_INVALID}
    Stm_VehicleStateSP2015Type: compu {1=STM_VEHICLE_STATE_SP2015_PARKING_BN_NOK, 2=STM_VEHICLE_STATE_SP2015_PARKING_BN_OK, 3=STM_VEHICLE_STATE_SP2015_CUSTOMER_ABSENT, 5=STM_VEHICLE_STATE_SP2015_LIVING, 7=STM_VEHICLE_STATE_SP2015_CHECK_ANALYS_DIAGNOSTICS, 8=STM_VEHICLE_STATE_SP2015_READINESS_TO_DRIVE_INIT, 10=STM_VEHICLE_STATE_SP2015_DRIVE, 12=STM_VEHICLE_STATE_SP2015_READINESS_TO_DRIVE_STOP, 14=STM_VEHICLE_STATE_SP2015_UNAVAILABLE, 15=STM_VEHICLE_STATE_SP2015_INVALID}
    Stm_VehicleStateType: compu {1=STM_VEHICLE_STATE_PARKING_BN_NOK, 2=STM_VEHICLE_STATE_PARKING_BN_OK, 3=STM_VEHICLE_STATE_CUSTOMER_ABSENT, 5=STM_VEHICLE_STATE_LIVING, 7=STM_VEHICLE_STATE_CHECK_ANALYS_DIAGNOSTICS, 8=STM_VEHICLE_STATE_READINESS_TO_DRIVE_INIT, 10=STM_VEHICLE_STATE_DRIVE, 12=STM_VEHICLE_STATE_READINESS_TO_DRIVE_STOP, 14=STM_VEHICLE_STATE_UNAVAILABLE, 15=STM_VEHICLE_STATE_INVALID}
package /BMW/Platform/SysTime/DataTypeMappingSets
  data type mapping set DataTMappingSet1: mode-request-type-map{implementation-data-type=SysTime_LifeCycleRequestType, mode-group=SysTime_LifeCycle}
package /BMW/Platform/SysTime/Dcm/ImplementationDataTypes
  impl type Array4: category=ARRAY
    element data: array-size=4, array-size-semantics=FIXED-SIZE, implementation-data-type=uint8
package /BMW/Platform/SysTime/ImplementationDataTypes
  impl type SysTime_LifeCycleRequestType: compu {0=SYSTIME_INITIALIZED, 1=SYSTIME_RUNNING, 2=SYSTIME_STOPPED}, implementation-data-type=uint8
package /BMW/Platform/Vin/ImplementationDataTypes
  impl type Vin_ComVinType: category=STRUCTURE, dynamic-array-size-profile=None
    7 x element, all with category=TYPE_REFERENCE, implementation-data-type=uint8:
      Vin{1..7}
package /BMW/SystemDescription/BaseTypes
  base type ascii8: category=FIXED_LENGTH, base-type-size=8, base-type-encoding=ISO-8859-1
package /BMW/SystemDescription/CompuMethods
  compu method ACLNY_COG: phys=raw*0.002-65 for raw >0..<255; unit m/s²
  compu method ACLNY_COG_ERR_AMP: phys=raw*0.005 for raw >0..<255; unit m/s²
  compu method ACTVN_FN_ESTP_VIRT_FTAX: 0=Funktion virtueller Endanschlag deaktivieren (ACTVN_FN_ESTP_VIRT_FTAX_Funktion_virtueller_Endanschlag_deaktivieren) (Funktion virtueller Endanschlag deaktivieren durch Fahrzeugführung), 1=Funktion virtueller Endanschlag aktivieren (ACTVN_FN_ESTP_VIRT_FTAX_Funktion_virtueller_Endanschlag_aktivieren) (Funktion virtueller Endanschlag aktivieren durch Fahrzeugführung), 13=Funktionsschnittstelle_ist_nicht_verfuegbar (ACTVN_FN_ESTP_VIRT_FTAX_Funktionsschnittstelle_ist_nicht_verfuegbar) (Sendefunktion in Betrieb, Werte nicht verfügbar), 14=Funktion_meldet_Fehler (ACTVN_FN_ESTP_VIRT_FTAX_Funktion_meldet_Fehler) (Sendefunktion in Betrieb, meldet Fehler), 15=Signal_unbefuellt (ACTVN_FN_ESTP_VIRT_FTAX_Signal_unbefuellt) (Sendefunktion nicht in Betrieb)
  compu method ALIV_4_BIT_UInt: phys=raw for raw >0..<255
  compu method ALIV_4_BIT_Unsigned_Integer: phys=raw for raw >0..<255
  compu method ALIV_COU_4: 0..14=Zählerstand 0..E (After counter reading 14, the counter restarts at 0 again in cycles), 15=Signal ungültig (ALIV_COU_4_Signal_ungueltig)
  compu method ALIV_COU_V: 0..14=Zählerstand 0..E (After counter reading 14, the counter restarts at 0 again in cycles), 15=Signal ungültig (ALIV_COU_V_Signal_ungueltig)
  compu method AVL_FORC_GRD: phys=raw*0.0084-17 for raw >0..<255; unit kN
  compu method AVL_PINA_EPS: phys=raw*0.0439453125-1439.956055 for raw >0..<255
  compu method AVL_PINA_IDX_ICM: phys=raw*0.0439453125-1439.956055 for raw >0..<255
  compu method AVL_PWR_EL: phys=raw*0.1-12 for raw >0..<255; unit kW
  compu method AVL_RPM_WHL: phys=raw/64-511.984375 for raw >0..<255; unit rad/s
  compu method AVL_STEA_PNI_OFFS: phys=raw*0.021994-45 for raw 0..4092, 4093=Funktionsschnittstelle_ist_nicht_verfuegbar (AVL_STEA_PNI_OFFS_Funktionsschnittstelle_ist_nicht_verfuegbar) (Signal Tag - Schnittstelle ist nicht verfügbar), 4094=Funktion_meldet_Fehler (AVL_STEA_PNI_OFFS_Funktion_meldet_Fehler) (Signal Tag - Funktion meldet Fehler), 4095=Signal_unbefuellt (AVL_STEA_PNI_OFFS_Signal_unbefuellt) (Signal Tag - Signal ist unbefüllt)
  compu method CHL_4_UInt: phys=raw for raw >0..<255
  compu method COU_BS_RESP: phys=raw for raw >0..<255
  compu method CRC_V_VEH: phys=raw for raw >0..<255
  compu method CRC8: phys=raw for raw >0..<255
  compu method CTR_BS_PRTNT: 0=Keine Kommunikation (CTR_BS_PRTNT_Keine_Kommunikation), 1=Kom_Parken_BN_niO (CTR_BS_PRTNT_Kom_Parken_BN_niO), 2=Kom_Parken_BN_iO (CTR_BS_PRTNT_Kom_Parken_BN_iO), 3=Kom_Standfunktionen_Kunde_nicht_im_FZG (CTR_BS_PRTNT_Kom_Standfunktionen_Kunde_nicht_im_FZG), 4=reserviert (CTR_BS_PRTNT_reserviert), 5=Kom_Wohnen (CTR_BS_PRTNT_Kom_Wohnen), 6=reserviert (CTR_BS_PRTNT_reserviert_2), 7=Kom_Pruefen_Analyse_Diagnose (CTR_BS_PRTNT_Kom_Pruefen_Analyse_Diagnose), 8=Kom_Fahrbereitschaft_herstellen (CTR_BS_PRTNT_Kom_Fahrbereitschaft_herstellen), 9=reserviert (CTR_BS_PRTNT_reserviert_3), 10=Kom_Fahren (CTR_BS_PRTNT_Kom_Fahren), 11=reserviert (CTR_BS_PRTNT_reserviert_4), 12=Kom_Fahrbereitschaft_beenden (CTR_BS_PRTNT_Kom_Fahrbereitschaft_beenden), 13=reserviert (CTR_BS_PRTNT_reserviert_5) (Hinweis: Reserviert für funktionale Kennung Signal-Tag.), 14=reserviert (CTR_BS_PRTNT_reserviert_6) (Hinweis: Reserviert für funktionale Kennung Signal-Tag.), 15=Signal_unbefuellt (CTR_BS_PRTNT_Signal_unbefuellt)
  compu method CTR_DEAC_EPS_FNS: mask 15: 0=Keine_Deaktivierung_EPS_Funktionen (CTR_DEAC_EPS_FNS_Keine_Deaktivierung_EPS_Funktionen) (Es besteht keine Anforderung zur Deaktivierung von Funktionen auf der EPS.), mask 9: 1=Deaktivierung_EPS_Funktionen_ Funktionsgruppe_1 (CTR_DEAC_EPS_FNS_Deaktivierung_EPS_Funktionen_Funktionsgruppe_1) (Anforderung zur Deaktivierung einer spezifizierten Funktionsgruppe 1 auf der EPS. Die detaillierte Spezifikation der Funktionsgruppe 1 erfolgt im Entwicklungsprozess mit den Lieferanten.), mask 10: 2=Deaktivierung_EPS_Funktionen_ Funktionsgruppe_2 (CTR_DEAC_EPS_FNS_Deaktivierung_EPS_Funktionen_Funktionsgruppe_2) (Anforderung zur Deaktivierung einer spezifizierten Funktionsgruppe 2 auf der EPS. Die detaillierte Spezifikation der Funktionsgruppe 2 erfolgt im Entwicklungsprozess mit den Lieferanten.), mask 15: 13=Funktionsschnittstelle_ist_nicht_verfuegbar (CTR_DEAC_EPS_FNS_Funktionsschnittstelle_ist_nicht_verfuegbar) (Sendefunktion in Betrieb, Werte nicht verfügbar), mask 15: 14=Funktion_meldet_Fehler (CTR_DEAC_EPS_FNS_Funktion_meldet_Fehler) (Sendefunktion in Betrieb, meldet Fehler), mask 15: 15=Signal_unbefuellt (CTR_DEAC_EPS_FNS_Signal_unbefuellt) (Wird nicht aktiv gesetzt)
  compu method CTR_ERRM_BN_U: mask 33: 0=Keine Unterspannung Normalbetrieb (CTR_ERRM_BN_U_Keine_Unterspannung_Normalbetrieb) (Unterspannungsschwelle für Normalbetrieb nicht erreicht.), mask 33: 1=Unterspannung Normalbetrieb (CTR_ERRM_BN_U_Unterspannung_Normalbetrieb) (Unterspannungsschwelle für Normalbetrieb unterschritten.), mask 34: 0=Keine Unterspannung MSA-Start (CTR_ERRM_BN_U_Keine_Unterspannung_MSA_Start) (Unterspannungsschwelle für MSA-Start Festigkeit nicht erreicht.), mask 34: 2=Unterspannung MSA-Start (CTR_ERRM_BN_U_Unterspannung_MSA_Start) (Unterspannungsschwelle für MSA-Start Festigkeit unterschritten.), mask 36: 0=Keine Überspannung (CTR_ERRM_BN_U_Keine_Ueberspannung) (Überspannungsschwelle nicht erreicht.), mask 36: 4=Überspannung (CTR_ERRM_BN_U_Ueberspannung) (Überspannungsschwelle überschritten.), mask 63: 61=Funktionsschnittstelle_ist_nicht_verfuegbar (CTR_ERRM_BN_U_Funktionsschnittstelle_ist_nicht_verfuegbar) (Sendefunktion in Betrieb, Werte nicht verfügbar), mask 63: 62=Funktion_meldet_Fehler (CTR_ERRM_BN_U_Funktion_meldet_Fehler) (Sendefunktion in Betrieb, meldet Fehler), mask 63: 63=Signal_unbefuellt (CTR_ERRM_BN_U_Signal_unbefuellt) (Sendefunktion nicht in Betrieb)
  compu method CTR_WARN_DIR_VIB_EPS: 0=Keine_Richtung (CTR_WARN_DIR_VIB_EPS_Keine_Richtung) (Ungerichteter Impuls Diese Codierung wird auch versendet, wenn keine haptische Warnung erfolgt.), 1=Richtung_links (CTR_WARN_DIR_VIB_EPS_Richtung_links) (Impuls Richtung links), 2=Richtung_rechts (CTR_WARN_DIR_VIB_EPS_Richtung_rechts) (Impuls Richtung rechts), 3=Signal_unbefuellt (CTR_WARN_DIR_VIB_EPS_Signal_unbefuellt) (Sendefunktion nicht in Betrieb)
  compu method CTR_WARN_ILVL_VIB_EPS: 0=Intensitaetsstufe_0 (CTR_WARN_ILVL_VIB_EPS_Intensitaetsstufe_0) (Diese Codierung wird auch verwendet, wenn keine haptische Warnung erfolgt.), 1=Intensitaetsstufe_1 (CTR_WARN_ILVL_VIB_EPS_Intensitaetsstufe_1), 2=Intensitaetsstufe_2 (CTR_WARN_ILVL_VIB_EPS_Intensitaetsstufe_2), 3=Intensitaetsstufe_3 (CTR_WARN_ILVL_VIB_EPS_Intensitaetsstufe_3), 4=Intensitaetsstufe_4 (CTR_WARN_ILVL_VIB_EPS_Intensitaetsstufe_4), 5=Intensitaetsstufe_5 (CTR_WARN_ILVL_VIB_EPS_Intensitaetsstufe_5), 6=Intensitaetsstufe_6 (CTR_WARN_ILVL_VIB_EPS_Intensitaetsstufe_6), 7=Intensitaetsstufe_7 (CTR_WARN_ILVL_VIB_EPS_Intensitaetsstufe_7), 8=Intensitaetsstufe_8 (CTR_WARN_ILVL_VIB_EPS_Intensitaetsstufe_8), 9=Intensitaetsstufe_9 (CTR_WARN_ILVL_VIB_EPS_Intensitaetsstufe_9), 10=Intensitaetsstufe_10 (CTR_WARN_ILVL_VIB_EPS_Intensitaetsstufe_10), 11=Intensitaetsstufe_11 (CTR_WARN_ILVL_VIB_EPS_Intensitaetsstufe_11), 12=Intensitaetsstufe_12 (CTR_WARN_ILVL_VIB_EPS_Intensitaetsstufe_12), 13=Reserviert (CTR_WARN_ILVL_VIB_EPS_Reserviert) (Hinweis: Reserviert für funktionale Kennung Signal-Tag.), 14=Reserviert (CTR_WARN_ILVL_VIB_EPS_Reserviert_2) (Hinweis: Reserviert für funktionale Kennung Signal-Tag.), 15=Signal_unbefuellt (CTR_WARN_ILVL_VIB_EPS_Signal_unbefuellt) (Sendefunktion nicht in Betrieb)
  compu method CTR_WARN_PTRN_VIB_EPS: 0=Keine_haptische_Warnung (CTR_WARN_PTRN_VIB_EPS_Keine_haptische_Warnung), 1=Muster_1 (CTR_WARN_PTRN_VIB_EPS_Muster_1), 2=Muster_2 (CTR_WARN_PTRN_VIB_EPS_Muster_2), 3=Muster_3 (CTR_WARN_PTRN_VIB_EPS_Muster_3), 4=Muster_4 (CTR_WARN_PTRN_VIB_EPS_Muster_4), 5=Muster_5 (CTR_WARN_PTRN_VIB_EPS_Muster_5), 6=Muster_6 (CTR_WARN_PTRN_VIB_EPS_Muster_6), 7=Muster_7 (CTR_WARN_PTRN_VIB_EPS_Muster_7), 8=Muster_8 (CTR_WARN_PTRN_VIB_EPS_Muster_8), 9=Muster_9 (CTR_WARN_PTRN_VIB_EPS_Muster_9), 10=Muster_10 (CTR_WARN_PTRN_VIB_EPS_Muster_10), 13=Funktionsschnittstelle_ist_nicht_verfuegbar (CTR_WARN_PTRN_VIB_EPS_Funktionsschnittstelle_ist_nicht_verfuegbar) (Sendefunktion in Betrieb, Werte nicht verfügbar), 14=Funktion_meldet_Fehler (CTR_WARN_PTRN_VIB_EPS_Funktion_meldet_Fehler) (Sendefunktion in Betrieb, meldet Fehler), 15=Signal_unbefuellt (CTR_WARN_PTRN_VIB_EPS_Signal_unbefuellt) (Sendefunktion nicht in Betrieb)
  compu method DBG_8Bit: phys=raw for raw >0..<255
  compu method DIAG_ST_OBD: identical
  compu method DVCO_VEH: 0=Fahrzeug steht (DVCO_VEH_Fahrzeug_steht) (See above), 1=Fahrzeug fährt vorwärts (DVCO_VEH_Fahrzeug_faehrt_vorwaerts) (FL and FR forwards), 2=Fahrzeug fährt rückwärts (DVCO_VEH_Fahrzeug_faehrt_rueckwaerts) (FL and FR backwards), 3=Fahrzeug fährt (DVCO_VEH_Fahrzeug_faehrt) (Direction recognition not possible, e.g. air gap too large), 4=Fahrzeug steht, Hinterachse auf Rollenprüfstand erkannt (DVCO_VEH_Fahrzeug_steht_Hinterachse_auf_Rollenpruefstand_erkannt) (Fahrzeug auf Hinterachs-Ein-Achs- Rollenprüfstand erkannt. Signalverhalten von Geschwindigkeit_Fahrzeug_Schwerpunkt siehe Signalbeschreibung DVCO_VEH), 5=Fahrzeug steht, Zwei-Achs-Rollenbetrieb gesetzt (DVCO_VEH_Fahrzeug_steht_Zwei_Achs_Rollenbetrieb_gesetzt) (Codierung wird beim CAS4 im F25 erst ab I400 richtig interpretiert. Signal Geschwindigkeit_Fahrzeug_Schwerpunkt entspricht der Rollengeschwindigkeit, Details siehe Signalbeschreibung), 6=Fahrzeug steht, Vorderachse auf Rollenprüfstand erkannt (DVCO_VEH_Fahrzeug_steht_Vorderachse_auf_Rollenpruefstand_erkannt) (Fahrzeug auf Vorderachs-Ein-Achs-Rollenprüfstand erkannt. (Bit kann erst ab SP2013 gesetzt werden) Signalverhalten von Geschwindigkeit_Fahrzeug_Schwerpunkt siehe Signalbeschreibung DVCO_VEH), 7=Signal ungültig (DVCO_VEH_Signal_ungueltig) (Wird beim Aufstarten gesetzt, solange kein gültiger Zustand ermittelt werden kann und beim Auftreten eines Kommunikationsfehlers.)
  compu method ENERG_AVAI_ARS: phys=raw for raw 0..100, 253=Funktionsschnittstelle_ist_nicht_verfuegbar (ENERG_AVAI_ARS_Funktionsschnittstelle_ist_nicht_verfuegbar) (Sendefunktion in Betrieb, Werte nicht verfügbar), 254=Funktion_meldet_Fehler (ENERG_AVAI_ARS_Funktion_meldet_Fehler) (Nutzsignal kann nicht berechnet werden), 255=Signal_unbefuellt (ENERG_AVAI_ARS_Signal_unbefuellt) (Sendefunktion nicht in Betrieb); unit %
  compu method FACT_ASS_STMOM_FTAX: phys=raw/256+1 for raw >0..<255
  compu method FACT_CTRR_STMOM_FTAX: phys=raw/256+0.0078125 for raw >0..<255
  compu method FACT_DMPNG_ADDON_STMOM_FTAX: phys=raw/64 for raw 0..128, 253=Reserviert (FACT_DMPNG_ADDON_STMOM_FTAX_Reserviert) (Hinweis: Reserviert für funktionale Kennung Signal-Tag.), 254=Reserviert (FACT_DMPNG_ADDON_STMOM_FTAX_Reserviert_2) (Hinweis: Reserviert für funktionale Kennung Signal-Tag.), 255=Signal_unbefuellt (FACT_DMPNG_ADDON_STMOM_FTAX_Signal_unbefuellt) (Sendefunktion nicht in Betrieb)
  compu method FACT_MO_STE_SO_DXP: phys=raw*0.02 for raw 0..250, 253=Funktionsschnittstelle_ist_nicht_verfuegbar (FACT_MO_STE_SO_DXP_Funktionsschnittstelle_ist_nicht_verfuegbar) (Sendefunktion in Betrieb, Werte nicht verfügbar), 254=Funktion_meldet_Fehler (FACT_MO_STE_SO_DXP_Funktion_meldet_Fehler) (Sendefunktion in Betrieb, meldet Fehler), 255=Signal_unbefuellt (FACT_MO_STE_SO_DXP_Signal_unbefuellt) (Sendefunktion nicht in Betrieb)
  compu method FKTN_PRTNT: mask 2147483649: 0=Konfiguration aus (FKTN_PRTNT_Konfiguration_aus), mask 2147483649: 1=Konfiguration ein (FKTN_PRTNT_Konfiguration_ein), mask 2147483650: 0=Ethernet Infrastruktur aus (FKTN_PRTNT_Ethernet_Infrastruktur_aus), mask 2147483650: 2=Ethernet Infrastruktur ein (FKTN_PRTNT_Ethernet_Infrastruktur_ein), mask 2147483652: 0=Datenkommunikation_aus (FKTN_PRTNT_Datenkommunikation_aus) (Gilt ab SP2018), mask 2147483652: 4=Datenkommunikation_ein (FKTN_PRTNT_Datenkommunikation_ein) (Gilt ab SP2018), mask 2147483904: 0=Klimabetrieb aus (FKTN_PRTNT_Klimabetrieb_aus), mask 2147483904: 256=Klimabetrieb ein (FKTN_PRTNT_Klimabetrieb_ein), mask 2147484160: 0=Entertainmentbetrieb aus (FKTN_PRTNT_Entertainmentbetrieb_aus), mask 2147484160: 512=Entertainmentbetrieb ein (FKTN_PRTNT_Entertainmentbetrieb_ein), mask 2147484672: 0=Externe_Kommunikation aus (FKTN_PRTNT_Externe_Kommunikation_aus), mask 2147484672: 1024=Externe_Kommunikation ein (FKTN_PRTNT_Externe_Kommunikation_ein), mask 2147485696: 0=Entertainmentbetrieb_Fond_aus (FKTN_PRTNT_Entertainmentbetrieb_Fond_aus) (Gilt ab SP2018), mask 2147485696: 2048=Entertainmentbetrieb_Fond_ein (FKTN_PRTNT_Entertainmentbetrieb_Fond_ein) (Gilt ab SP2018), mask 2147487744: 0=Assistenz_Parken_high aus (FKTN_PRTNT_Assistenz_Parken_high_aus), mask 2147487744: 4096=Assistenz_Parken_high ein (FKTN_PRTNT_Assistenz_Parken_high_ein), mask 2147516416: 0=Laden aus (FKTN_PRTNT_Laden_aus), mask 2147516416: 32768=Laden ein (FKTN_PRTNT_Laden_ein), mask 2147549184: 0=Fahrzeug Infrastruktur aus (FKTN_PRTNT_Fahrzeug_Infrastruktur_aus), mask 2147549184: 65536=Fahrzeug Infrastruktur ein (FKTN_PRTNT_Fahrzeug_Infrastruktur_ein), mask 2148007936: 0=Licht_aus (FKTN_PRTNT_Licht_aus) (Gilt ab SP2018), mask 2148007936: 524288=Licht_ein (FKTN_PRTNT_Licht_ein) (Gilt ab SP2018), mask 2148532224: 0=TN_48V_aus (FKTN_PRTNT_TN_48V_aus), mask 2148532224: 1048576=TN_48V_ein (FKTN_PRTNT_TN_48V_ein), mask 4294967295: 4294967295=Signal_unbefuellt (FKTN_PRTNT_Signal_unbefuellt)
  compu method I_SPEC_ARS: phys=raw for raw 0..252, 253=Funktionsschnittstelle_ist_nicht_verfuegbar (I_SPEC_ARS_Funktionsschnittstelle_ist_nicht_verfuegbar) (Sendefunktion in Betrieb, Werte nicht verfügbar), 254=Funktion_meldet_Fehler (I_SPEC_ARS_Funktion_meldet_Fehler) (Nutzsignal kann nicht berechnet werden), 255=Signal_unbefuellt (I_SPEC_ARS_Signal_unbefuellt) (Sendefunktion nicht in Betrieb); unit A
  compu method ID_FN_INQY: 41216=Bedienung Tasten Entertainment (ID_FN_INQY_Bedienung_Tasten_Entertainment), 62976=Steuerung Außenspiegel (ID_FN_INQY_Steuerung_Aussenspiegel), 57857=Sicher Fahrgestellnummer (ID_FN_INQY_Sicher_Fahrgestellnummer), 9730=Regensensor-Wischergeschwindigkeit (ID_FN_INQY_Regensensor_Wischergeschwindigkeit), 14850=Status Funkschlüssel (ID_FN_INQY_Status_Funkschluessel), 26370=Bedienung Tastgeber Bedienelement Front (ID_FN_INQY_Bedienung_Tastgeber_Bedienelement_Front), 32258=Status Verdeck Cabrio (ID_FN_INQY_Status_Verdeck_Cabrio) (Wird ab BN2020 nur noch von HMI verwendet), 36866=Status Schlüssel Suche (ID_FN_INQY_Status_Schluessel_Suche), 58882=Status Klima Luftverteilung FA (ID_FN_INQY_Status_Klima_Luftverteilung_FA), 59906=Status Klima Luftverteilung BF (ID_FN_INQY_Status_Klima_Luftverteilung_BF), 60418=Status Klima SH/ZH Zusatzwasserpumpe (ID_FN_INQY_Status_Klima_SH_ZH_Zusatzwasserpumpe), 60930=Status Klima Zusatzprogramme (ID_FN_INQY_Status_Klima_Zusatzprogramme) (Wird ab BN2020 nur noch von HMI verwendet), 61442=Status Klima Standfunktionen (ID_FN_INQY_Status_Klima_Standfunktionen), 63234=Einheiten BN2020 (ID_FN_INQY_Einheiten_BN2020), 63490=Uhrzeit/Datum (ID_FN_INQY_Uhrzeit_Datum), 3843=Status Service Call TeleX (ID_FN_INQY_Status_Service_Call_TeleX), 4867=Status Service Call Teleservice (ID_FN_INQY_Status_Service_Call_Teleservice), 12803=Verbrauch Information Daten (ID_FN_INQY_Verbrauch_Information_Daten), 13827=Anzeige Checkcontrol-Meldung (Rolle) (ID_FN_INQY_Anzeige_Checkcontrol_Meldung_Rolle_), 14851=Status Monitor Front (ID_FN_INQY_Status_Monitor_Front) ((E60, RR01)), 16643=Status Kartendaten (ID_FN_INQY_Status_Kartendaten), 23555=Status Bordcomputer BN2020 (ID_FN_INQY_Status_Bordcomputer_BN2020) ((E60)), 24579=Daten Bordcomputer (Fahrtbeginn) (ID_FN_INQY_Daten_Bordcomputer_Fahrtbeginn_) ((E60)), 32771=Fahrgestellnummer (ID_FN_INQY_Fahrgestellnummer), 33027=Elektronischer Motorölmessstab (ID_FN_INQY_Elektronischer_Motoroelmessstab), 34819=Fahrzeugtyp (ID_FN_INQY_Fahrzeugtyp), 38147=Codierung Powermanagement (ID_FN_INQY_Codierung_Powermanagement), 40451=Bedienung_Uhrzeit_Datum (ID_FN_INQY_Bedienung_Uhrzeit_Datum), 43523=Bedienung_Uhrzeit_Datum_UTC (ID_FN_INQY_Bedienung_Uhrzeit_Datum_UTC), 43779=Bedienung_Datum_Winterzeit_Sommerzeit (ID_FN_INQY_Bedienung_Datum_Winterzeit_Sommerzeit), 46595=Position Fensterheber FAT (ID_FN_INQY_Position_Fensterheber_FAT) (ATTENTION:The CAN identifier of the message cannot be given here, even if the message comes from the SI bus with E60. The E60 door electronics DRD on the SI bus must react to this coding and send out the position of window regulator DRD message on request.), 46851=Position Fensterheber FATH (ID_FN_INQY_Position_Fensterheber_FATH), 47107=Position Fensterheber BFT (ID_FN_INQY_Position_Fensterheber_BFT) (ATTENTION:The CAN identifier of the message is given here, even if the message comes from the SI bus with E60. The E60 door electronics PSD on the SI bus must react to this coding and send out the position of electric windows PSD message on request.), 47363=Position Fensterheber BFTH (ID_FN_INQY_Position_Fensterheber_BFTH), 47619=Position SHD (ID_FN_INQY_Position_SHD), 48131=Position Fensterheber Sicherheitsfahrzeug (ID_FN_INQY_Position_Fensterheber_Sicherheitsfahrzeug), 48899=Position Fensterheber Heckscheibe (ID_FN_INQY_Position_Fensterheber_Heckscheibe), 49155=Konfiguration FAS (ID_FN_INQY_Konfiguration_FAS), 49411=Konfiguration BFS (ID_FN_INQY_Konfiguration_BFS), 49667=Konfiguration FASH (ID_FN_INQY_Konfiguration_FASH), 49923=Konfiguration BFSH (ID_FN_INQY_Konfiguration_BFSH), 53251=Status Spurverlassenswarnsystem CKM (ID_FN_INQY_Status_Spurverlassenswarnsystem_CKM), 54531=Status Zentralverriegelung CKM (ID_FN_INQY_Status_Zentralverriegelung_CKM), 55043=Status DWA CKM (ID_FN_INQY_Status_DWA_CKM), 56067=Status Memorypositionen CKM (ID_FN_INQY_Status_Memorypositionen_CKM), 56579=Status Licht CKM (ID_FN_INQY_Status_Licht_CKM), 57603=Status ALC CKM (ID_FN_INQY_Status_ALC_CKM), 58115=Status Heckklappe CKM (ID_FN_INQY_Status_Heckklappe_CKM), 60163=Grenzwerte Schwenk Links (ID_FN_INQY_Grenzwerte_Schwenk_Links), 60419=Grenzwerte Schwenk Rechts (ID_FN_INQY_Grenzwerte_Schwenk_Rechts), 61699=Status Licht Erweitert CKM (ID_FN_INQY_Status_Licht_Erweitert_CKM), 9731=Wirkungsgrad Information Data (ID_FN_INQY_Wirkungsgrad_Information_Data), 10243=Relativzeit BN2020 (ID_FN_INQY_Relativzeit_BN2020), 3588=GPS_Datum_CAN (ID_FN_INQY_GPS_Datum_CAN), 3844=GPS_Uhrzeit_CAN (ID_FN_INQY_GPS_Uhrzeit_CAN), 6660=Status Konfiguration Kombi 4 (ID_FN_INQY_Status_Konfiguration_Kombi_4), 9220=Status Konfiguration Kombi (ID_FN_INQY_Status_Konfiguration_Kombi), 9988=Konfiguration DSC (ID_FN_INQY_Konfiguration_DSC), 11780=Status M-Drive 2 (ID_FN_INQY_Status_M_Drive_2), 13316=Konfiguration EPS (ID_FN_INQY_Konfiguration_EPS), 13572=Messung Motoröl (ID_FN_INQY_Messung_Motoroel), 16132=Identifikationsnummer Sensorcluster (ID_FN_INQY_Identifikationsnummer_Sensorcluster), 16642=Status_Hindernis_Tuer (ID_FN_INQY_Status_Hindernis_Tuer), 65535=Signal_unbefuellt (ID_FN_INQY_Signal_unbefuellt), 65533=Reserviert_nicht_verfuegbar (ID_FN_INQY_Reserviert_nicht_verfuegbar) (Hinweis: Reserviert für funktionale Kennung Signal-Tag "Funktionsschnittstelle_ist_nicht_verfuegbar"), 65534=Reserviert_Fehler (ID_FN_INQY_Reserviert_Fehler) (Hinweis: Reserviert für funktionale Kennung Signal-Tag "Funktion_meldet_Fehler")
  compu method ID_FN_RQ_STG_EFAN: 1=AFS-Anforderung (ID_FN_RQ_STG_EFAN_AFS_Anforderung) (Diese Nachricht darf vom AFS ausschließlich zum Bauteilschutz im Notfall versandt werden! Anforderung wird vom E6x/PL2/PL4 AFS nicht mehr versendet.), 2=EPS-Anforderung (ID_FN_RQ_STG_EFAN_EPS_Anforderung) (Diese Nachricht darf vom EPS ausschließlich zum Bauteilschutz im Notfall versandt werden!), 3=DSC-Anforderung (ID_FN_RQ_STG_EFAN_DSC_Anforderung) (Diese Nachricht darf vom DSC ausschließlich zum Bauteilschutz im Notfall versandt werden!), 4=Servotronic-Anforderung (ID_FN_RQ_STG_EFAN_Servotronic_Anforderung) (Diese Kodierung wird _nicht_ in den Baureihen L1 bis L5 verwendet. Diese Nachricht darf ausschließlich zum Bauteilschutz im Notfall versandt werden!), 255=Signal ungültig (ID_FN_RQ_STG_EFAN_Signal_ungueltig)
  compu method ID_TEMP_CPO_HET_MNG: 1=EPS-Motortemperatur (ID_TEMP_CPO_HET_MNG_EPS_Motortemperatur), 13=Reserviert (ID_TEMP_CPO_HET_MNG_Reserviert) (Hinweis: Reserviert für funktionale Kennung Signal-Tag.), 14=Reserviert (ID_TEMP_CPO_HET_MNG_Reserviert_2) (Hinweis: Reserviert für funktionale Kennung Signal-Tag.), 15=Signal_unbefuellt (ID_TEMP_CPO_HET_MNG_Signal_unbefuellt) (Sendefunktion nicht in Betrieb)
  compu method IDX_TORQ_SEN: 0=Initialisierung (IDX_TORQ_SEN_Initialisierung), 1=Keine Index Flanke (IDX_TORQ_SEN_Keine_Index_Flanke) (FUSI: Verwendung im Funktionsrahmen zu prüfen.), 2=Index Flanke (IDX_TORQ_SEN_Index_Flanke) (Gilt für steigende und fallende Flanken FUSI: Verwendung im Funktionsrahmen zu prüfen.), 3=Signal ungültig (IDX_TORQ_SEN_Signal_ungueltig)
  compu method MILE_KM: phys=raw for raw >0..<255; unit km
  compu method MIN_I_SPEC_ARS: phys=raw-252 for raw 0..252, 253=Funktionsschnittstelle_ist_nicht_verfuegbar (MIN_I_SPEC_ARS_Funktionsschnittstelle_ist_nicht_verfuegbar) (Sendefunktion in Betrieb, Werte nicht verfügbar), 254=Funktion_meldet_Fehler (MIN_I_SPEC_ARS_Funktion_meldet_Fehler) (Nutzsignal kann nicht berechnet werden), 255=Signal_unbefuellt (MIN_I_SPEC_ARS_Signal_unbefuellt) (Sendefunktion nicht in Betrieb); unit A
  compu method NO_CC_EPS: phys=raw for raw >0..<255
  compu method NO_VECH_{1..7}: identical
  compu method OFFS_GRD_MID_EPS: phys=raw*0.0439453125-89.95605469 for raw >0..<255
  compu method OFFS_QUAD_PINA_EPS: phys=raw-127 for raw >0..<255
  compu method QU_ACLNY_COG: 8=Initialisierung (QU_ACLNY_COG_Initialisierung) (Tritt während der Initialisierungsphase auf bis Ist-Wert verfügbar (Vorbefüllung). Nutzsignal wird permanent mit Nutzwert 0 befüllt.), 1=Signalwert ist gültig und abgesichert und plausibilisiert (QU_ACLNY_COG_Signalwert_ist_gueltig_und_abgesichert_und_plausibilisiert) (Nutzsignal verfügbar, bereitgestellt aus zwei Sensoren (nur bei redundanter Sensorik) elektrische und Modellüberwachung i.O.), 9=Signalwert ist gültig und abgesichert, Zustand/Status temporär (QU_ACLNY_COG_Signalwert_ist_gueltig_und_abgesichert_Zustand_Status_temporaer) (Nutzsignal verfügbar; elektrische und Modellüberwachung i.O. Es liegt eine Signaltoleranz aufgrund nicht abgeschlossenen Offsetabgleichs an. FuSi : Bei sicherheitsrelevanten Funktionen ist die Fehleramplitude auszuwerten), 2=Signalwert ist gültig (QU_ACLNY_COG_Signalwert_ist_gueltig) (Nutzsignal verfügbar, bereitgestellt aus einem Sensor (Nur bei einfacher Sensorik) elektrische und Modellüberwachung i.O.), 10=Signalwert ist gültig, Zustand/Status temporär (QU_ACLNY_COG_Signalwert_ist_gueltig_Zustand_Status_temporaer) (Nutzsignal verfügbar, bereitgestellt aus einem Sensor elektrische und Modellüberwachung i.O. Es liegt eine Signaltoleranz aufgrund nicht abgeschlossenen Offsetabgleichs an. FuSi : Bei sicherheitsrelevanten Funktionen ist die Fehleramplitude auszuwerten), 3=Signalqualität bzw. Überwachung eingeschränkt (QU_ACLNY_COG_Signalqualitaet_bzw_Ueberwachung_eingeschraenkt) (keine Modellüberwachung, da Eingangsgrößen für Überwachung fehlen (zum Bsp. Gierrate), elektrische Überwachung i.O. Nutzsignal wird aus Sensorwert gebildet. FuSi: keine Verwendung für sicherheitsrelevante Funktionen), 11=Signalqualität bzw. Überwachung eingeschränkt, Zustand/Status temporär (QU_ACLNY_COG_Signalqualitaet_bzw_Ueberwachung_eingeschraenkt_Zustand_Status_temporaer) (keine Modellüberwachung, da Eingangsgrößen für Überwachung fehlen (zum Bsp. Gierrate), elektrische Überwachung i.O. Es liegt eine Signaltoleranz aufgrund nicht abgeschlossenen Offsetabgleichs an. Nutzsignal wird aus Sensorwert gebildet. FuSi: keine Verwendung für sicherheitsrelevante Funktionen), 4=Reserved (QU_ACLNY_COG_Reserved), 12=Ersatzwert ist im Nutzsignal gesetzt, Zustand/Status temporär (QU_ACLNY_COG_Ersatzwert_ist_im_Nutzsignal_gesetzt_Zustand_Status_temporaer) (elektrische Überwachung oder Modellüberwachung zeigt Fehler an, deshalb wird Ersatzwert aus Modell versendet FuSi: keine Verwendung für sicherheitsrelevante Funktionen), 6=Signalwert ist ungültig (QU_ACLNY_COG_Signalwert_ist_ungueltig) (Das zugehörige Nutzsignal wird permanent mit der Ungültigkeitskennung befüllt. elektrische Überwachung oder Modellüberwachung zeigt Fehler an, kein Ersatzwert verfügbar. Diese Codierung wird ab SP2015 nicht mehr bedient.), 14=Signalwert ist ungültig, Zustand/Status temporär (QU_ACLNY_COG_Signalwert_ist_ungueltig_Zustand_Status_temporaer) (Das zugehörige Nutzsignal wird permanent mit der Ungültigkeitskennung befüllt. elektrische Überwachung oder Modellüberwachung zeigt Fehler an, kein Ersatzwert verfügbar), 7=Reserved (QU_ACLNY_COG_Reserved_2), 15=Signal ungültig (QU_ACLNY_COG_Signal_ungueltig) (Kann nur vom Gateway gesetzt werden)
  compu method QU_AVL_FORC_GRD: 8=Initialisierung (QU_AVL_FORC_GRD_Initialisierung) (At the startup of the TSU driver. Nutzsignal wird permanent mit 0,0016 befüllt.), 2=Signalwert ist gültig (QU_AVL_FORC_GRD_Signalwert_ist_gueltig) (The signal is valid since every input signal is valid FUSI: Do not use for safety critical functions), 14=Signalwert ist ungültig, Zustand/Status temporär (QU_AVL_FORC_GRD_Signalwert_ist_ungueltig_Zustand_Status_temporaer) (The signal is invalid since one of the input signals is invalid. Das zugehörige Nutzsignal wird permanent mit der Ungültigkeitskennung befüllt.), 15=Signal ungültig (QU_AVL_FORC_GRD_Signal_ungueltig) (Kann Funktional nicht gesetzt werden)
  compu method QU_AVL_PINA_EPS: 8=Initialisierung (QU_AVL_PINA_EPS_Initialisierung) (Nach jedem Reset und Aufstarten des EPS-Steuergeräts. Nutzsignal wird permanent mit Nutzwert 0 befüllt.), 1=Signalwert ist gültig und abgesichert und plausibilisiert (QU_AVL_PINA_EPS_Signalwert_ist_gueltig_und_abgesichert_und_plausibilisiert) (Position ist aufgesetzt und offsetkompensiert. Sensorwert gültig und elektrische Überwachung i.O. und EPS intern plausibilisiert), 2=Signalwert ist gültig (QU_AVL_PINA_EPS_Signalwert_ist_gueltig) (Position ist aufgesetzt und offsetkompensiert Sensorwert gültig und elektrische Überwachung i.O.), 4=Ersatzwert ist im Nutzsignal gesetzt (QU_AVL_PINA_EPS_Ersatzwert_ist_im_Nutzsignal_gesetzt) (Signalwert rein aus dem Sensor, d.h. die Position ist aufintegriert (Relativ) Sensorwert gültig und elektrische Überwachung i.O. FUSI: keine Verwendung für sicherheitsrelevante Funktionen.), 9=Signalwert ist gültig, Zustand/Status temporär (mittlere Signalqualität) (QU_AVL_PINA_EPS_Signalwert_ist_gueltig_Zustand_Status_temporaer_mittlere_Signalqualitaet_) (Wird erst ab SP2015 unterstützt: Position ist aufgesetzt. Die minimale Signaltoleranz ist allerdings noch nicht erreicht. Sensorwert gültig und elektrische Überwachung i.O.), 10=Signalwert ist gültig, Zustand/Status temporär (geringe Signalqualität) (QU_AVL_PINA_EPS_Signalwert_ist_gueltig_Zustand_Status_temporaer_geringe_Signalqualitaet_) (Position ist aufgesetzt, es liegt aber noch eine Signaltoleranz bis etwa 30° Lenkradwinkel vor. Sensorwert gültig und elektrische Überwachung i.O. Wird erst ab SP2013 (außer F15-F16, 444) unterstützt.), 12=Abgleichwert ist im Nutzsignal gesetzt, Zustand/Status temporär (QU_AVL_PINA_EPS_Abgleichwert_ist_im_Nutzsignal_gesetzt_Zustand_Status_temporaer) (Nicht vertrauenswürdige aufgesetzte und offsetkompensierte Position, die in diesem Zustand korrigiert wird (durch Aufsetzalgorithmus im ICM). Dieser Zustand bleibt mindestens 50ms bestehen. FUSI: keine Verwendung für sicherheitsrelevante Funktionen.), 14=Signalwert ist ungültig, Zustand/Status temporär (QU_AVL_PINA_EPS_Signalwert_ist_ungueltig_Zustand_Status_temporaer) (Das zugehörige Nutzsignal wird permanent mit der Ungültigkeitskennung befüllt. Wird gesetzt bei internen EPS Fehler (Sensor Fehler, Interner Kommunikationsfehler,...) Dieser Zustand bleibt mindestens 20ms bestehen.), 15=Signal ungültig (QU_AVL_PINA_EPS_Signal_ungueltig)
  compu method QU_AVL_RPM_WHL: 8=Initialisierung (QU_AVL_RPM_WHL_Initialisierung) (Wird gelegt solange aufgrund des Aufstartvorgangs (und der dazu gehörenden Sensorprüfung) für den zugehörigen Raddrehzahlsensor kein Wert ermittelt werden kann. Nutzsignal wird permanent mit der Ungültigkeitskennung befüllt.), 1=Signalwert ist gültig und abgesichert und plausibilisiert (QU_AVL_RPM_WHL_Signalwert_ist_gueltig_und_abgesichert_und_plausibilisiert) (Ist der zugehörige Raddrehzahlsensor i.O. geprüft, so wird der Qualifier auf diesem Zustand gesetzt.), 9=Reserved (QU_AVL_RPM_WHL_Reserved), 2=Reserved (QU_AVL_RPM_WHL_Reserved_2), 10=Reserved (QU_AVL_RPM_WHL_Reserved_3), 3=Reserved (QU_AVL_RPM_WHL_Reserved_4), 11=Signalqualität bzw. Überwachung eingeschränkt, Zustand/Status temporär (QU_AVL_RPM_WHL_Signalqualitaet_bzw_Ueberwachung_eingeschraenkt_Zustand_Status_temporaer) (Implementierungsinfo des DSC-8 Bosch-Systems: Wird gelegt, wenn bei gesetzter Rollenerkennung des ICM-Q/L die Anfahrüberwachung des DSC zuschlägt.), 4=Ersatzwert ist im Nutzsignal gesetzt (QU_AVL_RPM_WHL_Ersatzwert_ist_im_Nutzsignal_gesetzt) (Wird gelegt, solange keine gültige Drehrichtung erkannt wurde. (z.B. Stillstand) Kann nur bei Sensoren mit Drehrichtungserkennung gesetzt werden.), 12=Ersatzwert ist im Nutzsignal gesetzt Zustand / Status Temporär (QU_AVL_RPM_WHL_Ersatzwert_ist_im_Nutzsignal_gesetzt_Zustand_Status_Temporaer) (Nutzsignal liefert das aktuelle Rohsignal mit eingeschränkter Qualität (es kann zu Abweichungen kommen). Der Übergang zum "Signalwert ist gültig" (0001) erfolgt über eine Einschwingphase (ca. 300ms) Kann auftreten während bzw. nach Unterspannung am Raddrehzahlsensor (DSC) In der PL6 wird dieser Code nicht verwendet.), 6=Wert_nicht_verfuegbar_Fehler_elektrisch (QU_AVL_RPM_WHL_Wert_nicht_verfuegbar_Fehler_elektrisch) (Im Fehlerfall wird abhängig von der Ursache entweder 0110 (Schwerpunkt: elektrische Fehler mit Reparaturbedarf) oder 1110 (Schwerpunkt: Plausibilitätsfehler ohne Reparaturbedarf) gesendet. Die Umsetzung ist produktlinienspezifisch unterschiedlich. Nutzsignal wird permanent mit der Ungültigkeitskennung befüllt.), 14=Wert_nicht_verfuegbar_Plausibilitaetsfehler (QU_AVL_RPM_WHL_Wert_nicht_verfuegbar_Plausibilitaetsfehler) (Im Fehlerfall wird abhängig von der Ursache entweder 0110 (Schwerpunkt: elektrische Fehler mit Reparaturbedarf) oder 1110 (Schwerpunkt: Plausibilitätsfehler ohne Reparaturbedarf) gesendet. Die Umsetzung ist produktlinienspezifisch unterschiedlich. Nutzsignal wird permanent mit der Ungültigkeitskennung befüllt.), 7=Reserved (QU_AVL_RPM_WHL_Reserved_5), 15=Signal ungültig (QU_AVL_RPM_WHL_Signal_ungueltig) (Kann nur vom Gateway gesetzt werden)
  compu method QU_AVL_STMOM_DV_ACT: 8=Initialisierung (QU_AVL_STMOM_DV_ACT_Initialisierung) (Tritt während der Initialisierungsphase auf (Vorbefüllung). Nutzsignal wird permanent mit Nutzwert 0 befüllt.), 1=Signalwert ist gültig und abgesichert und plausibilisiert (QU_AVL_STMOM_DV_ACT_Signalwert_ist_gueltig_und_abgesichert_und_plausibilisiert) (The TSU works properly and the two torque signals are close enough to be plausible), 14=Signalwert ist ungültig, Zustand/Status temporär (QU_AVL_STMOM_DV_ACT_Signalwert_ist_ungueltig_Zustand_Status_temporaer) (Das zugehörige Nutzsignal wird permanent mit der Ungültigkeitskennung befüllt. The communication with the TSU or the TSU itself is wrong or because of some other reason the TSU signals are not good Wird in der L6 nicht verwendet), 6=Signalwert ist ungültig (QU_AVL_STMOM_DV_ACT_Signalwert_ist_ungueltig) (Wird in der L6 verwendet für die Ungültigkeitskennung des Signalwert Das zugehörige Nutzsignal wird permanent mit der Ungültigkeitskennung befüllt.), 15=Signal ungültig (QU_AVL_STMOM_DV_ACT_Signal_ungueltig) (Wird funktional nicht versendet)
  compu method QU_DGR_AISP_ENERG: 0=Degradationsstufe 0 (QU_DGR_AISP_ENERG_Degradationsstufe_0) (Keine Anlaufverzögerung oder Anlaufunterbrechung des Kompressors Incl. Default- und Aufstartwert), 1=Degradationsstufe 1 (QU_DGR_AISP_ENERG_Degradationsstufe_1) (Geringe Anlaufverzögerung (Geringe Aufweitung der Anregelschwellen, keine Anlaufsperre oder -unterbrechung)), 2=Degradationsstufe 2 (QU_DGR_AISP_ENERG_Degradationsstufe_2) (Mittlere Anlaufverzögerung (Mittlere Aufweitung der Anregelschwellen, keine Anlaufsperre oder -unterbrechung)), 3=Degradationsstufe 3 (QU_DGR_AISP_ENERG_Degradationsstufe_3) (Maximale Anlaufverzögerung (Maximale Aufweitung der Anregelschwellen, keine Anlaufsperre oder -unterbrechung)), 4=Degradationsstufe 4 (QU_DGR_AISP_ENERG_Degradationsstufe_4) (Anlaufsperre für definierte Zeitspanne oder Anlaufunterbrechung), 15=Signal ungültig (QU_DGR_AISP_ENERG_Signal_ungueltig)
  compu method QU_FN_ENSU_SFY: mask 240: 144=Sichere_Energieversorgung_aktiv (QU_FN_ENSU_SFY_Sichere_Energieversorgung_aktiv) (Zustand der sicheren Energieversorgung: Die sichere Energieversorgung ist aktiv, es liegt kein Fehler oder Vorwarnung vor.), mask 240: 176=Sichere_Energieversorgung_aktiv_Vorwarnung (QU_FN_ENSU_SFY_Sichere_Energieversorgung_aktiv_Vorwarnung) (Zustand der sicheren Energieversorgung: Die sichere Energieversorgung ist aktiv, es liegt eine Vorwarnung vor. Der Zustand kann wieder in _aktiv zurückwechseln oder in _nicht_verfügbar_Fehler wechseln.), mask 15: 0=Sichere_Energieversorgung_Klasse_0 (QU_FN_ENSU_SFY_Sichere_Energieversorgung_Klasse_0) (Zusätzlich zum Zustand die Klasse der sicheren Energieversorgung: Es ist keine spezielle Ausprägung der sicheren Energieversorgung angefordert und umgesetzt. Die Klassen sind weder pauschal disjunkt noch pauschal überschneidend oder pauschal inkludierend.), mask 15: 1=Sichere_Energieversorgung_Klasse_1 (QU_FN_ENSU_SFY_Sichere_Energieversorgung_Klasse_1) (Zusätzlich zum Zustand die Klasse der sicheren Energieversorgung: Es ist eine spezielle Ausprägung der sicheren Energieversorgung angefordert und umgesetzt. Die Klassen sind weder pauschal disjunkt noch pauschal überschneidend oder pauschal inkludierend.), mask 15: 2=Sichere_Energieversorgung_Klasse_2 (QU_FN_ENSU_SFY_Sichere_Energieversorgung_Klasse_2) (Zusätzlich zum Zustand die Klasse der sicheren Energieversorgung: Es ist eine spezielle Ausprägung der sicheren Energieversorgung angefordert und umgesetzt. Die Klassen sind weder pauschal disjunkt noch pauschal überschneidend oder pauschal inkludierend.), mask 15: 3=Sichere_Energieversorgung_Klasse_3 (QU_FN_ENSU_SFY_Sichere_Energieversorgung_Klasse_3) (Zusätzlich zum Zustand die Klasse der sicheren Energieversorgung: Es ist eine spezielle Ausprägung der sicheren Energieversorgung angefordert und umgesetzt. Die Klassen sind weder pauschal disjunkt noch pauschal überschneidend oder pauschal inkludierend.), mask 15: 4=Sichere_Energieversorgung_Klasse_4 (QU_FN_ENSU_SFY_Sichere_Energieversorgung_Klasse_4) (Zusätzlich zum Zustand die Klasse der sicheren Energieversorgung: Es ist eine spezielle Ausprägung der sicheren Energieversorgung angefordert und umgesetzt. Die Klassen sind weder pauschal disjunkt noch pauschal überschneidend oder pauschal inkludierend.), mask 15: 5=Sichere_Energieversorgung_Klasse_5 (QU_FN_ENSU_SFY_Sichere_Energieversorgung_Klasse_5) (Zusätzlich zum Zustand die Klasse der sicheren Energieversorgung: Es ist eine spezielle Ausprägung der sicheren Energieversorgung angefordert und umgesetzt. Die Klassen sind weder pauschal disjunkt noch pauschal überschneidend oder pauschal inkludierend.), mask 240: 96=Sichere_Energieversorgung_nicht_verfuegbar_Fehler (QU_FN_ENSU_SFY_Sichere_Energieversorgung_nicht_verfuegbar_Fehler) (Zustand der sicheren Energieversorgung: Die sichere Energieversorgung ist nicht verfügbar, weil ein Fehler vorliegt.), mask 255: 254=Funktion_meldet_Fehler (QU_FN_ENSU_SFY_Funktion_meldet_Fehler) (Sendefunktion in Betrieb, meldet Fehler), mask 255: 255=Signal_unbefuellt (QU_FN_ENSU_SFY_Signal_unbefuellt) (Sendefunktion nicht in Betrieb)
  compu method QU_FN_EST: 128=Initialisierung (QU_FN_EST_Initialisierung) (EPS Initialisierungszustand), 160=Funktion verfügbar - Aktiv, 12V EPS (QU_FN_EST_Funktion_verfuegbar_Aktiv_12V_EPS) (12V EPS / EPS im Normalzustand), 164=Funktion verfügbar - Aktiv, 12V EAS (QU_FN_EST_Funktion_verfuegbar_Aktiv_12V_EAS) (12V EAS / EPS im Normalzustand.), 168=Funktion verfügbar - Aktiv, 24V EAS (QU_FN_EST_Funktion_verfuegbar_Aktiv_24V_EAS) (24V EAS / EPS im Normalzustand), 162=Funktion verfügbar - Aktiv, Notfallfunktion Umwelteinflüsse - Aktiv (QU_FN_EST_Funktion_verfuegbar_Aktiv_Notfallfunktion_Umwelteinfluesse_Aktiv) (Diese Codierung wird ab SP2015 verwendet: Notfallfunktion zur Reduzierung Liegenbleiber aufgrund von Umwelteinflüssen aktiv), 49=Funktion in Rückfallebene (QU_FN_EST_Funktion_in_Rueckfallebene) (24V EAS / Kl.30 Abfall von 24V -> 12V Ritzelwinkelschnittstelle soll nicht zur Verfügung stehen => Service nicht verfügbar, Fahrdynamikschnittstelle verfügbar Heilung im aktuellen Zündungszyklus nicht möglich), 51=Funktion in Rückfallebene, Notfallfunktion Umwelteinflüsse- Aktiv (QU_FN_EST_Funktion_in_Rueckfallebene_Notfallfunktion_Umwelteinfluesse_Aktiv) (Diese Codierung wird ab SP2015 verwendet: 24V EAS / Kl.30 Abfall von 24V -> 12V Zusätzlich ist die Notfallfunktion zur Reduzierung Liegenbleiber aufgrund von Umwelteinflüssen aktiv. Ritzelwinkelschnittstelle soll nicht zur Verfügung stehen => Service nicht verfügbar, Fahrdynamikschnittstelle verfügbar Heilung im aktuellen Zündungszyklus nicht möglich), 176=Funktion temporär in Rückfallebene (QU_FN_EST_Funktion_temporaer_in_Rueckfallebene) (Unterstützungslevel < Schwellwert (z.B. 70%) Heilung im aktuellen Zündungszyklus möglich), 178=Funktion temporär in Rückfallebene, Notfallfunktion Umwelteinflüsse- Aktiv (QU_FN_EST_Funktion_temporaer_in_Rueckfallebene_Notfallfunktion_Umwelteinfluesse_Aktiv) (Diese Codierung wird ab SP2015 verwendet: Unterstützungslevel < Schwellwert (z.B. 70%) Zusätzlich ist die Notfallfunktion zur Reduzierung Liegenbleiber aufgrund von Umwelteinflüssen aktiv. Heilung im aktuellen Zündungszyklus möglich), 96=Funktion nicht verfügbar - Fehler (QU_FN_EST_Funktion_nicht_verfuegbar_Fehler) (EPS Zustand = Fehler Heilung im aktuellen Zündungszyklus nicht möglich), 224=Funktion nicht verfügbar - ausgeschaltet (QU_FN_EST_Funktion_nicht_verfuegbar_ausgeschaltet) (Wird gesetzt zum Beispiel kurzfristig nach dem Zustand "Initialisierung", im KL.15N Nachlauf, im Werkmodus,...), 255=Signal ungültig (QU_FN_EST_Signal_ungueltig) (Wird Funktional nicht versendet.)
  compu method QU_FN_FDR: mask 3848: 512=Funktion verfügbar und bereit, nicht aktiv, Schlupfschwellen normal (QU_FN_FDR_Funktion_verfuegbar_und_bereit_nicht_aktiv_Schlupfschwellen_normal), mask 3848: 520=Funktion verfügbar und bereit, nicht aktiv, Schlupfschwellen aufgeweitet (QU_FN_FDR_Funktion_verfuegbar_und_bereit_nicht_aktiv_Schlupfschwellen_aufgeweitet), mask 3856: 2576=Funktion verfügbar und aktiv, FDR Regeleingriff VL (QU_FN_FDR_Funktion_verfuegbar_und_aktiv_FDR_Regeleingriff_VL), mask 3872: 2592=Funktion verfügbar und aktiv, FDR Regeleingriff VR (QU_FN_FDR_Funktion_verfuegbar_und_aktiv_FDR_Regeleingriff_VR), mask 3904: 2624=Funktion verfügbar und aktiv, FDR Regeleingriff HL (QU_FN_FDR_Funktion_verfuegbar_und_aktiv_FDR_Regeleingriff_HL), mask 3968: 2688=Funktion verfügbar und aktiv, FDR Regeleingriff HR (QU_FN_FDR_Funktion_verfuegbar_und_aktiv_FDR_Regeleingriff_HR), mask 3848: 2560=Funktion verfügbar und aktiv, Schlupfschwellen normal (QU_FN_FDR_Funktion_verfuegbar_und_aktiv_Schlupfschwellen_normal), mask 3848: 2568=Funktion verfügbar und aktiv, Schlupfschwellen aufgeweitet (QU_FN_FDR_Funktion_verfuegbar_und_aktiv_Schlupfschwellen_aufgeweitet), mask 3840: 1536=Funktion nicht verfügbar: Fehler (QU_FN_FDR_Funktion_nicht_verfuegbar_Fehler), mask 3840: 3584=Funktion nicht verfügbar: Ausgeschaltet (QU_FN_FDR_Funktion_nicht_verfuegbar_Ausgeschaltet) (Diese Codierung wird versendet wenn mind. eine dieser Bedingungen erfüllt ist: Initialisierungsphase des SG (Vorbefüllung), Zündung=aus, Motorstart, INITAusblendung aktiv, Funktion über DTC-Taster deaktiviert), mask 3840: 2048=reserviert (QU_FN_FDR_reserviert), mask 3840: 512=reserviert (QU_FN_FDR_reserviert_2), mask 3848: 768=reserviert (QU_FN_FDR_reserviert_3), mask 3848: 776=reserviert (QU_FN_FDR_reserviert_4), mask 4095: 4095=Signal ungültig (QU_FN_FDR_Signal_ungueltig) (Nutzung nur vom Gateway, nicht seitens Sender-SG)
  compu method QU_FN_VIB_EPS: 1=Funktion_verfuegbar_nicht_aktiv (QU_FN_VIB_EPS_Funktion_verfuegbar_nicht_aktiv) (Funktion EPS-Lenkradvibration ist verfügbar, Vibration ist aber nicht aktiv.), 9=Funktion_verfuegbar_aktiv (QU_FN_VIB_EPS_Funktion_verfuegbar_aktiv) (Funktion EPS-Lenkradvibration ist verfügbar und Vibration ist aktiv), 14=Funktion_nicht_verfuegbar (QU_FN_VIB_EPS_Funktion_nicht_verfuegbar) (Funktion EPS-Lenkradvibration ist temporär nicht verfügbar Dieser Zustand stellt sich dann ein, wenn die Funktion aufgrund eines EPS-internen Fehlers oder einer Degradation vorübergehend nicht zur Verfügung gestellt werden kann.), 6=Fehler (QU_FN_VIB_EPS_Fehler) (Funktion EPS-Lenkradvibration ist dauerhaft nicht verfügbar Dieser Zustand stellt sich dann ein, wenn die Funktion aufgrund eines EPS-internen Fehlers oder einer Degradation in dem aktuellen Klemme15-Zyklus nicht mehr zur Verfügung gestellt werden kann.), 15=Signal_unbefuellt (QU_FN_VIB_EPS_Signal_unbefuellt) (Sendefunktion nicht in Betrieb)
  compu method QU_SER_STMOM_STMOM_DV_ACT: 128=Schnittstelle wird initialisiert (QU_SER_STMOM_STMOM_DV_ACT_Schnittstelle_wird_initialisiert) (Wird beim Hochfahren des Steuergerätes gesetzt (Vorbefüllung).), 32=Schnittstelle verfügbar / funktionsbereit ohne Zusatzdämpfung (QU_SER_STMOM_STMOM_DV_ACT_Schnittstelle_verfuegbar_funktionsbereit_ohne_Zusatzdaempfung) (Schnittsstelle verfügbar/funktionsbereit.), 34=Schnittstelle verfügbar / funktionsbereit mit Zusatzdämpfung (QU_SER_STMOM_STMOM_DV_ACT_Schnittstelle_verfuegbar_funktionsbereit_mit_Zusatzdaempfung) (Wird bei EPS mit Dämpfungfunktion versendet.), 33=Schnittstelle aktiv - Zusatzdämpfung nicht verfügbar (QU_SER_STMOM_STMOM_DV_ACT_Schnittstelle_aktiv_Zusatzdaempfung_nicht_verfuegbar) (Schnittstelle aktiv (ohne Zusatzdämpfung)), 35=Schnittstelle aktiv - Zusatzdämpfung verfügbar (QU_SER_STMOM_STMOM_DV_ACT_Schnittstelle_aktiv_Zusatzdaempfung_verfuegbar) (Wird bei EPS mit Dämpfungfunktion versendet.), 96=Service nicht verfügbar - Fehler (QU_SER_STMOM_STMOM_DV_ACT_Service_nicht_verfuegbar_Fehler) (EPS Zustand = Fehler.), 224=Service nicht verfügbar - Standby - PMA (QU_SER_STMOM_STMOM_DV_ACT_Service_nicht_verfuegbar_Standby_PMA) (PMA aktiv deshalb Fahrdynamik Schnittstelle inaktiv.), 225=Service nicht verfügbar - Standby - EPS Status (QU_SER_STMOM_STMOM_DV_ACT_Service_nicht_verfuegbar_Standby_EPS_Status) (Wird verwendet für alle andere EPS Zustände als: -Verfügbar -Fehler Fahrdynamik Schnittstelle inaktiv.), 255=Signal ungültig (QU_SER_STMOM_STMOM_DV_ACT_Signal_ungueltig) (Wird Funktional nicht versendet.)
  compu method QU_ST_CON_VEH: 2=Signalwert gültig (QU_ST_CON_VEH_Signalwert_gueltig), 3=Signalwert eingeschränkt gültig (QU_ST_CON_VEH_Signalwert_eingeschraenkt_gueltig), 6=Reserviert für die nicht umgesetzte Kennung "Fehler" (QU_ST_CON_VEH_Reserviert_fuer_die_nicht_umgesetzte_Kennung_Fehler_) (Codierung wird nicht befüllt), 14=Wert_nicht_verfuegbar (QU_ST_CON_VEH_Wert_nicht_verfuegbar) (Siehe Signalbeschreibung), 15=Signal unbefüllt (QU_ST_CON_VEH_Signal_unbefuellt)
  compu method QU_SUM_AVL_I_DRDY_SFY: 1=Wert_gueltig_abgesichert (QU_SUM_AVL_I_DRDY_SFY_Wert_gueltig_abgesichert) (Stromwert gueltig und abgesichert), 3=Wert_gueltig_eingeschraenkt (QU_SUM_AVL_I_DRDY_SFY_Wert_gueltig_eingeschraenkt) (Stromwert nicht abgesichert), 6=Wert_nicht_verfuegbar_Fehler (QU_SUM_AVL_I_DRDY_SFY_Wert_nicht_verfuegbar_Fehler) (Sendefunktion in Betrieb, Werte nicht verfügbar), 14=Wert_nicht_verfuegbar (QU_SUM_AVL_I_DRDY_SFY_Wert_nicht_verfuegbar) (Sendefunktion in Betrieb, meldet Fehler), 15=Signal_unbefuellt (QU_SUM_AVL_I_DRDY_SFY_Signal_unbefuellt) (Sendefunktion nicht in Betrieb)
  compu method QU_TAR_DMPNG_ADDON_STMOM_FTAX: 1=Sollwert Zusatzdämpfung nicht umsetzen (QU_TAR_DMPNG_ADDON_STMOM_FTAX_Sollwert_Zusatzdaempfung_nicht_umsetzen), 2=Sollwert Zusatzdämpfung umsetzen (QU_TAR_DMPNG_ADDON_STMOM_FTAX_Sollwert_Zusatzdaempfung_umsetzen), 15=Signal unbefüllt (QU_TAR_DMPNG_ADDON_STMOM_FTAX_Signal_unbefuellt) (Wird nicht aktiv gesetzt)
  compu method QU_TAR_FACT_STMOM_FTAX: 2=Sollwerte umsetzen (QU_TAR_FACT_STMOM_FTAX_Sollwerte_umsetzen) (Es wird ein Lenkmoment angefordert.), 7=Sollwerte nicht vorhanden (QU_TAR_FACT_STMOM_FTAX_Sollwerte_nicht_vorhanden) (Wird immer gesetzt wenn keine EPS verbaut ist.), 14=Standby: Sollwerte nicht umsetzen (QU_TAR_FACT_STMOM_FTAX_Standby_Sollwerte_nicht_umsetzen) (Es wird kein Moment angefordert. Wird auch im Fehlerfall gesetzt.), 15=Signal ungültig (QU_TAR_FACT_STMOM_FTAX_Signal_ungueltig) (Wird nicht aktiv gesetzt)
  compu method QU_TAR_QTA_STMOM_DV: 2=Sollwerte umsetzen (QU_TAR_QTA_STMOM_DV_Sollwerte_umsetzen) (Es wird ein Lenkmoment angefordert.), 7=Sollwerte nicht vorhanden (QU_TAR_QTA_STMOM_DV_Sollwerte_nicht_vorhanden) (Wird gesendet, wenn die Funktion auscodiert ist. Wird immer gesetzt wenn keine EPS verbaut ist.), 14=Sollwerte nicht umsetzen - Standby (QU_TAR_QTA_STMOM_DV_Sollwerte_nicht_umsetzen_Standby) (Es wird kein Moment angefordert.), 15=Signal ungültig (QU_TAR_QTA_STMOM_DV_Signal_ungueltig) (Wird nicht aktiv gesetzt)
  compu method QU_TAR_STMOM_DV_ACT: 2=Sollwerte umsetzen (QU_TAR_STMOM_DV_ACT_Sollwerte_umsetzen) (Es wird ein Lenkmoment angefordert.), 7=Sollwerte nicht vorhanden (QU_TAR_STMOM_DV_ACT_Sollwerte_nicht_vorhanden) (Wird immer gesetzt wenn keine EPS verbaut ist), 14=Standby: Sollwerte nicht umsetzen (QU_TAR_STMOM_DV_ACT_Standby_Sollwerte_nicht_umsetzen) (Es wird kein Moment angefordert. Wird auch im Fehlerfall gesetzt.), 15=Signal ungültig (QU_TAR_STMOM_DV_ACT_Signal_ungueltig) (Wird nicht aktiv gesetzt)
  compu method QU_V_VEH_COG: 8=Initialisierung (QU_V_VEH_COG_Initialisierung) (Tritt während der Initialisierungsphase auf bis Ist-Wert verfügbar (Vorbefüllung). Nutzsignal wird permanent mit Nutzwert 0 befüllt.), 1=Signalwert ist gültig und abgesichert und plausibilisiert (QU_V_VEH_COG_Signalwert_ist_gueltig_und_abgesichert_und_plausibilisiert), 9=Reserved (QU_V_VEH_COG_Reserved), 2=Reserved (QU_V_VEH_COG_Reserved_2), 10=Signalwert ist gültig, Zustand/Status temporär (QU_V_VEH_COG_Signalwert_ist_gueltig_Zustand_Status_temporaer) (FUSI: Eine für die Berechnung der Geschwindigkeit notwendige Größe fehlt (z.B. Längsbeschleunigung, Raddrehzahl,...). Signalqualität bei instabiler Fahrt eingeschränkt. (Für sicherheitsrelevante Funktionen Anwendbarkeit des Signals prüfen.)), 3=Reserved (QU_V_VEH_COG_Reserved_3), 11=Signalqualität bzw. Überwachung eingeschränkt, Zustand/Status temporär (QU_V_VEH_COG_Signalqualitaet_bzw_Ueberwachung_eingeschraenkt_Zustand_Status_temporaer) (FUSI: Mehr als eine für die Berechnung der Geschwindigkeit notwendige Größe fehlt (z.B. Längsbeschleunigung, Raddrehzahl,...). Signalqualität bei instabiler Fahrt eingeschränkt. (Für sicherheitsrelevante Funktionen Anwendbarkeit des Signals prüfen.)), 4=Reserved (QU_V_VEH_COG_Reserved_4), 12=Reserved (QU_V_VEH_COG_Reserved_5), 6=Reserved (QU_V_VEH_COG_Reserved_6), 14=Signalwert ist ungültig, Zustand/Status temporär (QU_V_VEH_COG_Signalwert_ist_ungueltig_Zustand_Status_temporaer) (Keine Raddrehzahlen verfügbar, Berechnung der Geschwindigkeit nicht möglich. Das zugehörige Nutzsignal wird permanent mit der Ungültigkeitskennung befüllt.), 7=Reserved (QU_V_VEH_COG_Reserved_7), 15=Signal ungültig (QU_V_VEH_COG_Signal_ungueltig) (Kann nur vom Gateway gesetzt werden)
  compu method QU_VYAW_VEH: 8=Initialisierung (QU_VYAW_VEH_Initialisierung) (Tritt während der Initialisierungsphase auf bis Ist-Wert verfügbar (Vorbefüllung). Nutzsignal wird permanent mit Nutzwert 0 befüllt.), 1=Signalwert ist gültig und abgesichert und plausibilisiert (QU_VYAW_VEH_Signalwert_ist_gueltig_und_abgesichert_und_plausibilisiert) (Nutzsignal verfügbar, bereitgestellt aus zwei Sensoren (nur bei redundanter Sensorik) elektrische und Modellüberwachung i.O.), 9=Signalwert ist gültig und abgesichert, Zustand/Status temporär (QU_VYAW_VEH_Signalwert_ist_gueltig_und_abgesichert_Zustand_Status_temporaer) (Nutzsignal verfügbar, bereitgestellt aus zwei Sensoren (nur bei redundanter Sensorik) elektrische und Modellüberwachung i.O. Es liegt eine Signaltoleranz aufgrund nicht abgeschlossenen Offsetabgleichs an. FuSi : Bei sicherheitsrelevanten Funktionen ist die Fehleramplitude auszuwerten), 2=Signalwert ist gültig (QU_VYAW_VEH_Signalwert_ist_gueltig) (Nutzsignal verfügbar, bereitgestellt aus einem Sensor elektrische und Modellüberwachung i.O.), 10=Signalwert ist gültig, Zustand/Status temporär (QU_VYAW_VEH_Signalwert_ist_gueltig_Zustand_Status_temporaer) (Nutzsignal verfügbar, bereitgestellt aus einem Sensor elektrische und Modellüberwachung i.O. Es liegt eine Signaltoleranz aufgrund nicht abgeschlossenen Offsetabgleichs an. FuSi : Bei sicherheitsrelevanten Funktionen ist die Fehleramplitude auszuwerten.), 3=Signalqualität bzw. Überwachung eingeschränkt (QU_VYAW_VEH_Signalqualitaet_bzw_Ueberwachung_eingeschraenkt) (keine Modellüberwachung, da Eingangsgrößen für Überwachung fehlen (zum Bsp. Querbeschleunigung, Lenkwinkel, ...), elektrische Überwachung i.O Nutzsignal wird aus Sensorwert gebildet. FuSi: keine Verwendung für sicherheitsrelevante Funktionen), 11=Signalqualität bzw. Überwachung eingeschränkt, Zustand/Status temporär (QU_VYAW_VEH_Signalqualitaet_bzw_Ueberwachung_eingeschraenkt_Zustand_Status_temporaer) (keine Modellüberwachung, da Eingangsgrößen für Überwachung fehlen (zum Bsp. Querbeschleunigung, Lenkwinkel, ...), elektrische Überwachung i.O Es liegt eine Signaltoleranz aufgrund nicht abgeschlossenen Offsetabgleichs an. Nutzsignal wird aus Sensorwert gebildet. FuSi : Bei sicherheitsrelevanten Funktionen ist die Fehleramplitude auszuwerten), 4=Reserved (QU_VYAW_VEH_Reserved), 12=Ersatzwert: Abgleichwert ist im Nutzsignal gesetzt, Zustand/Status temporär (QU_VYAW_VEH_Ersatzwert_Abgleichwert_ist_im_Nutzsignal_gesetzt_Zustand_Status_temporaer) (elektrische Überwachung oder Modellüberwachung zeigt Fehler an, deshalb wird Ersatzwert aus Modell (Lenkwinkel) versendet FuSi: keine Verwendung für sicherheitsrelevante Funktionen), 6=Signalwert ist ungültig (QU_VYAW_VEH_Signalwert_ist_ungueltig) (elektrische Überwachung oder Modellüberwachung zeigt Fehler an, kein Ersatzwert verfügbar (Steuergerät interner Fehler). Das zugehörige Nutzsignal wird permanent mit der Ungültigkeitskennung befüllt. Diese Codierung wird ab SP2015 nicht mehr bedient.), 14=Signalwert ist ungültig, Zustand/Status temporär (QU_VYAW_VEH_Signalwert_ist_ungueltig_Zustand_Status_temporaer) (elektrische Überwachung oder Modellüberwachung zeigt Fehler an, kein Ersatzwert verfügbar (Eingangssignale Fehler). Das zugehörige Nutzsignal wird permanent mit der Ungültigkeitskennung befüllt.), 7=Reserved (QU_VYAW_VEH_Reserved_2), 15=Signal ungültig (QU_VYAW_VEH_Signal_ungueltig) (Kann nur vom Gateway gesetzt werden)
  compu method RQ_CULI: 0=Keine_Strombegrenzung (RQ_CULI_Keine_Strombegrenzung) (Keine Strombegrenzung angefordert.), 10=Maximale_Strombegrenzung (RQ_CULI_Maximale_Strombegrenzung) (Sicherheits-Strombegrenzung angefordert.), 13=Reserviert_nicht_verfuegbar (RQ_CULI_Reserviert_nicht_verfuegbar) (Hinweis: Reserviert für funktionale Kennung Signal-Tag.), 14=Reserviert_Fehler (RQ_CULI_Reserviert_Fehler) (Hinweis: Reserviert für funktionale Kennung Signal-Tag.), 15=Signal_unbefuellt (RQ_CULI_Signal_unbefuellt) (Sendefunktion nicht in Betrieb)
  compu method RQ_CULI_EST_SFY: 0=Keine_Strombegrenzung (RQ_CULI_EST_SFY_Keine_Strombegrenzung) (Keine Strombegrenzung angefordert.), 1=Komfort_Strombegrenzung (RQ_CULI_EST_SFY_Komfort_Strombegrenzung) (Strombegrenzung über ELMa angefordert.), 10=Maximale_Strombegrenzung (RQ_CULI_EST_SFY_Maximale_Strombegrenzung) (Sicherheits-Strombegrenzung angefordert.), 13=Reserviert_nicht_verfuegbar (RQ_CULI_EST_SFY_Reserviert_nicht_verfuegbar) (Hinweis: Reserviert für funktionale Kennung Signal-Tag.), 14=Reserviert_Fehler (RQ_CULI_EST_SFY_Reserviert_Fehler) (Hinweis: Reserviert für funktionale Kennung Signal-Tag.), 15=Signal_unbefuellt (RQ_CULI_EST_SFY_Signal_unbefuellt) (Sendefunktion nicht in Betrieb)
  compu method RQ_RST_OBD_DIAG: 0=Keine Anforderung Reset OBD_Diagnose (RQ_RST_OBD_DIAG_Keine_Anforderung_Reset_OBD_Diagnose), 2=Anforderung Reset OBD_Diagnose (RQ_RST_OBD_DIAG_Anforderung_Reset_OBD_Diagnose), 3=Signal ungültig (RQ_RST_OBD_DIAG_Signal_ungueltig)
  compu method RQ_STG_EFAN: 0=AUS (RQ_STG_EFAN_AUS), 1..14=Stufe, 15=Signal ungültig (RQ_STG_EFAN_Signal_ungueltig)
  compu method SECU_CHAL: phys=raw for raw >0..<255
  compu method SSS_IDENT: 0=ZGW VIN (SSS_IDENT_ZGW_VIN), 255=Signal ungültig (SSS_IDENT_Signal_ungueltig)
  compu method SSV_IDENT: 0=REF_BAC4CAN_VIN (SSV_IDENT_REF_BAC4CAN_VIN), 1=DME1 VIN (SSV_IDENT_DME1_VIN), 2=DME2 VIN (SSV_IDENT_DME2_VIN), 3=RSE VIN (SSV_IDENT_RSE_VIN) (Vorhalt), 4=KAFAS, VIN (SSV_IDENT_KAFAS_VIN) (Vorhalt), 5=DSC_Modul VIN (SSV_IDENT_DSC_Modul_VIN) (Vorhalt), 6=VDP VIN (SSV_IDENT_VDP_VIN) (Vorhalt), 7=SAS VIN (SSV_IDENT_SAS_VIN) (Vorhalt), 8=NiVi VIN (SSV_IDENT_NiVi_VIN) (Vorhalt), 9=HU_VIN (SSV_IDENT_HU_VIN) (Alle HUs), 10=EPS_VIN (SSV_IDENT_EPS_VIN) (Vorhalt), 11=REF_BAC4_FR_VIN (SSV_IDENT_REF_BAC4_FR_VIN), 19=MRR_VIN (SSV_IDENT_MRR_VIN), 20=ATM2_VIN (SSV_IDENT_ATM2_VIN), 21=Kombi_VIN (SSV_IDENT_Kombi_VIN), 255=Signal ungültig (SSV_IDENT_Signal_ungueltig)
  compu method ST_ANO_MSA_ENG_STOP: 0=Kein Ankündigung (ST_ANO_MSA_ENG_STOP_Kein_Ankuendigung) (kein MSA-Motorstopp angekündigt oder aktiv), 1=Ankündigung MSA-Motorstopp (ST_ANO_MSA_ENG_STOP_Ankuendigung_MSA_Motorstopp) (MSA-Motorstopp angekündigt oder aktiv in Durchführung), 3=Signal ungültig (ST_ANO_MSA_ENG_STOP_Signal_ungueltig)
  compu method ST_CC_EPS: 0=Rücksetzen (ST_CC_EPS_Ruecksetzen) (Betreffende CC-message wird gelöscht), 1=Setzen (ST_CC_EPS_Setzen) (CC-message display), 3=Signal ungültig (ST_CC_EPS_Signal_ungueltig)
  compu method ST_CENG_DRV: 0=Motor steht (ST_CENG_DRV_Motor_steht) (Motorstillstand anhand interner Bedingungen erkannt (z.B. Kurbelwellendrehzahl < Schwelle für bestimmte Zeit)), 1=Motor startet (ST_CENG_DRV_Motor_startet) (Startroutinen aktiv, Motor in Vorsteuerung), 2=Motor läuft (ST_CENG_DRV_Motor_laeuft) (Motor im geregelten Betrieb, Motorlauf ohne Startsystemeingriff gewährleistet), 3=Motor im Auslauf (ST_CENG_DRV_Motor_im_Auslauf) (Anforderung zum Motorabstellen (z.B. über MSA-Anforderung, Anforderung Fahrbereitschaft beenden, etc.)), 13=Funktionsschnittstelle_ist_nicht_verfuegbar (ST_CENG_DRV_Funktionsschnittstelle_ist_nicht_verfuegbar) (DME in der Initialisierung (z.B. nach Reset)), 14=Reserviert (ST_CENG_DRV_Reserviert) (Hinweis: Reserviert für funktionale Kennung Signal-Tag.), 15=Signal_unbefuellt (ST_CENG_DRV_Signal_unbefuellt) (Sendefunktion nicht in Betrieb)
  compu method ST_CON_VEH: 0=reserviert (ST_CON_VEH_reserviert), 1=Parken_BN_niO (ST_CON_VEH_Parken_BN_niO), 2=Parken_BN_iO (ST_CON_VEH_Parken_BN_iO), 3=Standfunktionen_Kunde_nicht_im_FZG (ST_CON_VEH_Standfunktionen_Kunde_nicht_im_FZG), 5=Wohnen (ST_CON_VEH_Wohnen), 7=Pruefen_Analyse_Diagnose (ST_CON_VEH_Pruefen_Analyse_Diagnose), 8=Fahrbereitschaft_herstellen (ST_CON_VEH_Fahrbereitschaft_herstellen), 10=Fahren (ST_CON_VEH_Fahren), 12=Fahrbereitschaft_beenden (ST_CON_VEH_Fahrbereitschaft_beenden), 13=reserviert (ST_CON_VEH_reserviert_2) (Hinweis: Reserviert für funktionale Kennung Signal-Tag.), 14=reserviert (ST_CON_VEH_reserviert_3) (Hinweis: Reserviert für funktionale Kennung Signal-Tag.), 15=Signal_unbefuellt (ST_CON_VEH_Signal_unbefuellt)
  compu method ST_CULI_EST: 0=Keine_Strombegrenzung (ST_CULI_EST_Keine_Strombegrenzung) (Keine Strombegrenzung aktiv.), 1=Komfort_Strombegrenzung (ST_CULI_EST_Komfort_Strombegrenzung) (Strombegrenzung über ELMa aktiv.), 10=Maximale_Strombegrenzung (ST_CULI_EST_Maximale_Strombegrenzung) (Sicherheits-Strombegrenzung aktiv), 13=Reserviert_nicht_verfuegbar (ST_CULI_EST_Reserviert_nicht_verfuegbar) (Hinweis: Reserviert für funktionale Kennung Signal-Tag.), 14=Reserviert_Fehler (ST_CULI_EST_Reserviert_Fehler) (Hinweis: Reserviert für funktionale Kennung Signal-Tag.), 15=Signal_unbefuellt (ST_CULI_EST_Signal_unbefuellt) (Sendefunktion nicht in Betrieb)
  compu method ST_DCSW: 0=Trennelement auf 24V (ST_DCSW_Trennelement_auf_24V) (Kein Fehler - Trennelement ist auf Position 24V. (bei 150W und 750W PCU)), 1=Trennelement wird auf 12V umgeschaltet werden (ST_DCSW_Trennelement_wird_auf_12V_umgeschaltet_werden) (Trennelement wird von Position 24V auf Position 12V umgeschaltet werden (bei 150W und 750W PCU)), 2=Trennelement auf 12V (ST_DCSW_Trennelement_auf_12V) (Trennelement ist auf Position 12V. (bei 150W und 750W PCU)), 3=Signal ungültig (ST_DCSW_Signal_ungueltig)
  compu method ST_DIAG_OBD_MUX_IMME: phys=raw for raw 4..60, 1=Cal-ID (software calibration identification) (ST_DIAG_OBD_MUX_IMME_Cal_ID_software_calibration_identification_), 2=CVN (software calibration verification number) (ST_DIAG_OBD_MUX_IMME_CVN_software_calibration_verification_number_), 63=Ungültig (ST_DIAG_OBD_MUX_IMME_Ungueltig) (Wird funktional nicht bedient.)
  compu method ST_DIAG_OBD_MUX_MAX: phys=raw for raw >0..<255
  compu method ST_ENERG_FZM: 0=ENSTATE_GOOD (ST_ENERG_FZM_ENSTATE_GOOD), 1=ENSTATE_OK (ST_ENERG_FZM_ENSTATE_OK), 2=ENSTATE_SHORTAGE (ST_ENERG_FZM_ENSTATE_SHORTAGE), 3=ENSTATE_SEVERE_SHORTAGE (ST_ENERG_FZM_ENSTATE_SEVERE_SHORTAGE), 15=Signal ungültig (ST_ENERG_FZM_Signal_ungueltig)
  compu method ST_ENERG_SUPY: mask 255: 0=Kein Spannungseinbruch (ST_ENERG_SUPY_Kein_Spannungseinbruch), mask 129: 1=Startspannungseinbruch auf Versorgungszweig 1 (ST_ENERG_SUPY_Startspannungseinbruch_auf_Versorgungszweig_1) (Auf Versorgungszweig 1 ist bei MSA2.3 der Starter. Bei MSA2.5 kann beim Kaltstart Versorgungszweig 1 und Versorgungszweig 2 über ein Relais verbunden werden.), mask 130: 2=Startspannungseinbruch auf Versorgungszweig 2 (ST_ENERG_SUPY_Startspannungseinbruch_auf_Versorgungszweig_2) (Auf Versorgungszweig 2 ist bei MSA2.5 der Starter. Bei den Hybriden ist die Zustarteinrichtung ebenfalls auf Versorgungszweig 2.), mask 132: 4=Spannungsversorgung 48 Volt (ST_ENERG_SUPY_Spannungsversorgung_48_Volt), mask 255: 253=Reserviert (ST_ENERG_SUPY_Reserviert) (Hinweis: Reserviert für funktionale Kennung Signal-Tag), mask 255: 254=Reserviert (ST_ENERG_SUPY_Reserviert_2) (Hinweis: Reserviert für funktionale Kennung Signal-Tag), mask 255: 255=Signal_unbefuellt (ST_ENERG_SUPY_Signal_unbefuellt) (Sendefunktion nicht in Betrieb)
  compu method ST_IDC_CC_EPS: 0=Kein Blinken (ST_IDC_CC_EPS_Kein_Blinken), 1=Langsames Blinken (ST_IDC_CC_EPS_Langsames_Blinken) (Langsamer Takt = 1 Hz), 2=Schnelles Blinken (ST_IDC_CC_EPS_Schnelles_Blinken) (Schneller Takt = 3 Hz), 3=Signal ungültig (ST_IDC_CC_EPS_Signal_ungueltig)
  compu method ST_ILK_ERRM_FZM: 0=Fehlerspeicherfreigabe (ST_ILK_ERRM_FZM_Fehlerspeicherfreigabe) (Eintrag von Fehlern uneingeschränkt), 1=Fehlerspeichersperre (ST_ILK_ERRM_FZM_Fehlerspeichersperre) (Bereich Netzwerkfehler ist zu sperren), 2=Reserve (ST_ILK_ERRM_FZM_Reserve) (reserviert für zukünftige Erweiterungen), 3=Signal ungültig (ST_ILK_ERRM_FZM_Signal_ungueltig)
  compu method ST_LDREL_GEN: 0=Keine Entlastungsfkt. Aktiv / Rücknahme (ST_LDREL_GEN_Keine_Entlastungsfkt_Aktiv_Ruecknahme), 1=iGR-High (ST_LDREL_GEN_iGR_High), 2=SULEV-Fkt (ST_LDREL_GEN_SULEV_Fkt), 3=Entlastung nach Motorstart (ST_LDREL_GEN_Entlastung_nach_Motorstart), 4=Rennstart mit oder ohne AGM Batterie (ST_LDREL_GEN_Rennstart_mit_oder_ohne_AGM_Batterie), 5=ELMOTENTL Hitze (ST_LDREL_GEN_ELMOTENTL_Hitze), 6=ELMOTENTL Kälte (ST_LDREL_GEN_ELMOTENTL_Kaelte), 7=Entlastung Anfahrschwäche wie P66,P85 (ST_LDREL_GEN_Entlastung_Anfahrschwaeche_wie_P66_P85), 8=Übertemperatur Generator (ST_LDREL_GEN_Uebertemperatur_Generator), 9=Entlastung aus Sicherheitsgründen (ST_LDREL_GEN_Entlastung_aus_Sicherheitsgruenden), 10=Entlastung Begrenzung Lagerkräfte (ST_LDREL_GEN_Entlastung_Begrenzung_Lagerkraefte), 11=Entlastung aus Komfortgründen (ST_LDREL_GEN_Entlastung_aus_Komfortgruenden), 12=Entlastung aus funktionalen Gründen (ST_LDREL_GEN_Entlastung_aus_funktionalen_Gruenden), 15=Signal ungültig (ST_LDREL_GEN_Signal_ungueltig)
  compu method ST_MOT_DRV: 0=Kein E-Maschine verfügbar (ST_MOT_DRV_Kein_E_Maschine_verfuegbar) (Keine Traktions-E-Maschine verfügbar, oder Traktions-E-Maschine(n) nicht bereit, oder elektrische Fahrbereitschaft nicht zulässig.), 1=E-Maschine ist elektrisch fahrbereit oder bereits aktiv (ST_MOT_DRV_E_Maschine_ist_elektrisch_fahrbereit_oder_bereits_aktiv) (Hochvoltsystem ist aktiv, Traktions-E-Maschine(n) bereit und elektrische Fahrbereitschaft zulässig.), 3=Signal ungültig (ST_MOT_DRV_Signal_ungueltig)
  compu method ST_OBD_CYC: mask 9: 0=Warm-Up-Zyklus nicht aktiv (ST_OBD_CYC_Warm_Up_Zyklus_nicht_aktiv), mask 9: 1=Warm-Up-Zyklus aktiv (ST_OBD_CYC_Warm_Up_Zyklus_aktiv), mask 10: 0=Driving-Zyklus nicht aktiv (ST_OBD_CYC_Driving_Zyklus_nicht_aktiv), mask 10: 2=Driving-Zyklus aktiv (ST_OBD_CYC_Driving_Zyklus_aktiv), mask 44: 0=RBM-Zyklus nicht aktiv (ST_OBD_CYC_RBM_Zyklus_nicht_aktiv), mask 44: 4=RBM-Zyklus aktiv (ST_OBD_CYC_RBM_Zyklus_aktiv), mask 44: 32=RBM-Zyklus nicht erfüllbar (ST_OBD_CYC_RBM_Zyklus_nicht_erfuellbar), mask 24: 0=Kein PFC-Zyklus (ST_OBD_CYC_Kein_PFC_Zyklus), mask 24: 16=PFC-Zyklus erfüllt (ST_OBD_CYC_PFC_Zyklus_erfuellt), mask 63: 63=Signal ungültig (ST_OBD_CYC_Signal_ungueltig)
  compu method ST_OFFS_QUAD_PINA_EPS: 0=Algorithmus (Funktion) im Sleep-Modus (ST_OFFS_QUAD_PINA_EPS_Algorithmus_Funktion_im_Sleep_Modus) (Die Funktion ist bereit aber zur Zeit nicht aktiv), 1=Offset wird ermittelt (ST_OFFS_QUAD_PINA_EPS_Offset_wird_ermittelt), 2=Offset übernehmen, Aufsetzen über Index (ST_OFFS_QUAD_PINA_EPS_Offset_uebernehmen_Aufsetzen_ueber_Index) (Kann nur gesendet werden wenn Qualifier_Ist_Position_EPS = Ersatzwert oder ab SP2013 (außer F15-F16, 444) "Signalwert ist gültig, Zustand/Status temporär"), 3=Offset übernehmen, Aufsetzen über Modelvergleich (ST_OFFS_QUAD_PINA_EPS_Offset_uebernehmen_Aufsetzen_ueber_Modelvergleich) (Kann nur gesendet werden wenn Qualifier_Ist_Position_EPS = Ersatzwert oder ab SP2013 (außer F15-F16, 444) "Signalwert ist gültig, Zustand/Status temporär"), 4=Offset übernehmen, Aufsetzen über Anschlag-Anschlag (ST_OFFS_QUAD_PINA_EPS_Offset_uebernehmen_Aufsetzen_ueber_Anschlag_Anschlag) (Kann nur gesendet werden wenn Qualifier_Ist_Position_EPS = Ersatzwert oder ab SP2013 (außer F15-F16, 444) "Signalwert ist gültig, Zustand/Status temporär"), 5=Offset übernehmen, Aufsetzen über Summenlenkwinkel (im AFS-Fall) (ST_OFFS_QUAD_PINA_EPS_Offset_uebernehmen_Aufsetzen_ueber_Summenlenkwinkel_im_AFS_Fall_) (Kann nur gesendet werden wenn Qualifier_Ist_Position_EPS = Ersatzwert oder ab SP2013 (außer F15-F16, 444) "Signalwert ist gültig, Zustand/Status temporär" Wird zurzeit nicht verwendet.), 6=Offset in Prüfung (ST_OFFS_QUAD_PINA_EPS_Offset_in_Pruefung) (Wird gesetzt nach Offset übernehmen (nicht nach Groboffset!) bzw. sofern die EPS sich selbst aufsetzen konnte und nach Offset korrigieren, während der Bestätigungsphase.), 7=Offset korrigieren (ST_OFFS_QUAD_PINA_EPS_Offset_korrigieren) (Kann nur gesendet werden wenn Qualifier_Ist_Position_EPS = "Gültig" oder "Gültig und Abgesichert"), 8=Initialisierung (ST_OFFS_QUAD_PINA_EPS_Initialisierung) (wird im aller ersten Rechenzyklus gesetzt (10ms)), 9=Restoffset wird ermittelt (ST_OFFS_QUAD_PINA_EPS_Restoffset_wird_ermittelt) (Wird gesetzt, nachdem im Zustand "Offset wird ermittelt" erstmals nur ein Groboffset bestimmt und an die EPS gesendet werden konnte. Wird erst ab SP2013 (außer F15-F16, 444) unterstützt.), 11=Offset übernehmen, Groboffset über Modell (ST_OFFS_QUAD_PINA_EPS_Offset_uebernehmen_Groboffset_ueber_Modell) (Kann nur gesendet werden wenn Qualifier_Ist_Position_EPS = Ersatzwert Wird erst ab SP2013 (außer F15-F16, 444) unterstützt.), 15=Signal ungültig (ST_OFFS_QUAD_PINA_EPS_Signal_ungueltig) (Kann Funktional nicht gesetzt werden)
  compu method ST_UDP: 0=Kein Spannungseinbruch (ST_UDP_Kein_Spannungseinbruch) (kein Spannungseinbruch angekündigt oder aktiv), 1=Startspannungseinbruch bis maximal Spannungsschwelle 1 (ST_UDP_Startspannungseinbruch_bis_maximal_Spannungsschwelle_1) (Spannungseinbruch bis Schwelle 1 aktiv (z.B. Ankündigung vor Einbruch, bei Ansteuerung Startsystem, Nachlauf nach Abwurf Startsystem bis Normalisierung des BN-Niveaus) Siehe GS95024-2-1 (Kap. 4.11.2.2) Warmstart), 2=Startspannungseinbruch bis maximal Spannungsschwelle 2 (ST_UDP_Startspannungseinbruch_bis_maximal_Spannungsschwelle_2) (Spannungseinbruch bis Schwelle 2 aktiv (z.B. Ankündigung vor Einbruch, bei Ansteuerung Startsystem, Nachlauf nach Abwurf Startsystem bis Normalisierung des BN-Niveaus) Siehe GS95024-2-1 (Kap. 4.11.2.1) Kaltstart), 13=Funktionsschnittstelle_ist_nicht_verfuegbar (ST_UDP_Funktionsschnittstelle_ist_nicht_verfuegbar) (DME in der Initialisierung (z.B. nach Reset)), 14=Reserviert (ST_UDP_Reserviert) (Hinweis: Reserviert für funktionale Kennung Signal-Tag.), 15=Signal_unbefuellt (ST_UDP_Signal_unbefuellt) (Sendefunktion nicht in Betrieb)
  compu method ST_V_VEH_NSS: 12=Fahrzeug im stillstandsnahen Bereich (ST_V_VEH_NSS_Fahrzeug_im_stillstandsnahen_Bereich) (Dieser Zustand wird eingenommen wenn sowohl die Fahrzeuggeschwindigkeit (V_VEH_COG) als auch die 4 Einzelradgeschwindigkeit 10 kmh unterschreiten.), 13=Fahrzeug nicht im stillstandsnahen Bereich (ST_V_VEH_NSS_Fahrzeug_nicht_im_stillstandsnahen_Bereich) (Dieser Zustand wird eingenommen wenn das Fahrzeug sich nicht sicher im stillstandsnahen Bereich befindet. Mindestens eine der 5 Geschwindigkeiten, Fahrzeuggeschwindigkeit (V_VEH_COG) oder Einzelradgeschwindigkeiten, überschreitet die Schwelle von 10 kmh. Das heißt das Fahrzeug kann eine beliebige Geschwindigkeit aufweisen, auch unter 10 kmh. Es bedeutet nicht zwangsläufig dass das Fahrzeug schneller als 10kmh fährt.), 15=Signal ungültig (ST_V_VEH_NSS_Signal_ungueltig) (Dieser Zustand wird beim Aufstarten des Steuergeräts gesetzt bis ein gültiger Wert bereit gestellt werden kann. Während des laufenden Betriebs kann dieser Zustand eingenommen werden, wenn die Raddrehzahlen nicht zur Verfügung stehen.)
  compu method STMOM_QTA_DV: phys=raw*0.005-10 for raw >0..<255; unit Nm
  compu method STU_8_BYTE: phys=raw for raw >0..<255
  compu method STU_RESP: phys=raw for raw >0..<255
  compu method SU_CLU_STMOM_SFE_DXP: 1=Ultrahart (SU_CLU_STMOM_SFE_DXP_Ultrahart), 2=Sportlich ausgewogen (SU_CLU_STMOM_SFE_DXP_Sportlich_ausgewogen), 3=Ausgewogen (SU_CLU_STMOM_SFE_DXP_Ausgewogen), 4=Weich (SU_CLU_STMOM_SFE_DXP_Weich), 13=Funktionsschnittstelle_ist_nicht_verfuegbar (SU_CLU_STMOM_SFE_DXP_Funktionsschnittstelle_ist_nicht_verfuegbar) (Sendefunktion in Betrieb, Werte nicht verfügbar), 14=Funktion_meldet_Fehler (SU_CLU_STMOM_SFE_DXP_Funktion_meldet_Fehler) (Sendefunktion in Betrieb, meldet Fehler), 15=Signal_unbefuellt (SU_CLU_STMOM_SFE_DXP_Signal_unbefuellt) (Sendefunktion nicht in Betrieb)
  compu method TAR_STMOM_DV_ACT: phys=raw*0.006-12 for raw >0..<255; unit Nm
  compu method TEMP_CPO_HET_MNG: phys=raw-48 for raw 0..252, 253=Reserviert (TEMP_CPO_HET_MNG_Reserviert) (Hinweis: Reserviert für funktionale Kennung Signal-Tag.), 254=Reserviert (TEMP_CPO_HET_MNG_Reserviert_2) (Hinweis: Reserviert für funktionale Kennung Signal-Tag.), 255=Signal_unbefuellt (TEMP_CPO_HET_MNG_Signal_unbefuellt) (Sendefunktion nicht in Betrieb); unit °C
  compu method TOT_STR_EPS: phys=raw*0.012213 for raw >0..<255
  compu method TRANF_CC_EPS: phys=raw for raw >0..<255; unit s
  compu method TRGG_ENGTORQ_EPS: phys=raw*0.01-10 for raw 0..2000, 4093=Funktionsschnittstelle_ist_nicht_verfuegbar (TRGG_ENGTORQ_EPS_Funktionsschnittstelle_ist_nicht_verfuegbar) (Sendefunktion in Betrieb, Werte nicht verfügbar), 4094=Funktion_meldet_Fehler (TRGG_ENGTORQ_EPS_Funktion_meldet_Fehler) (Sendefunktion in Betrieb, meldet Fehler), 4095=Signal_unbefuellt (TRGG_ENGTORQ_EPS_Signal_unbefuellt) (Sendefunktion nicht in Betrieb); unit Nm
  compu method UI_32_noIniVal_noDflVal_4294967295_1_0_noEnc_hasRng: phys=raw for raw >0..<255; unit s
  compu method UI_8_noIniVal_noDflVal_255_0_50s_MI_40_noEnc_hasRng: phys=raw*0.5-40 for raw >0..<255; unit °C
  compu method UN_PO_EPS: 0=Ritzelschnittstelle (UN_PO_EPS_Ritzelschnittstelle) (Die Position wird in Grad übertragen.), 1=Zahnstangenhubschnittstelle (UN_PO_EPS_Zahnstangenhubschnittstelle) (Die Position wird in Millimeter übertragen (Einheit=0.2mm).), 3=Signal ungültig (UN_PO_EPS_Signal_ungueltig)
  compu method UN_TOT_STR_EPS: 0=Ritzelschnittstelle (UN_TOT_STR_EPS_Ritzelschnittstelle) (Die Position wird in Grad übertragen), 1=Zahnstangenhubschnittstelle (UN_TOT_STR_EPS_Zahnstangenhubschnittstelle) (Die Position wird in Millimeter übertragen (Einheit: 0.2mm)), 3=Signal ungültig (UN_TOT_STR_EPS_Signal_ungueltig)
  compu method V_VEH_COG: phys=raw/64 for raw >0..<255; unit km/h
  compu method VYAW_VEH: phys=raw*0.005-163.84 for raw >0..<255; unit °/s
  compu method VYAW_VEH_ERR_AMP: phys=raw*0.0125 for raw >0..<255; unit °/s
package /BMW/SystemDescription/DataConstrs
  range ACLNY_COG: phys -65..65, raw 0..65535
  range ACLNY_COG_ERR_AMP: phys 0..20, raw 0..4095
  range ACTVN_FN_ESTP_VIRT_FTAX: raw 0..15
  range ALIV_4_BIT_UInt: phys 0..14, raw 0..15
  range ALIV_4_BIT_Unsigned_Integer: phys 0..14, raw 0..15
  range ALIV_COU_4: raw 0..15
  range ALIV_COU_V: raw 0..15
  range AVL_FORC_GRD: phys -17..17, raw 0..4095
  range AVL_PINA_EPS: phys -1439.9560546875..1439.9560546875, raw 0..65535
  range AVL_PINA_IDX_ICM: phys -1439.9560546875..1439.9560546875, raw 0..65535
  range AVL_PWR_EL: phys -12..12, raw 0..255
  range AVL_RPM_WHL: phys -400..400, raw 0..65535
  range AVL_STEA_PNI_OFFS: phys -45..45, raw 0..4095
  range CHL_4_UInt: phys 0..14, raw 0..15
  range COU_BS_RESP: phys 0..16777214, raw 0..16777215
  range CRC_V_VEH: phys 0..255, raw 0..255
  range CRC8: phys 0..255, raw 0..255
  range CTR_BS_PRTNT: raw 0..15
  range CTR_DEAC_EPS_FNS: raw 0..15
  range CTR_ERRM_BN_U: raw 0..63
  range CTR_WARN_DIR_VIB_EPS: raw 0..3
  range CTR_WARN_ILVL_VIB_EPS: raw 0..15
  range CTR_WARN_PTRN_VIB_EPS: raw 0..15
  range DBG_8Bit: raw 0..255
  range DIAG_ST_OBD: raw 0..63
  range DVCO_VEH: raw 0..7
  range ENERG_AVAI_ARS: phys 0..100, raw 0..255
  range FACT_ASS_STMOM_FTAX: phys 1..1.9921875, raw 0..255
  range FACT_CTRR_STMOM_FTAX: phys 0.0078125..1, raw 0..255
  range FACT_DMPNG_ADDON_STMOM_FTAX: phys 0..2, raw 0..255
  range FACT_MO_STE_SO_DXP: phys 0..5, raw 0..255
  range FKTN_PRTNT: raw 0..4294967295
  range I_SPEC_ARS: phys 0..252, raw 0..255
  range ID_FN_INQY: raw 0..65535
  range ID_FN_RQ_STG_EFAN: raw 0..255
  range ID_TEMP_CPO_HET_MNG: raw 0..15
  range IDX_TORQ_SEN: raw 0..3
  range MILE_KM: phys 0..16777214, raw 0..16777215
  range MIN_I_SPEC_ARS: phys -252..0, raw 0..255
  range NO_CC_EPS: phys 0..65534, raw 0..65535
  range NO_VECH_{1..7}: raw 0..255
  range OFFS_GRD_MID_EPS: phys -89.9560546875..89.9560546875, raw 0..4095
  range OFFS_QUAD_PINA_EPS: phys -127..127, raw 0..255
  range QU_ACLNY_COG: raw 0..15
  range QU_AVL_FORC_GRD: raw 0..15
  range QU_AVL_PINA_EPS: raw 0..15
  range QU_AVL_RPM_WHL: raw 0..15
  range QU_AVL_STMOM_DV_ACT: raw 0..15
  range QU_DGR_AISP_ENERG: raw 0..15
  range QU_FN_ENSU_SFY: raw 0..255
  range QU_FN_EST: raw 0..255
  range QU_FN_FDR: raw 0..4095
  range QU_FN_VIB_EPS: raw 0..15
  range QU_SER_STMOM_STMOM_DV_ACT: raw 0..255
  range QU_ST_CON_VEH: raw 0..15
  range QU_SUM_AVL_I_DRDY_SFY: raw 0..15
  range QU_TAR_DMPNG_ADDON_STMOM_FTAX: raw 0..15
  range QU_TAR_FACT_STMOM_FTAX: raw 0..15
  range QU_TAR_QTA_STMOM_DV: raw 0..15
  range QU_TAR_STMOM_DV_ACT: raw 0..15
  range QU_V_VEH_COG: raw 0..15
  range QU_VYAW_VEH: raw 0..15
  range RQ_CULI: raw 0..15
  range RQ_CULI_EST_SFY: raw 0..15
  range RQ_RST_OBD_DIAG: raw 0..3
  range RQ_STG_EFAN: raw 0..15
  range SECU_CHAL: raw 0..1099511627775
  range SSS_IDENT: raw 0..255
  range SSV_IDENT: raw 0..255
  range ST_ANO_MSA_ENG_STOP: raw 0..3
  range ST_CC_EPS: raw 0..3
  range ST_CENG_DRV: raw 0..15
  range ST_CON_VEH: raw 0..15
  range ST_CULI_EST: raw 0..15
  range ST_DCSW: raw 0..3
  range ST_DIAG_OBD_MUX_IMME: phys 4..60, raw 0..63
  range ST_DIAG_OBD_MUX_MAX: phys 4..60, raw 0..63
  range ST_ENERG_FZM: raw 0..15
  range ST_ENERG_SUPY: raw 0..255
  range ST_IDC_CC_EPS: raw 0..3
  range ST_ILK_ERRM_FZM: raw 0..3
  range ST_LDREL_GEN: raw 0..15
  range ST_MOT_DRV: raw 0..3
  range ST_OBD_CYC: raw 0..63
  range ST_OFFS_QUAD_PINA_EPS: raw 0..15
  range ST_UDP: raw 0..15
  range ST_V_VEH_NSS: raw 0..15
  range STMOM_QTA_DV: phys -10..10, raw 0..4095
  range STU_8_BYTE: raw 0..18446744073709551615
  range STU_RESP: raw 0..16777215
  range SU_CLU_STMOM_SFE_DXP: raw 0..15
  range TAR_STMOM_DV_ACT: phys -12..12, raw 0..4095
  range TEMP_CPO_HET_MNG: phys -48..204, raw 0..255
  range TOT_STR_EPS: phys 0..50, raw 0..4095
  range TRANF_CC_EPS: phys 0..14, raw 0..15
  range TRGG_ENGTORQ_EPS: phys -10..10, raw 0..4095
  range UI_32_noIniVal_noDflVal_4294967295_1_0_noEnc_hasRng: phys 0..4294967294, raw 0..4294967295
  range UI_8_noIniVal_noDflVal_255_0_50s_MI_40_noEnc_hasRng: phys -40..85, raw 0..255
  range UN_PO_EPS: raw 0..3
  range UN_TOT_STR_EPS: raw 0..3
  range V_VEH_COG: phys 0..350, raw 0..65535
  range VYAW_VEH: phys -163.84..163.83, raw 0..65535
  range VYAW_VEH_ERR_AMP: phys 0..50, raw 0..4095
package /BMW/SystemDescription/Units
  15 x unit, all with factor-si-to-unit=1, offset-si-to-unit=0:
    ampere: display-name=A
    degree_celsius: display-name=°C
    degree_per_second: display-name=°/s
    kilometer: display-name=km
    kilometer_per_hour: display-name=km/h
    kilonewton: display-name=kN
    kilowatt: display-name=kW
    liter: display-name=l
    meter_per_second_squared: display-name=m/s²
    millisecond: display-name=ms
    newton_meter: display-name=Nm
    no_unit
    percent: display-name=%
    radian_per_second: display-name=rad/s
    second: display-name=s
package /BMW/Units
  5 x unit, all with offset-si-to-unit=0:
    ampere: display-name=A, factor-si-to-unit=1
    degree_per_second: display-name=°/s, factor-si-to-unit=3.1415926535897931
    kilometer_per_hour: display-name=km/h, factor-si-to-unit=1000
    kilonewton: display-name=kN, factor-si-to-unit=1000
    kilowatt: display-name=kW, factor-si-to-unit=1000
package /ComponentTypes/DataTypeMappingSets
  data type mapping set TMS_Bac4_ApplicationState: mode-request-type-map{implementation-data-type=Bac4_ApplicationStateType, mode-group=Bac4_ApplicationState}
package /DataTypes
  18 x impl type:
    ALIV_CON_VEH: category=VALUE, base-type=uint8, compu {identical}
    Bac4_ApplicationStateType: category=VALUE, base-type=uint8, sw-calibration-access=READ-ONLY, compu {phys=raw for raw 0, phys=raw for raw 1, phys=raw for raw 2, phys=raw for raw 3, phys=raw for raw 4}, type-emitter=RTE
    BMW_Application_Reset_IRV: category=VALUE, base-type=uint8, sw-calibration-access=READ-ONLY, compu {10=BMW_APPLICATION_RESET_HARD, 20=BMW_APPLICATION_RESET_PROGRAMMING, 255=BMW_APPLICATION_RESET_INIT; unit RESET}, type-emitter=RTE
    CON_VEH_dummy_56_63: category=VALUE, base-type=uint8, compu {identical}
    CRC_CON_VEH: category=VALUE, base-type=uint8, compu {identical} "Standartabsicherung Apllikations-CRC."
    CTR_BS_PRTNT:
      category=VALUE
      base-type=uint8
      compu {0=KeineKommunikation (CTR_BS_PRTNT_KeineKommunikation) (BNE original name: Keine Kommunikation), 1=Kom_Parken_BN_niO (CTR_BS_PRTNT_Kom_Parken_BN_niO), 2=Kom_Parken_BN_iO (CTR_BS_PRTNT_Kom_Parken_BN_iO), 3=Kom_Standfunktionen_Kunde_nicht_im_FZG (CTR_BS_PRTNT_Kom_Standfunktionen_Kunde_nicht_im_FZG), 4=reserviert (CTR_BS_PRTNT_reserviert), 5=Kom_Wohnen (CTR_BS_PRTNT_Kom_Wohnen), 6=reserviert_bne_95F305A59796464C872A83A9688DA49E_6 (CTR_BS_PRTNT_reserviert_bne_95F305A59796464C872A83A9688DA49E_6) (BNE original name: reserviert), 7=Kom_Pruefen_Analyse_Diagnose (CTR_BS_PRTNT_Kom_Pruefen_Analyse_Diagnose), 8=Kom_Fahrbereitschaft_herstellen (CTR_BS_PRTNT_Kom_Fahrbereitschaft_herstellen), 9=reserviert_bne_95F305A59796464C872A83A9688DA49E_9 (CTR_BS_PRTNT_reserviert_bne_95F305A59796464C872A83A9688DA49E_9) (BNE original name: reserviert), 10=Kom_Fahren (CTR_BS_PRTNT_Kom_Fahren), 11=reserviert_bne_95F305A59796464C872A83A9688DA49E_11 (CTR_BS_PRTNT_reserviert_bne_95F305A59796464C872A83A9688DA49E_11) (BNE original name: reserviert), 12=Kom_Fahrbereitschaft_beenden (CTR_BS_PRTNT_Kom_Fahrbereitschaft_beenden), 13=reserviert_bne_95F305A59796464C872A83A9688DA49E_13 (CTR_BS_PRTNT_reserviert_bne_95F305A59796464C872A83A9688DA49E_13) (BNE original name: reserviert), 14=reserviert_bne_95F305A59796464C872A83A9688DA49E_14 (CTR_BS_PRTNT_reserviert_bne_95F305A59796464C872A83A9688DA49E_14) (BNE original name: reserviert), 15=Signal_unbefuellt (CTR_BS_PRTNT_Signal_unbefuellt)}
    CTR_FKTN_PRTNT:
      category=VALUE
      base-type=uint32
      compu {mask 2147483649: 0=KonfigurationAus (FKTN_PRTNT_KonfigurationAus) (BNE original name: Konfiguration aus), mask 2147483649: 1=KonfigurationEin (FKTN_PRTNT_KonfigurationEin) (BNE original name: Konfiguration ein), mask 2147483650: 0=EthernetInfrastrukturAus (FKTN_PRTNT_EthernetInfrastrukturAus) (BNE original name: Ethernet Infrastruktur aus), mask 2147483650: 2=EthernetInfrastrukturEin (FKTN_PRTNT_EthernetInfrastrukturEin) (BNE original name: Ethernet Infrastruktur ein), mask 2147483904: 0=KlimabetriebAus (FKTN_PRTNT_KlimabetriebAus) (BNE original name: Klimabetrieb aus), mask 2147483904: 256=KlimabetriebEin (FKTN_PRTNT_KlimabetriebEin) (BNE original name: Klimabetrieb ein), mask 2147484160: 0=EntertainmentbetriebAus (FKTN_PRTNT_EntertainmentbetriebAus) (BNE original name: Entertainmentbetrieb aus), mask 2147484160: 512=EntertainmentbetriebEin (FKTN_PRTNT_EntertainmentbetriebEin) (BNE original name: Entertainmentbetrieb ein), mask 2147484672: 0=Externe_KommunikationAus (FKTN_PRTNT_Externe_KommunikationAus) (BNE original name: Externe_Kommunikation aus), mask 2147484672: 1024=Externe_KommunikationEin (FKTN_PRTNT_Externe_KommunikationEin) (BNE original name: Externe_Kommunikation ein), mask 2147485696: 0=Entertainmentbetrieb_Fond_aus (FKTN_PRTNT_Entertainmentbetrieb_Fond_aus) (Gilt ab SP2018), mask 2147485696: 2048=Entertainmentbetrieb_Fond_ein (FKTN_PRTNT_Entertainmentbetrieb_Fond_ein) (Gilt ab SP2018), mask 2147487744: 0=Assistenz_Parken_highAus (FKTN_PRTNT_Assistenz_Parken_highAus) (BNE original name: Assistenz_Parken_high aus), mask 2147487744: 4096=Assistenz_Parken_highEin (FKTN_PRTNT_Assistenz_Parken_highEin) (BNE original name: Assistenz_Parken_high ein), mask 2147516416: 0=LadenAus (FKTN_PRTNT_LadenAus) (BNE original name: Laden aus), mask 2147516416: 32768=LadenEin (FKTN_PRTNT_LadenEin) (BNE original name: Laden ein), mask 2147549184: 0=FahrzeugInfrastrukturAus (FKTN_PRTNT_FahrzeugInfrastrukturAus) (BNE original name: Fahrzeug Infrastruktur aus), mask 2147549184: 65536=FahrzeugInfrastrukturEin (FKTN_PRTNT_FahrzeugInfrastrukturEin) (BNE original name: Fahrzeug Infrastruktur ein), mask 2148007936: 0=Licht_aus (FKTN_PRTNT_Licht_aus) (Gilt ab SP2018), mask 2148007936: 524288=Licht_ein (FKTN_PRTNT_Licht_ein) (Gilt ab SP2018), mask 4294967295: 4294967295=Signal_unbefuellt (FKTN_PRTNT_Signal_unbefuellt)}
    MILE_KM:
      category=VALUE
      base-type=uint32
      compu {identical} "Automatisch generiert (Migration 2004-10-30) Transp.MOST-GW-Migration, 01.09.2006: Zusammenführung der Signalklasse Wegstrecke_Kilometer [1] mit den Parametern MileageKM [2]."
      range phys 0..16777214 "Automatisch generiert (Migration 2004-10-30) Transp.MOST-GW-Migration, 01.09.2006: Zusammenführung der Signalklasse Wegstrecke_Kilometer [1] mit den Parametern MileageKM [2]."
      invalid-value=16777215
    NO_VECH_1: category=ARRAY
      element Element: array-size=1, array-size-semantics=FIXED-SIZE, implementation-data-type=uint8
    NO_VECH_2: category=ARRAY
      element Element: array-size=1, array-size-semantics=FIXED-SIZE, implementation-data-type=uint8
    NO_VECH_3: category=ARRAY
      element Element: array-size=1, array-size-semantics=FIXED-SIZE, implementation-data-type=uint8
    NO_VECH_4: category=ARRAY
      element Element: array-size=1, array-size-semantics=FIXED-SIZE, implementation-data-type=uint8
    NO_VECH_5: category=ARRAY
      element Element: array-size=1, array-size-semantics=FIXED-SIZE, implementation-data-type=uint8
    NO_VECH_6: category=ARRAY
      element Element: array-size=1, array-size-semantics=FIXED-SIZE, implementation-data-type=uint8
    NO_VECH_7: category=ARRAY
      element Element: array-size=1, array-size-semantics=FIXED-SIZE, implementation-data-type=uint8
    QU_ST_CON_VEH:
      category=VALUE
      base-type=uint8
      compu {2=SignalwertGueltig (QU_ST_CON_VEH_SignalwertGueltig) (BNE original name: Signalwert gültig), 3=SignalwertEingeschraenktGueltig (QU_ST_CON_VEH_SignalwertEingeschraenktGueltig) (BNE original name: Signalwert eingeschränkt gültig), 6=ReserviertFuerDieNichtUmgesetzteKennung_Fehler_ (QU_ST_CON_VEH_ReserviertFuerDieNichtUmgesetzteKennung_Fehler_) (BNE original name: Reserviert für die nicht umgesetzte Kennung "Fehler"), 14=Wert_nicht_verfuegbar (QU_ST_CON_VEH_Wert_nicht_verfuegbar) (Siehe Signalbeschreibung), 15=SignalUnbefuellt (QU_ST_CON_VEH_SignalUnbefuellt) (BNE original name: Signal unbefüllt)}
    sigGroup_CON_VEH: category=STRUCTURE, dynamic-array-size-profile=None
      7 x element, all with category=TYPE_REFERENCE:
        ST_CON_VEH: range raw 0..15, implementation-data-type=ST_CON_VEH
        CTR_FKTN_PRTNT: implementation-data-type=CTR_FKTN_PRTNT
        CRC_CON_VEH: range phys 0..255 "Standartabsicherung Apllikations-CRC.", implementation-data-type=CRC_CON_VEH
        CON_VEH_dummy_56_63: range phys 0..255, implementation-data-type=CON_VEH_dummy_56_63
        CTR_BS_PRTNT: range raw 0..15, implementation-data-type=CTR_BS_PRTNT
        ALIV_CON_VEH: range phys 0..14, implementation-data-type=ALIV_CON_VEH
        QU_ST_CON_VEH: range raw 0..15, implementation-data-type=QU_ST_CON_VEH
    ST_CON_VEH:
      category=VALUE
      base-type=uint8
      compu {0=reserviert (ST_CON_VEH_reserviert), 1=Parken_BN_niO (ST_CON_VEH_Parken_BN_niO), 2=Parken_BN_iO (ST_CON_VEH_Parken_BN_iO), 3=Standfunktionen_Kunde_nicht_im_FZG (ST_CON_VEH_Standfunktionen_Kunde_nicht_im_FZG), 5=Wohnen (ST_CON_VEH_Wohnen), 7=Pruefen_Analyse_Diagnose (ST_CON_VEH_Pruefen_Analyse_Diagnose), 8=Fahrbereitschaft_herstellen (ST_CON_VEH_Fahrbereitschaft_herstellen), 10=Fahren (ST_CON_VEH_Fahren), 12=Fahrbereitschaft_beenden (ST_CON_VEH_Fahrbereitschaft_beenden), 13=reserviert_bne_E673DEE4F91F432391662F6004C0175A_13 (ST_CON_VEH_reserviert_bne_E673DEE4F91F432391662F6004C0175A_13) (BNE original name: reserviert), 14=reserviert_bne_E673DEE4F91F432391662F6004C0175A_14 (ST_CON_VEH_reserviert_bne_E673DEE4F91F432391662F6004C0175A_14) (BNE original name: reserviert), 15=Signal_unbefuellt (ST_CON_VEH_Signal_unbefuellt)}
package /DataTypes/Units
  unit RESET: display-name=RESET, factor-si-to-unit=1, offset-si-to-unit=0
package /MICROSAR_SWCS_DEV/Dem_swc/DataTypes
  6 x impl type:
    Dem_DebouncingStateType: compu {mask 1: 1=DEM_TEMPORARILY_DEFECTIVE, mask 2: 2=DEM_FINALLY_DEFECTIVE, mask 4: 4=DEM_TEMPORARILY_HEALED, mask 8: 8=DEM_TEST_COMPLETE, mask 16: 16=DEM_DTR_UPDATE}, range raw 0..255, implementation-data-type=uint8
    Dem_DTCFormatType: compu {0=DEM_DTC_FORMAT_OBD, 1=DEM_DTC_FORMAT_UDS, 2=DEM_DTC_FORMAT_J1939}, implementation-data-type=uint8
    Dem_EventIdType: range raw 1..65535, implementation-data-type=uint16
    Dem_MaxDataValueType: category=ARRAY, sw-calibration-access=READ-ONLY
      element Dem_MaxDataValueTypeElement: array-size=18, array-size-semantics=FIXED-SIZE, implementation-data-type=uint8
    Dem_MonitorStatusType: compu {mask 1: 1=DEM_MONITOR_STATUS_TF, mask 2: 2=DEM_MONITOR_STATUS_TNCTOC}, range raw 0..255, implementation-data-type=uint8
    Dem_UdsStatusByteType: compu {mask 1: 1=DEM_UDS_STATUS_TF, mask 2: 2=DEM_UDS_STATUS_TFTOC, mask 4: 4=DEM_UDS_STATUS_PDTC, mask 8: 8=DEM_UDS_STATUS_CDTC, mask 16: 16=DEM_UDS_STATUS_TNCSLC, mask 32: 32=DEM_UDS_STATUS_TFSLC, mask 64: 64=DEM_UDS_STATUS_TNCTOC, mask 128: 128=DEM_UDS_STATUS_WIR}, range raw 0..255, implementation-data-type=uint8
package /MICROSAR_SWCS_DEV/WdgM_swc/DataTypes
  impl type WdgM_CheckpointIdType: category=VALUE, base-type=WdgM_CheckpointIdType, range raw 0..254
package /MICROSAR_SWCS_DEV/WdgM_swc/DataTypes/BaseTypes
  base type WdgM_CheckpointIdType: category=FIXED_LENGTH, base-type-size=8, base-type-encoding=NONE, native-declaration=uint8
package /Predefined_DEV/ImplementationDataTypes
  impl type Dem_UdsStatusByteType: compu {mask 1: 1=DEM_UDS_STATUS_TF, mask 2: 2=DEM_UDS_STATUS_TFTOC, mask 4: 4=DEM_UDS_STATUS_PDTC, mask 8: 8=DEM_UDS_STATUS_CDTC, mask 16: 16=DEM_UDS_STATUS_TNCSLC, mask 32: 32=DEM_UDS_STATUS_TFSLC, mask 64: 64=DEM_UDS_STATUS_TNCTOC, mask 128: 128=DEM_UDS_STATUS_WIR}, range raw 0..255, implementation-data-type=uint8
  impl type NvM_RequestResultType: compu {0=NVM_REQ_OK, 1=NVM_REQ_NOT_OK, 2=NVM_REQ_PENDING, 3=NVM_REQ_INTEGRITY_FAILED, 4=NVM_REQ_BLOCK_SKIPPED, 5=NVM_REQ_NV_INVALIDATED, 6=NVM_REQ_CANCELED, 7=NVM_REQ_REDUNDANCY_FAILED, 8=NVM_REQ_RESTORED_FROM_ROM}, implementation-data-type=uint8
  impl type NvM_ServiceIdType: compu {6=NVM_READ_BLOCK, 7=NVM_WRITE_BLOCK, 8=NVM_RESTORE_BLOCK_DEFAULTS, 9=NVM_ERASE_BLOCK, 11=NVM_INVALIDATE_NV_BLOCK, 12=NVM_READ_ALL}, implementation-data-type=uint8
