AUTOSAR XML (schema 4-2-2)
package /BMW_CONF
  module config Dcm
    DcmConfigSet
      DcmDsd: DcmDsdRequestManufacturerNotificationEnabled=1
        4 x DcmDsdServiceRequestManufacturerNotification:
          Coding
          Darh
          StdDiag
          Swt
        DcmDsdServiceTable
          6 x DcmDsdService, all with DcmDsdServiceUsed=1, DcmDsdSidTabSessionLevelRef=DcmDspSessionRow_EXTENDED_DIAGNOSTIC_SESSION:
            DcmDsdService_CLEAR_DIAGNOSTIC_INFORMATION: DcmDsdSidTabServiceId=20, DcmDsdSidTabSubfuncAvail=0, DcmDsdSidTabSessionLevelRef=DcmDspSessionRow_DEFAULT_SESSION
            DcmDsdService_READ_DATA_BY_IDENTIFIER: DcmDsdSidTabServiceId=34, DcmDsdSidTabSubfuncAvail=0, DcmDsdSidTabSessionLevelRef=DcmDspSessionRow_CODING_SESSION, DcmDsdSidTabSessionLevelRef=DcmDspSessionRow_DEFAULT_SESSION, DcmDsdSidTabSessionLevelRef=DcmDspSessionRow_HDD_DOWNLOAD_SESSION
            DcmDsdService_REQUEST_UPLOAD: DcmDsdSidTabServiceId=53, DcmDsdSidTabSubfuncAvail=0
            DcmDsdService_ROUTINE_CONTROL: DcmDsdSidTabServiceId=49, DcmDsdSidTabSubfuncAvail=1, DcmDsdSidTabSessionLevelRef=DcmDspSessionRow_CODING_SESSION, DcmDsdSidTabSessionLevelRef=DcmDspSessionRow_DEFAULT_SESSION, DcmDsdSidTabSessionLevelRef=DcmDspSessionRow_HDD_DOWNLOAD_SESSION, DcmDsdSidTabSessionLevelRef=DcmDspSessionRow_SWT_SESSION
            DcmDsdService_SECURITY_ACCESS: DcmDsdSidTabServiceId=39, DcmDsdSidTabSubfuncAvail=1
              DcmDsdSubService_0x3 (DcmDsdSubService): DcmDsdSubServiceId=3, DcmDsdSubServiceUsed=1, DcmDsdSubServiceSessionLevelRef=DcmDspSessionRow_EXTENDED_DIAGNOSTIC_SESSION
              DcmDsdSubService_0x4 (DcmDsdSubService): DcmDsdSubServiceId=4, DcmDsdSubServiceUsed=1, DcmDsdSubServiceSessionLevelRef=DcmDspSessionRow_EXTENDED_DIAGNOSTIC_SESSION
            DcmDsdService_WRITE_DATA_BY_IDENTIFIER: DcmDsdSidTabServiceId=46, DcmDsdSidTabSubfuncAvail=0, DcmDsdSidTabSessionLevelRef=DcmDspSessionRow_CODING_SESSION, DcmDsdSidTabSessionLevelRef=DcmDspSessionRow_DEFAULT_SESSION
      DcmDsl
        DcmDslDiagResp: DcmDslDiagRespMaxNumRespPend=2, DcmDslDiagRespOnSecondDeclinedRequest=1
        DcmDslProtocol
          DcmDslProtocolRow_DCM_UDS_ON_FLEXRAY (DcmDslProtocolRow): DcmDslProtocolID=DCM_UDS_ON_FLEXRAY, DcmDslProtocolRowUsed=1, DcmDslProtocolTransType=TYPE1, DcmSendRespPendOnTransToBoot=1
            14 x DcmDslConnection:
              DcmDslConnection_0xF0
                DcmDslMainConnection: DcmDslProtocolRxTesterSourceAddr=240
                  DcmDslProtocolRx_0xF0_fu (DcmDslProtocolRx): DcmDslProtocolRxAddrType=DCM_FUNCTIONAL_TYPE
                  DcmDslProtocolRx_0xF0_ph (DcmDslProtocolRx): DcmDslProtocolRxAddrType=DCM_PHYSICAL_TYPE
                  DcmDslProtocolTx_0xF0 (DcmDslProtocolTx)
              DcmDslConnection_0xF1
                DcmDslMainConnection: DcmDslProtocolRxTesterSourceAddr=241
                  DcmDslProtocolRx_0xF1_fu (DcmDslProtocolRx): DcmDslProtocolRxAddrType=DCM_FUNCTIONAL_TYPE
                  DcmDslProtocolRx_0xF1_ph (DcmDslProtocolRx): DcmDslProtocolRxAddrType=DCM_PHYSICAL_TYPE
                  DcmDslProtocolTx_0xF1 (DcmDslProtocolTx)
              DcmDslConnection_0xF2
                DcmDslMainConnection: DcmDslProtocolRxTesterSourceAddr=242
                  DcmDslProtocolRx_0xF2_fu (DcmDslProtocolRx): DcmDslProtocolRxAddrType=DCM_FUNCTIONAL_TYPE
                  DcmDslProtocolRx_0xF2_ph (DcmDslProtocolRx): DcmDslProtocolRxAddrType=DCM_PHYSICAL_TYPE
                  DcmDslProtocolTx_0xF2 (DcmDslProtocolTx)
              DcmDslConnection_0xF3
                DcmDslMainConnection: DcmDslProtocolRxTesterSourceAddr=243
                  DcmDslProtocolRx_0xF3_fu (DcmDslProtocolRx): DcmDslProtocolRxAddrType=DCM_FUNCTIONAL_TYPE
                  DcmDslProtocolRx_0xF3_ph (DcmDslProtocolRx): DcmDslProtocolRxAddrType=DCM_PHYSICAL_TYPE
                  DcmDslProtocolTx_0xF3 (DcmDslProtocolTx)
              DcmDslConnection_0xF4
                DcmDslMainConnection: DcmDslProtocolRxTesterSourceAddr=244
                  DcmDslProtocolRx_0xF4_fu (DcmDslProtocolRx): DcmDslProtocolRxAddrType=DCM_FUNCTIONAL_TYPE
                  DcmDslProtocolRx_0xF4_ph (DcmDslProtocolRx): DcmDslProtocolRxAddrType=DCM_PHYSICAL_TYPE
                  DcmDslProtocolTx_0xF4 (DcmDslProtocolTx)
              DcmDslConnection_0xF5
                DcmDslMainConnection: DcmDslProtocolRxTesterSourceAddr=245
                  DcmDslProtocolRx_0xF5_fu (DcmDslProtocolRx): DcmDslProtocolRxAddrType=DCM_FUNCTIONAL_TYPE
                  DcmDslProtocolRx_0xF5_ph (DcmDslProtocolRx): DcmDslProtocolRxAddrType=DCM_PHYSICAL_TYPE
                  DcmDslProtocolTx_0xF5 (DcmDslProtocolTx)
              DcmDslConnection_0xF6
                DcmDslMainConnection: DcmDslProtocolRxTesterSourceAddr=246
                  DcmDslProtocolRx_0xF6_fu (DcmDslProtocolRx): DcmDslProtocolRxAddrType=DCM_FUNCTIONAL_TYPE
                  DcmDslProtocolRx_0xF6_ph (DcmDslProtocolRx): DcmDslProtocolRxAddrType=DCM_PHYSICAL_TYPE
                  DcmDslProtocolTx_0xF6 (DcmDslProtocolTx)
              DcmDslConnection_0xF7
                DcmDslMainConnection: DcmDslProtocolRxTesterSourceAddr=247
                  DcmDslProtocolRx_0xF7_fu (DcmDslProtocolRx): DcmDslProtocolRxAddrType=DCM_FUNCTIONAL_TYPE
                  DcmDslProtocolRx_0xF7_ph (DcmDslProtocolRx): DcmDslProtocolRxAddrType=DCM_PHYSICAL_TYPE
                  DcmDslProtocolTx_0xF7 (DcmDslProtocolTx)
              DcmDslConnection_0xF8
                DcmDslMainConnection: DcmDslProtocolRxTesterSourceAddr=248
                  DcmDslProtocolRx_0xF8_fu (DcmDslProtocolRx): DcmDslProtocolRxAddrType=DCM_FUNCTIONAL_TYPE
                  DcmDslProtocolRx_0xF8_ph (DcmDslProtocolRx): DcmDslProtocolRxAddrType=DCM_PHYSICAL_TYPE
                  DcmDslProtocolTx_0xF8 (DcmDslProtocolTx)
              DcmDslConnection_0xF9
                DcmDslMainConnection: DcmDslProtocolRxTesterSourceAddr=249
                  DcmDslProtocolRx_0xF9_fu (DcmDslProtocolRx): DcmDslProtocolRxAddrType=DCM_FUNCTIONAL_TYPE
                  DcmDslProtocolRx_0xF9_ph (DcmDslProtocolRx): DcmDslProtocolRxAddrType=DCM_PHYSICAL_TYPE
                  DcmDslProtocolTx_0xF9 (DcmDslProtocolTx)
              DcmDslConnection_0xFA
                DcmDslMainConnection: DcmDslProtocolRxTesterSourceAddr=250
                  DcmDslProtocolRx_0xFA_fu (DcmDslProtocolRx): DcmDslProtocolRxAddrType=DCM_FUNCTIONAL_TYPE
                  DcmDslProtocolRx_0xFA_ph (DcmDslProtocolRx): DcmDslProtocolRxAddrType=DCM_PHYSICAL_TYPE
                  DcmDslProtocolTx_0xFA (DcmDslProtocolTx)
              DcmDslConnection_0xFB
                DcmDslMainConnection: DcmDslProtocolRxTesterSourceAddr=251
                  DcmDslProtocolRx_0xFB_fu (DcmDslProtocolRx): DcmDslProtocolRxAddrType=DCM_FUNCTIONAL_TYPE
                  DcmDslProtocolRx_0xFB_ph (DcmDslProtocolRx): DcmDslProtocolRxAddrType=DCM_PHYSICAL_TYPE
                  DcmDslProtocolTx_0xFB (DcmDslProtocolTx)
              DcmDslConnection_0xFC
                DcmDslMainConnection: DcmDslProtocolRxTesterSourceAddr=252
                  DcmDslProtocolRx_0xFC_fu (DcmDslProtocolRx): DcmDslProtocolRxAddrType=DCM_FUNCTIONAL_TYPE
                  DcmDslProtocolRx_0xFC_ph (DcmDslProtocolRx): DcmDslProtocolRxAddrType=DCM_PHYSICAL_TYPE
                  DcmDslProtocolTx_0xFC (DcmDslProtocolTx)
              DcmDslConnection_0xFD
                DcmDslMainConnection: DcmDslProtocolRxTesterSourceAddr=253
                  DcmDslProtocolRx_0xFD_fu (DcmDslProtocolRx): DcmDslProtocolRxAddrType=DCM_FUNCTIONAL_TYPE
                  DcmDslProtocolRx_0xFD_ph (DcmDslProtocolRx): DcmDslProtocolRxAddrType=DCM_PHYSICAL_TYPE
                  DcmDslProtocolTx_0xFD (DcmDslProtocolTx)
      DcmDsp: DcmDspDataDefaultEndianness=BIG_ENDIAN, DcmDspMaxDidToRead=1, DcmResponseToEcuReset=BEFORE_RESET
        6 x DcmDspCommonAuthorization:
          DcmDspCommonAuthorization_1b931cac: DcmDspCommonAuthorizationSessionRef=DcmDspSessionRow_DEFAULT_SESSION, DcmDspCommonAuthorizationSessionRef=DcmDspSessionRow_EXTENDED_DIAGNOSTIC_SESSION, DcmDspCommonAuthorizationSessionRef=DcmDspSessionRow_SWT_SESSION
          DcmDspCommonAuthorization_3f08b769: DcmDspCommonAuthorizationSessionRef=DcmDspSessionRow_CODING_SESSION
          DcmDspCommonAuthorization_3f08b76a: DcmDspCommonAuthorizationSecurityLevelRef=DcmDspSecurityRow_Coding, DcmDspCommonAuthorizationSessionRef=DcmDspSessionRow_CODING_SESSION
          DcmDspCommonAuthorization_ba9a6fdf: DcmDspCommonAuthorizationSessionRef=DcmDspSessionRow_CODING_SESSION, DcmDspCommonAuthorizationSessionRef=DcmDspSessionRow_DEFAULT_SESSION, DcmDspCommonAuthorizationSessionRef=DcmDspSessionRow_EXTENDED_DIAGNOSTIC_SESSION
          DcmDspCommonAuthorization_d884a83: DcmDspCommonAuthorizationSessionRef=DcmDspSessionRow_EXTENDED_DIAGNOSTIC_SESSION
          DcmDspCommonAuthorization_eabf1d27: DcmDspCommonAuthorizationSessionRef=DcmDspSessionRow_DEFAULT_SESSION, DcmDspCommonAuthorizationSessionRef=DcmDspSessionRow_EXTENDED_DIAGNOSTIC_SESSION
        107 x DcmDspData:
          DcmDspData_ActiveDiagnosticSession: DcmDspDataConditionCheckReadFncUsed=1, DcmDspDataSize=8, DcmDspDataType=UINT8_N, DcmDspDataUsePort=USE_DATA_SYNCH_CLIENT_SERVER
          DcmDspData_DmDtcAktiveMeldung: DcmDspDataConditionCheckReadFncUsed=1, DcmDspDataSize=168, DcmDspDataType=UINT8_DYN, DcmDspDataUsePort=USE_DATA_SYNCH_CLIENT_SERVER
          DcmDspData_DmIsDtcActiveResponse: DcmDspDataConditionCheckReadFncUsed=1, DcmDspDataType=UINT8_DYN, DcmDspDataUsePort=USE_DATA_SYNCH_CLIENT_SERVER
          DcmDspData_EcuSerialNumber: DcmDspDataConditionCheckReadFncUsed=0, DcmDspDataSize=80, DcmDspDataType=UINT8_N, DcmDspDataUsePort=USE_DATA_SYNCH_CLIENT_SERVER
          DcmDspData_EnergySavingState: DcmDspDataConditionCheckReadFncUsed=1, DcmDspDataSize=8, DcmDspDataType=UINT8_N, DcmDspDataUsePort=USE_DATA_SYNCH_CLIENT_SERVER
          DcmDspData_EthGetNumberOfPorts: DcmDspDataSize=8, DcmDspDataType=UINT8_N
          DcmDspData_EthPhyLinkState: DcmDspDataSize=24, DcmDspDataType=UINT8_N
          DcmDspData_EthSignalQuality: DcmDspDataType=UINT8_N
          DcmDspData_ExtendedEnergySavingState: DcmDspDataConditionCheckReadFncUsed=1, DcmDspDataSize=8, DcmDspDataType=UINT8_N, DcmDspDataUsePort=USE_DATA_SYNCH_CLIENT_SERVER
          DcmDspData_FlashTimingParameter: DcmDspDataConditionCheckReadFncUsed=0, DcmDspDataSize=96, DcmDspDataType=UINT8_N, DcmDspDataUsePort=USE_DATA_SYNCH_CLIENT_SERVER
          DcmDspData_HddDownloadStatus: DcmDspDataType=UINT8_N
          DcmDspData_HddDownloadTimeToCompletion: DcmDspDataSize=32, DcmDspDataType=UINT8_N
          DcmDspData_Herstelldatum: DcmDspDataConditionCheckReadFncUsed=0, DcmDspDataSize=24, DcmDspDataType=UINT8_N, DcmDspDataUsePort=USE_DATA_SYNCH_CLIENT_SERVER
          DcmDspData_IndivDataTable: DcmDspDataConditionCheckReadFncUsed=0, DcmDspDataType=UINT8_N, DcmDspDataUsePort=USE_DATA_SYNCH_CLIENT_SERVER
          DcmDspData_IpConfiguration: DcmDspDataConditionCheckReadFnc=EthDiagMM_CheckConditionReadDataIpConfig, DcmDspDataConditionCheckReadFncUsed=1, DcmDspDataReadFnc=EthDiagMM_ReadDataIpConfig, DcmDspDataSize=104, DcmDspDataType=UINT8, DcmDspDataUsePort=USE_DATA_SYNCH_FNC
          DcmDspData_ListManipulationApplicationData: DcmDspDataType=UINT8_N
          DcmDspData_ListManipulationGeneral: DcmDspDataType=UINT8_N
          DcmDspData_ListManipulationSecureBoot: DcmDspDataType=UINT8_N
          DcmDspData_ListManipulationSecurityArtifact: DcmDspDataType=UINT8_N
          DcmDspData_ListManipulationSw: DcmDspDataType=UINT8_N
          DcmDspData_MileKmEeprom: DcmDspDataSize=24, DcmDspDataType=UINT8_N
          DcmDspData_PiaProfile{0..2}: DcmDspDataConditionCheckReadFncUsed=1, DcmDspDataType=UINT8_DYN, DcmDspDataUsePort=USE_DATA_ASYNCH_CLIENT_SERVER
          DcmDspData_PiaProfileA: DcmDspDataConditionCheckReadFncUsed=1, DcmDspDataType=UINT8_DYN, DcmDspDataUsePort=USE_DATA_ASYNCH_CLIENT_SERVER
          DcmDspData_ProgrammingCounter: DcmDspDataConditionCheckReadFncUsed=0, DcmDspDataSize=32, DcmDspDataType=UINT8_N, DcmDspDataUsePort=USE_DATA_SYNCH_CLIENT_SERVER
          DcmDspData_ProgrammingCounterMaxValue: DcmDspDataConditionCheckReadFncUsed=0, DcmDspDataSize=16, DcmDspDataType=UINT8_N, DcmDspDataUsePort=USE_DATA_SYNCH_CLIENT_SERVER
          DcmDspData_Pruefstempel: DcmDspDataSize=24, DcmDspDataType=UINT8_N
          DcmDspData_ReadActiveSession: DcmDspDataConditionCheckReadFncUsed=1, DcmDspDataSize=8, DcmDspDataType=UINT8_N, DcmDspDataUsePort=USE_DATA_SYNCH_CLIENT_SERVER
          DcmDspData_ReadActiveSessionState: DcmDspDataConditionCheckReadFncUsed=1, DcmDspDataSize=8, DcmDspDataType=UINT8_N, DcmDspDataUsePort=USE_DATA_SYNCH_CLIENT_SERVER
          DcmDspData_ReadOpMode: DcmDspDataConditionCheckReadFncUsed=1, DcmDspDataSize=8, DcmDspDataType=UINT8_N, DcmDspDataUsePort=USE_DATA_SYNCH_CLIENT_SERVER
          DcmDspData_ReadRoeState: DcmDspDataConditionCheckReadFncUsed=1, DcmDspDataSize=8, DcmDspDataType=UINT8_N, DcmDspDataUsePort=USE_DATA_SYNCH_CLIENT_SERVER
          DcmDspData_Readhwmodificationindex: DcmDspDataSize=16, DcmDspDataType=UINT8_N
          DcmDspData_Sekundaererfehlerspeicher: DcmDspDataType=UINT8_N
          DcmDspData_SensorenAnzahlLesen: DcmDspDataSize=8, DcmDspDataType=UINT8_N
          DcmDspData_SgbdIdx: DcmDspDataConditionCheckReadFncUsed=0, DcmDspDataSize=24, DcmDspDataType=UINT8_N, DcmDspDataUsePort=USE_DATA_SYNCH_CLIENT_SERVER
          DcmDspData_StatusDmFssMaster: DcmDspDataSize=16, DcmDspDataType=UINT8_N
          DcmDspData_StatusSystime: DcmDspDataSize=32, DcmDspDataType=UINT8_N
          DcmDspData_SvkAktuell: DcmDspDataConditionCheckReadFncUsed=1, DcmDspDataType=UINT8_DYN, DcmDspDataUsePort=USE_DATA_ASYNCH_CLIENT_SERVER
          DcmDspData_SvkBackup{01..03}: DcmDspDataConditionCheckReadFncUsed=1, DcmDspDataType=UINT8_N, DcmDspDataUsePort=USE_DATA_ASYNCH_CLIENT_SERVER
          DcmDspData_SvkBackup{04..61}: DcmDspDataType=UINT8_N
          DcmDspData_SvkSysSupplier: DcmDspDataConditionCheckReadFncUsed=1, DcmDspDataType=UINT8_N, DcmDspDataUsePort=USE_DATA_ASYNCH_CLIENT_SERVER
          DcmDspData_SvkWerk: DcmDspDataConditionCheckReadFncUsed=1, DcmDspDataType=UINT8_N, DcmDspDataUsePort=USE_DATA_ASYNCH_CLIENT_SERVER
          DcmDspData_SwfkDeleteSupported: DcmDspDataConditionCheckReadFncUsed=0, DcmDspDataSize=8, DcmDspDataType=UINT8_N, DcmDspDataUsePort=USE_DATA_SYNCH_CLIENT_SERVER
          DcmDspData_SystemSupplierIdentifier: DcmDspDataSize=24, DcmDspDataType=UINT8_N
          DcmDspData_Systemzeit: DcmDspDataConditionCheckReadFncUsed=0, DcmDspDataSize=32, DcmDspDataType=UINT8_N, DcmDspDataUsePort=USE_DATA_SYNCH_CLIENT_SERVER
          DcmDspData_Vin: DcmDspDataConditionCheckReadFncUsed=1, DcmDspDataSize=136, DcmDspDataType=UINT8_N, DcmDspDataUsePort=USE_DATA_ASYNCH_CLIENT_SERVER
          DcmDspData_ZgwZertifikat: DcmDspDataType=UINT8_N
        104 x DcmDspDid, all with DcmDspDidUsed=1:
          DcmDspDid_ActiveDiagnosticSession: DcmDspDidIdentifier=61830, DcmDspDidInfoRef=DcmDspDidInfo_ActiveDiagnosticSession
            DcmDspDidSignal_ActiveDiagnosticSession (DcmDspDidSignal): DcmDspDidDataPos=0, DcmDspDidDataRef=DcmDspData_ActiveDiagnosticSession
          DcmDspDid_DmDtcAktiveMeldung: DcmDspDidIdentifier=5892, DcmDspDidInfoRef=DcmDspDidInfo_DmDtcAktiveMeldung
            DcmDspDidSignal_DmDtcAktiveMeldung (DcmDspDidSignal): DcmDspDidDataPos=0, DcmDspDidDataRef=DcmDspData_DmDtcAktiveMeldung
          DcmDspDid_DmIsDtcActiveResponse: DcmDspDidIdentifier=5923, DcmDspDidInfoRef=DcmDspDidInfo_DmIsDtcActiveResponse
            DcmDspDidSignal_DmIsDtcActiveResponse (DcmDspDidSignal): DcmDspDidDataPos=0, DcmDspDidDataRef=DcmDspData_DmIsDtcActiveResponse
          DcmDspDid_EcuSerialNumber: DcmDspDidIdentifier=61836, DcmDspDidInfoRef=DcmDspDidInfo_EcuSerialNumber
            DcmDspDidSignal_EcuSerialNumber (DcmDspDidSignal): DcmDspDidDataPos=0, DcmDspDidDataRef=DcmDspData_EcuSerialNumber
          DcmDspDid_EnergySavingState: DcmDspDidIdentifier=4106, DcmDspDidInfoRef=DcmDspDidInfo_EnergySavingState
            DcmDspDidSignal_EnergySavingState (DcmDspDidSignal): DcmDspDidDataPos=0, DcmDspDidDataRef=DcmDspData_EnergySavingState
          DcmDspDid_EthGetNumberOfPorts: DcmDspDidIdentifier=6144, DcmDspDidInfoRef=DcmDspDidInfo_EthGetNumberOfPorts
            DcmDspDidSignal_EthGetNumberOfPorts (DcmDspDidSignal): DcmDspDidDataPos=0, DcmDspDidDataRef=DcmDspData_EthGetNumberOfPorts
          DcmDspDid_EthPhyLinkState: DcmDspDidIdentifier=6146, DcmDspDidInfoRef=DcmDspDidInfo_EthPhyLinkState
            DcmDspDidSignal_EthPhyLinkState (DcmDspDidSignal): DcmDspDidDataPos=0, DcmDspDidDataRef=DcmDspData_EthPhyLinkState
          DcmDspDid_EthSignalQuality: DcmDspDidIdentifier=6145, DcmDspDidInfoRef=DcmDspDidInfo_EthSignalQuality
            DcmDspDidSignal_EthSignalQuality (DcmDspDidSignal): DcmDspDidDataPos=0, DcmDspDidDataRef=DcmDspData_EthSignalQuality
          DcmDspDid_ExtendedEnergySavingState: DcmDspDidIdentifier=4110, DcmDspDidInfoRef=DcmDspDidInfo_ExtendedEnergySavingState
            DcmDspDidSignal_ExtendedEnergySavingState (DcmDspDidSignal): DcmDspDidDataPos=0, DcmDspDidDataRef=DcmDspData_ExtendedEnergySavingState
          DcmDspDid_FlashTimingParameter: DcmDspDidIdentifier=9476, DcmDspDidInfoRef=DcmDspDidInfo_FlashTimingParameter
            DcmDspDidSignal_FlashTimingParameter (DcmDspDidSignal): DcmDspDidDataPos=0, DcmDspDidDataRef=DcmDspData_FlashTimingParameter
          DcmDspDid_HddDownloadStatus: DcmDspDidIdentifier=9488, DcmDspDidInfoRef=DcmDspDidInfo_HddDownloadStatus
            DcmDspDidSignal_HddDownloadStatus (DcmDspDidSignal): DcmDspDidDataPos=0, DcmDspDidDataRef=DcmDspData_HddDownloadStatus
          DcmDspDid_HddDownloadTimeToCompletion: DcmDspDidIdentifier=9489, DcmDspDidInfoRef=DcmDspDidInfo_HddDownloadTimeToCompletion
            DcmDspDidSignal_HddDownloadTimeToCompletion (DcmDspDidSignal): DcmDspDidDataPos=0, DcmDspDidDataRef=DcmDspData_HddDownloadTimeToCompletion
          DcmDspDid_Herstelldatum: DcmDspDidIdentifier=61835, DcmDspDidInfoRef=DcmDspDidInfo_Herstelldatum
            DcmDspDidSignal_Herstelldatum (DcmDspDidSignal): DcmDspDidDataPos=0, DcmDspDidDataRef=DcmDspData_Herstelldatum
          DcmDspDid_IndivDataTable: DcmDspDidIdentifier=5940, DcmDspDidInfoRef=DcmDspDidInfo_IndivDataTable
            DcmDspDidSignal_IndivDataTable (DcmDspDidSignal): DcmDspDidDataPos=0, DcmDspDidDataRef=DcmDspData_IndivDataTable
          DcmDspDid_IpConfiguration: DcmDspDidIdentifier=5930, DcmDspDidInfoRef=DcmDspDidInfo_IpConfiguration
            DcmDspDidSignal_IpConfiguration (DcmDspDidSignal): DcmDspDidDataPos=0, DcmDspDidDataRef=DcmDspData_IpConfiguration
          DcmDspDid_ListManipulationApplicationData: DcmDspDidIdentifier=9618, DcmDspDidInfoRef=DcmDspDidInfo_ListManipulationApplicationData
            DcmDspDidSignal_ListManipulationApplicationData (DcmDspDidSignal): DcmDspDidDataPos=0, DcmDspDidDataRef=DcmDspData_ListManipulationApplicationData
          DcmDspDid_ListManipulationGeneral: DcmDspDidIdentifier=9620, DcmDspDidInfoRef=DcmDspDidInfo_ListManipulationGeneral
            DcmDspDidSignal_ListManipulationGeneral (DcmDspDidSignal): DcmDspDidDataPos=0, DcmDspDidDataRef=DcmDspData_ListManipulationGeneral
          DcmDspDid_ListManipulationSecureBoot: DcmDspDidIdentifier=9619, DcmDspDidInfoRef=DcmDspDidInfo_ListManipulationSecureBoot
            DcmDspDidSignal_ListManipulationSecureBoot (DcmDspDidSignal): DcmDspDidDataPos=0, DcmDspDidDataRef=DcmDspData_ListManipulationSecureBoot
          DcmDspDid_ListManipulationSecurityArtifact: DcmDspDidIdentifier=9616, DcmDspDidInfoRef=DcmDspDidInfo_ListManipulationSecurityArtifact
            DcmDspDidSignal_ListManipulationSecurityArtifact (DcmDspDidSignal): DcmDspDidDataPos=0, DcmDspDidDataRef=DcmDspData_ListManipulationSecurityArtifact
          DcmDspDid_ListManipulationSw: DcmDspDidIdentifier=9617, DcmDspDidInfoRef=DcmDspDidInfo_ListManipulationSw
            DcmDspDidSignal_ListManipulationSw (DcmDspDidSignal): DcmDspDidDataPos=0, DcmDspDidDataRef=DcmDspData_ListManipulationSw
          DcmDspDid_MileKmEeprom: DcmDspDidIdentifier=9536, DcmDspDidInfoRef=DcmDspDidInfo_MileKmEeprom
            DcmDspDidSignal_MileKmEeprom (DcmDspDidSignal): DcmDspDidDataPos=0, DcmDspDidDataRef=DcmDspData_MileKmEeprom
          DcmDspDid_PiaProfile0: DcmDspDidIdentifier=9568, DcmDspDidInfoRef=DcmDspDidInfo_PiaProfile0
            DcmDspDidSignal_PiaProfile0 (DcmDspDidSignal): DcmDspDidDataPos=0, DcmDspDidDataRef=DcmDspData_PiaProfile0
          DcmDspDid_PiaProfile1: DcmDspDidIdentifier=9569, DcmDspDidInfoRef=DcmDspDidInfo_PiaProfile1
            DcmDspDidSignal_PiaProfile1 (DcmDspDidSignal): DcmDspDidDataPos=0, DcmDspDidDataRef=DcmDspData_PiaProfile1
          DcmDspDid_PiaProfile2: DcmDspDidIdentifier=9570, DcmDspDidInfoRef=DcmDspDidInfo_PiaProfile2
            DcmDspDidSignal_PiaProfile2 (DcmDspDidSignal): DcmDspDidDataPos=0, DcmDspDidDataRef=DcmDspData_PiaProfile2
          DcmDspDid_PiaProfileA: DcmDspDidIdentifier=9571, DcmDspDidInfoRef=DcmDspDidInfo_PiaProfileA
            DcmDspDidSignal_PiaProfileA (DcmDspDidSignal): DcmDspDidDataPos=0, DcmDspDidDataRef=DcmDspData_PiaProfileA
          DcmDspDid_ProgrammingCounter: DcmDspDidIdentifier=9474, DcmDspDidInfoRef=DcmDspDidInfo_ProgrammingCounter
            DcmDspDidSignal_ProgrammingCounter (DcmDspDidSignal): DcmDspDidDataPos=0, DcmDspDidDataRef=DcmDspData_ProgrammingCounter
          DcmDspDid_ProgrammingCounterMaxValue: DcmDspDidIdentifier=9475, DcmDspDidInfoRef=DcmDspDidInfo_ProgrammingCounterMaxValue
            DcmDspDidSignal_ProgrammingCounterMaxValue (DcmDspDidSignal): DcmDspDidDataPos=0, DcmDspDidDataRef=DcmDspData_ProgrammingCounterMaxValue
          DcmDspDid_Pruefstempel: DcmDspDidIdentifier=4096, DcmDspDidInfoRef=DcmDspDidInfo_Pruefstempel
            DcmDspDidSignal_Pruefstempel (DcmDspDidSignal): DcmDspDidDataPos=0, DcmDspDidDataRef=DcmDspData_Pruefstempel
          DcmDspDid_ReadActiveSessionState: DcmDspDidIdentifier=61696, DcmDspDidInfoRef=DcmDspDidInfo_ReadActiveSessionState
            4 x DcmDspDidSignal:
              DcmDspDidSignal_ReadActiveSession: DcmDspDidDataPos=0, DcmDspDidDataRef=DcmDspData_ReadActiveSession
              DcmDspDidSignal_ReadActiveSessionState: DcmDspDidDataPos=8, DcmDspDidDataRef=DcmDspData_ReadActiveSessionState
              DcmDspDidSignal_ReadOpMode: DcmDspDidDataPos=16, DcmDspDidDataRef=DcmDspData_ReadOpMode
              DcmDspDidSignal_ReadRoeState: DcmDspDidDataPos=24, DcmDspDidDataRef=DcmDspData_ReadRoeState
          DcmDspDid_Readhwmodificationindex: DcmDspDidIdentifier=61778, DcmDspDidInfoRef=DcmDspDidInfo_Readhwmodificationindex
            DcmDspDidSignal_Readhwmodificationindex (DcmDspDidSignal): DcmDspDidDataPos=0, DcmDspDidDataRef=DcmDspData_Readhwmodificationindex
          DcmDspDid_Sekundaererfehlerspeicher: DcmDspDidIdentifier=8192, DcmDspDidInfoRef=DcmDspDidInfo_Sekundaererfehlerspeicher
            DcmDspDidSignal_Sekundaererfehlerspeicher (DcmDspDidSignal): DcmDspDidDataPos=0, DcmDspDidDataRef=DcmDspData_Sekundaererfehlerspeicher
          DcmDspDid_SensorenAnzahlLesen: DcmDspDidIdentifier=5632, DcmDspDidInfoRef=DcmDspDidInfo_SensorenAnzahlLesen
            DcmDspDidSignal_SensorenAnzahlLesen (DcmDspDidSignal): DcmDspDidDataPos=0, DcmDspDidDataRef=DcmDspData_SensorenAnzahlLesen
          DcmDspDid_SgbdIdx: DcmDspDidIdentifier=61776, DcmDspDidInfoRef=DcmDspDidInfo_SgbdIdx
            DcmDspDidSignal_SgbdIdx (DcmDspDidSignal): DcmDspDidDataPos=0, DcmDspDidDataRef=DcmDspData_SgbdIdx
          DcmDspDid_StatusDmFssMaster: DcmDspDidIdentifier=5904, DcmDspDidInfoRef=DcmDspDidInfo_StatusDmFssMaster
            DcmDspDidSignal_StatusDmFssMaster (DcmDspDidSignal): DcmDspDidDataPos=0, DcmDspDidDataRef=DcmDspData_StatusDmFssMaster
          DcmDspDid_StatusSystime: DcmDspDidIdentifier=5925, DcmDspDidInfoRef=DcmDspDidInfo_StatusSystime
            DcmDspDidSignal_StatusSystime (DcmDspDidSignal): DcmDspDidDataPos=0, DcmDspDidDataRef=DcmDspData_StatusSystime
          DcmDspDid_SvkAktuell: DcmDspDidIdentifier=61697, DcmDspDidInfoRef=DcmDspDidInfo_SvkAktuell
            DcmDspDidSignal_SvkAktuell (DcmDspDidSignal): DcmDspDidDataPos=0, DcmDspDidDataRef=DcmDspData_SvkAktuell
          DcmDspDid_SvkBackup01: DcmDspDidIdentifier=61700, DcmDspDidInfoRef=DcmDspDidInfo_SvkBackup01
            DcmDspDidSignal_SvkBackup01 (DcmDspDidSignal): DcmDspDidDataPos=0, DcmDspDidDataRef=DcmDspData_SvkBackup01
          DcmDspDid_SvkBackup02: DcmDspDidIdentifier=61701, DcmDspDidInfoRef=DcmDspDidInfo_SvkBackup02
            DcmDspDidSignal_SvkBackup02 (DcmDspDidSignal): DcmDspDidDataPos=0, DcmDspDidDataRef=DcmDspData_SvkBackup02
          DcmDspDid_SvkBackup03: DcmDspDidIdentifier=61702, DcmDspDidInfoRef=DcmDspDidInfo_SvkBackup03
            DcmDspDidSignal_SvkBackup03 (DcmDspDidSignal): DcmDspDidDataPos=0, DcmDspDidDataRef=DcmDspData_SvkBackup03
          DcmDspDid_SvkBackup04: DcmDspDidIdentifier=61703, DcmDspDidInfoRef=DcmDspDidInfo_SvkBackup04
            DcmDspDidSignal_SvkBackup04 (DcmDspDidSignal): DcmDspDidDataPos=0, DcmDspDidDataRef=DcmDspData_SvkBackup04
          DcmDspDid_SvkBackup05: DcmDspDidIdentifier=61704, DcmDspDidInfoRef=DcmDspDidInfo_SvkBackup05
            DcmDspDidSignal_SvkBackup05 (DcmDspDidSignal): DcmDspDidDataPos=0, DcmDspDidDataRef=DcmDspData_SvkBackup05
          DcmDspDid_SvkBackup06: DcmDspDidIdentifier=61705, DcmDspDidInfoRef=DcmDspDidInfo_SvkBackup06
            DcmDspDidSignal_SvkBackup06 (DcmDspDidSignal): DcmDspDidDataPos=0, DcmDspDidDataRef=DcmDspData_SvkBackup06
          DcmDspDid_SvkBackup07: DcmDspDidIdentifier=61706, DcmDspDidInfoRef=DcmDspDidInfo_SvkBackup07
            DcmDspDidSignal_SvkBackup07 (DcmDspDidSignal): DcmDspDidDataPos=0, DcmDspDidDataRef=DcmDspData_SvkBackup07
          DcmDspDid_SvkBackup08: DcmDspDidIdentifier=61707, DcmDspDidInfoRef=DcmDspDidInfo_SvkBackup08
            DcmDspDidSignal_SvkBackup08 (DcmDspDidSignal): DcmDspDidDataPos=0, DcmDspDidDataRef=DcmDspData_SvkBackup08
          DcmDspDid_SvkBackup09: DcmDspDidIdentifier=61708, DcmDspDidInfoRef=DcmDspDidInfo_SvkBackup09
            DcmDspDidSignal_SvkBackup09 (DcmDspDidSignal): DcmDspDidDataPos=0, DcmDspDidDataRef=DcmDspData_SvkBackup09
          DcmDspDid_SvkBackup10: DcmDspDidIdentifier=61709, DcmDspDidInfoRef=DcmDspDidInfo_SvkBackup10
            DcmDspDidSignal_SvkBackup10 (DcmDspDidSignal): DcmDspDidDataPos=0, DcmDspDidDataRef=DcmDspData_SvkBackup10
          DcmDspDid_SvkBackup11: DcmDspDidIdentifier=61710, DcmDspDidInfoRef=DcmDspDidInfo_SvkBackup11
            DcmDspDidSignal_SvkBackup11 (DcmDspDidSignal): DcmDspDidDataPos=0, DcmDspDidDataRef=DcmDspData_SvkBackup11
          DcmDspDid_SvkBackup12: DcmDspDidIdentifier=61711, DcmDspDidInfoRef=DcmDspDidInfo_SvkBackup12
            DcmDspDidSignal_SvkBackup12 (DcmDspDidSignal): DcmDspDidDataPos=0, DcmDspDidDataRef=DcmDspData_SvkBackup12
          DcmDspDid_SvkBackup13: DcmDspDidIdentifier=61712, DcmDspDidInfoRef=DcmDspDidInfo_SvkBackup13
            DcmDspDidSignal_SvkBackup13 (DcmDspDidSignal): DcmDspDidDataPos=0, DcmDspDidDataRef=DcmDspData_SvkBackup13
          DcmDspDid_SvkBackup14: DcmDspDidIdentifier=61713, DcmDspDidInfoRef=DcmDspDidInfo_SvkBackup14
            DcmDspDidSignal_SvkBackup14 (DcmDspDidSignal): DcmDspDidDataPos=0, DcmDspDidDataRef=DcmDspData_SvkBackup14
          DcmDspDid_SvkBackup15: DcmDspDidIdentifier=61714, DcmDspDidInfoRef=DcmDspDidInfo_SvkBackup15
            DcmDspDidSignal_SvkBackup15 (DcmDspDidSignal): DcmDspDidDataPos=0, DcmDspDidDataRef=DcmDspData_SvkBackup15
          DcmDspDid_SvkBackup16: DcmDspDidIdentifier=61715, DcmDspDidInfoRef=DcmDspDidInfo_SvkBackup16
            DcmDspDidSignal_SvkBackup16 (DcmDspDidSignal): DcmDspDidDataPos=0, DcmDspDidDataRef=DcmDspData_SvkBackup16
          DcmDspDid_SvkBackup17: DcmDspDidIdentifier=61716, DcmDspDidInfoRef=DcmDspDidInfo_SvkBackup17
            DcmDspDidSignal_SvkBackup17 (DcmDspDidSignal): DcmDspDidDataPos=0, DcmDspDidDataRef=DcmDspData_SvkBackup17
          DcmDspDid_SvkBackup18: DcmDspDidIdentifier=61717, DcmDspDidInfoRef=DcmDspDidInfo_SvkBackup18
            DcmDspDidSignal_SvkBackup18 (DcmDspDidSignal): DcmDspDidDataPos=0, DcmDspDidDataRef=DcmDspData_SvkBackup18
          DcmDspDid_SvkBackup19: DcmDspDidIdentifier=61718, DcmDspDidInfoRef=DcmDspDidInfo_SvkBackup19
            DcmDspDidSignal_SvkBackup19 (DcmDspDidSignal): DcmDspDidDataPos=0, DcmDspDidDataRef=DcmDspData_SvkBackup19
          DcmDspDid_SvkBackup20: DcmDspDidIdentifier=61719, DcmDspDidInfoRef=DcmDspDidInfo_SvkBackup20
            DcmDspDidSignal_SvkBackup20 (DcmDspDidSignal): DcmDspDidDataPos=0, DcmDspDidDataRef=DcmDspData_SvkBackup20
          DcmDspDid_SvkBackup21: DcmDspDidIdentifier=61720, DcmDspDidInfoRef=DcmDspDidInfo_SvkBackup21
            DcmDspDidSignal_SvkBackup21 (DcmDspDidSignal): DcmDspDidDataPos=0, DcmDspDidDataRef=DcmDspData_SvkBackup21
          DcmDspDid_SvkBackup22: DcmDspDidIdentifier=61721, DcmDspDidInfoRef=DcmDspDidInfo_SvkBackup22
            DcmDspDidSignal_SvkBackup22 (DcmDspDidSignal): DcmDspDidDataPos=0, DcmDspDidDataRef=DcmDspData_SvkBackup22
          DcmDspDid_SvkBackup23: DcmDspDidIdentifier=61722, DcmDspDidInfoRef=DcmDspDidInfo_SvkBackup23
            DcmDspDidSignal_SvkBackup23 (DcmDspDidSignal): DcmDspDidDataPos=0, DcmDspDidDataRef=DcmDspData_SvkBackup23
          DcmDspDid_SvkBackup24: DcmDspDidIdentifier=61723, DcmDspDidInfoRef=DcmDspDidInfo_SvkBackup24
            DcmDspDidSignal_SvkBackup24 (DcmDspDidSignal): DcmDspDidDataPos=0, DcmDspDidDataRef=DcmDspData_SvkBackup24
          DcmDspDid_SvkBackup25: DcmDspDidIdentifier=61724, DcmDspDidInfoRef=DcmDspDidInfo_SvkBackup25
            DcmDspDidSignal_SvkBackup25 (DcmDspDidSignal): DcmDspDidDataPos=0, DcmDspDidDataRef=DcmDspData_SvkBackup25
          DcmDspDid_SvkBackup26: DcmDspDidIdentifier=61725, DcmDspDidInfoRef=DcmDspDidInfo_SvkBackup26
            DcmDspDidSignal_SvkBackup26 (DcmDspDidSignal): DcmDspDidDataPos=0, DcmDspDidDataRef=DcmDspData_SvkBackup26
          DcmDspDid_SvkBackup27: DcmDspDidIdentifier=61726, DcmDspDidInfoRef=DcmDspDidInfo_SvkBackup27
            DcmDspDidSignal_SvkBackup27 (DcmDspDidSignal): DcmDspDidDataPos=0, DcmDspDidDataRef=DcmDspData_SvkBackup27
          DcmDspDid_SvkBackup28: DcmDspDidIdentifier=61727, DcmDspDidInfoRef=DcmDspDidInfo_SvkBackup28
            DcmDspDidSignal_SvkBackup28 (DcmDspDidSignal): DcmDspDidDataPos=0, DcmDspDidDataRef=DcmDspData_SvkBackup28
          DcmDspDid_SvkBackup29: DcmDspDidIdentifier=61728, DcmDspDidInfoRef=DcmDspDidInfo_SvkBackup29
            DcmDspDidSignal_SvkBackup29 (DcmDspDidSignal): DcmDspDidDataPos=0, DcmDspDidDataRef=DcmDspData_SvkBackup29
          DcmDspDid_SvkBackup30: DcmDspDidIdentifier=61729, DcmDspDidInfoRef=DcmDspDidInfo_SvkBackup30
            DcmDspDidSignal_SvkBackup30 (DcmDspDidSignal): DcmDspDidDataPos=0, DcmDspDidDataRef=DcmDspData_SvkBackup30
          DcmDspDid_SvkBackup31: DcmDspDidIdentifier=61730, DcmDspDidInfoRef=DcmDspDidInfo_SvkBackup31
            DcmDspDidSignal_SvkBackup31 (DcmDspDidSignal): DcmDspDidDataPos=0, DcmDspDidDataRef=DcmDspData_SvkBackup31
          DcmDspDid_SvkBackup32: DcmDspDidIdentifier=61731, DcmDspDidInfoRef=DcmDspDidInfo_SvkBackup32
            DcmDspDidSignal_SvkBackup32 (DcmDspDidSignal): DcmDspDidDataPos=0, DcmDspDidDataRef=DcmDspData_SvkBackup32
          DcmDspDid_SvkBackup33: DcmDspDidIdentifier=61732, DcmDspDidInfoRef=DcmDspDidInfo_SvkBackup33
            DcmDspDidSignal_SvkBackup33 (DcmDspDidSignal): DcmDspDidDataPos=0, DcmDspDidDataRef=DcmDspData_SvkBackup33
          DcmDspDid_SvkBackup34: DcmDspDidIdentifier=61733, DcmDspDidInfoRef=DcmDspDidInfo_SvkBackup34
            DcmDspDidSignal_SvkBackup34 (DcmDspDidSignal): DcmDspDidDataPos=0, DcmDspDidDataRef=DcmDspData_SvkBackup34
          DcmDspDid_SvkBackup35: DcmDspDidIdentifier=61734, DcmDspDidInfoRef=DcmDspDidInfo_SvkBackup35
            DcmDspDidSignal_SvkBackup35 (DcmDspDidSignal): DcmDspDidDataPos=0, DcmDspDidDataRef=DcmDspData_SvkBackup35
          DcmDspDid_SvkBackup36: DcmDspDidIdentifier=61735, DcmDspDidInfoRef=DcmDspDidInfo_SvkBackup36
            DcmDspDidSignal_SvkBackup36 (DcmDspDidSignal): DcmDspDidDataPos=0, DcmDspDidDataRef=DcmDspData_SvkBackup36
          DcmDspDid_SvkBackup37: DcmDspDidIdentifier=61736, DcmDspDidInfoRef=DcmDspDidInfo_SvkBackup37
            DcmDspDidSignal_SvkBackup37 (DcmDspDidSignal): DcmDspDidDataPos=0, DcmDspDidDataRef=DcmDspData_SvkBackup37
          DcmDspDid_SvkBackup38: DcmDspDidIdentifier=61737, DcmDspDidInfoRef=DcmDspDidInfo_SvkBackup38
            DcmDspDidSignal_SvkBackup38 (DcmDspDidSignal): DcmDspDidDataPos=0, DcmDspDidDataRef=DcmDspData_SvkBackup38
          DcmDspDid_SvkBackup39: DcmDspDidIdentifier=61738, DcmDspDidInfoRef=DcmDspDidInfo_SvkBackup39
            DcmDspDidSignal_SvkBackup39 (DcmDspDidSignal): DcmDspDidDataPos=0, DcmDspDidDataRef=DcmDspData_SvkBackup39
          DcmDspDid_SvkBackup40: DcmDspDidIdentifier=61739, DcmDspDidInfoRef=DcmDspDidInfo_SvkBackup40
            DcmDspDidSignal_SvkBackup40 (DcmDspDidSignal): DcmDspDidDataPos=0, DcmDspDidDataRef=DcmDspData_SvkBackup40
          DcmDspDid_SvkBackup41: DcmDspDidIdentifier=61740, DcmDspDidInfoRef=DcmDspDidInfo_SvkBackup41
            DcmDspDidSignal_SvkBackup41 (DcmDspDidSignal): DcmDspDidDataPos=0, DcmDspDidDataRef=DcmDspData_SvkBackup41
          DcmDspDid_SvkBackup42: DcmDspDidIdentifier=61741, DcmDspDidInfoRef=DcmDspDidInfo_SvkBackup42
            DcmDspDidSignal_SvkBackup42 (DcmDspDidSignal): DcmDspDidDataPos=0, DcmDspDidDataRef=DcmDspData_SvkBackup42
          DcmDspDid_SvkBackup43: DcmDspDidIdentifier=61742, DcmDspDidInfoRef=DcmDspDidInfo_SvkBackup43
            DcmDspDidSignal_SvkBackup43 (DcmDspDidSignal): DcmDspDidDataPos=0, DcmDspDidDataRef=DcmDspData_SvkBackup43
          DcmDspDid_SvkBackup44: DcmDspDidIdentifier=61743, DcmDspDidInfoRef=DcmDspDidInfo_SvkBackup44
            DcmDspDidSignal_SvkBackup44 (DcmDspDidSignal): DcmDspDidDataPos=0, DcmDspDidDataRef=DcmDspData_SvkBackup44
          DcmDspDid_SvkBackup45: DcmDspDidIdentifier=61744, DcmDspDidInfoRef=DcmDspDidInfo_SvkBackup45
            DcmDspDidSignal_SvkBackup45 (DcmDspDidSignal): DcmDspDidDataPos=0, DcmDspDidDataRef=DcmDspData_SvkBackup45
          DcmDspDid_SvkBackup46: DcmDspDidIdentifier=61745, DcmDspDidInfoRef=DcmDspDidInfo_SvkBackup46
            DcmDspDidSignal_SvkBackup46 (DcmDspDidSignal): DcmDspDidDataPos=0, DcmDspDidDataRef=DcmDspData_SvkBackup46
          DcmDspDid_SvkBackup47: DcmDspDidIdentifier=61746, DcmDspDidInfoRef=DcmDspDidInfo_SvkBackup47
            DcmDspDidSignal_SvkBackup47 (DcmDspDidSignal): DcmDspDidDataPos=0, DcmDspDidDataRef=DcmDspData_SvkBackup47
          DcmDspDid_SvkBackup48: DcmDspDidIdentifier=61747, DcmDspDidInfoRef=DcmDspDidInfo_SvkBackup48
            DcmDspDidSignal_SvkBackup48 (DcmDspDidSignal): DcmDspDidDataPos=0, DcmDspDidDataRef=DcmDspData_SvkBackup48
          DcmDspDid_SvkBackup49: DcmDspDidIdentifier=61748, DcmDspDidInfoRef=DcmDspDidInfo_SvkBackup49
            DcmDspDidSignal_SvkBackup49 (DcmDspDidSignal): DcmDspDidDataPos=0, DcmDspDidDataRef=DcmDspData_SvkBackup49
          DcmDspDid_SvkBackup50: DcmDspDidIdentifier=61749, DcmDspDidInfoRef=DcmDspDidInfo_SvkBackup50
            DcmDspDidSignal_SvkBackup50 (DcmDspDidSignal): DcmDspDidDataPos=0, DcmDspDidDataRef=DcmDspData_SvkBackup50
          DcmDspDid_SvkBackup51: DcmDspDidIdentifier=61750, DcmDspDidInfoRef=DcmDspDidInfo_SvkBackup51
            DcmDspDidSignal_SvkBackup51 (DcmDspDidSignal): DcmDspDidDataPos=0, DcmDspDidDataRef=DcmDspData_SvkBackup51
          DcmDspDid_SvkBackup52: DcmDspDidIdentifier=61751, DcmDspDidInfoRef=DcmDspDidInfo_SvkBackup52
            DcmDspDidSignal_SvkBackup52 (DcmDspDidSignal): DcmDspDidDataPos=0, DcmDspDidDataRef=DcmDspData_SvkBackup52
          DcmDspDid_SvkBackup53: DcmDspDidIdentifier=61752, DcmDspDidInfoRef=DcmDspDidInfo_SvkBackup53
            DcmDspDidSignal_SvkBackup53 (DcmDspDidSignal): DcmDspDidDataPos=0, DcmDspDidDataRef=DcmDspData_SvkBackup53
          DcmDspDid_SvkBackup54: DcmDspDidIdentifier=61753, DcmDspDidInfoRef=DcmDspDidInfo_SvkBackup54
            DcmDspDidSignal_SvkBackup54 (DcmDspDidSignal): DcmDspDidDataPos=0, DcmDspDidDataRef=DcmDspData_SvkBackup54
          DcmDspDid_SvkBackup55: DcmDspDidIdentifier=61754, DcmDspDidInfoRef=DcmDspDidInfo_SvkBackup55
            DcmDspDidSignal_SvkBackup55 (DcmDspDidSignal): DcmDspDidDataPos=0, DcmDspDidDataRef=DcmDspData_SvkBackup55
          DcmDspDid_SvkBackup56: DcmDspDidIdentifier=61755, DcmDspDidInfoRef=DcmDspDidInfo_SvkBackup56
            DcmDspDidSignal_SvkBackup56 (DcmDspDidSignal): DcmDspDidDataPos=0, DcmDspDidDataRef=DcmDspData_SvkBackup56
          DcmDspDid_SvkBackup57: DcmDspDidIdentifier=61756, DcmDspDidInfoRef=DcmDspDidInfo_SvkBackup57
            DcmDspDidSignal_SvkBackup57 (DcmDspDidSignal): DcmDspDidDataPos=0, DcmDspDidDataRef=DcmDspData_SvkBackup57
          DcmDspDid_SvkBackup58: DcmDspDidIdentifier=61757, DcmDspDidInfoRef=DcmDspDidInfo_SvkBackup58
            DcmDspDidSignal_SvkBackup58 (DcmDspDidSignal): DcmDspDidDataPos=0, DcmDspDidDataRef=DcmDspData_SvkBackup58
          DcmDspDid_SvkBackup59: DcmDspDidIdentifier=61758, DcmDspDidInfoRef=DcmDspDidInfo_SvkBackup59
            DcmDspDidSignal_SvkBackup59 (DcmDspDidSignal): DcmDspDidDataPos=0, DcmDspDidDataRef=DcmDspData_SvkBackup59
          DcmDspDid_SvkBackup60: DcmDspDidIdentifier=61759, DcmDspDidInfoRef=DcmDspDidInfo_SvkBackup60
            DcmDspDidSignal_SvkBackup60 (DcmDspDidSignal): DcmDspDidDataPos=0, DcmDspDidDataRef=DcmDspData_SvkBackup60
          DcmDspDid_SvkBackup61: DcmDspDidIdentifier=61760, DcmDspDidInfoRef=DcmDspDidInfo_SvkBackup61
            DcmDspDidSignal_SvkBackup61 (DcmDspDidSignal): DcmDspDidDataPos=0, DcmDspDidDataRef=DcmDspData_SvkBackup61
          DcmDspDid_SvkSysSupplier: DcmDspDidIdentifier=61698, DcmDspDidInfoRef=DcmDspDidInfo_SvkSysSupplier
            DcmDspDidSignal_SvkSysSupplier (DcmDspDidSignal): DcmDspDidDataPos=0, DcmDspDidDataRef=DcmDspData_SvkSysSupplier
          DcmDspDid_SvkWerk: DcmDspDidIdentifier=61699, DcmDspDidInfoRef=DcmDspDidInfo_SvkWerk
            DcmDspDidSignal_SvkWerk (DcmDspDidSignal): DcmDspDidDataPos=0, DcmDspDidDataRef=DcmDspData_SvkWerk
          DcmDspDid_SwfkDeleteSupported: DcmDspDidIdentifier=9479, DcmDspDidInfoRef=DcmDspDidInfo_SwfkDeleteSupported
            DcmDspDidSignal_SwfkDeleteSupported (DcmDspDidSignal): DcmDspDidDataPos=0, DcmDspDidDataRef=DcmDspData_SwfkDeleteSupported
          DcmDspDid_SystemSupplierIdentifier: DcmDspDidIdentifier=61834, DcmDspDidInfoRef=DcmDspDidInfo_SystemSupplierIdentifier
            DcmDspDidSignal_SystemSupplierIdentifier (DcmDspDidSignal): DcmDspDidDataPos=0, DcmDspDidDataRef=DcmDspData_SystemSupplierIdentifier
          DcmDspDid_Systemzeit: DcmDspDidIdentifier=5889, DcmDspDidInfoRef=DcmDspDidInfo_Systemzeit
            DcmDspDidSignal_Systemzeit (DcmDspDidSignal): DcmDspDidDataPos=0, DcmDspDidDataRef=DcmDspData_Systemzeit
          DcmDspDid_Vin: DcmDspDidIdentifier=61840, DcmDspDidInfoRef=DcmDspDidInfo_Vin
            DcmDspDidSignal_Vin (DcmDspDidSignal): DcmDspDidDataPos=0, DcmDspDidDataRef=DcmDspData_Vin
          DcmDspDid_ZgwZertifikat: DcmDspDidIdentifier=5919, DcmDspDidInfoRef=DcmDspDidInfo_ZgwZertifikat
            DcmDspDidSignal_ZgwZertifikat (DcmDspDidSignal): DcmDspDidDataPos=0, DcmDspDidDataRef=DcmDspData_ZgwZertifikat
        105 x DcmDspDidInfo, all with DcmDspDidDynamicallyDefined=0:
          DcmDspDidInfo_ActiveDiagnosticSession
            DcmDspDidRead: DcmDspDidReadSessionRef=DcmDspSessionRow_EXTENDED_DIAGNOSTIC_SESSION, DcmDspDidReadSessionRef=DcmDspSessionRow_DEFAULT_SESSION
          DcmDspDidInfo_Cps
            DcmDspDidRead:
              DcmDspDidReadSessionRef = DcmDspSessionRow_DEFAULT_SESSION
              DcmDspDidReadSessionRef = DcmDspSessionRow_EXTENDED_DIAGNOSTIC_SESSION
              DcmDspDidReadSessionRef = DcmDspSessionRow_CODING_SESSION
            DcmDspDidWrite: DcmDspDidWriteSecurityLevelRef=DcmDspSecurityRow_Coding, DcmDspDidWriteSessionRef=DcmDspSessionRow_CODING_SESSION
          DcmDspDidInfo_DmDtcAktiveMeldung
            DcmDspDidRead: DcmDspDidReadSessionRef=DcmDspSessionRow_DEFAULT_SESSION, DcmDspDidReadSessionRef=DcmDspSessionRow_EXTENDED_DIAGNOSTIC_SESSION
          DcmDspDidInfo_DmIsDtcActiveResponse
            DcmDspDidRead: DcmDspDidReadSessionRef=DcmDspSessionRow_DEFAULT_SESSION, DcmDspDidReadSessionRef=DcmDspSessionRow_EXTENDED_DIAGNOSTIC_SESSION
          DcmDspDidInfo_EcuSerialNumber
            DcmDspDidRead: DcmDspDidReadSessionRef=DcmDspSessionRow_EXTENDED_DIAGNOSTIC_SESSION, DcmDspDidReadSessionRef=DcmDspSessionRow_DEFAULT_SESSION
          DcmDspDidInfo_EnergySavingState
            DcmDspDidRead: DcmDspDidReadSessionRef=DcmDspSessionRow_DEFAULT_SESSION, DcmDspDidReadSessionRef=DcmDspSessionRow_EXTENDED_DIAGNOSTIC_SESSION
          DcmDspDidInfo_EthGetNumberOfPorts
            DcmDspDidRead: DcmDspDidReadSessionRef=DcmDspSessionRow_DEFAULT_SESSION, DcmDspDidReadSessionRef=DcmDspSessionRow_EXTENDED_DIAGNOSTIC_SESSION
          DcmDspDidInfo_EthPhyLinkState
            DcmDspDidRead: DcmDspDidReadSessionRef=DcmDspSessionRow_DEFAULT_SESSION, DcmDspDidReadSessionRef=DcmDspSessionRow_EXTENDED_DIAGNOSTIC_SESSION
          DcmDspDidInfo_EthSignalQuality
            DcmDspDidRead: DcmDspDidReadSessionRef=DcmDspSessionRow_DEFAULT_SESSION, DcmDspDidReadSessionRef=DcmDspSessionRow_EXTENDED_DIAGNOSTIC_SESSION
          DcmDspDidInfo_ExtendedEnergySavingState
            DcmDspDidRead: DcmDspDidReadSessionRef=DcmDspSessionRow_DEFAULT_SESSION, DcmDspDidReadSessionRef=DcmDspSessionRow_EXTENDED_DIAGNOSTIC_SESSION
          DcmDspDidInfo_FlashTimingParameter
            DcmDspDidRead: DcmDspDidReadSessionRef=DcmDspSessionRow_DEFAULT_SESSION, DcmDspDidReadSessionRef=DcmDspSessionRow_EXTENDED_DIAGNOSTIC_SESSION
          DcmDspDidInfo_HddDownloadStatus
            DcmDspDidRead: DcmDspDidReadSessionRef=DcmDspSessionRow_HDD_DOWNLOAD_SESSION
          DcmDspDidInfo_HddDownloadTimeToCompletion
            DcmDspDidRead: DcmDspDidReadSessionRef=DcmDspSessionRow_HDD_DOWNLOAD_SESSION
          DcmDspDidInfo_Herstelldatum
            DcmDspDidRead: DcmDspDidReadSessionRef=DcmDspSessionRow_DEFAULT_SESSION, DcmDspDidReadSessionRef=DcmDspSessionRow_EXTENDED_DIAGNOSTIC_SESSION
          DcmDspDidInfo_IndivDataTable
            DcmDspDidRead: DcmDspDidReadSessionRef=DcmDspSessionRow_EXTENDED_DIAGNOSTIC_SESSION
          DcmDspDidInfo_IpConfiguration
            DcmDspDidRead: DcmDspDidReadSessionRef=DcmDspSessionRow_DEFAULT_SESSION, DcmDspDidReadSessionRef=DcmDspSessionRow_EXTENDED_DIAGNOSTIC_SESSION
          DcmDspDidInfo_ListManipulationApplicationData
            DcmDspDidRead: DcmDspDidReadSessionRef=DcmDspSessionRow_EXTENDED_DIAGNOSTIC_SESSION, DcmDspDidReadSessionRef=DcmDspSessionRow_DEFAULT_SESSION
          DcmDspDidInfo_ListManipulationGeneral
            DcmDspDidRead: DcmDspDidReadSessionRef=DcmDspSessionRow_DEFAULT_SESSION, DcmDspDidReadSessionRef=DcmDspSessionRow_EXTENDED_DIAGNOSTIC_SESSION
          DcmDspDidInfo_ListManipulationSecureBoot
            DcmDspDidRead: DcmDspDidReadSessionRef=DcmDspSessionRow_EXTENDED_DIAGNOSTIC_SESSION, DcmDspDidReadSessionRef=DcmDspSessionRow_DEFAULT_SESSION
          DcmDspDidInfo_ListManipulationSecurityArtifact
            DcmDspDidRead: DcmDspDidReadSessionRef=DcmDspSessionRow_DEFAULT_SESSION, DcmDspDidReadSessionRef=DcmDspSessionRow_EXTENDED_DIAGNOSTIC_SESSION
          DcmDspDidInfo_ListManipulationSw
            DcmDspDidRead: DcmDspDidReadSessionRef=DcmDspSessionRow_DEFAULT_SESSION, DcmDspDidReadSessionRef=DcmDspSessionRow_EXTENDED_DIAGNOSTIC_SESSION
          DcmDspDidInfo_MileKmEeprom
            DcmDspDidRead: DcmDspDidReadSessionRef=DcmDspSessionRow_EXTENDED_DIAGNOSTIC_SESSION, DcmDspDidReadSessionRef=DcmDspSessionRow_DEFAULT_SESSION
          DcmDspDidInfo_PiaProfile0
            DcmDspDidRead: DcmDspDidReadSessionRef=DcmDspSessionRow_EXTENDED_DIAGNOSTIC_SESSION
            DcmDspDidWrite: DcmDspDidWriteSessionRef=DcmDspSessionRow_EXTENDED_DIAGNOSTIC_SESSION
          DcmDspDidInfo_PiaProfile1
            DcmDspDidRead: DcmDspDidReadSessionRef=DcmDspSessionRow_EXTENDED_DIAGNOSTIC_SESSION
            DcmDspDidWrite: DcmDspDidWriteSessionRef=DcmDspSessionRow_EXTENDED_DIAGNOSTIC_SESSION
          DcmDspDidInfo_PiaProfile2
            DcmDspDidRead: DcmDspDidReadSessionRef=DcmDspSessionRow_EXTENDED_DIAGNOSTIC_SESSION
            DcmDspDidWrite: DcmDspDidWriteSessionRef=DcmDspSessionRow_EXTENDED_DIAGNOSTIC_SESSION
          DcmDspDidInfo_PiaProfileA
            DcmDspDidRead: DcmDspDidReadSessionRef=DcmDspSessionRow_EXTENDED_DIAGNOSTIC_SESSION
            DcmDspDidWrite: DcmDspDidWriteSessionRef=DcmDspSessionRow_EXTENDED_DIAGNOSTIC_SESSION
          DcmDspDidInfo_ProgrammingCounter
            DcmDspDidRead: DcmDspDidReadSessionRef=DcmDspSessionRow_EXTENDED_DIAGNOSTIC_SESSION, DcmDspDidReadSessionRef=DcmDspSessionRow_DEFAULT_SESSION
          DcmDspDidInfo_ProgrammingCounterMaxValue
            DcmDspDidRead: DcmDspDidReadSessionRef=DcmDspSessionRow_EXTENDED_DIAGNOSTIC_SESSION, DcmDspDidReadSessionRef=DcmDspSessionRow_DEFAULT_SESSION
          DcmDspDidInfo_Pruefstempel
            DcmDspDidRead: DcmDspDidReadSessionRef=DcmDspSessionRow_EXTENDED_DIAGNOSTIC_SESSION, DcmDspDidReadSessionRef=DcmDspSessionRow_DEFAULT_SESSION
            DcmDspDidWrite: DcmDspDidWriteSessionRef=DcmDspSessionRow_EXTENDED_DIAGNOSTIC_SESSION, DcmDspDidWriteSessionRef=DcmDspSessionRow_DEFAULT_SESSION
          DcmDspDidInfo_ReadActiveSessionState
            DcmDspDidRead: DcmDspDidReadSessionRef=DcmDspSessionRow_EXTENDED_DIAGNOSTIC_SESSION, DcmDspDidReadSessionRef=DcmDspSessionRow_DEFAULT_SESSION
          DcmDspDidInfo_Readhwmodificationindex
            DcmDspDidRead: DcmDspDidReadSessionRef=DcmDspSessionRow_EXTENDED_DIAGNOSTIC_SESSION, DcmDspDidReadSessionRef=DcmDspSessionRow_DEFAULT_SESSION
          DcmDspDidInfo_Sekundaererfehlerspeicher
            DcmDspDidRead: DcmDspDidReadSessionRef=DcmDspSessionRow_DEFAULT_SESSION, DcmDspDidReadSessionRef=DcmDspSessionRow_EXTENDED_DIAGNOSTIC_SESSION
          DcmDspDidInfo_SensorenAnzahlLesen
            DcmDspDidRead: DcmDspDidReadSessionRef=DcmDspSessionRow_EXTENDED_DIAGNOSTIC_SESSION, DcmDspDidReadSessionRef=DcmDspSessionRow_DEFAULT_SESSION
          DcmDspDidInfo_SgbdIdx
            DcmDspDidRead: DcmDspDidReadSessionRef=DcmDspSessionRow_EXTENDED_DIAGNOSTIC_SESSION, DcmDspDidReadSessionRef=DcmDspSessionRow_DEFAULT_SESSION
          DcmDspDidInfo_StatusDmFssMaster
            DcmDspDidRead: DcmDspDidReadSessionRef=DcmDspSessionRow_DEFAULT_SESSION, DcmDspDidReadSessionRef=DcmDspSessionRow_EXTENDED_DIAGNOSTIC_SESSION
          DcmDspDidInfo_StatusSystime
            DcmDspDidRead: DcmDspDidReadSessionRef=DcmDspSessionRow_DEFAULT_SESSION, DcmDspDidReadSessionRef=DcmDspSessionRow_EXTENDED_DIAGNOSTIC_SESSION
          DcmDspDidInfo_SvkAktuell
            DcmDspDidRead: DcmDspDidReadSessionRef=DcmDspSessionRow_EXTENDED_DIAGNOSTIC_SESSION, DcmDspDidReadSessionRef=DcmDspSessionRow_DEFAULT_SESSION
          DcmDspDidInfo_SvkBackup01
            DcmDspDidRead: DcmDspDidReadSessionRef=DcmDspSessionRow_EXTENDED_DIAGNOSTIC_SESSION, DcmDspDidReadSessionRef=DcmDspSessionRow_DEFAULT_SESSION
          DcmDspDidInfo_SvkBackup02
            DcmDspDidRead: DcmDspDidReadSessionRef=DcmDspSessionRow_EXTENDED_DIAGNOSTIC_SESSION, DcmDspDidReadSessionRef=DcmDspSessionRow_DEFAULT_SESSION
          DcmDspDidInfo_SvkBackup03
            DcmDspDidRead: DcmDspDidReadSessionRef=DcmDspSessionRow_DEFAULT_SESSION, DcmDspDidReadSessionRef=DcmDspSessionRow_EXTENDED_DIAGNOSTIC_SESSION
          DcmDspDidInfo_SvkBackup04
            DcmDspDidRead: DcmDspDidReadSessionRef=DcmDspSessionRow_EXTENDED_DIAGNOSTIC_SESSION, DcmDspDidReadSessionRef=DcmDspSessionRow_DEFAULT_SESSION
          DcmDspDidInfo_SvkBackup05
            DcmDspDidRead: DcmDspDidReadSessionRef=DcmDspSessionRow_EXTENDED_DIAGNOSTIC_SESSION, DcmDspDidReadSessionRef=DcmDspSessionRow_DEFAULT_SESSION
          DcmDspDidInfo_SvkBackup06
            DcmDspDidRead: DcmDspDidReadSessionRef=DcmDspSessionRow_DEFAULT_SESSION, DcmDspDidReadSessionRef=DcmDspSessionRow_EXTENDED_DIAGNOSTIC_SESSION
          DcmDspDidInfo_SvkBackup07
            DcmDspDidRead: DcmDspDidReadSessionRef=DcmDspSessionRow_DEFAULT_SESSION, DcmDspDidReadSessionRef=DcmDspSessionRow_EXTENDED_DIAGNOSTIC_SESSION
          DcmDspDidInfo_SvkBackup08
            DcmDspDidRead: DcmDspDidReadSessionRef=DcmDspSessionRow_DEFAULT_SESSION, DcmDspDidReadSessionRef=DcmDspSessionRow_EXTENDED_DIAGNOSTIC_SESSION
          DcmDspDidInfo_SvkBackup09
            DcmDspDidRead: DcmDspDidReadSessionRef=DcmDspSessionRow_DEFAULT_SESSION, DcmDspDidReadSessionRef=DcmDspSessionRow_EXTENDED_DIAGNOSTIC_SESSION
          DcmDspDidInfo_SvkBackup10
            DcmDspDidRead: DcmDspDidReadSessionRef=DcmDspSessionRow_DEFAULT_SESSION, DcmDspDidReadSessionRef=DcmDspSessionRow_EXTENDED_DIAGNOSTIC_SESSION
          DcmDspDidInfo_SvkBackup11
            DcmDspDidRead: DcmDspDidReadSessionRef=DcmDspSessionRow_EXTENDED_DIAGNOSTIC_SESSION, DcmDspDidReadSessionRef=DcmDspSessionRow_DEFAULT_SESSION
          DcmDspDidInfo_SvkBackup12
            DcmDspDidRead: DcmDspDidReadSessionRef=DcmDspSessionRow_DEFAULT_SESSION, DcmDspDidReadSessionRef=DcmDspSessionRow_EXTENDED_DIAGNOSTIC_SESSION
          DcmDspDidInfo_SvkBackup13
            DcmDspDidRead: DcmDspDidReadSessionRef=DcmDspSessionRow_DEFAULT_SESSION, DcmDspDidReadSessionRef=DcmDspSessionRow_EXTENDED_DIAGNOSTIC_SESSION
          DcmDspDidInfo_SvkBackup14
            DcmDspDidRead: DcmDspDidReadSessionRef=DcmDspSessionRow_EXTENDED_DIAGNOSTIC_SESSION, DcmDspDidReadSessionRef=DcmDspSessionRow_DEFAULT_SESSION
          DcmDspDidInfo_SvkBackup15
            DcmDspDidRead: DcmDspDidReadSessionRef=DcmDspSessionRow_EXTENDED_DIAGNOSTIC_SESSION, DcmDspDidReadSessionRef=DcmDspSessionRow_DEFAULT_SESSION
          DcmDspDidInfo_SvkBackup16
            DcmDspDidRead: DcmDspDidReadSessionRef=DcmDspSessionRow_EXTENDED_DIAGNOSTIC_SESSION, DcmDspDidReadSessionRef=DcmDspSessionRow_DEFAULT_SESSION
          DcmDspDidInfo_SvkBackup17
            DcmDspDidRead: DcmDspDidReadSessionRef=DcmDspSessionRow_DEFAULT_SESSION, DcmDspDidReadSessionRef=DcmDspSessionRow_EXTENDED_DIAGNOSTIC_SESSION
          DcmDspDidInfo_SvkBackup18
            DcmDspDidRead: DcmDspDidReadSessionRef=DcmDspSessionRow_EXTENDED_DIAGNOSTIC_SESSION, DcmDspDidReadSessionRef=DcmDspSessionRow_DEFAULT_SESSION
          DcmDspDidInfo_SvkBackup19
            DcmDspDidRead: DcmDspDidReadSessionRef=DcmDspSessionRow_EXTENDED_DIAGNOSTIC_SESSION, DcmDspDidReadSessionRef=DcmDspSessionRow_DEFAULT_SESSION
          DcmDspDidInfo_SvkBackup20
            DcmDspDidRead: DcmDspDidReadSessionRef=DcmDspSessionRow_EXTENDED_DIAGNOSTIC_SESSION, DcmDspDidReadSessionRef=DcmDspSessionRow_DEFAULT_SESSION
          DcmDspDidInfo_SvkBackup21
            DcmDspDidRead: DcmDspDidReadSessionRef=DcmDspSessionRow_EXTENDED_DIAGNOSTIC_SESSION, DcmDspDidReadSessionRef=DcmDspSessionRow_DEFAULT_SESSION
          DcmDspDidInfo_SvkBackup22
            DcmDspDidRead: DcmDspDidReadSessionRef=DcmDspSessionRow_EXTENDED_DIAGNOSTIC_SESSION, DcmDspDidReadSessionRef=DcmDspSessionRow_DEFAULT_SESSION
          DcmDspDidInfo_SvkBackup23
            DcmDspDidRead: DcmDspDidReadSessionRef=DcmDspSessionRow_EXTENDED_DIAGNOSTIC_SESSION, DcmDspDidReadSessionRef=DcmDspSessionRow_DEFAULT_SESSION
          DcmDspDidInfo_SvkBackup24
            DcmDspDidRead: DcmDspDidReadSessionRef=DcmDspSessionRow_DEFAULT_SESSION, DcmDspDidReadSessionRef=DcmDspSessionRow_EXTENDED_DIAGNOSTIC_SESSION
          DcmDspDidInfo_SvkBackup25
            DcmDspDidRead: DcmDspDidReadSessionRef=DcmDspSessionRow_EXTENDED_DIAGNOSTIC_SESSION, DcmDspDidReadSessionRef=DcmDspSessionRow_DEFAULT_SESSION
          DcmDspDidInfo_SvkBackup26
            DcmDspDidRead: DcmDspDidReadSessionRef=DcmDspSessionRow_DEFAULT_SESSION, DcmDspDidReadSessionRef=DcmDspSessionRow_EXTENDED_DIAGNOSTIC_SESSION
          DcmDspDidInfo_SvkBackup27
            DcmDspDidRead: DcmDspDidReadSessionRef=DcmDspSessionRow_DEFAULT_SESSION, DcmDspDidReadSessionRef=DcmDspSessionRow_EXTENDED_DIAGNOSTIC_SESSION
          DcmDspDidInfo_SvkBackup28
            DcmDspDidRead: DcmDspDidReadSessionRef=DcmDspSessionRow_EXTENDED_DIAGNOSTIC_SESSION, DcmDspDidReadSessionRef=DcmDspSessionRow_DEFAULT_SESSION
          DcmDspDidInfo_SvkBackup29
            DcmDspDidRead: DcmDspDidReadSessionRef=DcmDspSessionRow_EXTENDED_DIAGNOSTIC_SESSION, DcmDspDidReadSessionRef=DcmDspSessionRow_DEFAULT_SESSION
          DcmDspDidInfo_SvkBackup30
            DcmDspDidRead: DcmDspDidReadSessionRef=DcmDspSessionRow_DEFAULT_SESSION, DcmDspDidReadSessionRef=DcmDspSessionRow_EXTENDED_DIAGNOSTIC_SESSION
          DcmDspDidInfo_SvkBackup31
            DcmDspDidRead: DcmDspDidReadSessionRef=DcmDspSessionRow_DEFAULT_SESSION, DcmDspDidReadSessionRef=DcmDspSessionRow_EXTENDED_DIAGNOSTIC_SESSION
          DcmDspDidInfo_SvkBackup32
            DcmDspDidRead: DcmDspDidReadSessionRef=DcmDspSessionRow_DEFAULT_SESSION, DcmDspDidReadSessionRef=DcmDspSessionRow_EXTENDED_DIAGNOSTIC_SESSION
          DcmDspDidInfo_SvkBackup33
            DcmDspDidRead: DcmDspDidReadSessionRef=DcmDspSessionRow_DEFAULT_SESSION, DcmDspDidReadSessionRef=DcmDspSessionRow_EXTENDED_DIAGNOSTIC_SESSION
          DcmDspDidInfo_SvkBackup34
            DcmDspDidRead: DcmDspDidReadSessionRef=DcmDspSessionRow_EXTENDED_DIAGNOSTIC_SESSION, DcmDspDidReadSessionRef=DcmDspSessionRow_DEFAULT_SESSION
          DcmDspDidInfo_SvkBackup35
            DcmDspDidRead: DcmDspDidReadSessionRef=DcmDspSessionRow_DEFAULT_SESSION, DcmDspDidReadSessionRef=DcmDspSessionRow_EXTENDED_DIAGNOSTIC_SESSION
          DcmDspDidInfo_SvkBackup36
            DcmDspDidRead: DcmDspDidReadSessionRef=DcmDspSessionRow_EXTENDED_DIAGNOSTIC_SESSION, DcmDspDidReadSessionRef=DcmDspSessionRow_DEFAULT_SESSION
          DcmDspDidInfo_SvkBackup37
            DcmDspDidRead: DcmDspDidReadSessionRef=DcmDspSessionRow_DEFAULT_SESSION, DcmDspDidReadSessionRef=DcmDspSessionRow_EXTENDED_DIAGNOSTIC_SESSION
          DcmDspDidInfo_SvkBackup38
            DcmDspDidRead: DcmDspDidReadSessionRef=DcmDspSessionRow_DEFAULT_SESSION, DcmDspDidReadSessionRef=DcmDspSessionRow_EXTENDED_DIAGNOSTIC_SESSION
          DcmDspDidInfo_SvkBackup39
            DcmDspDidRead: DcmDspDidReadSessionRef=DcmDspSessionRow_DEFAULT_SESSION, DcmDspDidReadSessionRef=DcmDspSessionRow_EXTENDED_DIAGNOSTIC_SESSION
          DcmDspDidInfo_SvkBackup40
            DcmDspDidRead: DcmDspDidReadSessionRef=DcmDspSessionRow_EXTENDED_DIAGNOSTIC_SESSION, DcmDspDidReadSessionRef=DcmDspSessionRow_DEFAULT_SESSION
          DcmDspDidInfo_SvkBackup41
            DcmDspDidRead: DcmDspDidReadSessionRef=DcmDspSessionRow_DEFAULT_SESSION, DcmDspDidReadSessionRef=DcmDspSessionRow_EXTENDED_DIAGNOSTIC_SESSION
          DcmDspDidInfo_SvkBackup42
            DcmDspDidRead: DcmDspDidReadSessionRef=DcmDspSessionRow_EXTENDED_DIAGNOSTIC_SESSION, DcmDspDidReadSessionRef=DcmDspSessionRow_DEFAULT_SESSION
          DcmDspDidInfo_SvkBackup43
            DcmDspDidRead: DcmDspDidReadSessionRef=DcmDspSessionRow_EXTENDED_DIAGNOSTIC_SESSION, DcmDspDidReadSessionRef=DcmDspSessionRow_DEFAULT_SESSION
          DcmDspDidInfo_SvkBackup44
            DcmDspDidRead: DcmDspDidReadSessionRef=DcmDspSessionRow_DEFAULT_SESSION, DcmDspDidReadSessionRef=DcmDspSessionRow_EXTENDED_DIAGNOSTIC_SESSION
          DcmDspDidInfo_SvkBackup45
            DcmDspDidRead: DcmDspDidReadSessionRef=DcmDspSessionRow_EXTENDED_DIAGNOSTIC_SESSION, DcmDspDidReadSessionRef=DcmDspSessionRow_DEFAULT_SESSION
          DcmDspDidInfo_SvkBackup46
            DcmDspDidRead: DcmDspDidReadSessionRef=DcmDspSessionRow_EXTENDED_DIAGNOSTIC_SESSION, DcmDspDidReadSessionRef=DcmDspSessionRow_DEFAULT_SESSION
          DcmDspDidInfo_SvkBackup47
            DcmDspDidRead: DcmDspDidReadSessionRef=DcmDspSessionRow_EXTENDED_DIAGNOSTIC_SESSION, DcmDspDidReadSessionRef=DcmDspSessionRow_DEFAULT_SESSION
          DcmDspDidInfo_SvkBackup48
            DcmDspDidRead: DcmDspDidReadSessionRef=DcmDspSessionRow_DEFAULT_SESSION, DcmDspDidReadSessionRef=DcmDspSessionRow_EXTENDED_DIAGNOSTIC_SESSION
          DcmDspDidInfo_SvkBackup49
            DcmDspDidRead: DcmDspDidReadSessionRef=DcmDspSessionRow_DEFAULT_SESSION, DcmDspDidReadSessionRef=DcmDspSessionRow_EXTENDED_DIAGNOSTIC_SESSION
          DcmDspDidInfo_SvkBackup50
            DcmDspDidRead: DcmDspDidReadSessionRef=DcmDspSessionRow_DEFAULT_SESSION, DcmDspDidReadSessionRef=DcmDspSessionRow_EXTENDED_DIAGNOSTIC_SESSION
          DcmDspDidInfo_SvkBackup51
            DcmDspDidRead: DcmDspDidReadSessionRef=DcmDspSessionRow_DEFAULT_SESSION, DcmDspDidReadSessionRef=DcmDspSessionRow_EXTENDED_DIAGNOSTIC_SESSION
          DcmDspDidInfo_SvkBackup52
            DcmDspDidRead: DcmDspDidReadSessionRef=DcmDspSessionRow_EXTENDED_DIAGNOSTIC_SESSION, DcmDspDidReadSessionRef=DcmDspSessionRow_DEFAULT_SESSION
          DcmDspDidInfo_SvkBackup53
            DcmDspDidRead: DcmDspDidReadSessionRef=DcmDspSessionRow_EXTENDED_DIAGNOSTIC_SESSION, DcmDspDidReadSessionRef=DcmDspSessionRow_DEFAULT_SESSION
          DcmDspDidInfo_SvkBackup54
            DcmDspDidRead: DcmDspDidReadSessionRef=DcmDspSessionRow_DEFAULT_SESSION, DcmDspDidReadSessionRef=DcmDspSessionRow_EXTENDED_DIAGNOSTIC_SESSION
          DcmDspDidInfo_SvkBackup55
            DcmDspDidRead: DcmDspDidReadSessionRef=DcmDspSessionRow_EXTENDED_DIAGNOSTIC_SESSION, DcmDspDidReadSessionRef=DcmDspSessionRow_DEFAULT_SESSION
          DcmDspDidInfo_SvkBackup56
            DcmDspDidRead: DcmDspDidReadSessionRef=DcmDspSessionRow_DEFAULT_SESSION, DcmDspDidReadSessionRef=DcmDspSessionRow_EXTENDED_DIAGNOSTIC_SESSION
          DcmDspDidInfo_SvkBackup57
            DcmDspDidRead: DcmDspDidReadSessionRef=DcmDspSessionRow_DEFAULT_SESSION, DcmDspDidReadSessionRef=DcmDspSessionRow_EXTENDED_DIAGNOSTIC_SESSION
          DcmDspDidInfo_SvkBackup58
            DcmDspDidRead: DcmDspDidReadSessionRef=DcmDspSessionRow_EXTENDED_DIAGNOSTIC_SESSION, DcmDspDidReadSessionRef=DcmDspSessionRow_DEFAULT_SESSION
          DcmDspDidInfo_SvkBackup59
            DcmDspDidRead: DcmDspDidReadSessionRef=DcmDspSessionRow_DEFAULT_SESSION, DcmDspDidReadSessionRef=DcmDspSessionRow_EXTENDED_DIAGNOSTIC_SESSION
          DcmDspDidInfo_SvkBackup60
            DcmDspDidRead: DcmDspDidReadSessionRef=DcmDspSessionRow_EXTENDED_DIAGNOSTIC_SESSION, DcmDspDidReadSessionRef=DcmDspSessionRow_DEFAULT_SESSION
          DcmDspDidInfo_SvkBackup61
            DcmDspDidRead: DcmDspDidReadSessionRef=DcmDspSessionRow_DEFAULT_SESSION, DcmDspDidReadSessionRef=DcmDspSessionRow_EXTENDED_DIAGNOSTIC_SESSION
          DcmDspDidInfo_SvkSysSupplier
            DcmDspDidRead: DcmDspDidReadSessionRef=DcmDspSessionRow_EXTENDED_DIAGNOSTIC_SESSION, DcmDspDidReadSessionRef=DcmDspSessionRow_DEFAULT_SESSION
          DcmDspDidInfo_SvkWerk
            DcmDspDidRead: DcmDspDidReadSessionRef=DcmDspSessionRow_DEFAULT_SESSION, DcmDspDidReadSessionRef=DcmDspSessionRow_EXTENDED_DIAGNOSTIC_SESSION
          DcmDspDidInfo_SwfkDeleteSupported
            DcmDspDidRead: DcmDspDidReadSessionRef=DcmDspSessionRow_DEFAULT_SESSION, DcmDspDidReadSessionRef=DcmDspSessionRow_EXTENDED_DIAGNOSTIC_SESSION
          DcmDspDidInfo_SystemSupplierIdentifier
            DcmDspDidRead: DcmDspDidReadSessionRef=DcmDspSessionRow_EXTENDED_DIAGNOSTIC_SESSION, DcmDspDidReadSessionRef=DcmDspSessionRow_DEFAULT_SESSION
          DcmDspDidInfo_Systemzeit
            DcmDspDidRead: DcmDspDidReadSessionRef=DcmDspSessionRow_EXTENDED_DIAGNOSTIC_SESSION, DcmDspDidReadSessionRef=DcmDspSessionRow_DEFAULT_SESSION
          DcmDspDidInfo_Vin
            DcmDspDidRead: DcmDspDidReadSessionRef=DcmDspSessionRow_EXTENDED_DIAGNOSTIC_SESSION, DcmDspDidReadSessionRef=DcmDspSessionRow_DEFAULT_SESSION
          DcmDspDidInfo_ZgwZertifikat
            DcmDspDidRead: DcmDspDidReadSessionRef=DcmDspSessionRow_EXTENDED_DIAGNOSTIC_SESSION, DcmDspDidReadSessionRef=DcmDspSessionRow_DEFAULT_SESSION
        DcmDspDidRange_Coding (DcmDspDidRange):
          DcmDspDidRangeHasGaps = 1
          DcmDspDidRangeIdentifierLowerLimit = 12288
          DcmDspDidRangeIdentifierUpperLimit = 14334
          DcmDspDidRangeMaxDataLength = 0
          DcmDspDidRangeUsePort = 1
          DcmDspDidRangeInfoRef = DcmDspDidInfo_Cps
        DcmDspRoe
          DcmDspRoeEvent: DcmDspRoeInitialEventStatus=DCM_ROE_CLEARED
            DcmDspRoeEventProperties
              DcmDspRoeOnChangeOfDataIdentifier: DcmDspRoeDidRef=DcmDspDid_DmDtcAktiveMeldung
          DcmDspRoeEventWindowTime: DcmDspRoeEventWindowTime=DCM_ROE_EVENT_WINDOW_INFINITE, DcmDspRoeStorageState=1
        58 x DcmDspRoutine:
          DcmDspRoutine_AblageSystemkontext: DcmDspRoutineIdentifier=16384, DcmDspRoutineUsePort=1, DcmDspRoutineUsed=1, DcmDspCommonAuthorizationRef=DcmDspCommonAuthorization_eabf1d27
            DcmDspStartRoutine_START_AblageSystemkontext (DcmDspStartRoutine)
              DcmDspStartRoutineIn_START_AblageSystemkontext (DcmDspStartRoutineIn)
                DcmDspStartRoutineInSignal_Function (DcmDspStartRoutineInSignal): DcmDspRoutineSignalEndianness=BIG_ENDIAN, DcmDspRoutineSignalLength=8, DcmDspRoutineSignalPos=0, DcmDspRoutineSignalType=UINT8
              DcmDspStartRoutineOut_START_AblageSystemkontext (DcmDspStartRoutineOut)
                DcmDspStartRoutineOutSignal_StatDmLockState (DcmDspStartRoutineOutSignal): DcmDspRoutineSignalEndianness=BIG_ENDIAN, DcmDspRoutineSignalLength=8, DcmDspRoutineSignalPos=8, DcmDspRoutineSignalType=UINT8
                DcmDspStartRoutineOutSignal_StatFunction (DcmDspStartRoutineOutSignal): DcmDspRoutineSignalEndianness=BIG_ENDIAN, DcmDspRoutineSignalLength=8, DcmDspRoutineSignalPos=0, DcmDspRoutineSignalType=UINT8
          DcmDspRoutine_ActivateZgwApplicationmode: DcmDspRoutineIdentifier=4111, DcmDspRoutineUsePort=0, DcmDspRoutineUsed=1, DcmDspCommonAuthorizationRef=DcmDspCommonAuthorization_d884a83
            DcmDspStartRoutine_START_ActivateZgwApplicationmode (DcmDspStartRoutine): DcmDspStartRoutineFnc=EthDiagMM_RoutineControlDeActivateParallelFlashModeStart
          DcmDspRoutine_ActivateZgwCodingmode: DcmDspRoutineIdentifier=4109, DcmDspRoutineUsePort=1, DcmDspRoutineUsed=1, DcmDspCommonAuthorizationRef=DcmDspCommonAuthorization_3f08b769
            DcmDspStartRoutine_START_ActivateZgwCodingmode (DcmDspStartRoutine)
          DcmDspRoutine_ActivateZgwFlashmode: DcmDspRoutineIdentifier=4110, DcmDspRoutineUsePort=0, DcmDspRoutineUsed=1, DcmDspCommonAuthorizationRef=DcmDspCommonAuthorization_d884a83
            DcmDspStartRoutine_START_ActivateZgwFlashmode (DcmDspStartRoutine): DcmDspStartRoutineFnc=EthDiagMM_RoutineControlActivateParallelFlashModeStart
          DcmDspRoutine_CheckCodingSignature: DcmDspRoutineIdentifier=3841, DcmDspRoutineUsePort=1, DcmDspRoutineUsed=1, DcmDspCommonAuthorizationRef=DcmDspCommonAuthorization_3f08b76a
            DcmDspStartRoutine_START_CheckCodingSignature (DcmDspStartRoutine)
              DcmDspStartRoutineOut_START_CheckCodingSignature (DcmDspStartRoutineOut)
                DcmDspStartRoutineOutSignal_DataOutX (DcmDspStartRoutineOutSignal): DcmDspRoutineSignalLength=8, DcmDspRoutineSignalPos=0, DcmDspRoutineSignalType=UINT8
          DcmDspRoutine_CheckHttpConnection: DcmDspRoutineIdentifier=4130, DcmDspRoutineUsePort=1, DcmDspRoutineUsed=1, DcmDspCommonAuthorizationRef=DcmDspCommonAuthorization_eabf1d27
            DcmDspStartRoutine_START_CheckHttpConnection (DcmDspStartRoutine)
              DcmDspStartRoutineIn_START_CheckHttpConnection (DcmDspStartRoutineIn)
                DcmDspStartRoutineInSignal_ServerUrl (DcmDspStartRoutineInSignal): DcmDspRoutineSignalPos=32
                DcmDspStartRoutineInSignal_TimeOutTime (DcmDspStartRoutineInSignal): DcmDspRoutineSignalEndianness=BIG_ENDIAN, DcmDspRoutineSignalLength=32, DcmDspRoutineSignalPos=0, DcmDspRoutineSignalType=UINT32
              DcmDspStartRoutineOut_START_CheckHttpConnection (DcmDspStartRoutineOut)
                DcmDspStartRoutineOutSignal_HttpConnectionStatus (DcmDspStartRoutineOutSignal): DcmDspRoutineSignalEndianness=BIG_ENDIAN, DcmDspRoutineSignalLength=8, DcmDspRoutineSignalPos=0, DcmDspRoutineSignalType=UINT8
                DcmDspStartRoutineOutSignal_HttpResponseCode (DcmDspStartRoutineOutSignal): DcmDspRoutineSignalEndianness=BIG_ENDIAN, DcmDspRoutineSignalLength=16, DcmDspRoutineSignalPos=8, DcmDspRoutineSignalType=UINT16
          DcmDspRoutine_ControlExtendedEnergySavingState: DcmDspRoutineIdentifier=4099, DcmDspRoutineUsePort=1, DcmDspRoutineUsed=1, DcmDspCommonAuthorizationRef=DcmDspCommonAuthorization_eabf1d27
            DcmDspStartRoutine_START_ControlExtendedEnergySavingState (DcmDspStartRoutine)
              DcmDspStartRoutineIn_START_ControlExtendedEnergySavingState (DcmDspStartRoutineIn)
                DcmDspStartRoutineInSignal_ExtendedOperatingMode (DcmDspStartRoutineInSignal): DcmDspRoutineSignalLength=8, DcmDspRoutineSignalPos=0, DcmDspRoutineSignalType=UINT8
          DcmDspRoutine_DiagCommLoopback: DcmDspRoutineIdentifier=771, DcmDspRoutineUsePort=1, DcmDspRoutineUsed=1, DcmDspCommonAuthorizationRef=DcmDspCommonAuthorization_eabf1d27
            DcmDspStartRoutine_START_DiagCommLoopback (DcmDspStartRoutine)
              DcmDspStartRoutineIn_START_DiagCommLoopback (DcmDspStartRoutineIn)
                DcmDspStartRoutineInSignal_dataIn (DcmDspStartRoutineInSignal): DcmDspRoutineSignalPos=0, DcmDspRoutineSignalType=VARIABLE_LENGTH
              DcmDspStartRoutineOut_START_DiagCommLoopback (DcmDspStartRoutineOut)
                DcmDspStartRoutineOutSignal_dataOut (DcmDspStartRoutineOutSignal): DcmDspRoutineSignalPos=0, DcmDspRoutineSignalType=VARIABLE_LENGTH
          DcmDspRoutine_DmClientTriggerDtcEntry: DcmDspRoutineIdentifier=772, DcmDspRoutineUsePort=1, DcmDspRoutineUsed=1, DcmDspCommonAuthorizationRef=DcmDspCommonAuthorization_eabf1d27
            DcmDspStartRoutine_START_DmClientTriggerDtcEntry (DcmDspStartRoutine)
              DcmDspStartRoutineIn_START_DmClientTriggerDtcEntry (DcmDspStartRoutineIn)
                DcmDspStartRoutineInSignal_DTCType (DcmDspStartRoutineInSignal): DcmDspRoutineSignalLength=8, DcmDspRoutineSignalPos=0, DcmDspRoutineSignalType=UINT8
              DcmDspStartRoutineOut_START_DmClientTriggerDtcEntry (DcmDspStartRoutineOut)
                4 x DcmDspStartRoutineOutSignal, all with DcmDspRoutineSignalLength=8, DcmDspRoutineSignalType=UINT8:
                  DcmDspStartRoutineOutSignal_DTCByte1: DcmDspRoutineSignalPos=8
                  DcmDspStartRoutineOutSignal_DTCByte2: DcmDspRoutineSignalPos=16
                  DcmDspStartRoutineOutSignal_DTCByte3: DcmDspRoutineSignalPos=24
                  DcmDspStartRoutineOutSignal_DTCTypeOut: DcmDspRoutineSignalPos=0
          DcmDspRoutine_Energiesparmode: DcmDspRoutineIdentifier=3852, DcmDspRoutineUsePort=1, DcmDspRoutineUsed=1, DcmDspCommonAuthorizationRef=DcmDspCommonAuthorization_eabf1d27
            DcmDspStartRoutine_START_Energiesparmode (DcmDspStartRoutine)
              DcmDspStartRoutineIn_START_Energiesparmode (DcmDspStartRoutineIn)
                DcmDspStartRoutineInSignal_OperatingMode (DcmDspStartRoutineInSignal): DcmDspRoutineSignalLength=8, DcmDspRoutineSignalPos=0, DcmDspRoutineSignalType=UINT8
          DcmDspRoutine_EraseIdrData: DcmDspRoutineIdentifier=4122, DcmDspRoutineUsePort=1, DcmDspRoutineUsed=1, DcmDspCommonAuthorizationRef=DcmDspCommonAuthorization_d884a83
            DcmDspStartRoutine_START_EraseIdrData (DcmDspStartRoutine)
              DcmDspStartRoutineOut_START_EraseIdrData (DcmDspStartRoutineOut)
                DcmDspStartRoutineOutSignal_routineResult (DcmDspStartRoutineOutSignal): DcmDspRoutineSignalLength=8, DcmDspRoutineSignalPos=0, DcmDspRoutineSignalType=UINT8
          DcmDspRoutine_EthArlTable: DcmDspRoutineIdentifier=4162, DcmDspRoutineUsePort=1, DcmDspRoutineUsed=1, DcmDspCommonAuthorizationRef=DcmDspCommonAuthorization_eabf1d27
            DcmDspStartRoutine_START_EthArlTable (DcmDspStartRoutine)
              DcmDspStartRoutineIn_START_EthArlTable (DcmDspStartRoutineIn)
                DcmDspStartRoutineInSignal_PortIndex (DcmDspStartRoutineInSignal): DcmDspRoutineSignalEndianness=BIG_ENDIAN, DcmDspRoutineSignalLength=8, DcmDspRoutineSignalPos=0, DcmDspRoutineSignalType=UINT8
              DcmDspStartRoutineOut_START_EthArlTable (DcmDspStartRoutineOut)
                DcmDspStartRoutineOutSignal_StatArlVlanIdEntries (DcmDspStartRoutineOutSignal): DcmDspRoutineSignalPos=8
                DcmDspStartRoutineOutSignal_StatNumArlVlanIdEntriesWert (DcmDspStartRoutineOutSignal): DcmDspRoutineSignalEndianness=BIG_ENDIAN, DcmDspRoutineSignalLength=8, DcmDspRoutineSignalPos=0, DcmDspRoutineSignalType=UINT8
          DcmDspRoutine_EthArpTable: DcmDspRoutineIdentifier=4163, DcmDspRoutineUsePort=1, DcmDspRoutineUsed=1, DcmDspCommonAuthorizationRef=DcmDspCommonAuthorization_eabf1d27
            DcmDspStartRoutine_START_EthArpTable (DcmDspStartRoutine)
              DcmDspStartRoutineIn_START_EthArpTable (DcmDspStartRoutineIn)
                DcmDspStartRoutineInSignal_ArpTableForIpAddress (DcmDspStartRoutineInSignal): DcmDspRoutineSignalPos=8
                DcmDspStartRoutineInSignal_IpVersion (DcmDspStartRoutineInSignal): DcmDspRoutineSignalEndianness=BIG_ENDIAN, DcmDspRoutineSignalLength=8, DcmDspRoutineSignalPos=0, DcmDspRoutineSignalType=UINT8
              DcmDspStartRoutineOut_START_EthArpTable (DcmDspStartRoutineOut)
                DcmDspStartRoutineOutSignal_StatArpIpMacEntries (DcmDspStartRoutineOutSignal): DcmDspRoutineSignalPos=8
                DcmDspStartRoutineOutSignal_StatNumArpEntriesWert (DcmDspStartRoutineOutSignal): DcmDspRoutineSignalEndianness=BIG_ENDIAN, DcmDspRoutineSignalLength=8, DcmDspRoutineSignalPos=0, DcmDspRoutineSignalType=UINT8
          DcmDspRoutine_EthEnableTestMode: DcmDspRoutineIdentifier=4172, DcmDspRoutineUsePort=1, DcmDspRoutineUsed=1, DcmDspCommonAuthorizationRef=DcmDspCommonAuthorization_d884a83
            DcmDspStartRoutine_START_EthEnableTestMode (DcmDspStartRoutine)
              DcmDspStartRoutineIn_START_EthEnableTestMode (DcmDspStartRoutineIn)
                3 x DcmDspStartRoutineInSignal, all with DcmDspRoutineSignalEndianness=BIG_ENDIAN, DcmDspRoutineSignalLength=8, DcmDspRoutineSignalType=UINT8:
                  DcmDspStartRoutineInSignal_PortIndex: DcmDspRoutineSignalPos=0
                  DcmDspStartRoutineInSignal_TestDuration: DcmDspRoutineSignalPos=8
                  DcmDspStartRoutineInSignal_TestModeId: DcmDspRoutineSignalPos=16
              DcmDspStartRoutineOut_START_EthEnableTestMode (DcmDspStartRoutineOut)
                DcmDspStartRoutineOutSignal_StatPhyTestMode (DcmDspStartRoutineOutSignal): DcmDspRoutineSignalEndianness=BIG_ENDIAN, DcmDspRoutineSignalLength=8, DcmDspRoutineSignalPos=0, DcmDspRoutineSignalType=UINT8
          DcmDspRoutine_EthExtendedArlTable: DcmDspRoutineIdentifier=4174, DcmDspRoutineUsePort=1, DcmDspRoutineUsed=1, DcmDspCommonAuthorizationRef=DcmDspCommonAuthorization_eabf1d27
            DcmDspStartRoutine_START_EthExtendedArlTable (DcmDspStartRoutine)
              DcmDspStartRoutineOut_START_EthExtendedArlTable (DcmDspStartRoutineOut)
                DcmDspStartRoutineOutSignal_StatExtendedArlVlanIdEntries (DcmDspStartRoutineOutSignal): DcmDspRoutineSignalPos=8
                DcmDspStartRoutineOutSignal_StatNumArlVlanIdEntriesWert (DcmDspStartRoutineOutSignal): DcmDspRoutineSignalEndianness=BIG_ENDIAN, DcmDspRoutineSignalLength=8, DcmDspRoutineSignalPos=0, DcmDspRoutineSignalType=UINT8
          DcmDspRoutine_EthGetDhcpStatus: DcmDspRoutineIdentifier=4175, DcmDspRoutineUsePort=1, DcmDspRoutineUsed=1, DcmDspCommonAuthorizationRef=DcmDspCommonAuthorization_ba9a6fdf
            DcmDspStartRoutine_START_EthGetDhcpStatus (DcmDspStartRoutine)
              DcmDspStartRoutineIn_START_EthGetDhcpStatus (DcmDspStartRoutineIn)
                DcmDspStartRoutineInSignal_NwInterfaceIndex (DcmDspStartRoutineInSignal): DcmDspRoutineSignalEndianness=BIG_ENDIAN, DcmDspRoutineSignalLength=8, DcmDspRoutineSignalPos=0, DcmDspRoutineSignalType=UINT8
              DcmDspStartRoutineOut_START_EthGetDhcpStatus (DcmDspStartRoutineOut)
                DcmDspStartRoutineOutSignal_StatDhcpClientState (DcmDspStartRoutineOutSignal): DcmDspRoutineSignalEndianness=BIG_ENDIAN, DcmDspRoutineSignalLength=8, DcmDspRoutineSignalPos=0, DcmDspRoutineSignalType=UINT8
          DcmDspRoutine_EthGetEthernetSwitches: DcmDspRoutineIdentifier=4176, DcmDspRoutineUsePort=1, DcmDspRoutineUsed=1, DcmDspCommonAuthorizationRef=DcmDspCommonAuthorization_ba9a6fdf
            DcmDspStartRoutine_START_EthGetEthernetSwitches (DcmDspStartRoutine)
              DcmDspStartRoutineOut_START_EthGetEthernetSwitches (DcmDspStartRoutineOut)
                DcmDspStartRoutineOutSignal_StatEthSwitchEntries (DcmDspStartRoutineOutSignal): DcmDspRoutineSignalPos=8
                DcmDspStartRoutineOutSignal_StatNumEthSwitchEntriesWert (DcmDspStartRoutineOutSignal): DcmDspRoutineSignalEndianness=BIG_ENDIAN, DcmDspRoutineSignalLength=8, DcmDspRoutineSignalPos=0, DcmDspRoutineSignalType=UINT8
          DcmDspRoutine_EthGetPortTxRxStats: DcmDspRoutineIdentifier=4169, DcmDspRoutineUsePort=1, DcmDspRoutineUsed=1, DcmDspCommonAuthorizationRef=DcmDspCommonAuthorization_eabf1d27
            DcmDspStartRoutine_START_EthGetPortTxRxStats (DcmDspStartRoutine)
              DcmDspStartRoutineIn_START_EthGetPortTxRxStats (DcmDspStartRoutineIn)
                DcmDspStartRoutineInSignal_PortIndex (DcmDspStartRoutineInSignal): DcmDspRoutineSignalEndianness=BIG_ENDIAN, DcmDspRoutineSignalLength=8, DcmDspRoutineSignalPos=0, DcmDspRoutineSignalType=UINT8
              DcmDspStartRoutineOut_START_EthGetPortTxRxStats (DcmDspStartRoutineOut)
                6 x DcmDspStartRoutineOutSignal, all with DcmDspRoutineSignalEndianness=BIG_ENDIAN, DcmDspRoutineSignalLength=32, DcmDspRoutineSignalType=UINT32:
                  DcmDspStartRoutineOutSignal_StatBytesSentWert: DcmDspRoutineSignalPos=32
                  DcmDspStartRoutineOutSignal_StatNumberOfDroppedRxPacketsWert: DcmDspRoutineSignalPos=160
                  DcmDspStartRoutineOutSignal_StatNumberOfDroppedTxPacketsWert: DcmDspRoutineSignalPos=64
                  DcmDspStartRoutineOutSignal_StatNumberOfReceivedPacketsWert: DcmDspRoutineSignalPos=96
                  DcmDspStartRoutineOutSignal_StatNumberOfTransmittedPacketsWert: DcmDspRoutineSignalPos=0
                  DcmDspStartRoutineOutSignal_StatStatBytesReceivedWert: DcmDspRoutineSignalPos=128
          DcmDspRoutine_EthGetSwitchVlanConfiguration: DcmDspRoutineIdentifier=4177, DcmDspRoutineUsePort=1, DcmDspRoutineUsed=1, DcmDspCommonAuthorizationRef=DcmDspCommonAuthorization_ba9a6fdf
            DcmDspStartRoutine_START_EthGetSwitchVlanConfiguration (DcmDspStartRoutine)
              DcmDspStartRoutineIn_START_EthGetSwitchVlanConfiguration (DcmDspStartRoutineIn)
                DcmDspStartRoutineInSignal_SwitchIndex (DcmDspStartRoutineInSignal): DcmDspRoutineSignalEndianness=BIG_ENDIAN, DcmDspRoutineSignalLength=8, DcmDspRoutineSignalPos=0, DcmDspRoutineSignalType=UINT8
              DcmDspStartRoutineOut_START_EthGetSwitchVlanConfiguration (DcmDspStartRoutineOut)
                DcmDspStartRoutineOutSignal_StatNumVlanConfigurationEntriesWert (DcmDspStartRoutineOutSignal): DcmDspRoutineSignalEndianness=BIG_ENDIAN, DcmDspRoutineSignalLength=8, DcmDspRoutineSignalPos=0, DcmDspRoutineSignalType=UINT8
                DcmDspStartRoutineOutSignal_StatVlanConfigEntries (DcmDspStartRoutineOutSignal): DcmDspRoutineSignalPos=8
          DcmDspRoutine_EthIpConfiguration: DcmDspRoutineIdentifier=4165, DcmDspRoutineUsePort=1, DcmDspRoutineUsed=1, DcmDspCommonAuthorizationRef=DcmDspCommonAuthorization_eabf1d27
            DcmDspStartRoutine_START_EthIpConfiguration (DcmDspStartRoutine)
              DcmDspStartRoutineIn_START_EthIpConfiguration (DcmDspStartRoutineIn)
                DcmDspStartRoutineInSignal_InternalExternalAddress (DcmDspStartRoutineInSignal): DcmDspRoutineSignalEndianness=BIG_ENDIAN, DcmDspRoutineSignalLength=8, DcmDspRoutineSignalPos=0, DcmDspRoutineSignalType=UINT8
                DcmDspStartRoutineInSignal_TriggerGratuitousArp (DcmDspStartRoutineInSignal): DcmDspRoutineSignalEndianness=BIG_ENDIAN, DcmDspRoutineSignalLength=8, DcmDspRoutineSignalPos=8, DcmDspRoutineSignalType=UINT8
              DcmDspStartRoutineOut_START_EthIpConfiguration (DcmDspStartRoutineOut)
                DcmDspStartRoutineOutSignal_EcuType (DcmDspStartRoutineOutSignal): DcmDspRoutineSignalEndianness=BIG_ENDIAN, DcmDspRoutineSignalLength=8, DcmDspRoutineSignalPos=0, DcmDspRoutineSignalType=UINT8
                DcmDspStartRoutineOutSignal_StatEthIpConfiguration (DcmDspStartRoutineOutSignal): DcmDspRoutineSignalPos=8
          DcmDspRoutine_EthPhyIdentifier: DcmDspRoutineIdentifier=4167, DcmDspRoutineUsePort=1, DcmDspRoutineUsed=1, DcmDspCommonAuthorizationRef=DcmDspCommonAuthorization_eabf1d27
            DcmDspStartRoutine_START_EthPhyIdentifier (DcmDspStartRoutine)
              DcmDspStartRoutineIn_START_EthPhyIdentifier (DcmDspStartRoutineIn)
                DcmDspStartRoutineInSignal_PortIndex (DcmDspStartRoutineInSignal): DcmDspRoutineSignalEndianness=BIG_ENDIAN, DcmDspRoutineSignalLength=8, DcmDspRoutineSignalPos=0, DcmDspRoutineSignalType=UINT8
              DcmDspStartRoutineOut_START_EthPhyIdentifier (DcmDspStartRoutineOut)
                DcmDspStartRoutineOutSignal_StatOuiData (DcmDspStartRoutineOutSignal): DcmDspRoutineSignalEndianness=BIG_ENDIAN, DcmDspRoutineSignalLength=48, DcmDspRoutineSignalPos=0, DcmDspRoutineSignalType=VARIABLE_LENGTH
          DcmDspRoutine_EthPhySwitchEngineReset: DcmDspRoutineIdentifier=4164, DcmDspRoutineUsePort=1, DcmDspRoutineUsed=1, DcmDspCommonAuthorizationRef=DcmDspCommonAuthorization_d884a83
            DcmDspStartRoutine_START_EthPhySwitchEngineReset (DcmDspStartRoutine)
              DcmDspStartRoutineIn_START_EthPhySwitchEngineReset (DcmDspStartRoutineIn)
                DcmDspStartRoutineInSignal_PortIndex (DcmDspStartRoutineInSignal): DcmDspRoutineSignalEndianness=BIG_ENDIAN, DcmDspRoutineSignalLength=8, DcmDspRoutineSignalPos=0, DcmDspRoutineSignalType=UINT8
                DcmDspStartRoutineInSignal_StopPhyForT (DcmDspStartRoutineInSignal): DcmDspRoutineSignalEndianness=BIG_ENDIAN, DcmDspRoutineSignalLength=8, DcmDspRoutineSignalPos=8, DcmDspRoutineSignalType=UINT8
              DcmDspStartRoutineOut_START_EthPhySwitchEngineReset (DcmDspStartRoutineOut)
                DcmDspStartRoutineOutSignal_StatPhyReset (DcmDspStartRoutineOutSignal): DcmDspRoutineSignalEndianness=BIG_ENDIAN, DcmDspRoutineSignalLength=8, DcmDspRoutineSignalPos=0, DcmDspRoutineSignalType=UINT8
          DcmDspRoutine_EthReadPhyRegister: DcmDspRoutineIdentifier=4161, DcmDspRoutineUsePort=1, DcmDspRoutineUsed=1, DcmDspCommonAuthorizationRef=DcmDspCommonAuthorization_eabf1d27
            DcmDspStartRoutine_START_EthReadPhyRegister (DcmDspStartRoutine)
              DcmDspStartRoutineIn_START_EthReadPhyRegister (DcmDspStartRoutineIn)
                DcmDspStartRoutineInSignal_Data (DcmDspStartRoutineInSignal): DcmDspRoutineSignalPos=8
                DcmDspStartRoutineInSignal_RegReadRange (DcmDspStartRoutineInSignal): DcmDspRoutineSignalEndianness=BIG_ENDIAN, DcmDspRoutineSignalLength=8, DcmDspRoutineSignalPos=0, DcmDspRoutineSignalType=UINT8
              DcmDspStartRoutineOut_START_EthReadPhyRegister (DcmDspStartRoutineOut)
                DcmDspStartRoutineOutSignal_StatRegReadData (DcmDspStartRoutineOutSignal): DcmDspRoutineSignalPos=8
                DcmDspStartRoutineOutSignal_StatRegReadOk (DcmDspStartRoutineOutSignal): DcmDspRoutineSignalEndianness=BIG_ENDIAN, DcmDspRoutineSignalLength=8, DcmDspRoutineSignalPos=0, DcmDspRoutineSignalType=UINT8
          DcmDspRoutine_EthResetPortTxRxStats: DcmDspRoutineIdentifier=4171, DcmDspRoutineUsePort=1, DcmDspRoutineUsed=1, DcmDspCommonAuthorizationRef=DcmDspCommonAuthorization_eabf1d27
            DcmDspStartRoutine_START_EthResetPortTxRxStats (DcmDspStartRoutine)
          DcmDspRoutine_EthWritePhyRegister: DcmDspRoutineIdentifier=4173, DcmDspRoutineUsePort=1, DcmDspRoutineUsed=1, DcmDspCommonAuthorizationRef=DcmDspCommonAuthorization_d884a83
            DcmDspStartRoutine_START_EthWritePhyRegister (DcmDspStartRoutine)
              DcmDspStartRoutineIn_START_EthWritePhyRegister (DcmDspStartRoutineIn)
                DcmDspStartRoutineInSignal_Data (DcmDspStartRoutineInSignal): DcmDspRoutineSignalPos=8
                DcmDspStartRoutineInSignal_RegWriteProtect (DcmDspStartRoutineInSignal): DcmDspRoutineSignalEndianness=BIG_ENDIAN, DcmDspRoutineSignalLength=8, DcmDspRoutineSignalPos=0, DcmDspRoutineSignalType=UINT8
              DcmDspStartRoutineOut_START_EthWritePhyRegister (DcmDspStartRoutineOut)
                DcmDspStartRoutineOutSignal_StatRegWriteOk (DcmDspStartRoutineOutSignal): DcmDspRoutineSignalEndianness=BIG_ENDIAN, DcmDspRoutineSignalLength=8, DcmDspRoutineSignalPos=0, DcmDspRoutineSignalType=UINT8
          DcmDspRoutine_ExternalHsfz: DcmDspRoutineIdentifier=4131, DcmDspRoutineUsePort=0, DcmDspRoutineUsed=1, DcmDspCommonAuthorizationRef=DcmDspCommonAuthorization_eabf1d27
            DcmDspStartRoutine_START_ExternalHsfz (DcmDspStartRoutine): DcmDspStartRoutineFnc=EthDiagMM_RoutineControlSetDiagIfcStart
              DcmDspStartRoutineIn_START_ExternalHsfz (DcmDspStartRoutineIn)
                DcmDspStartRoutineInSignal_Activation (DcmDspStartRoutineInSignal): DcmDspRoutineSignalLength=8, DcmDspRoutineSignalPos=0, DcmDspRoutineSignalType=UINT8
          DcmDspRoutine_FehlerspeicherEndeWerksablauf: DcmDspRoutineIdentifier=4193, DcmDspRoutineUsePort=1, DcmDspRoutineUsed=1, DcmDspCommonAuthorizationRef=DcmDspCommonAuthorization_eabf1d27
            DcmDspRequestRoutineResults_RESULT_FehlerspeicherEndeWerksablauf (DcmDspRequestRoutineResults)
              RESULT_FehlerspeicherEndeWerksablauf_OUT (DcmDspRequestRoutineResultsOut)
                DcmDspRequestRoutineResultsOutSignal_StatFsEndeWabl (DcmDspRequestRoutineResultsOutSignal): DcmDspRoutineSignalEndianness=BIG_ENDIAN, DcmDspRoutineSignalLength=8, DcmDspRoutineSignalPos=0, DcmDspRoutineSignalType=UINT8
            DcmDspStartRoutine_START_FehlerspeicherEndeWerksablauf (DcmDspStartRoutine)
          DcmDspRoutine_FsMsmN101AbfrageFzgsec: DcmDspRoutineIdentifier=532, DcmDspRoutineUsePort=1, DcmDspRoutineUsed=1, DcmDspCommonAuthorizationRef=DcmDspCommonAuthorization_d884a83
            DcmDspStartRoutine_START_FsMsmN101AbfrageFzgsec (DcmDspStartRoutine)
              DcmDspStartRoutineIn_START_FsMsmN101AbfrageFzgsec (DcmDspStartRoutineIn)
                DcmDspStartRoutineInSignal_FunktionsId (DcmDspStartRoutineInSignal): DcmDspRoutineSignalEndianness=BIG_ENDIAN, DcmDspRoutineSignalLength=8, DcmDspRoutineSignalPos=0, DcmDspRoutineSignalType=UINT8
              DcmDspStartRoutineOut_START_FsMsmN101AbfrageFzgsec (DcmDspStartRoutineOut)
                3 x DcmDspStartRoutineOutSignal, all with DcmDspRoutineSignalEndianness=BIG_ENDIAN, DcmDspRoutineSignalLength=8, DcmDspRoutineSignalType=UINT8:
                  DcmDspStartRoutineOutSignal_Res1: DcmDspRoutineSignalPos=0
                  DcmDspStartRoutineOutSignal_Res2: DcmDspRoutineSignalPos=8
                  DcmDspStartRoutineOutSignal_State: DcmDspRoutineSignalPos=16
          DcmDspRoutine_FsMsmN102: DcmDspRoutineIdentifier=560, DcmDspRoutineUsePort=1, DcmDspRoutineUsed=1, DcmDspCommonAuthorizationRef=DcmDspCommonAuthorization_d884a83
            DcmDspStartRoutine_START_FsMsmN102 (DcmDspStartRoutine)
              DcmDspStartRoutineIn_START_FsMsmN102 (DcmDspStartRoutineIn)
                DcmDspStartRoutineInSignal_FunktionsId (DcmDspStartRoutineInSignal): DcmDspRoutineSignalEndianness=BIG_ENDIAN, DcmDspRoutineSignalLength=8, DcmDspRoutineSignalPos=0, DcmDspRoutineSignalType=UINT8
              DcmDspStartRoutineOut_START_FsMsmN102 (DcmDspStartRoutineOut)
                3 x DcmDspStartRoutineOutSignal, all with DcmDspRoutineSignalEndianness=BIG_ENDIAN, DcmDspRoutineSignalLength=8, DcmDspRoutineSignalType=UINT8:
                  DcmDspStartRoutineOutSignal_Res1: DcmDspRoutineSignalPos=0
                  DcmDspStartRoutineOutSignal_Res2: DcmDspRoutineSignalPos=8
                  DcmDspStartRoutineOutSignal_State: DcmDspRoutineSignalPos=16
          DcmDspRoutine_FsMsmN111: DcmDspRoutineIdentifier=533, DcmDspRoutineUsePort=1, DcmDspRoutineUsed=1, DcmDspCommonAuthorizationRef=DcmDspCommonAuthorization_eabf1d27
            DcmDspStartRoutine_START_FsMsmN111 (DcmDspStartRoutine)
              DcmDspStartRoutineIn_START_FsMsmN111 (DcmDspStartRoutineIn)
                DcmDspStartRoutineInSignal_FscsmId (DcmDspStartRoutineInSignal): DcmDspRoutineSignalEndianness=BIG_ENDIAN, DcmDspRoutineSignalLength=8, DcmDspRoutineSignalPos=8, DcmDspRoutineSignalType=UINT8
                DcmDspStartRoutineInSignal_ParameterId (DcmDspStartRoutineInSignal): DcmDspRoutineSignalEndianness=BIG_ENDIAN, DcmDspRoutineSignalLength=8, DcmDspRoutineSignalPos=0, DcmDspRoutineSignalType=UINT8
              DcmDspStartRoutineOut_START_FsMsmN111 (DcmDspStartRoutineOut)
                4 x DcmDspStartRoutineOutSignal:
                  DcmDspStartRoutineOutSignal_Data: DcmDspRoutineSignalPos=24
                  DcmDspStartRoutineOutSignal_Len: DcmDspRoutineSignalEndianness=BIG_ENDIAN, DcmDspRoutineSignalLength=8, DcmDspRoutineSignalPos=16, DcmDspRoutineSignalType=UINT8
                  DcmDspStartRoutineOutSignal_Res1: DcmDspRoutineSignalEndianness=BIG_ENDIAN, DcmDspRoutineSignalLength=8, DcmDspRoutineSignalPos=0, DcmDspRoutineSignalType=UINT8
                  DcmDspStartRoutineOutSignal_Res2: DcmDspRoutineSignalEndianness=BIG_ENDIAN, DcmDspRoutineSignalLength=8, DcmDspRoutineSignalPos=8, DcmDspRoutineSignalType=UINT8
          DcmDspRoutine_FsMsmN220X: DcmDspRoutineIdentifier=529, DcmDspRoutineUsePort=1, DcmDspRoutineUsed=1, DcmDspCommonAuthorizationRef=DcmDspCommonAuthorization_d884a83
            DcmDspStartRoutine_START_FsMsmN220X (DcmDspStartRoutine)
              DcmDspStartRoutineIn_START_FsMsmN220X (DcmDspStartRoutineIn)
                DcmDspStartRoutineInSignal_Par3Req (DcmDspStartRoutineInSignal): DcmDspRoutineSignalEndianness=BIG_ENDIAN, DcmDspRoutineSignalLength=8, DcmDspRoutineSignalPos=0, DcmDspRoutineSignalType=UINT8
                DcmDspStartRoutineInSignal_Par4Req (DcmDspStartRoutineInSignal): DcmDspRoutineSignalEndianness=BIG_ENDIAN, DcmDspRoutineSignalLength=8, DcmDspRoutineSignalPos=8, DcmDspRoutineSignalType=UINT8
              DcmDspStartRoutineOut_START_FsMsmN220X (DcmDspStartRoutineOut)
                DcmDspStartRoutineOutSignal_Par3Resp (DcmDspStartRoutineOutSignal): DcmDspRoutineSignalEndianness=BIG_ENDIAN, DcmDspRoutineSignalLength=8, DcmDspRoutineSignalPos=0, DcmDspRoutineSignalType=UINT8
                DcmDspStartRoutineOutSignal_Par4Resp (DcmDspStartRoutineOutSignal): DcmDspRoutineSignalEndianness=BIG_ENDIAN, DcmDspRoutineSignalLength=8, DcmDspRoutineSignalPos=8, DcmDspRoutineSignalType=UINT8
          DcmDspRoutine_FsMsmN300XTeleservice: DcmDspRoutineIdentifier=528, DcmDspRoutineUsePort=1, DcmDspRoutineUsed=1, DcmDspCommonAuthorizationRef=DcmDspCommonAuthorization_eabf1d27
            DcmDspRequestRoutineResults_RESULT_FsMsmN300XTeleservice (DcmDspRequestRoutineResults)
              RESULT_FsMsmN300XTeleservice_OUT (DcmDspRequestRoutineResultsOut)
                5 x DcmDspRequestRoutineResultsOutSignal, all with DcmDspRoutineSignalEndianness=BIG_ENDIAN:
                  DcmDspRequestRoutineResultsOutSignal_IdResp: DcmDspRoutineSignalLength=8, DcmDspRoutineSignalPos=8, DcmDspRoutineSignalType=UINT8
                  DcmDspRequestRoutineResultsOutSignal_Len: DcmDspRoutineSignalLength=16, DcmDspRoutineSignalPos=24, DcmDspRoutineSignalType=UINT16
                  DcmDspRequestRoutineResultsOutSignal_Par4Resp: DcmDspRoutineSignalLength=8, DcmDspRoutineSignalPos=0, DcmDspRoutineSignalType=UINT8
                  DcmDspRequestRoutineResultsOutSignal_Par6Resp: DcmDspRoutineSignalLength=8, DcmDspRoutineSignalPos=16, DcmDspRoutineSignalType=UINT8
                  DcmDspRequestRoutineResultsOutSignal_Zufallszahl: DcmDspRoutineSignalLength=160, DcmDspRoutineSignalPos=40, DcmDspRoutineSignalType=VARIABLE_LENGTH
            DcmDspStartRoutine_START_FsMsmN300XTeleservice (DcmDspStartRoutine)
              DcmDspStartRoutineIn_START_FsMsmN300XTeleservice (DcmDspStartRoutineIn)
                5 x DcmDspStartRoutineInSignal, all with DcmDspRoutineSignalEndianness=BIG_ENDIAN, DcmDspRoutineSignalLength=8, DcmDspRoutineSignalType=UINT8:
                  DcmDspStartRoutineInSignal_Id: DcmDspRoutineSignalPos=8
                  DcmDspStartRoutineInSignal_Par4Req: DcmDspRoutineSignalPos=0
                  DcmDspStartRoutineInSignal_Par6Req: DcmDspRoutineSignalPos=16
                  DcmDspStartRoutineInSignal_Par7Req: DcmDspRoutineSignalPos=24
                  DcmDspStartRoutineInSignal_Par8Req: DcmDspRoutineSignalPos=32
              DcmDspStartRoutineOut_START_FsMsmN300XTeleservice (DcmDspStartRoutineOut)
                DcmDspStartRoutineOutSignal_Par4Resp (DcmDspStartRoutineOutSignal): DcmDspRoutineSignalEndianness=BIG_ENDIAN, DcmDspRoutineSignalLength=8, DcmDspRoutineSignalPos=0, DcmDspRoutineSignalType=UINT8
          DcmDspRoutine_FsN251: DcmDspRoutineIdentifier=564, DcmDspRoutineUsePort=1, DcmDspRoutineUsed=1, DcmDspCommonAuthorizationRef=DcmDspCommonAuthorization_eabf1d27
            DcmDspStartRoutine_START_FsN251 (DcmDspStartRoutine)
              DcmDspStartRoutineIn_START_FsN251 (DcmDspStartRoutineIn)
                DcmDspStartRoutineInSignal_Adr (DcmDspStartRoutineInSignal): DcmDspRoutineSignalPos=8
                DcmDspStartRoutineInSignal_Len (DcmDspStartRoutineInSignal): DcmDspRoutineSignalEndianness=BIG_ENDIAN, DcmDspRoutineSignalLength=8, DcmDspRoutineSignalPos=0, DcmDspRoutineSignalType=UINT8
              DcmDspStartRoutineOut_START_FsN251 (DcmDspStartRoutineOut)
                DcmDspStartRoutineOutSignal_Res1 (DcmDspStartRoutineOutSignal): DcmDspRoutineSignalEndianness=BIG_ENDIAN, DcmDspRoutineSignalLength=8, DcmDspRoutineSignalPos=0, DcmDspRoutineSignalType=UINT8
                DcmDspStartRoutineOutSignal_Res2 (DcmDspStartRoutineOutSignal): DcmDspRoutineSignalEndianness=BIG_ENDIAN, DcmDspRoutineSignalLength=8, DcmDspRoutineSignalPos=8, DcmDspRoutineSignalType=UINT8
          DcmDspRoutine_FsN252: DcmDspRoutineIdentifier=565, DcmDspRoutineUsePort=1, DcmDspRoutineUsed=1, DcmDspCommonAuthorizationRef=DcmDspCommonAuthorization_eabf1d27
            DcmDspStartRoutine_START_FsN252 (DcmDspStartRoutine)
              DcmDspStartRoutineIn_START_FsN252 (DcmDspStartRoutineIn)
                DcmDspStartRoutineInSignal_DataToCompare (DcmDspStartRoutineInSignal): DcmDspRoutineSignalLength=128, DcmDspRoutineSignalPos=0, DcmDspRoutineSignalType=VARIABLE_LENGTH
              DcmDspStartRoutineOut_START_FsN252 (DcmDspStartRoutineOut)
                DcmDspStartRoutineOutSignal_Result1 (DcmDspStartRoutineOutSignal): DcmDspRoutineSignalLength=8, DcmDspRoutineSignalPos=0, DcmDspRoutineSignalType=UINT8
                DcmDspStartRoutineOutSignal_Result2 (DcmDspStartRoutineOutSignal): DcmDspRoutineSignalLength=8, DcmDspRoutineSignalPos=8, DcmDspRoutineSignalType=UINT8
          DcmDspRoutine_FsN30X: DcmDspRoutineIdentifier=524, DcmDspRoutineUsePort=1, DcmDspRoutineUsed=1, DcmDspCommonAuthorizationRef=DcmDspCommonAuthorization_eabf1d27
            DcmDspRequestRoutineResults_RESULT_FsN30X (DcmDspRequestRoutineResults)
              RESULT_FsN30X_OUT (DcmDspRequestRoutineResultsOut)
                DcmDspRequestRoutineResultsOutSignal_Par4Resp (DcmDspRequestRoutineResultsOutSignal): DcmDspRoutineSignalEndianness=BIG_ENDIAN, DcmDspRoutineSignalLength=8, DcmDspRoutineSignalPos=0, DcmDspRoutineSignalType=UINT8
                DcmDspRequestRoutineResultsOutSignal_R1R2R3 (DcmDspRequestRoutineResultsOutSignal): DcmDspRoutineSignalEndianness=BIG_ENDIAN, DcmDspRoutineSignalLength=32, DcmDspRoutineSignalPos=8, DcmDspRoutineSignalType=VARIABLE_LENGTH
            DcmDspStartRoutine_START_FsN30X (DcmDspStartRoutine)
              DcmDspStartRoutineIn_START_FsN30X (DcmDspStartRoutineIn)
                5 x DcmDspStartRoutineInSignal:
                  DcmDspStartRoutineInSignal_Enc: DcmDspRoutineSignalPos=40
                  DcmDspStartRoutineInSignal_Id: DcmDspRoutineSignalEndianness=BIG_ENDIAN, DcmDspRoutineSignalLength=8, DcmDspRoutineSignalPos=8, DcmDspRoutineSignalType=UINT8
                  DcmDspStartRoutineInSignal_Len: DcmDspRoutineSignalEndianness=BIG_ENDIAN, DcmDspRoutineSignalLength=16, DcmDspRoutineSignalPos=24, DcmDspRoutineSignalType=UINT16
                  DcmDspStartRoutineInSignal_Par4Req: DcmDspRoutineSignalEndianness=BIG_ENDIAN, DcmDspRoutineSignalLength=8, DcmDspRoutineSignalPos=0, DcmDspRoutineSignalType=UINT8
                  DcmDspStartRoutineInSignal_Par6Req: DcmDspRoutineSignalEndianness=BIG_ENDIAN, DcmDspRoutineSignalLength=8, DcmDspRoutineSignalPos=16, DcmDspRoutineSignalType=UINT8
              DcmDspStartRoutineOut_START_FsN30X (DcmDspStartRoutineOut)
                DcmDspStartRoutineOutSignal_Par4Resp (DcmDspStartRoutineOutSignal): DcmDspRoutineSignalEndianness=BIG_ENDIAN, DcmDspRoutineSignalLength=8, DcmDspRoutineSignalPos=0, DcmDspRoutineSignalType=UINT8
          DcmDspRoutine_FsN31034: DcmDspRoutineIdentifier=530, DcmDspRoutineUsePort=1, DcmDspRoutineUsed=1, DcmDspCommonAuthorizationRef=DcmDspCommonAuthorization_d884a83
            DcmDspStartRoutine_START_FsN31034 (DcmDspStartRoutine)
              DcmDspStartRoutineIn_START_FsN31034 (DcmDspStartRoutineIn)
                4 x DcmDspStartRoutineInSignal:
                  DcmDspStartRoutineInSignal_Data: DcmDspRoutineSignalPos=32
                  DcmDspStartRoutineInSignal_Len: DcmDspRoutineSignalEndianness=BIG_ENDIAN, DcmDspRoutineSignalLength=16, DcmDspRoutineSignalPos=16, DcmDspRoutineSignalType=UINT16
                  DcmDspStartRoutineInSignal_Par4Req: DcmDspRoutineSignalEndianness=BIG_ENDIAN, DcmDspRoutineSignalLength=8, DcmDspRoutineSignalPos=0, DcmDspRoutineSignalType=UINT8
                  DcmDspStartRoutineInSignal_Par5: DcmDspRoutineSignalEndianness=BIG_ENDIAN, DcmDspRoutineSignalLength=8, DcmDspRoutineSignalPos=8, DcmDspRoutineSignalType=UINT8
              DcmDspStartRoutineOut_START_FsN31034 (DcmDspStartRoutineOut)
                DcmDspStartRoutineOutSignal_Par4Resp (DcmDspStartRoutineOutSignal): DcmDspRoutineSignalEndianness=BIG_ENDIAN, DcmDspRoutineSignalLength=8, DcmDspRoutineSignalPos=0, DcmDspRoutineSignalType=UINT8
          DcmDspRoutine_FsN5005: DcmDspRoutineIdentifier=531, DcmDspRoutineUsePort=1, DcmDspRoutineUsed=1, DcmDspCommonAuthorizationRef=DcmDspCommonAuthorization_d884a83
            DcmDspRequestRoutineResults_RESULT_FsN5005 (DcmDspRequestRoutineResults)
              RESULT_FsN5005_OUT (DcmDspRequestRoutineResultsOut)
                4 x DcmDspRequestRoutineResultsOutSignal:
                  DcmDspRequestRoutineResultsOutSignal_Len: DcmDspRoutineSignalEndianness=BIG_ENDIAN, DcmDspRoutineSignalLength=8, DcmDspRoutineSignalPos=16, DcmDspRoutineSignalType=UINT8
                  DcmDspRequestRoutineResultsOutSignal_Res1: DcmDspRoutineSignalEndianness=BIG_ENDIAN, DcmDspRoutineSignalLength=8, DcmDspRoutineSignalPos=0, DcmDspRoutineSignalType=UINT8
                  DcmDspRequestRoutineResultsOutSignal_Res2: DcmDspRoutineSignalEndianness=BIG_ENDIAN, DcmDspRoutineSignalLength=8, DcmDspRoutineSignalPos=8, DcmDspRoutineSignalType=UINT8
                  DcmDspRequestRoutineResultsOutSignal_SgMitFehlern: DcmDspRoutineSignalPos=24
            DcmDspStartRoutine_START_FsN5005 (DcmDspStartRoutine)
              DcmDspStartRoutineIn_START_FsN5005 (DcmDspStartRoutineIn)
                DcmDspStartRoutineInSignal_Adr (DcmDspStartRoutineInSignal): DcmDspRoutineSignalPos=8
                DcmDspStartRoutineInSignal_Len (DcmDspStartRoutineInSignal): DcmDspRoutineSignalEndianness=BIG_ENDIAN, DcmDspRoutineSignalLength=8, DcmDspRoutineSignalPos=0, DcmDspRoutineSignalType=UINT8
              DcmDspStartRoutineOut_START_FsN5005 (DcmDspStartRoutineOut)
                DcmDspStartRoutineOutSignal_Res1 (DcmDspStartRoutineOutSignal): DcmDspRoutineSignalEndianness=BIG_ENDIAN, DcmDspRoutineSignalLength=8, DcmDspRoutineSignalPos=0, DcmDspRoutineSignalType=UINT8
                DcmDspStartRoutineOutSignal_Res2 (DcmDspStartRoutineOutSignal): DcmDspRoutineSignalEndianness=BIG_ENDIAN, DcmDspRoutineSignalLength=8, DcmDspRoutineSignalPos=8, DcmDspRoutineSignalType=UINT8
          DcmDspRoutine_FsN5012: DcmDspRoutineIdentifier=568, DcmDspRoutineUsePort=1, DcmDspRoutineUsed=1, DcmDspCommonAuthorizationRef=DcmDspCommonAuthorization_eabf1d27
            DcmDspRequestRoutineResults_RESULT_FsN5012 (DcmDspRequestRoutineResults)
              RESULT_FsN5012_OUT (DcmDspRequestRoutineResultsOut)
                3 x DcmDspRequestRoutineResultsOutSignal:
                  DcmDspRequestRoutineResultsOutSignal_RandomNumberFscsm: DcmDspRoutineSignalLength=128, DcmDspRoutineSignalPos=16, DcmDspRoutineSignalType=VARIABLE_LENGTH
                  DcmDspRequestRoutineResultsOutSignal_Result1: DcmDspRoutineSignalLength=8, DcmDspRoutineSignalPos=0, DcmDspRoutineSignalType=UINT8
                  DcmDspRequestRoutineResultsOutSignal_Result2: DcmDspRoutineSignalLength=8, DcmDspRoutineSignalPos=8, DcmDspRoutineSignalType=UINT8
            DcmDspStartRoutine_START_FsN5012 (DcmDspStartRoutine)
              DcmDspStartRoutineOut_START_FsN5012 (DcmDspStartRoutineOut)
                DcmDspStartRoutineOutSignal_Result1 (DcmDspStartRoutineOutSignal): DcmDspRoutineSignalLength=8, DcmDspRoutineSignalPos=0, DcmDspRoutineSignalType=UINT8
                DcmDspStartRoutineOutSignal_Result2 (DcmDspStartRoutineOutSignal): DcmDspRoutineSignalLength=8, DcmDspRoutineSignalPos=8, DcmDspRoutineSignalType=UINT8
          DcmDspRoutine_FsN5034: DcmDspRoutineIdentifier=569, DcmDspRoutineUsePort=1, DcmDspRoutineUsed=1, DcmDspCommonAuthorizationRef=DcmDspCommonAuthorization_eabf1d27
            DcmDspRequestRoutineResults_RESULT_FsN5034 (DcmDspRequestRoutineResults)
              RESULT_FsN5034_OUT (DcmDspRequestRoutineResultsOut)
                DcmDspRequestRoutineResultsOutSignal_Result1 (DcmDspRequestRoutineResultsOutSignal): DcmDspRoutineSignalLength=8, DcmDspRoutineSignalPos=0, DcmDspRoutineSignalType=UINT8
                DcmDspRequestRoutineResultsOutSignal_Result2 (DcmDspRequestRoutineResultsOutSignal): DcmDspRoutineSignalLength=8, DcmDspRoutineSignalPos=8, DcmDspRoutineSignalType=UINT8
            DcmDspStartRoutine_START_FsN5034 (DcmDspStartRoutine)
              DcmDspStartRoutineIn_START_FsN5034 (DcmDspStartRoutineIn)
                DcmDspStartRoutineInSignal_Data (DcmDspStartRoutineInSignal): DcmDspRoutineSignalLength=792, DcmDspRoutineSignalPos=0, DcmDspRoutineSignalType=VARIABLE_LENGTH
              DcmDspStartRoutineOut_START_FsN5034 (DcmDspStartRoutineOut)
                DcmDspStartRoutineOutSignal_Result1 (DcmDspStartRoutineOutSignal): DcmDspRoutineSignalLength=8, DcmDspRoutineSignalPos=0, DcmDspRoutineSignalType=UINT8
                DcmDspStartRoutineOutSignal_Result2 (DcmDspStartRoutineOutSignal): DcmDspRoutineSignalLength=8, DcmDspRoutineSignalPos=8, DcmDspRoutineSignalType=UINT8
          DcmDspRoutine_FsN70X: DcmDspRoutineIdentifier=527, DcmDspRoutineUsePort=1, DcmDspRoutineUsed=1, DcmDspCommonAuthorizationRef=DcmDspCommonAuthorization_eabf1d27
            DcmDspRequestRoutineResults_RESULT_FsN70X (DcmDspRequestRoutineResults)
              RESULT_FsN70X_OUT (DcmDspRequestRoutineResultsOut)
                DcmDspRequestRoutineResultsOutSignal_Par4Resp (DcmDspRequestRoutineResultsOutSignal): DcmDspRoutineSignalEndianness=BIG_ENDIAN, DcmDspRoutineSignalLength=8, DcmDspRoutineSignalPos=0, DcmDspRoutineSignalType=UINT8
                DcmDspRequestRoutineResultsOutSignal_Result (DcmDspRequestRoutineResultsOutSignal): DcmDspRoutineSignalEndianness=BIG_ENDIAN, DcmDspRoutineSignalLength=8, DcmDspRoutineSignalPos=8, DcmDspRoutineSignalType=UINT8
            DcmDspStartRoutine_START_FsN70X (DcmDspStartRoutine)
              DcmDspStartRoutineIn_START_FsN70X (DcmDspStartRoutineIn)
                DcmDspStartRoutineInSignal_Adr (DcmDspStartRoutineInSignal): DcmDspRoutineSignalEndianness=BIG_ENDIAN, DcmDspRoutineSignalLength=8, DcmDspRoutineSignalPos=8, DcmDspRoutineSignalType=UINT8
                DcmDspStartRoutineInSignal_Par4Req (DcmDspStartRoutineInSignal): DcmDspRoutineSignalEndianness=BIG_ENDIAN, DcmDspRoutineSignalLength=8, DcmDspRoutineSignalPos=0, DcmDspRoutineSignalType=UINT8
              DcmDspStartRoutineOut_START_FsN70X (DcmDspStartRoutineOut)
                DcmDspStartRoutineOutSignal_Par4Resp (DcmDspStartRoutineOutSignal): DcmDspRoutineSignalEndianness=BIG_ENDIAN, DcmDspRoutineSignalLength=8, DcmDspRoutineSignalPos=0, DcmDspRoutineSignalType=UINT8
          DcmDspRoutine_FsN7112: DcmDspRoutineIdentifier=534, DcmDspRoutineUsePort=1, DcmDspRoutineUsed=1, DcmDspCommonAuthorizationRef=DcmDspCommonAuthorization_eabf1d27
            DcmDspRequestRoutineResults_RESULT_FsN7112 (DcmDspRequestRoutineResults)
              RESULT_FsN7112_OUT (DcmDspRequestRoutineResultsOut)
                3 x DcmDspRequestRoutineResultsOutSignal:
                  DcmDspRequestRoutineResultsOutSignal_Result1: DcmDspRoutineSignalLength=8, DcmDspRoutineSignalPos=0, DcmDspRoutineSignalType=UINT8
                  DcmDspRequestRoutineResultsOutSignal_Result2: DcmDspRoutineSignalLength=8, DcmDspRoutineSignalPos=8, DcmDspRoutineSignalType=UINT8
                  DcmDspRequestRoutineResultsOutSignal_ResultResponse: DcmDspRoutineSignalLength=128, DcmDspRoutineSignalPos=16, DcmDspRoutineSignalType=VARIABLE_LENGTH
            DcmDspStartRoutine_START_FsN7112 (DcmDspStartRoutine)
              DcmDspStartRoutineIn_START_FsN7112 (DcmDspStartRoutineIn)
                DcmDspStartRoutineInSignal_Challenge (DcmDspStartRoutineInSignal): DcmDspRoutineSignalLength=128, DcmDspRoutineSignalPos=0, DcmDspRoutineSignalType=VARIABLE_LENGTH
              DcmDspStartRoutineOut_START_FsN7112 (DcmDspStartRoutineOut)
                DcmDspStartRoutineOutSignal_Result1 (DcmDspStartRoutineOutSignal): DcmDspRoutineSignalLength=8, DcmDspRoutineSignalPos=0, DcmDspRoutineSignalType=UINT8
                DcmDspStartRoutineOutSignal_Result2 (DcmDspStartRoutineOutSignal): DcmDspRoutineSignalLength=8, DcmDspRoutineSignalPos=8, DcmDspRoutineSignalType=UINT8
          DcmDspRoutine_GetActualConfig: DcmDspRoutineIdentifier=4113, DcmDspRoutineUsePort=0, DcmDspRoutineUsed=1, DcmDspCommonAuthorizationRef=DcmDspCommonAuthorization_eabf1d27
            DcmDspStartRoutine_START_GetActualConfig (DcmDspStartRoutine): DcmDspStartRoutineFnc=EthDiagMM_RoutineControlGetActualConfigStart
              DcmDspStartRoutineOut_START_GetActualConfig (DcmDspStartRoutineOut)
                DcmDspStartRoutineOutSignal_EcuAddress (DcmDspStartRoutineOutSignal): DcmDspRoutineSignalLength=8, DcmDspRoutineSignalPos=8, DcmDspRoutineSignalType=UINT8
                DcmDspStartRoutineOutSignal_StatIdsWert (DcmDspStartRoutineOutSignal): DcmDspRoutineSignalLength=8, DcmDspRoutineSignalPos=0, DcmDspRoutineSignalType=UINT8
          DcmDspRoutine_IndividualDatenRettung: DcmDspRoutineIdentifier=4098, DcmDspRoutineUsePort=1, DcmDspRoutineUsed=1, DcmDspCommonAuthorizationRef=DcmDspCommonAuthorization_d884a83
            DcmDspStartRoutine_START_IndividualDatenRettung (DcmDspStartRoutine)
              DcmDspStartRoutineIn_START_IndividualDatenRettung (DcmDspStartRoutineIn)
              DcmDspStartRoutineOut_START_IndividualDatenRettung (DcmDspStartRoutineOut)
          DcmDspRoutine_InitLinBus: DcmDspRoutineIdentifier=16387, DcmDspRoutineUsePort=1, DcmDspRoutineUsed=1, DcmDspCommonAuthorizationRef=DcmDspCommonAuthorization_ba9a6fdf
            DcmDspStartRoutine_START_InitLinBus (DcmDspStartRoutine)
          DcmDspRoutine_InitLinSlave: DcmDspRoutineIdentifier=4128, DcmDspRoutineUsePort=1, DcmDspRoutineUsed=1, DcmDspCommonAuthorizationRef=DcmDspCommonAuthorization_eabf1d27
            DcmDspStartRoutine_START_InitLinSlave (DcmDspStartRoutine)
              DcmDspStartRoutineOut_START_InitLinSlave (DcmDspStartRoutineOut)
                DcmDspStartRoutineOutSignal_Status (DcmDspStartRoutineOutSignal): DcmDspRoutineSignalEndianness=BIG_ENDIAN, DcmDspRoutineSignalLength=8, DcmDspRoutineSignalPos=0, DcmDspRoutineSignalType=UINT8
          DcmDspRoutine_IsLoeschen: DcmDspRoutineIdentifier=3846, DcmDspRoutineUsePort=1, DcmDspRoutineUsed=1, DcmDspCommonAuthorizationRef=DcmDspCommonAuthorization_eabf1d27
            DcmDspStartRoutine_START_IsLoeschen (DcmDspStartRoutine)
          DcmDspRoutine_RamDatenSchreiben: DcmDspRoutineIdentifier=16390, DcmDspRoutineUsePort=1, DcmDspRoutineUsed=1, DcmDspCommonAuthorizationRef=DcmDspCommonAuthorization_eabf1d27
            DcmDspRequestRoutineResults_RESULT_RamDatenSchreiben (DcmDspRequestRoutineResults)
              RESULT_RamDatenSchreiben_OUT (DcmDspRequestRoutineResultsOut)
                DcmDspRequestRoutineResultsOutSignal_StatRamDatenSchreiben (DcmDspRequestRoutineResultsOutSignal): DcmDspRoutineSignalEndianness=BIG_ENDIAN, DcmDspRoutineSignalLength=8, DcmDspRoutineSignalPos=0, DcmDspRoutineSignalType=UINT8
            DcmDspStartRoutine_START_RamDatenSchreiben (DcmDspStartRoutine)
          DcmDspRoutine_RcCpp: DcmDspRoutineIdentifier=518, DcmDspRoutineUsePort=1, DcmDspRoutineUsed=1, DcmDspCommonAuthorizationRef=DcmDspCommonAuthorization_eabf1d27
            DcmDspStartRoutine_START_RcCpp (DcmDspStartRoutine)
              DcmDspStartRoutineIn_START_RcCpp (DcmDspStartRoutineIn)
                DcmDspStartRoutineInSignal_RcCppRsr (DcmDspStartRoutineInSignal): DcmDspRoutineSignalPos=0
              DcmDspStartRoutineOut_START_RcCpp (DcmDspStartRoutineOut)
                DcmDspStartRoutineOutSignal_StatApprovalChargingState (DcmDspStartRoutineOutSignal): DcmDspRoutineSignalEndianness=BIG_ENDIAN, DcmDspRoutineSignalLength=8, DcmDspRoutineSignalPos=16, DcmDspRoutineSignalType=UINT8
                DcmDspStartRoutineOutSignal_StatDuration (DcmDspStartRoutineOutSignal): DcmDspRoutineSignalEndianness=BIG_ENDIAN, DcmDspRoutineSignalLength=16, DcmDspRoutineSignalPos=0, DcmDspRoutineSignalType=UINT16
          DcmDspRoutine_RcCppc: DcmDspRoutineIdentifier=515, DcmDspRoutineUsePort=1, DcmDspRoutineUsed=1, DcmDspCommonAuthorizationRef=DcmDspCommonAuthorization_d884a83
            DcmDspStartRoutine_START_RcCppc (DcmDspStartRoutine)
              DcmDspStartRoutineOut_START_RcCppc (DcmDspStartRoutineOut)
                DcmDspStartRoutineOutSignal_dataOut (DcmDspStartRoutineOutSignal): DcmDspRoutineSignalPos=0, DcmDspRoutineSignalType=VARIABLE_LENGTH
          DcmDspRoutine_RcHdddRi4002
          DcmDspRoutine_RcPad: DcmDspRoutineIdentifier=28672, DcmDspRoutineUsePort=1, DcmDspRoutineUsed=1, DcmDspCommonAuthorizationRef=DcmDspCommonAuthorization_d884a83
            DcmDspStartRoutine_START_RcPad (DcmDspStartRoutine)
              DcmDspStartRoutineIn_START_RcPad (DcmDspStartRoutineIn)
                5 x DcmDspStartRoutineInSignal:
                  DcmDspStartRoutineInSignal_AppSpecificParam
                  DcmDspStartRoutineInSignal_Dpt: DcmDspRoutineSignalEndianness=BIG_ENDIAN, DcmDspRoutineSignalLength=8, DcmDspRoutineSignalPos=0, DcmDspRoutineSignalType=UINT8
                  DcmDspStartRoutineInSignal_MemObjIdent: DcmDspRoutineSignalPos=24
                  DcmDspStartRoutineInSignal_MoiAfid: DcmDspRoutineSignalEndianness=BIG_ENDIAN, DcmDspRoutineSignalLength=8, DcmDspRoutineSignalPos=16, DcmDspRoutineSignalType=UINT8
                  DcmDspStartRoutineInSignal_Rsvd: DcmDspRoutineSignalEndianness=BIG_ENDIAN, DcmDspRoutineSignalLength=8, DcmDspRoutineSignalPos=8, DcmDspRoutineSignalType=UINT8
              DcmDspStartRoutineOut_START_RcPad (DcmDspStartRoutineOut)
                DcmDspStartRoutineOutSignal_Rs (DcmDspStartRoutineOutSignal): DcmDspRoutineSignalEndianness=BIG_ENDIAN, DcmDspRoutineSignalLength=8, DcmDspRoutineSignalPos=0, DcmDspRoutineSignalType=UINT8
          DcmDspRoutine_RcRswedi: DcmDspRoutineIdentifier=517, DcmDspRoutineUsePort=1, DcmDspRoutineUsed=1, DcmDspCommonAuthorizationRef=DcmDspCommonAuthorization_eabf1d27
            DcmDspStartRoutine_START_RcRswedi (DcmDspStartRoutine)
              DcmDspStartRoutineIn_START_RcRswedi (DcmDspStartRoutineIn)
                DcmDspStartRoutineInSignal_DataIn (DcmDspStartRoutineInSignal): DcmDspRoutineSignalLength=64, DcmDspRoutineSignalPos=0, DcmDspRoutineSignalType=VARIABLE_LENGTH
              DcmDspStartRoutineOut_START_RcRswedi (DcmDspStartRoutineOut)
                DcmDspStartRoutineOutSignal_DataOut (DcmDspStartRoutineOutSignal): DcmDspRoutineSignalPos=0, DcmDspRoutineSignalType=VARIABLE_LENGTH
          DcmDspRoutine_RequestPreferredProtocol: DcmDspRoutineIdentifier=4129, DcmDspRoutineUsePort=1, DcmDspRoutineUsed=1, DcmDspCommonAuthorizationRef=DcmDspCommonAuthorization_eabf1d27
            DcmDspStartRoutine_START_RequestPreferredProtocol (DcmDspStartRoutine)
              DcmDspStartRoutineIn_START_RequestPreferredProtocol (DcmDspStartRoutineIn)
                DcmDspStartRoutineInSignal_SgbmId (DcmDspStartRoutineInSignal): DcmDspRoutineSignalEndianness=BIG_ENDIAN, DcmDspRoutineSignalLength=64, DcmDspRoutineSignalPos=0, DcmDspRoutineSignalType=VARIABLE_LENGTH
              DcmDspStartRoutineOut_START_RequestPreferredProtocol (DcmDspStartRoutineOut)
                DcmDspStartRoutineOutSignal_AnzahlItems (DcmDspStartRoutineOutSignal): DcmDspRoutineSignalEndianness=BIG_ENDIAN, DcmDspRoutineSignalLength=8, DcmDspRoutineSignalPos=0, DcmDspRoutineSignalType=UINT8
                DcmDspStartRoutineOutSignal_FpRpp31011021Eopfld (DcmDspStartRoutineOutSignal): DcmDspRoutineSignalPos=8
          DcmDspRoutine_ResetAktivierungsleitung: DcmDspRoutineIdentifier=4132, DcmDspRoutineUsePort=1, DcmDspRoutineUsed=1, DcmDspCommonAuthorizationRef=DcmDspCommonAuthorization_eabf1d27
            DcmDspStartRoutine_START_ResetAktivierungsleitung (DcmDspStartRoutine)
          DcmDspRoutine_SetDefaultBus: DcmDspRoutineIdentifier=4112, DcmDspRoutineUsePort=0, DcmDspRoutineUsed=1, DcmDspCommonAuthorizationRef=DcmDspCommonAuthorization_eabf1d27
            DcmDspStartRoutine_START_SetDefaultBus (DcmDspStartRoutine): DcmDspStartRoutineFnc=EthDiagMM_RoutineControlSetDiagIfcStart
              DcmDspStartRoutineIn_START_SetDefaultBus (DcmDspStartRoutineIn)
                DcmDspStartRoutineInSignal_ZustandDefaultBus (DcmDspStartRoutineInSignal): DcmDspRoutineSignalLength=8, DcmDspRoutineSignalPos=0, DcmDspRoutineSignalType=UINT8
          DcmDspRoutine_StartSystime: DcmDspRoutineIdentifier=4101, DcmDspRoutineUsePort=1, DcmDspRoutineUsed=1, DcmDspCommonAuthorizationRef=DcmDspCommonAuthorization_eabf1d27
            DcmDspStartRoutine_START_StartSystime (DcmDspStartRoutine)
          DcmDspRoutine_SteuernDmFssMaster: DcmDspRoutineIdentifier=773, DcmDspRoutineUsePort=1, DcmDspRoutineUsed=1, DcmDspCommonAuthorizationRef=DcmDspCommonAuthorization_eabf1d27
            DcmDspStartRoutine_START_SteuernDmFssMaster (DcmDspStartRoutine)
              DcmDspStartRoutineIn_START_SteuernDmFssMaster (DcmDspStartRoutineIn)
                DcmDspStartRoutineInSignal_ArgSignal (DcmDspStartRoutineInSignal): DcmDspRoutineSignalEndianness=BIG_ENDIAN, DcmDspRoutineSignalLength=8, DcmDspRoutineSignalPos=0, DcmDspRoutineSignalType=UINT8
              DcmDspStartRoutineOut_START_SteuernDmFssMaster (DcmDspStartRoutineOut)
                DcmDspStartRoutineOutSignal_StatSignal (DcmDspStartRoutineOutSignal): DcmDspRoutineSignalEndianness=BIG_ENDIAN, DcmDspRoutineSignalLength=8, DcmDspRoutineSignalPos=0, DcmDspRoutineSignalType=UINT8
            DcmDspStopRoutine_STOP_SteuernDmFssMaster (DcmDspStopRoutine)
          DcmDspRoutine_Swt: DcmDspRoutineIdentifier=3871, DcmDspRoutineUsePort=1, DcmDspRoutineUsed=1, DcmDspCommonAuthorizationRef=DcmDspCommonAuthorization_1b931cac
            DcmDspStartRoutine_START_Swt (DcmDspStartRoutine)
              DcmDspStartRoutineIn_START_Swt (DcmDspStartRoutineIn)
                DcmDspStartRoutineInSignal_DataIn (DcmDspStartRoutineInSignal): DcmDspRoutineSignalPos=8, DcmDspRoutineSignalType=VARIABLE_LENGTH
                DcmDspStartRoutineInSignal_RCOption (DcmDspStartRoutineInSignal): DcmDspRoutineSignalLength=8, DcmDspRoutineSignalPos=0, DcmDspRoutineSignalType=UINT8
              DcmDspStartRoutineOut_START_Swt (DcmDspStartRoutineOut)
                3 x DcmDspStartRoutineOutSignal:
                  DcmDspStartRoutineOutSignal_DataOut: DcmDspRoutineSignalPos=16, DcmDspRoutineSignalType=VARIABLE_LENGTH
                  DcmDspStartRoutineOutSignal_RCOptionOut: DcmDspRoutineSignalLength=8, DcmDspRoutineSignalPos=0, DcmDspRoutineSignalType=UINT8
                  DcmDspStartRoutineOutSignal_ReturnCode: DcmDspRoutineSignalLength=8, DcmDspRoutineSignalPos=8, DcmDspRoutineSignalType=UINT8
        DcmDspSecurity
          3 x DcmDspSecurityRow, all with DcmDspSecurityADRSize=4, DcmDspSecurityAttemptCounterEnabled=0, DcmDspSecurityDelayTime=0.0, DcmDspSecurityDelayTimeOnBoot=0.0, DcmDspSecuritySeedSize=8, DcmDspSecurityUsePort=USE_ASYNCH_CLIENT_SERVER:
            DcmDspSecurityRow_Coding: DcmDspSecurityLevel=1
            DcmDspSecurityRow_Programming_HDD: DcmDspSecurityLevel=9
            DcmDspSecurityRow_Swt: DcmDspSecurityLevel=10
        DcmDspSession
          6 x DcmDspSessionRow, all with DcmDspSessionForBoot=DCM_NO_BOOT:
            DcmDspSessionRow_CODING_SESSION: DcmDspSessionLevel=65, DcmDspSessionP2StarServerMax=5.0
            DcmDspSessionRow_DEFAULT_SESSION: DcmDspSessionLevel=1, DcmDspSessionP2ServerMax=0.05, DcmDspSessionP2StarServerMax=5.0
            DcmDspSessionRow_EXTENDED_DIAGNOSTIC_SESSION: DcmDspSessionLevel=3, DcmDspSessionP2StarServerMax=5.0
            DcmDspSessionRow_HDD_DOWNLOAD_SESSION: DcmDspSessionLevel=67, DcmDspSessionP2StarServerMax=5.0
            DcmDspSessionRow_PROGRAMMING_SESSION: DcmDspSessionLevel=2
            DcmDspSessionRow_SWT_SESSION: DcmDspSessionLevel=66
    DcmGeneral: DcmRespondAllRequest=0
