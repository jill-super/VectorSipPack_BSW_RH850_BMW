AUTOSAR XML (schema 4-2-2)
package /BMW_CONF
  module config SysTime
    SysTimeGeneral: SysTimeEnableServiceInterface=0, SysTimeInitialTimeout=5
