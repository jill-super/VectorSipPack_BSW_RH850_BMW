AUTOSAR XML (schema 4-2-2)
package /BMW_CONF
  module config Stm
    StmFeatureActivation_0 (StmFeatureActivation): StmCentralErrorLockEnabled=1, StmEnergyStateEnabled=1, StmVehicleStateSP2015Enabled=1
    StmGeneral: StmCentralErrorLockTimeout=21, StmEnergyStateTimeout=21, StmInitialCentralErrorLockTimeout=6, StmVehicleStateSP2015Timeout=0.5
