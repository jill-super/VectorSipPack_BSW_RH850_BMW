AUTOSAR XML (schema 4-2-2)
package /BMW_CONF
  module config Darh
    44 x DarhActiveReportedEvent:
      DarhActiveReportedEvent_CansmEBusACanOff: DarhDemEvent=CansmEBusACanOff
      DarhActiveReportedEvent_CansmEBusB2CanOff: DarhDemEvent=CansmEBusB2CanOff
      DarhActiveReportedEvent_CansmEBusBodyCanOff: DarhDemEvent=CansmEBusBodyCanOff
      DarhActiveReportedEvent_CansmEBusFaCanOff: DarhDemEvent=CansmEBusFaCanOff
      DarhActiveReportedEvent_CansmEBusIukCanOff: DarhDemEvent=CansmEBusIukCanOff
      DarhActiveReportedEvent_CansmEBusKCanOff: DarhDemEvent=CansmEBusKCanOff
      DarhActiveReportedEvent_CansmEBusLeCanOff: DarhDemEvent=CansmEBusLeCanOff
      DarhActiveReportedEvent_CansmEBusLpCanOff: DarhDemEvent=CansmEBusLpCanOff
      DarhActiveReportedEvent_CansmEBusZsgCanOff: DarhDemEvent=CansmEBusZsgCanOff
      DarhActiveReportedEvent_CantrcvEBusACanError: DarhDemEvent=CantrcvEBusACanError
      DarhActiveReportedEvent_CantrcvEBusB2CanError: DarhDemEvent=CantrcvEBusB2CanError
      DarhActiveReportedEvent_CantrcvEBusBodyCanError: DarhDemEvent=CantrcvEBusBodyCanError
      DarhActiveReportedEvent_CantrcvEBusFaCanError: DarhDemEvent=CantrcvEBusFaCanError
      DarhActiveReportedEvent_CantrcvEBusIukError: DarhDemEvent=CantrcvEBusIukError
      DarhActiveReportedEvent_CantrcvEBusKCanError: DarhDemEvent=CantrcvEBusKCanError
      DarhActiveReportedEvent_CantrcvEBusLeCanError: DarhDemEvent=CantrcvEBusLeCanError
      DarhActiveReportedEvent_CantrcvEBusLpCanError: DarhDemEvent=CantrcvEBusLpCanError
      DarhActiveReportedEvent_CantrcvEBusZsgCanError: DarhDemEvent=CantrcvEBusZsgCanError
      DarhActiveReportedEvent_CodingEventInvalidData: DarhDemEvent=CodingEventInvalidData
      DarhActiveReportedEvent_CodingEventNotCoded: DarhDemEvent=CodingEventNotCoded
      DarhActiveReportedEvent_CodingEventSignatureError: DarhDemEvent=CodingEventSignatureError
      DarhActiveReportedEvent_CodingEventTransactionFailed: DarhDemEvent=CodingEventTransactionFailed
      DarhActiveReportedEvent_CodingEventUnqualifiedData: DarhDemEvent=CodingEventUnqualifiedData
      DarhActiveReportedEvent_CodingEventWrongVehicle: DarhDemEvent=CodingEventWrongVehicle
      DarhActiveReportedEvent_DmTestAppl: DarhDemEvent=DmTestAppl
      DarhActiveReportedEvent_DmTestCom: DarhDemEvent=DmTestCom
      DarhActiveReportedEvent_EthSignalQualityLow: DarhDemEvent=EthSignalQualityLow
      DarhActiveReportedEvent_FrsmEClusterStartup: DarhDemEvent=FrsmEClusterStartup
      DarhActiveReportedEvent_FrsmEClusterSyncLoss: DarhDemEvent=FrsmEClusterSyncLoss
      DarhActiveReportedEvent_FrtrcvEFrBuserrorTrcv0: DarhDemEvent=FrtrcvEFrBuserrorTrcv0
      DarhActiveReportedEvent_FrtrcvEFrErrnTrcv{0..7}: DarhDemEvent=FrtrcvEFrErrnTrcv{0..7}
      DarhActiveReportedEvent_LinETimeout: DarhDemEvent=LIN_E_TIMEOUT
      DarhActiveReportedEvent_NvmEHardware: DarhDemEvent=NVM_E_HARDWARE
      DarhActiveReportedEvent_Overvoltage: DarhDemEvent=Overvoltage
      DarhActiveReportedEvent_SwtExternalCheckFailure: DarhDemEvent=SwtExternalCheckFailure
      DarhActiveReportedEvent_SwtInternalCheckFailure: DarhDemEvent=SwtInternalCheckFailure
      DarhActiveReportedEvent_Undervoltage: DarhDemEvent=Undervoltage
    DarhGeneral: DarhActiveReportListType=POSITIVE_LIST, DarhSystimeDidIdentifier=DemDidClass_Systemzeit
