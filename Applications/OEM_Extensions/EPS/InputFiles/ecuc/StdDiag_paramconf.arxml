AUTOSAR XML (schema 4-2-2)
package /BMW_CONF
  module config StdDiag
    StdDiagGeneral: StdDiagClearSecondaryErrorMemory=1, StdDiagUserCalloutForHddUpdateSession=1
    StdDiagProvideIDRL: DIDTableFormatIdentifier=1
      PiaClient (IDRLClient)
        4 x IndivData:
          PiaProfile0: DIDValue=9568
          PiaProfile1: DIDValue=9569
          PiaProfile2: DIDValue=9570
          PiaProfileA: DIDValue=9571
