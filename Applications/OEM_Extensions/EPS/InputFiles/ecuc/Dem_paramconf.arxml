AUTOSAR XML (schema 4-2-2)
package /BMW_CONF
  module config Dem
    DemConfigSet
      59 x DemDTC:
        DTC_21000_VSM_EVENT_OPMODE: DemDtcValue=135168, DemDTCAttributesRef=DemDTCAttributes_DTC_21000_VSM_EVENT_OPMODE
        DTC_21003_SWT_EXTERNAL_CHECK_FAILURE: DemDtcValue=135171, DemDTCAttributesRef=DemDTCAttributes_DTC_21003_SWT_EXTERNAL_CHECK_FAILURE
        DTC_21004_SWT_INTERNAL_CHECK_FAILURE: DemDtcValue=135172, DemDTCAttributesRef=DemDTCAttributes_DTC_21004_SWT_INTERNAL_CHECK_FAILURE
        DTC_21008_CODING_EVENT_NOT_CODED: DemDtcValue=135176, DemDTCAttributesRef=DemDTCAttributes_DTC_21008_CODING_EVENT_NOT_CODED
        DTC_21009_CODING_EVENT_TRANSACTION_FAILED: DemDtcValue=135177, DemDTCAttributesRef=DemDTCAttributes_DTC_21009_CODING_EVENT_TRANSACTION_FAILED
        DTC_2100A_CODING_EVENT_SIGNATURE_ERROR: DemDtcValue=135178, DemDTCAttributesRef=DemDTCAttributes_DTC_2100A_CODING_EVENT_SIGNATURE_ERROR
        DTC_2100B_CODING_EVENT_WRONG_VEHICLE: DemDtcValue=135179, DemDTCAttributesRef=DemDTCAttributes_DTC_2100B_CODING_EVENT_WRONG_VEHICLE
        DTC_2100C_CODING_EVENT_INVALID_DATA: DemDtcValue=135180, DemDTCAttributesRef=DemDTCAttributes_DTC_2100C_CODING_EVENT_INVALID_DATA
        DTC_2100D_CODING_EVENT_UNQUALIFIED_DATA: DemDtcValue=135181, DemDTCAttributesRef=DemDTCAttributes_DTC_2100D_CODING_EVENT_UNQUALIFIED_DATA
        DTC_21023_LIN_E_TIMEOUT: DemDtcValue=135203, DemDTCAttributesRef=DemDTCAttributes_DTC_21023_LIN_E_TIMEOUT
        DTC_21024_NVM_E_HARDWARE: DemDtcValue=135204, DemDTCAttributesRef=DemDTCAttributes_DTC_21024_NVM_E_HARDWARE
        DTC_2FF10_DM_TEST_APPL: DemDtcValue=196368, DemDTCAttributesRef=DemDTCAttributes_DTC_2FF10_DM_TEST_APPL
        DTC_30_DTC_000030: DemDtcValue=48, DemDTCAttributesRef=DemDTCAttributes_DTC_30_DTC_000030
        DTC_31_DTC_000031: DemDtcValue=49, DemDTCAttributesRef=DemDTCAttributes_DTC_31_DTC_000031
        DTC_32_DTC_000032: DemDtcValue=50, DemDTCAttributesRef=DemDTCAttributes_DTC_32_DTC_000032
        DTC_33_DTC_000033: DemDtcValue=51, DemDTCAttributesRef=DemDTCAttributes_DTC_33_DTC_000033
        DTC_34_DTC_000034: DemDtcValue=52, DemDTCAttributesRef=DemDTCAttributes_DTC_34_DTC_000034
        DTC_801C00_UDPNM_E_TCPIP_TRANSMIT_ERROR: DemDtcValue=8395776, DemDTCAttributesRef=DemDTCAttributes_DTC_801C00_UDPNM_E_TCPIP_TRANSMIT_ERROR
        DTC_801C7E_UNDERVOLTAGE: DemDtcValue=8395902, DemDTCAttributesRef=DemDTCAttributes_DTC_801C7E_UNDERVOLTAGE
        DTC_801D7A_FRIF_E_NIT_CH_A: DemDtcValue=8396154, DemDTCAttributesRef=DemDTCAttributes_DTC_801D7A_FRIF_E_NIT_CH_A
        DTC_801D7B_FRIF_E_ACS_CH_A: DemDtcValue=8396155, DemDTCAttributesRef=DemDTCAttributes_DTC_801D7B_FRIF_E_ACS_CH_A
        DTC_801D7C_CBS_REPLACEMENT_VALUE: DemDtcValue=8396156, DemDTCAttributesRef=DemDTCAttributes_DTC_801D7C_CBS_REPLACEMENT_VALUE
        DTC_801D7D_OVERVOLTAGE: DemDtcValue=8396157, DemDTCAttributesRef=DemDTCAttributes_DTC_801D7D_OVERVOLTAGE
        DTC_801D7F_PIA_E_IO_ERROR: DemDtcValue=8396159, DemDTCAttributesRef=DemDTCAttributes_DTC_801D7F_PIA_E_IO_ERROR
        DTC_CD0401_CANTRCV_E_BUS_FA_CAN_ERROR: DemDtcValue=13435905, DemDTCAttributesRef=DemDTCAttributes_DTC_CD0401_CANTRCV_E_BUS_FA_CAN_ERROR
        DTC_CD040A_CANSM_E_BUS_FA_CAN_OFF: DemDtcValue=13435914, DemDTCAttributesRef=DemDTCAttributes_DTC_CD040A_CANSM_E_BUS_FA_CAN_OFF
        DTC_CD040B_CANTRCV_E_BUS_K_CAN_ERROR: DemDtcValue=13435915, DemDTCAttributesRef=DemDTCAttributes_DTC_CD040B_CANTRCV_E_BUS_K_CAN_ERROR
        DTC_CD0414_CANSM_E_BUS_K_CAN_OFF: DemDtcValue=13435924, DemDTCAttributesRef=DemDTCAttributes_DTC_CD0414_CANSM_E_BUS_K_CAN_OFF
        DTC_CD0415_CANTRCV_E_BUS_IUK_ERROR: DemDtcValue=13435925, DemDTCAttributesRef=DemDTCAttributes_DTC_CD0415_CANTRCV_E_BUS_IUK_ERROR
        DTC_CD041E_CANSM_E_BUS_IuK_CAN_OFF: DemDtcValue=13435934, DemDTCAttributesRef=DemDTCAttributes_DTC_CD041E_CANSM_E_BUS_IuK_CAN_OFF
        DTC_CD041F_FRTRCV_E_FR_BUSERROR_TRCV0: DemDtcValue=13435935, DemDTCAttributesRef=DemDTCAttributes_DTC_CD041F_FRTRCV_E_FR_BUSERROR_TRCV0
        DTC_CD0420_FRSM_E_CLUSTER_SYNC_LOSS: DemDtcValue=13435936, DemDTCAttributesRef=DemDTCAttributes_DTC_CD0420_FRSM_E_CLUSTER_SYNC_LOSS
        DTC_CD042F_FRTRCV_E_FR_ERRN_TRCV0: DemDtcValue=13435951, DemDTCAttributesRef=DemDTCAttributes_DTC_CD042F_FRTRCV_E_FR_ERRN_TRCV0
        DTC_CD0431_FRTRCV_E_FR_ERRN_TRCV1: DemDtcValue=13435953, DemDTCAttributesRef=DemDTCAttributes_DTC_CD0431_FRTRCV_E_FR_ERRN_TRCV1
        DTC_CD0433_FRTRCV_E_FR_ERRN_TRCV2: DemDtcValue=13435955, DemDTCAttributesRef=DemDTCAttributes_DTC_CD0433_FRTRCV_E_FR_ERRN_TRCV2
        DTC_CD0435_FRTRCV_E_FR_ERRN_TRCV3: DemDtcValue=13435957, DemDTCAttributesRef=DemDTCAttributes_DTC_CD0435_FRTRCV_E_FR_ERRN_TRCV3
        DTC_CD0437_FRTRCV_E_FR_ERRN_TRCV4: DemDtcValue=13435959, DemDTCAttributesRef=DemDTCAttributes_DTC_CD0437_FRTRCV_E_FR_ERRN_TRCV4
        DTC_CD0439_FRTRCV_E_FR_ERRN_TRCV5: DemDtcValue=13435961, DemDTCAttributesRef=DemDTCAttributes_DTC_CD0439_FRTRCV_E_FR_ERRN_TRCV5
        DTC_CD043B_FRTRCV_E_FR_ERRN_TRCV6: DemDtcValue=13435963, DemDTCAttributesRef=DemDTCAttributes_DTC_CD043B_FRTRCV_E_FR_ERRN_TRCV6
        DTC_CD043D_FRTRCV_E_FR_ERRN_TRCV7: DemDtcValue=13435965, DemDTCAttributesRef=DemDTCAttributes_DTC_CD043D_FRTRCV_E_FR_ERRN_TRCV7
        DTC_CD045F_CANTRCV_E_BUS_BODY_CAN_ERROR: DemDtcValue=13435999, DemDTCAttributesRef=DemDTCAttributes_DTC_CD045F_CANTRCV_E_BUS_BODY_CAN_ERROR
        DTC_CD0468_CANSM_E_BUS_Body_CAN_OFF: DemDtcValue=13436008, DemDTCAttributesRef=DemDTCAttributes_DTC_CD0468_CANSM_E_BUS_Body_CAN_OFF
        DTC_CD0469_CANTRCV_E_BUS_LP_CAN_ERROR: DemDtcValue=13436009, DemDTCAttributesRef=DemDTCAttributes_DTC_CD0469_CANTRCV_E_BUS_LP_CAN_ERROR
        DTC_CD0472_CANSM_E_BUS_LP_CAN_OFF: DemDtcValue=13436018, DemDTCAttributesRef=DemDTCAttributes_DTC_CD0472_CANSM_E_BUS_LP_CAN_OFF
        DTC_CD0473_CANTRCV_E_BUS_LE_CAN_ERROR: DemDtcValue=13436019, DemDTCAttributesRef=DemDTCAttributes_DTC_CD0473_CANTRCV_E_BUS_LE_CAN_ERROR
        DTC_CD047C_CANSM_E_BUS_LE_CAN_OFF: DemDtcValue=13436028, DemDTCAttributesRef=DemDTCAttributes_DTC_CD047C_CANSM_E_BUS_LE_CAN_OFF
        DTC_CD047D_CANTRCV_E_BUS_A_CAN_ERROR: DemDtcValue=13436029, DemDTCAttributesRef=DemDTCAttributes_DTC_CD047D_CANTRCV_E_BUS_A_CAN_ERROR
        DTC_CD0486_CANSM_E_BUS_A_CAN_OFF: DemDtcValue=13436038, DemDTCAttributesRef=DemDTCAttributes_DTC_CD0486_CANSM_E_BUS_A_CAN_OFF
        DTC_CD0487_FRSM_E_CLUSTER_STARTUP: DemDtcValue=13436039, DemDTCAttributesRef=DemDTCAttributes_DTC_CD0487_FRSM_E_CLUSTER_STARTUP
        DTC_CD0501_CANTRCV_E_BUS_ZSG_CAN_ERROR: DemDtcValue=13436161, DemDTCAttributesRef=DemDTCAttributes_DTC_CD0501_CANTRCV_E_BUS_ZSG_CAN_ERROR
        DTC_CD050A_CANSM_E_BUS_ZSG_CAN_OFF: DemDtcValue=13436170, DemDTCAttributesRef=DemDTCAttributes_DTC_CD050A_CANSM_E_BUS_ZSG_CAN_OFF
        DTC_CD050B_CANTRCV_E_BUS_B2_CAN_ERROR: DemDtcValue=13436171, DemDTCAttributesRef=DemDTCAttributes_DTC_CD050B_CANTRCV_E_BUS_B2_CAN_ERROR
        DTC_CD0514_CANSM_E_BUS_B2_CAN_OFF: DemDtcValue=13436180, DemDTCAttributesRef=DemDTCAttributes_DTC_CD0514_CANSM_E_BUS_B2_CAN_OFF
        DTC_CD0601_DTC_CD0601: DemDtcValue=13436417, DemDTCAttributesRef=DemDTCAttributes_DTC_CD0601_DTC_CD0601
        DTC_CD0602_ETH_SIGNAL_QUALITY_LOW: DemDtcValue=13436418, DemDTCAttributesRef=DemDTCAttributes_DTC_CD0602_ETH_SIGNAL_QUALITY_LOW
        DTC_CD0605_DTC_CD0605: DemDtcValue=13436421, DemDTCAttributesRef=DemDTCAttributes_DTC_CD0605_DTC_CD0605
        DTC_CD0606_DTC_CD0606: DemDtcValue=13436422, DemDTCAttributesRef=DemDTCAttributes_DTC_CD0606_DTC_CD0606
        DTC_CD0607_DTC_CD0607: DemDtcValue=13436423, DemDTCAttributesRef=DemDTCAttributes_DTC_CD0607_DTC_CD0607
        DTC_CD0BFF_DM_TEST_COM: DemDtcValue=13437951, DemDTCAttributesRef=DemDTCAttributes_DTC_CD0BFF_DM_TEST_COM
      59 x DemDTCAttributes, all with DemImmediateNvStorage=0:
        DemDTCAttributes_DTC_21000_VSM_EVENT_OPMODE: DemAgingAllowed=0, DemDTCSignificance=DEM_EVENT_SIGNIFICANCE_FAULT, DemMaxNumberFreezeFrameRecords=2, DemExtendedDataClassRef=DemExtendedDataClass_NoHealing, DemFreezeFrameClassRef=DemFreezeFrameClass_711871ef, DemMemoryDestinationRef=DemPrimaryMemory
        DemDTCAttributes_DTC_21003_SWT_EXTERNAL_CHECK_FAILURE: DemAgingAllowed=0, DemDTCSignificance=DEM_EVENT_SIGNIFICANCE_OCCURRENCE, DemMaxNumberFreezeFrameRecords=2, DemExtendedDataClassRef=DemExtendedDataClass_NoHealing, DemFreezeFrameClassRef=DemFreezeFrameClass_8ef63883, DemMemoryDestinationRef=DemPrimaryMemory
        DemDTCAttributes_DTC_21004_SWT_INTERNAL_CHECK_FAILURE: DemAgingAllowed=0, DemDTCSignificance=DEM_EVENT_SIGNIFICANCE_FAULT, DemMaxNumberFreezeFrameRecords=2, DemExtendedDataClassRef=DemExtendedDataClass_NoHealing, DemFreezeFrameClassRef=DemFreezeFrameClass_9ec24f64, DemMemoryDestinationRef=DemPrimaryMemory
        DemDTCAttributes_DTC_21008_CODING_EVENT_NOT_CODED: DemAgingAllowed=0, DemDTCSignificance=DEM_EVENT_SIGNIFICANCE_FAULT, DemMaxNumberFreezeFrameRecords=2, DemExtendedDataClassRef=DemExtendedDataClass_NoHealing, DemFreezeFrameClassRef=DemFreezeFrameClass_711871ef, DemMemoryDestinationRef=DemPrimaryMemory
        DemDTCAttributes_DTC_21009_CODING_EVENT_TRANSACTION_FAILED: DemAgingAllowed=0, DemDTCSignificance=DEM_EVENT_SIGNIFICANCE_FAULT, DemMaxNumberFreezeFrameRecords=2, DemExtendedDataClassRef=DemExtendedDataClass_NoHealing, DemFreezeFrameClassRef=DemFreezeFrameClass_711871ef, DemMemoryDestinationRef=DemPrimaryMemory
        DemDTCAttributes_DTC_2100A_CODING_EVENT_SIGNATURE_ERROR: DemAgingAllowed=0, DemDTCSignificance=DEM_EVENT_SIGNIFICANCE_FAULT, DemMaxNumberFreezeFrameRecords=2, DemExtendedDataClassRef=DemExtendedDataClass_NoHealing, DemFreezeFrameClassRef=DemFreezeFrameClass_711871ef, DemMemoryDestinationRef=DemPrimaryMemory
        DemDTCAttributes_DTC_2100B_CODING_EVENT_WRONG_VEHICLE: DemAgingAllowed=0, DemDTCSignificance=DEM_EVENT_SIGNIFICANCE_FAULT, DemMaxNumberFreezeFrameRecords=2, DemExtendedDataClassRef=DemExtendedDataClass_NoHealing, DemFreezeFrameClassRef=DemFreezeFrameClass_711871ef, DemMemoryDestinationRef=DemPrimaryMemory
        DemDTCAttributes_DTC_2100C_CODING_EVENT_INVALID_DATA: DemAgingAllowed=0, DemDTCSignificance=DEM_EVENT_SIGNIFICANCE_FAULT, DemMaxNumberFreezeFrameRecords=2, DemExtendedDataClassRef=DemExtendedDataClass_NoHealing, DemFreezeFrameClassRef=DemFreezeFrameClass_711871ef, DemMemoryDestinationRef=DemPrimaryMemory
        DemDTCAttributes_DTC_2100D_CODING_EVENT_UNQUALIFIED_DATA: DemAgingAllowed=0, DemDTCSignificance=DEM_EVENT_SIGNIFICANCE_FAULT, DemMaxNumberFreezeFrameRecords=2, DemExtendedDataClassRef=DemExtendedDataClass_NoHealing, DemFreezeFrameClassRef=DemFreezeFrameClass_711871ef, DemMemoryDestinationRef=DemPrimaryMemory
        DemDTCAttributes_DTC_21023_LIN_E_TIMEOUT: DemAgingAllowed=0, DemDTCSignificance=DEM_EVENT_SIGNIFICANCE_FAULT, DemMaxNumberFreezeFrameRecords=2, DemExtendedDataClassRef=DemExtendedDataClass_NoHealing, DemFreezeFrameClassRef=DemFreezeFrameClass_711871ef, DemMemoryDestinationRef=DemPrimaryMemory
        DemDTCAttributes_DTC_21024_NVM_E_HARDWARE: DemAgingAllowed=0, DemDTCSignificance=DEM_EVENT_SIGNIFICANCE_FAULT, DemMaxNumberFreezeFrameRecords=2, DemExtendedDataClassRef=DemExtendedDataClass_NoHealing, DemFreezeFrameClassRef=DemFreezeFrameClass_711871ef, DemMemoryDestinationRef=DemPrimaryMemory
        DemDTCAttributes_DTC_2FF10_DM_TEST_APPL: DemAgingAllowed=0, DemDTCSignificance=DEM_EVENT_SIGNIFICANCE_OCCURRENCE, DemMaxNumberFreezeFrameRecords=2, DemExtendedDataClassRef=DemExtendedDataClass_NoHealing, DemFreezeFrameClassRef=DemFreezeFrameClass_711871ef, DemMemoryDestinationRef=DemPrimaryMemory
        DemDTCAttributes_DTC_30_DTC_000030: DemAgingAllowed=0, DemDTCSignificance=DEM_EVENT_SIGNIFICANCE_FAULT, DemMaxNumberFreezeFrameRecords=2, DemExtendedDataClassRef=DemExtendedDataClass_NoHealing, DemFreezeFrameClassRef=DemFreezeFrameClass_ebef81bf, DemMemoryDestinationRef=DemUserDefinedMemory
        DemDTCAttributes_DTC_31_DTC_000031: DemAgingAllowed=0, DemDTCSignificance=DEM_EVENT_SIGNIFICANCE_FAULT, DemMaxNumberFreezeFrameRecords=2, DemExtendedDataClassRef=DemExtendedDataClass_NoHealing, DemFreezeFrameClassRef=DemFreezeFrameClass_ebef81bf, DemMemoryDestinationRef=DemUserDefinedMemory
        DemDTCAttributes_DTC_32_DTC_000032: DemAgingAllowed=0, DemDTCSignificance=DEM_EVENT_SIGNIFICANCE_FAULT, DemMaxNumberFreezeFrameRecords=2, DemExtendedDataClassRef=DemExtendedDataClass_NoHealing, DemFreezeFrameClassRef=DemFreezeFrameClass_ebef81bf, DemMemoryDestinationRef=DemUserDefinedMemory
        DemDTCAttributes_DTC_33_DTC_000033: DemAgingAllowed=0, DemDTCSignificance=DEM_EVENT_SIGNIFICANCE_FAULT, DemMaxNumberFreezeFrameRecords=2, DemExtendedDataClassRef=DemExtendedDataClass_NoHealing, DemFreezeFrameClassRef=DemFreezeFrameClass_ebef81bf, DemMemoryDestinationRef=DemUserDefinedMemory
        DemDTCAttributes_DTC_34_DTC_000034: DemAgingAllowed=0, DemDTCSignificance=DEM_EVENT_SIGNIFICANCE_FAULT, DemMaxNumberFreezeFrameRecords=2, DemExtendedDataClassRef=DemExtendedDataClass_NoHealing, DemFreezeFrameClassRef=DemFreezeFrameClass_ebef81bf, DemMemoryDestinationRef=DemUserDefinedMemory
        DemDTCAttributes_DTC_801C00_UDPNM_E_TCPIP_TRANSMIT_ERROR: DemAgingAllowed=0, DemDTCSignificance=DEM_EVENT_SIGNIFICANCE_FAULT, DemMaxNumberFreezeFrameRecords=2, DemExtendedDataClassRef=DemExtendedDataClass_NoHealing, DemFreezeFrameClassRef=DemFreezeFrameClass_711871ef, DemMemoryDestinationRef=DemUserDefinedMemory
        DemDTCAttributes_DTC_801C7E_UNDERVOLTAGE: DemAgingAllowed=0, DemDTCSignificance=DEM_EVENT_SIGNIFICANCE_OCCURRENCE, DemMaxNumberFreezeFrameRecords=2, DemExtendedDataClassRef=DemExtendedDataClass_NoHealing, DemFreezeFrameClassRef=DemFreezeFrameClass_711871ef, DemMemoryDestinationRef=DemPrimaryMemory
        DemDTCAttributes_DTC_801D7A_FRIF_E_NIT_CH_A: DemAgingAllowed=0, DemDTCSignificance=DEM_EVENT_SIGNIFICANCE_FAULT, DemMaxNumberFreezeFrameRecords=2, DemExtendedDataClassRef=DemExtendedDataClass_NoHealing, DemFreezeFrameClassRef=DemFreezeFrameClass_711871ef, DemMemoryDestinationRef=DemUserDefinedMemory
        DemDTCAttributes_DTC_801D7B_FRIF_E_ACS_CH_A: DemAgingAllowed=0, DemDTCSignificance=DEM_EVENT_SIGNIFICANCE_FAULT, DemMaxNumberFreezeFrameRecords=2, DemExtendedDataClassRef=DemExtendedDataClass_NoHealing, DemFreezeFrameClassRef=DemFreezeFrameClass_711871ef, DemMemoryDestinationRef=DemUserDefinedMemory
        DemDTCAttributes_DTC_801D7C_CBS_REPLACEMENT_VALUE: DemAgingAllowed=0, DemDTCSignificance=DEM_EVENT_SIGNIFICANCE_FAULT, DemMaxNumberFreezeFrameRecords=2, DemExtendedDataClassRef=DemExtendedDataClass_NoHealing, DemFreezeFrameClassRef=DemFreezeFrameClass_711871ef, DemMemoryDestinationRef=DemUserDefinedMemory
        DemDTCAttributes_DTC_801D7D_OVERVOLTAGE: DemAgingAllowed=0, DemDTCSignificance=DEM_EVENT_SIGNIFICANCE_OCCURRENCE, DemMaxNumberFreezeFrameRecords=2, DemExtendedDataClassRef=DemExtendedDataClass_NoHealing, DemFreezeFrameClassRef=DemFreezeFrameClass_711871ef, DemMemoryDestinationRef=DemPrimaryMemory
        DemDTCAttributes_DTC_801D7F_PIA_E_IO_ERROR: DemAgingAllowed=0, DemDTCSignificance=DEM_EVENT_SIGNIFICANCE_FAULT, DemMaxNumberFreezeFrameRecords=2, DemExtendedDataClassRef=DemExtendedDataClass_NoHealing, DemFreezeFrameClassRef=DemFreezeFrameClass_711871ef, DemMemoryDestinationRef=DemUserDefinedMemory
        DemDTCAttributes_DTC_CD0401_CANTRCV_E_BUS_FA_CAN_ERROR: DemAgingAllowed=0, DemDTCSignificance=DEM_EVENT_SIGNIFICANCE_FAULT, DemMaxNumberFreezeFrameRecords=2, DemExtendedDataClassRef=DemExtendedDataClass_NoHealing, DemFreezeFrameClassRef=DemFreezeFrameClass_711871ef, DemMemoryDestinationRef=DemPrimaryMemory
        DemDTCAttributes_DTC_CD040A_CANSM_E_BUS_FA_CAN_OFF: DemAgingAllowed=0, DemDTCSignificance=DEM_EVENT_SIGNIFICANCE_FAULT, DemMaxNumberFreezeFrameRecords=2, DemExtendedDataClassRef=DemExtendedDataClass_NoHealing, DemFreezeFrameClassRef=DemFreezeFrameClass_711871ef, DemMemoryDestinationRef=DemPrimaryMemory
        DemDTCAttributes_DTC_CD040B_CANTRCV_E_BUS_K_CAN_ERROR: DemAgingAllowed=0, DemDTCSignificance=DEM_EVENT_SIGNIFICANCE_FAULT, DemMaxNumberFreezeFrameRecords=2, DemExtendedDataClassRef=DemExtendedDataClass_NoHealing, DemFreezeFrameClassRef=DemFreezeFrameClass_711871ef, DemMemoryDestinationRef=DemPrimaryMemory
        DemDTCAttributes_DTC_CD0414_CANSM_E_BUS_K_CAN_OFF: DemAgingAllowed=0, DemDTCSignificance=DEM_EVENT_SIGNIFICANCE_FAULT, DemMaxNumberFreezeFrameRecords=2, DemExtendedDataClassRef=DemExtendedDataClass_NoHealing, DemFreezeFrameClassRef=DemFreezeFrameClass_711871ef, DemMemoryDestinationRef=DemPrimaryMemory
        DemDTCAttributes_DTC_CD0415_CANTRCV_E_BUS_IUK_ERROR: DemAgingAllowed=0, DemDTCSignificance=DEM_EVENT_SIGNIFICANCE_FAULT, DemMaxNumberFreezeFrameRecords=2, DemExtendedDataClassRef=DemExtendedDataClass_NoHealing, DemFreezeFrameClassRef=DemFreezeFrameClass_711871ef, DemMemoryDestinationRef=DemPrimaryMemory
        DemDTCAttributes_DTC_CD041E_CANSM_E_BUS_IuK_CAN_OFF: DemAgingAllowed=0, DemDTCSignificance=DEM_EVENT_SIGNIFICANCE_FAULT, DemMaxNumberFreezeFrameRecords=2, DemExtendedDataClassRef=DemExtendedDataClass_NoHealing, DemFreezeFrameClassRef=DemFreezeFrameClass_711871ef, DemMemoryDestinationRef=DemPrimaryMemory
        DemDTCAttributes_DTC_CD041F_FRTRCV_E_FR_BUSERROR_TRCV0: DemAgingAllowed=0, DemDTCSignificance=DEM_EVENT_SIGNIFICANCE_FAULT, DemMaxNumberFreezeFrameRecords=2, DemExtendedDataClassRef=DemExtendedDataClass_NoHealing, DemFreezeFrameClassRef=DemFreezeFrameClass_711871ef, DemMemoryDestinationRef=DemPrimaryMemory
        DemDTCAttributes_DTC_CD0420_FRSM_E_CLUSTER_SYNC_LOSS: DemAgingAllowed=0, DemDTCSignificance=DEM_EVENT_SIGNIFICANCE_FAULT, DemMaxNumberFreezeFrameRecords=2, DemExtendedDataClassRef=DemExtendedDataClass_NoHealing, DemFreezeFrameClassRef=DemFreezeFrameClass_711871ef, DemMemoryDestinationRef=DemPrimaryMemory
        DemDTCAttributes_DTC_CD042F_FRTRCV_E_FR_ERRN_TRCV0: DemAgingAllowed=0, DemDTCSignificance=DEM_EVENT_SIGNIFICANCE_FAULT, DemMaxNumberFreezeFrameRecords=2, DemExtendedDataClassRef=DemExtendedDataClass_NoHealing, DemFreezeFrameClassRef=DemFreezeFrameClass_711871ef, DemMemoryDestinationRef=DemPrimaryMemory
        DemDTCAttributes_DTC_CD0431_FRTRCV_E_FR_ERRN_TRCV1: DemAgingAllowed=0, DemDTCSignificance=DEM_EVENT_SIGNIFICANCE_FAULT, DemMaxNumberFreezeFrameRecords=2, DemExtendedDataClassRef=DemExtendedDataClass_NoHealing, DemFreezeFrameClassRef=DemFreezeFrameClass_711871ef, DemMemoryDestinationRef=DemPrimaryMemory
        DemDTCAttributes_DTC_CD0433_FRTRCV_E_FR_ERRN_TRCV2: DemAgingAllowed=0, DemDTCSignificance=DEM_EVENT_SIGNIFICANCE_FAULT, DemMaxNumberFreezeFrameRecords=2, DemExtendedDataClassRef=DemExtendedDataClass_NoHealing, DemFreezeFrameClassRef=DemFreezeFrameClass_711871ef, DemMemoryDestinationRef=DemPrimaryMemory
        DemDTCAttributes_DTC_CD0435_FRTRCV_E_FR_ERRN_TRCV3: DemAgingAllowed=0, DemDTCSignificance=DEM_EVENT_SIGNIFICANCE_FAULT, DemMaxNumberFreezeFrameRecords=2, DemExtendedDataClassRef=DemExtendedDataClass_NoHealing, DemFreezeFrameClassRef=DemFreezeFrameClass_711871ef, DemMemoryDestinationRef=DemPrimaryMemory
        DemDTCAttributes_DTC_CD0437_FRTRCV_E_FR_ERRN_TRCV4: DemAgingAllowed=0, DemDTCSignificance=DEM_EVENT_SIGNIFICANCE_FAULT, DemMaxNumberFreezeFrameRecords=2, DemExtendedDataClassRef=DemExtendedDataClass_NoHealing, DemFreezeFrameClassRef=DemFreezeFrameClass_711871ef, DemMemoryDestinationRef=DemPrimaryMemory
        DemDTCAttributes_DTC_CD0439_FRTRCV_E_FR_ERRN_TRCV5: DemAgingAllowed=0, DemDTCSignificance=DEM_EVENT_SIGNIFICANCE_FAULT, DemMaxNumberFreezeFrameRecords=2, DemExtendedDataClassRef=DemExtendedDataClass_NoHealing, DemFreezeFrameClassRef=DemFreezeFrameClass_711871ef, DemMemoryDestinationRef=DemPrimaryMemory
        DemDTCAttributes_DTC_CD043B_FRTRCV_E_FR_ERRN_TRCV6: DemAgingAllowed=0, DemDTCSignificance=DEM_EVENT_SIGNIFICANCE_FAULT, DemMaxNumberFreezeFrameRecords=2, DemExtendedDataClassRef=DemExtendedDataClass_NoHealing, DemFreezeFrameClassRef=DemFreezeFrameClass_711871ef, DemMemoryDestinationRef=DemPrimaryMemory
        DemDTCAttributes_DTC_CD043D_FRTRCV_E_FR_ERRN_TRCV7: DemAgingAllowed=0, DemDTCSignificance=DEM_EVENT_SIGNIFICANCE_FAULT, DemMaxNumberFreezeFrameRecords=2, DemExtendedDataClassRef=DemExtendedDataClass_NoHealing, DemFreezeFrameClassRef=DemFreezeFrameClass_711871ef, DemMemoryDestinationRef=DemPrimaryMemory
        DemDTCAttributes_DTC_CD045F_CANTRCV_E_BUS_BODY_CAN_ERROR: DemAgingAllowed=0, DemDTCSignificance=DEM_EVENT_SIGNIFICANCE_FAULT, DemMaxNumberFreezeFrameRecords=2, DemExtendedDataClassRef=DemExtendedDataClass_NoHealing, DemFreezeFrameClassRef=DemFreezeFrameClass_711871ef, DemMemoryDestinationRef=DemPrimaryMemory
        DemDTCAttributes_DTC_CD0468_CANSM_E_BUS_Body_CAN_OFF: DemAgingAllowed=0, DemDTCSignificance=DEM_EVENT_SIGNIFICANCE_FAULT, DemMaxNumberFreezeFrameRecords=2, DemExtendedDataClassRef=DemExtendedDataClass_NoHealing, DemFreezeFrameClassRef=DemFreezeFrameClass_711871ef, DemMemoryDestinationRef=DemPrimaryMemory
        DemDTCAttributes_DTC_CD0469_CANTRCV_E_BUS_LP_CAN_ERROR: DemAgingAllowed=0, DemDTCSignificance=DEM_EVENT_SIGNIFICANCE_FAULT, DemMaxNumberFreezeFrameRecords=2, DemExtendedDataClassRef=DemExtendedDataClass_NoHealing, DemFreezeFrameClassRef=DemFreezeFrameClass_711871ef, DemMemoryDestinationRef=DemPrimaryMemory
        DemDTCAttributes_DTC_CD0472_CANSM_E_BUS_LP_CAN_OFF: DemAgingAllowed=0, DemDTCSignificance=DEM_EVENT_SIGNIFICANCE_FAULT, DemMaxNumberFreezeFrameRecords=2, DemExtendedDataClassRef=DemExtendedDataClass_NoHealing, DemFreezeFrameClassRef=DemFreezeFrameClass_711871ef, DemMemoryDestinationRef=DemPrimaryMemory
        DemDTCAttributes_DTC_CD0473_CANTRCV_E_BUS_LE_CAN_ERROR: DemAgingAllowed=0, DemDTCSignificance=DEM_EVENT_SIGNIFICANCE_FAULT, DemMaxNumberFreezeFrameRecords=2, DemExtendedDataClassRef=DemExtendedDataClass_NoHealing, DemFreezeFrameClassRef=DemFreezeFrameClass_711871ef, DemMemoryDestinationRef=DemPrimaryMemory
        DemDTCAttributes_DTC_CD047C_CANSM_E_BUS_LE_CAN_OFF: DemAgingAllowed=0, DemDTCSignificance=DEM_EVENT_SIGNIFICANCE_FAULT, DemMaxNumberFreezeFrameRecords=2, DemExtendedDataClassRef=DemExtendedDataClass_NoHealing, DemFreezeFrameClassRef=DemFreezeFrameClass_711871ef, DemMemoryDestinationRef=DemPrimaryMemory
        DemDTCAttributes_DTC_CD047D_CANTRCV_E_BUS_A_CAN_ERROR: DemAgingAllowed=0, DemDTCSignificance=DEM_EVENT_SIGNIFICANCE_FAULT, DemMaxNumberFreezeFrameRecords=2, DemExtendedDataClassRef=DemExtendedDataClass_NoHealing, DemFreezeFrameClassRef=DemFreezeFrameClass_711871ef, DemMemoryDestinationRef=DemPrimaryMemory
        DemDTCAttributes_DTC_CD0486_CANSM_E_BUS_A_CAN_OFF: DemAgingAllowed=0, DemDTCSignificance=DEM_EVENT_SIGNIFICANCE_FAULT, DemMaxNumberFreezeFrameRecords=2, DemExtendedDataClassRef=DemExtendedDataClass_NoHealing, DemFreezeFrameClassRef=DemFreezeFrameClass_711871ef, DemMemoryDestinationRef=DemPrimaryMemory
        DemDTCAttributes_DTC_CD0487_FRSM_E_CLUSTER_STARTUP: DemAgingAllowed=0, DemDTCSignificance=DEM_EVENT_SIGNIFICANCE_FAULT, DemMaxNumberFreezeFrameRecords=2, DemExtendedDataClassRef=DemExtendedDataClass_NoHealing, DemFreezeFrameClassRef=DemFreezeFrameClass_711871ef, DemMemoryDestinationRef=DemPrimaryMemory
        DemDTCAttributes_DTC_CD0501_CANTRCV_E_BUS_ZSG_CAN_ERROR: DemAgingAllowed=0, DemDTCSignificance=DEM_EVENT_SIGNIFICANCE_FAULT, DemMaxNumberFreezeFrameRecords=2, DemExtendedDataClassRef=DemExtendedDataClass_NoHealing, DemFreezeFrameClassRef=DemFreezeFrameClass_711871ef, DemMemoryDestinationRef=DemPrimaryMemory
        DemDTCAttributes_DTC_CD050A_CANSM_E_BUS_ZSG_CAN_OFF: DemAgingAllowed=0, DemDTCSignificance=DEM_EVENT_SIGNIFICANCE_FAULT, DemMaxNumberFreezeFrameRecords=2, DemExtendedDataClassRef=DemExtendedDataClass_NoHealing, DemFreezeFrameClassRef=DemFreezeFrameClass_711871ef, DemMemoryDestinationRef=DemPrimaryMemory
        DemDTCAttributes_DTC_CD050B_CANTRCV_E_BUS_B2_CAN_ERROR: DemAgingAllowed=0, DemDTCSignificance=DEM_EVENT_SIGNIFICANCE_FAULT, DemMaxNumberFreezeFrameRecords=2, DemExtendedDataClassRef=DemExtendedDataClass_NoHealing, DemFreezeFrameClassRef=DemFreezeFrameClass_711871ef, DemMemoryDestinationRef=DemPrimaryMemory
        DemDTCAttributes_DTC_CD0514_CANSM_E_BUS_B2_CAN_OFF: DemAgingAllowed=0, DemDTCSignificance=DEM_EVENT_SIGNIFICANCE_FAULT, DemMaxNumberFreezeFrameRecords=2, DemExtendedDataClassRef=DemExtendedDataClass_NoHealing, DemFreezeFrameClassRef=DemFreezeFrameClass_711871ef, DemMemoryDestinationRef=DemPrimaryMemory
        DemDTCAttributes_DTC_CD0601_DTC_CD0601: DemAgingAllowed=1, DemDTCSignificance=DEM_EVENT_SIGNIFICANCE_OCCURRENCE, DemMaxNumberFreezeFrameRecords=3, DemExtendedDataClassRef=DemExtendedDataClass_Healing, DemFreezeFrameClassRef=DemFreezeFrameClass_ebef819c, DemMemoryDestinationRef=DemUserDefinedMemory
        DemDTCAttributes_DTC_CD0602_ETH_SIGNAL_QUALITY_LOW: DemAgingAllowed=1, DemDTCSignificance=DEM_EVENT_SIGNIFICANCE_OCCURRENCE, DemMaxNumberFreezeFrameRecords=3, DemExtendedDataClassRef=DemExtendedDataClass_Healing, DemFreezeFrameClassRef=DemFreezeFrameClass_ebef819f, DemMemoryDestinationRef=DemPrimaryMemory
        DemDTCAttributes_DTC_CD0605_DTC_CD0605: DemAgingAllowed=1, DemDTCSignificance=DEM_EVENT_SIGNIFICANCE_OCCURRENCE, DemMaxNumberFreezeFrameRecords=3, DemExtendedDataClassRef=DemExtendedDataClass_Healing, DemFreezeFrameClassRef=DemFreezeFrameClass_ebef81bb, DemMemoryDestinationRef=DemUserDefinedMemory
        DemDTCAttributes_DTC_CD0606_DTC_CD0606: DemAgingAllowed=1, DemDTCSignificance=DEM_EVENT_SIGNIFICANCE_OCCURRENCE, DemMaxNumberFreezeFrameRecords=3, DemExtendedDataClassRef=DemExtendedDataClass_Healing, DemFreezeFrameClassRef=DemFreezeFrameClass_95fb4a10, DemMemoryDestinationRef=DemUserDefinedMemory
        DemDTCAttributes_DTC_CD0607_DTC_CD0607: DemAgingAllowed=1, DemDTCSignificance=DEM_EVENT_SIGNIFICANCE_OCCURRENCE, DemMaxNumberFreezeFrameRecords=3, DemExtendedDataClassRef=DemExtendedDataClass_Healing, DemFreezeFrameClassRef=DemFreezeFrameClass_7febc690, DemMemoryDestinationRef=DemUserDefinedMemory
        DemDTCAttributes_DTC_CD0BFF_DM_TEST_COM: DemAgingAllowed=0, DemDTCSignificance=DEM_EVENT_SIGNIFICANCE_OCCURRENCE, DemMaxNumberFreezeFrameRecords=2, DemExtendedDataClassRef=DemExtendedDataClass_NoHealing, DemFreezeFrameClassRef=DemFreezeFrameClass_711871ef, DemMemoryDestinationRef=DemPrimaryMemory
      59 x DemEventParameter, all with DemEventAvailable=1, DemEventFailureCycleCounterThreshold=1, DemOperationCycleRef=NON_OBD:
        CansmEBusACanOff: DemEventKind=DEM_EVENT_KIND_SWC, DemDTCRef=DTC_CD0486_CANSM_E_BUS_A_CAN_OFF, DemEnableConditionGroupRef=DEM_CONDITION_GROUP_ComErrorLock
        CansmEBusB2CanOff: DemEventKind=DEM_EVENT_KIND_SWC, DemDTCRef=DTC_CD0514_CANSM_E_BUS_B2_CAN_OFF, DemEnableConditionGroupRef=DEM_CONDITION_GROUP_ComErrorLock
        CansmEBusBodyCanOff: DemEventKind=DEM_EVENT_KIND_SWC, DemDTCRef=DTC_CD0468_CANSM_E_BUS_Body_CAN_OFF, DemEnableConditionGroupRef=DEM_CONDITION_GROUP_ComErrorLock
        CansmEBusFaCanOff: DemEventKind=DEM_EVENT_KIND_SWC, DemDTCRef=DTC_CD040A_CANSM_E_BUS_FA_CAN_OFF, DemEnableConditionGroupRef=DEM_CONDITION_GROUP_ComErrorLock
        CansmEBusIukCanOff: DemEventKind=DEM_EVENT_KIND_SWC, DemDTCRef=DTC_CD041E_CANSM_E_BUS_IuK_CAN_OFF, DemEnableConditionGroupRef=DEM_CONDITION_GROUP_ComErrorLock
        CansmEBusKCanOff: DemEventKind=DEM_EVENT_KIND_SWC, DemDTCRef=DTC_CD0414_CANSM_E_BUS_K_CAN_OFF, DemEnableConditionGroupRef=DEM_CONDITION_GROUP_ComErrorLock
        CansmEBusLeCanOff: DemEventKind=DEM_EVENT_KIND_SWC, DemDTCRef=DTC_CD047C_CANSM_E_BUS_LE_CAN_OFF, DemEnableConditionGroupRef=DEM_CONDITION_GROUP_ComErrorLock
        CansmEBusLpCanOff: DemEventKind=DEM_EVENT_KIND_SWC, DemDTCRef=DTC_CD0472_CANSM_E_BUS_LP_CAN_OFF, DemEnableConditionGroupRef=DEM_CONDITION_GROUP_ComErrorLock
        CansmEBusZsgCanOff: DemEventKind=DEM_EVENT_KIND_SWC, DemDTCRef=DTC_CD050A_CANSM_E_BUS_ZSG_CAN_OFF, DemEnableConditionGroupRef=DEM_CONDITION_GROUP_ComErrorLock
        CantrcvEBusACanError: DemEventKind=DEM_EVENT_KIND_SWC, DemDTCRef=DTC_CD047D_CANTRCV_E_BUS_A_CAN_ERROR, DemEnableConditionGroupRef=DEM_CONDITION_GROUP_ComErrorLock
        CantrcvEBusB2CanError: DemEventKind=DEM_EVENT_KIND_SWC, DemDTCRef=DTC_CD050B_CANTRCV_E_BUS_B2_CAN_ERROR, DemEnableConditionGroupRef=DEM_CONDITION_GROUP_ComErrorLock
        CantrcvEBusBodyCanError: DemEventKind=DEM_EVENT_KIND_SWC, DemDTCRef=DTC_CD045F_CANTRCV_E_BUS_BODY_CAN_ERROR, DemEnableConditionGroupRef=DEM_CONDITION_GROUP_ComErrorLock
        CantrcvEBusFaCanError: DemEventKind=DEM_EVENT_KIND_SWC, DemDTCRef=DTC_CD0401_CANTRCV_E_BUS_FA_CAN_ERROR, DemEnableConditionGroupRef=DEM_CONDITION_GROUP_ComErrorLock
        CantrcvEBusIukError: DemEventKind=DEM_EVENT_KIND_SWC, DemDTCRef=DTC_CD0415_CANTRCV_E_BUS_IUK_ERROR, DemEnableConditionGroupRef=DEM_CONDITION_GROUP_ComErrorLock
        CantrcvEBusKCanError: DemEventKind=DEM_EVENT_KIND_SWC, DemDTCRef=DTC_CD040B_CANTRCV_E_BUS_K_CAN_ERROR, DemEnableConditionGroupRef=DEM_CONDITION_GROUP_ComErrorLock
        CantrcvEBusLeCanError: DemEventKind=DEM_EVENT_KIND_SWC, DemDTCRef=DTC_CD0473_CANTRCV_E_BUS_LE_CAN_ERROR, DemEnableConditionGroupRef=DEM_CONDITION_GROUP_ComErrorLock
        CantrcvEBusLpCanError: DemEventKind=DEM_EVENT_KIND_SWC, DemDTCRef=DTC_CD0469_CANTRCV_E_BUS_LP_CAN_ERROR, DemEnableConditionGroupRef=DEM_CONDITION_GROUP_ComErrorLock
        CantrcvEBusZsgCanError: DemEventKind=DEM_EVENT_KIND_SWC, DemDTCRef=DTC_CD0501_CANTRCV_E_BUS_ZSG_CAN_ERROR, DemEnableConditionGroupRef=DEM_CONDITION_GROUP_ComErrorLock
        CbsReplacementValue: DemEventKind=DEM_EVENT_KIND_SWC, DemDTCRef=DTC_801D7C_CBS_REPLACEMENT_VALUE, DemEnableConditionGroupRef=DEM_CONDITION_GROUP_DefaultErrorLock
        CodingEventInvalidData: DemEventKind=DEM_EVENT_KIND_SWC, DemDTCRef=DTC_2100C_CODING_EVENT_INVALID_DATA, DemEnableConditionGroupRef=DEM_CONDITION_GROUP_DefaultErrorLock
        CodingEventNotCoded: DemEventKind=DEM_EVENT_KIND_SWC, DemDTCRef=DTC_21008_CODING_EVENT_NOT_CODED
          DemCallbackClearEventAllowed: DemClearEventAllowedBehavior=DEM_NO_STATUS_BYTE_CHANGE
        CodingEventSignatureError: DemEventKind=DEM_EVENT_KIND_SWC, DemDTCRef=DTC_2100A_CODING_EVENT_SIGNATURE_ERROR, DemEnableConditionGroupRef=DEM_CONDITION_GROUP_DefaultErrorLock
        CodingEventTransactionFailed: DemEventKind=DEM_EVENT_KIND_SWC, DemDTCRef=DTC_21009_CODING_EVENT_TRANSACTION_FAILED, DemEnableConditionGroupRef=DEM_CONDITION_GROUP_DefaultErrorLock
        CodingEventUnqualifiedData: DemEventKind=DEM_EVENT_KIND_SWC, DemDTCRef=DTC_2100D_CODING_EVENT_UNQUALIFIED_DATA, DemEnableConditionGroupRef=DEM_CONDITION_GROUP_DefaultErrorLock
        CodingEventWrongVehicle: DemEventKind=DEM_EVENT_KIND_SWC, DemDTCRef=DTC_2100B_CODING_EVENT_WRONG_VEHICLE, DemEnableConditionGroupRef=DEM_CONDITION_GROUP_DefaultErrorLock
        DmTestAppl: DemEventKind=DEM_EVENT_KIND_SWC, DemDTCRef=DTC_2FF10_DM_TEST_APPL, DemEnableConditionGroupRef=DEM_CONDITION_GROUP_DefaultErrorLock
        DmTestCom: DemEventKind=DEM_EVENT_KIND_SWC, DemDTCRef=DTC_CD0BFF_DM_TEST_COM, DemEnableConditionGroupRef=DEM_CONDITION_GROUP_ComErrorLock
        Dtc000030: DemEventKind=DEM_EVENT_KIND_SWC, DemDTCRef=DTC_30_DTC_000030, DemEnableConditionGroupRef=DEM_CONDITION_GROUP_DefaultErrorLock
        Dtc000031: DemEventKind=DEM_EVENT_KIND_SWC, DemDTCRef=DTC_31_DTC_000031, DemEnableConditionGroupRef=DEM_CONDITION_GROUP_DefaultErrorLock
        Dtc000032: DemEventKind=DEM_EVENT_KIND_SWC, DemDTCRef=DTC_32_DTC_000032, DemEnableConditionGroupRef=DEM_CONDITION_GROUP_DefaultErrorLock
        Dtc000033: DemEventKind=DEM_EVENT_KIND_SWC, DemDTCRef=DTC_33_DTC_000033, DemEnableConditionGroupRef=DEM_CONDITION_GROUP_DefaultErrorLock
        Dtc000034: DemEventKind=DEM_EVENT_KIND_SWC, DemDTCRef=DTC_34_DTC_000034, DemEnableConditionGroupRef=DEM_CONDITION_GROUP_DefaultErrorLock
        DtcCd0601: DemEventKind=DEM_EVENT_KIND_SWC, DemDTCRef=DTC_CD0601_DTC_CD0601, DemEnableConditionGroupRef=DEM_CONDITION_GROUP_ComErrorLock
        DtcCd{0605..0607}: DemEventKind=DEM_EVENT_KIND_SWC, DemDTCRef=DTC_CD{0605..0607}_DTC_CD{0605..0607}, DemEnableConditionGroupRef=DEM_CONDITION_GROUP_ComErrorLock
        EthSignalQualityLow: DemEventKind=DEM_EVENT_KIND_SWC, DemDTCRef=DTC_CD0602_ETH_SIGNAL_QUALITY_LOW, DemEnableConditionGroupRef=DEM_CONDITION_GROUP_ComErrorLock
        FrifEAcsChA: DemEventKind=DEM_EVENT_KIND_SWC, DemDTCRef=DTC_801D7B_FRIF_E_ACS_CH_A, DemEnableConditionGroupRef=DEM_CONDITION_GROUP_DefaultErrorLock
        FrifENitChA: DemEventKind=DEM_EVENT_KIND_SWC, DemDTCRef=DTC_801D7A_FRIF_E_NIT_CH_A, DemEnableConditionGroupRef=DEM_CONDITION_GROUP_DefaultErrorLock
        FrsmEClusterStartup: DemEventKind=DEM_EVENT_KIND_SWC, DemDTCRef=DTC_CD0487_FRSM_E_CLUSTER_STARTUP, DemEnableConditionGroupRef=DEM_CONDITION_GROUP_ComErrorLock
        FrsmEClusterSyncLoss: DemEventKind=DEM_EVENT_KIND_SWC, DemDTCRef=DTC_CD0420_FRSM_E_CLUSTER_SYNC_LOSS, DemEnableConditionGroupRef=DEM_CONDITION_GROUP_ComErrorLock
        FrtrcvEFrBuserrorTrcv0: DemEventKind=DEM_EVENT_KIND_SWC, DemDTCRef=DTC_CD041F_FRTRCV_E_FR_BUSERROR_TRCV0, DemEnableConditionGroupRef=DEM_CONDITION_GROUP_ComErrorLock
        FrtrcvEFrErrnTrcv0: DemEventKind=DEM_EVENT_KIND_SWC, DemDTCRef=DTC_CD042F_FRTRCV_E_FR_ERRN_TRCV0, DemEnableConditionGroupRef=DEM_CONDITION_GROUP_ComErrorLock
        FrtrcvEFrErrnTrcv1: DemEventKind=DEM_EVENT_KIND_SWC, DemDTCRef=DTC_CD0431_FRTRCV_E_FR_ERRN_TRCV1, DemEnableConditionGroupRef=DEM_CONDITION_GROUP_ComErrorLock
        FrtrcvEFrErrnTrcv2: DemEventKind=DEM_EVENT_KIND_SWC, DemDTCRef=DTC_CD0433_FRTRCV_E_FR_ERRN_TRCV2, DemEnableConditionGroupRef=DEM_CONDITION_GROUP_ComErrorLock
        FrtrcvEFrErrnTrcv3: DemEventKind=DEM_EVENT_KIND_SWC, DemDTCRef=DTC_CD0435_FRTRCV_E_FR_ERRN_TRCV3, DemEnableConditionGroupRef=DEM_CONDITION_GROUP_ComErrorLock
        FrtrcvEFrErrnTrcv4: DemEventKind=DEM_EVENT_KIND_SWC, DemDTCRef=DTC_CD0437_FRTRCV_E_FR_ERRN_TRCV4, DemEnableConditionGroupRef=DEM_CONDITION_GROUP_ComErrorLock
        FrtrcvEFrErrnTrcv5: DemEventKind=DEM_EVENT_KIND_SWC, DemDTCRef=DTC_CD0439_FRTRCV_E_FR_ERRN_TRCV5, DemEnableConditionGroupRef=DEM_CONDITION_GROUP_ComErrorLock
        FrtrcvEFrErrnTrcv6: DemEventKind=DEM_EVENT_KIND_SWC, DemDTCRef=DTC_CD043B_FRTRCV_E_FR_ERRN_TRCV6, DemEnableConditionGroupRef=DEM_CONDITION_GROUP_ComErrorLock
        FrtrcvEFrErrnTrcv7: DemEventKind=DEM_EVENT_KIND_SWC, DemDTCRef=DTC_CD043D_FRTRCV_E_FR_ERRN_TRCV7, DemEnableConditionGroupRef=DEM_CONDITION_GROUP_ComErrorLock
        LIN_E_TIMEOUT: DemEventKind=DEM_EVENT_KIND_BSW, DemDTCRef=DTC_21023_LIN_E_TIMEOUT, DemEnableConditionGroupRef=DEM_CONDITION_GROUP_DefaultErrorLock
        NVM_E_HARDWARE: DemEventKind=DEM_EVENT_KIND_BSW, DemDTCRef=DTC_21024_NVM_E_HARDWARE, DemEnableConditionGroupRef=DEM_CONDITION_GROUP_DefaultErrorLock
        Overvoltage: DemEventKind=DEM_EVENT_KIND_SWC, DemDTCRef=DTC_801D7D_OVERVOLTAGE, DemEnableConditionGroupRef=DEM_CONDITION_GROUP_DefaultErrorLock
        PiaEIoError: DemEventKind=DEM_EVENT_KIND_SWC, DemDTCRef=DTC_801D7F_PIA_E_IO_ERROR, DemEnableConditionGroupRef=DEM_CONDITION_GROUP_DefaultErrorLock
        SwtExternalCheckFailure: DemEventKind=DEM_EVENT_KIND_SWC, DemDTCRef=DTC_21003_SWT_EXTERNAL_CHECK_FAILURE, DemEnableConditionGroupRef=DEM_CONDITION_GROUP_DefaultErrorLock
        SwtInternalCheckFailure: DemEventKind=DEM_EVENT_KIND_SWC, DemDTCRef=DTC_21004_SWT_INTERNAL_CHECK_FAILURE, DemEnableConditionGroupRef=DEM_CONDITION_GROUP_DefaultErrorLock
        UDPNM_E_TCPIP_TRANSMIT_ERROR: DemEventKind=DEM_EVENT_KIND_BSW, DemDTCRef=DTC_801C00_UDPNM_E_TCPIP_TRANSMIT_ERROR, DemEnableConditionGroupRef=DEM_CONDITION_GROUP_DefaultErrorLock
        Undervoltage: DemEventKind=DEM_EVENT_KIND_SWC, DemDTCRef=DTC_801C7E_UNDERVOLTAGE, DemEnableConditionGroupRef=DEM_CONDITION_GROUP_DefaultErrorLock
        VsmEventOpmode: DemEventKind=DEM_EVENT_KIND_SWC, DemDTCRef=DTC_21000_VSM_EVENT_OPMODE
          DemCallbackClearEventAllowed: DemClearEventAllowedBehavior=DEM_NO_STATUS_BYTE_CHANGE
    DemGeneral:
      DemAgingCycleCounterProcessing = DEM_PROCESS_AGINGCTR_INTERN
      DemAgingRequieresTestedCycle = 1
      DemClearDTCBehavior = DEM_CLRRESP_NONVOLATILE_FINISH
      DemClearDTCLimitation = DEM_ALL_SUPPORTED_DTCS
      DemDataElementDefaultEndianness = BIG_ENDIAN
      DemEventDisplacementStrategy = DEM_DISPLACEMENT_FULL
      DemEventMemoryEntryStorageTrigger = DEM_TRIGGER_ON_TEST_FAILED
      DemOccurrenceCounterProcessing = DEM_PROCESS_OCCCTR_TF
      DemOperationCycleStatusStorage = 1
      DemPTOSupport = 0
      DemResetConfirmedBitOnOverflow = 1
      DemStatusBitHandlingTestFailedSinceLastClear = DEM_STATUS_BIT_AGING_AND_DISPLACEMENT
      DemStatusBitStorageTestFailed = 1
      DemTriggerMonitorInitBeforeClearOk = 1
      DemTypeOfDTCSupported = DEM_DTC_TRANSLATION_ISO14229_1
      DemTypeOfFreezeFrameRecordNumeration = DEM_FF_RECNUM_CALCULATED
      18 x DemDataElementClass:
        DemDataElementClass_ConditionByte
          DemInternalDataElementClass_ConditionByte (DemInternalDataElementClass): DemDataElementDataSize=1, DemInternalDataElement=DEM_OVFLIND
        DemDataElementClass_DuplicateIpAddress
        DemDataElementClass_EthArpDiscardType
        DemDataElementClass_EthDiscardedArpEntry
        DemDataElementClass_EthDroppedFrameStatus
        DemDataElementClass_EthSourceMacOfDuplicateIpAddress
          DemExternalCSDataElementClass_EthSourceMacOfDuplicateIpAddress (DemExternalCSDataElementClass): DemDataElementDataSize=6
        DemDataElementClass_FUwBn
        DemDataElementClass_FUwTn
          DemExternalCSDataElementClass_FUwTn (DemExternalCSDataElementClass): DemDataElementDataSize=3
        DemDataElementClass_FileManipulated
          DemExternalCSDataElementClass_FileManipulated (DemExternalCSDataElementClass): DemDataElementDataSize=18
        DemDataElementClass_HealingCounter
          DemInternalDataElementClass_HealingCounter (DemInternalDataElementClass): DemDataElementDataSize=1, DemInternalDataElement=DEM_AGINGCTR_UPCNT
        DemDataElementClass_KmStand
          DemExternalCSDataElementClass_KmStand (DemExternalCSDataElementClass): DemDataElementDataSize=3, DemDataElementUsePort=1
        DemDataElementClass_OccurrenceCounter
          DemInternalDataElementClass_OccurrenceCounter (DemInternalDataElementClass): DemDataElementDataSize=1, DemInternalDataElement=DEM_OCCCTR
        DemDataElementClass_Port0CrcErrorCount
        DemDataElementClass_Port0LowSignalQualityStatus
          DemExternalCSDataElementClass_Port0LowSignalQualityStatus (DemExternalCSDataElementClass): DemDataElementDataSize=1
        DemDataElementClass_SwtFehlerwert
          DemExternalSRDataElementClass_SwtFehlerwert (DemExternalSRDataElementClass): DemDataElementDataSize=8, DemDataElementDataType=UINT8
        DemDataElementClass_SwtSwid
          DemExternalCSDataElementClass_SwtSwid (DemExternalCSDataElementClass): DemDataElementDataSize=4, DemDataElementUsePort=1
        DemDataElementClass_SwtVin
          DemExternalCSDataElementClass_SwtVin (DemExternalCSDataElementClass): DemDataElementDataSize=7
        DemDataElementClass_Systemzeit
          DemExternalCSDataElementClass_Systemzeit (DemExternalCSDataElementClass): DemDataElementDataSize=4, DemDataElementUsePort=1
      15 x DemDidClass:
        DemDidClass_DuplicateIpAddress: DemDidIdentifier=6080, DemDidDataElementClassRef=DemDataElementClass_DuplicateIpAddress
        DemDidClass_EthArpDiscardType: DemDidIdentifier=5983, DemDidDataElementClassRef=DemDataElementClass_EthArpDiscardType
        DemDidClass_EthDiscardedArpEntry: DemDidIdentifier=5982, DemDidDataElementClassRef=DemDataElementClass_EthDiscardedArpEntry
        DemDidClass_EthDroppedFrameStatus: DemDidIdentifier=5981, DemDidDataElementClassRef=DemDataElementClass_EthDroppedFrameStatus
        DemDidClass_EthSourceMacOfDuplicateIpAddress: DemDidIdentifier=6081, DemDidDataElementClassRef=DemDataElementClass_EthSourceMacOfDuplicateIpAddress
        DemDidClass_FUwBn: DemDidIdentifier=5968, DemDidDataElementClassRef=DemDataElementClass_FUwBn
        DemDidClass_FUwTn: DemDidIdentifier=5969, DemDidDataElementClassRef=DemDataElementClass_FUwTn
        DemDidClass_FileManipulated: DemDidIdentifier=5985, DemDidDataElementClassRef=DemDataElementClass_FileManipulated
        DemDidClass_KmStand: DemDidIdentifier=5888, DemDidDataElementClassRef=DemDataElementClass_KmStand
        DemDidClass_Port0CrcErrorCount: DemDidIdentifier=5971, DemDidDataElementClassRef=DemDataElementClass_Port0CrcErrorCount
        DemDidClass_Port0LowSignalQualityStatus: DemDidIdentifier=5974, DemDidDataElementClassRef=DemDataElementClass_Port0LowSignalQualityStatus
        DemDidClass_SwtFehlerwert: DemDidIdentifier=5954, DemDidDataElementClassRef=DemDataElementClass_SwtFehlerwert
        DemDidClass_SwtSwid: DemDidIdentifier=5956, DemDidDataElementClassRef=DemDataElementClass_SwtSwid
        DemDidClass_SwtVin: DemDidIdentifier=5955, DemDidDataElementClassRef=DemDataElementClass_SwtVin
        DemDidClass_Systemzeit: DemDidIdentifier=5889, DemDidDataElementClassRef=DemDataElementClass_Systemzeit
      3 x DemEnableCondition, all with DemEnableConditionStatus=1:
        DemEnableCondition_Omc
        DemEnableCondition_StdDiag
        DemEnableCondition_Stm
      3 x DemEnableConditionGroup, all with DemEnableConditionRef=DemEnableCondition_StdDiag:
        DEM_CONDITION_GROUP_ComErrorLock: DemEnableConditionRef=DemEnableCondition_Stm
        DEM_CONDITION_GROUP_ComErrorLockFlAsTr: DemEnableConditionRef=DemEnableCondition_Omc, DemEnableConditionRef=DemEnableCondition_Stm
        DEM_CONDITION_GROUP_DefaultErrorLock
      DemExtendedDataClass_Healing (DemExtendedDataClass):
        DemExtendedDataRecordClassRef = DemExtendedDataRecordClass_OccurrenceCounter
        DemExtendedDataRecordClassRef = DemExtendedDataRecordClass_HealingCounter
        DemExtendedDataRecordClassRef = DemExtendedDataRecordClass_ConditionByte
      DemExtendedDataClass_NoHealing (DemExtendedDataClass):
        DemExtendedDataRecordClassRef = DemExtendedDataRecordClass_ConditionByte
        DemExtendedDataRecordClassRef = DemExtendedDataRecordClass_OccurrenceCounter
      3 x DemExtendedDataRecordClass, all with DemExtendedDataRecordUpdate=DEM_UPDATE_RECORD_YES:
        DemExtendedDataRecordClass_ConditionByte: DemExtendedDataRecordNumber=1, DemDataElementClassRef=DemDataElementClass_ConditionByte
        DemExtendedDataRecordClass_HealingCounter: DemExtendedDataRecordNumber=3, DemDataElementClassRef=DemDataElementClass_HealingCounter
        DemExtendedDataRecordClass_OccurrenceCounter: DemExtendedDataRecordNumber=2, DemDataElementClassRef=DemDataElementClass_OccurrenceCounter
      9 x DemFreezeFrameClass, all with DemDidClassRef=DemDidClass_FUwBn, DemDidClassRef=DemDidClass_FUwTn, DemDidClassRef=DemDidClass_KmStand, DemDidClassRef=DemDidClass_Systemzeit:
        DemFreezeFrameClass_711871ef
        DemFreezeFrameClass_7febc690: DemDidClassRef=DemDidClass_DuplicateIpAddress, DemDidClassRef=DemDidClass_EthSourceMacOfDuplicateIpAddress
        DemFreezeFrameClass_8ef63883: DemDidClassRef=DemDidClass_SwtFehlerwert
        DemFreezeFrameClass_95fb4a10: DemDidClassRef=DemDidClass_EthArpDiscardType, DemDidClassRef=DemDidClass_EthDiscardedArpEntry
        DemFreezeFrameClass_9ec24f64: DemDidClassRef=DemDidClass_SwtFehlerwert, DemDidClassRef=DemDidClass_SwtSwid, DemDidClassRef=DemDidClass_SwtVin
        DemFreezeFrameClass_ebef819c: DemDidClassRef=DemDidClass_Port0CrcErrorCount
        DemFreezeFrameClass_ebef819f: DemDidClassRef=DemDidClass_Port0LowSignalQualityStatus
        DemFreezeFrameClass_ebef81bb: DemDidClassRef=DemDidClass_EthDroppedFrameStatus
        DemFreezeFrameClass_ebef81bf: DemDidClassRef=DemDidClass_FileManipulated
      NON_OBD (DemOperationCycle): DemOperationCycleId=0, DemOperationCycleType=DEM_OPCYC_POWER
      DemPrimaryMemory
      DemUserDefinedMemory
