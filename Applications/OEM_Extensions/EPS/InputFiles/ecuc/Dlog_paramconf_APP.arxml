AUTOSAR XML (schema 4-2-2)
package /BMW_CONF
  module config Dlog
    Dlog_Features: EnableEcuWriteVin=1
    Dlog_General: DlogUseCoding=1
