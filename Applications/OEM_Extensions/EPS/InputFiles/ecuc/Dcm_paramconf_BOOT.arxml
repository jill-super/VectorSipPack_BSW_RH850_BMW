AUTOSAR XML (schema 4-2-2)
package /BMW_CONF
  module config Dcm
    DcmConfigSet
      DcmDsd: DcmDsdRequestManufacturerNotificationEnabled=1
        Prog (DcmDsdServiceRequestManufacturerNotification)
        DcmDsdServiceTable
          3 x DcmDsdService, all with DcmDsdServiceUsed=1, DcmDsdSidTabSessionLevelRef=DcmDspSessionRow_PROGRAMMING_SESSION:
            DcmDsdService_READ_DATA_BY_IDENTIFIER: DcmDsdSidTabServiceId=34, DcmDsdSidTabSubfuncAvail=0, DcmDsdSidTabSessionLevelRef=DcmDspSessionRow_DEFAULT_SESSION, DcmDsdSidTabSessionLevelRef=DcmDspSessionRow_EXTENDED_DIAGNOSTIC_SESSION
            DcmDsdService_ROUTINE_CONTROL: DcmDsdSidTabServiceId=49, DcmDsdSidTabSubfuncAvail=1, DcmDsdSidTabSessionLevelRef=DcmDspSessionRow_DEFAULT_SESSION, DcmDsdSidTabSessionLevelRef=DcmDspSessionRow_EXTENDED_DIAGNOSTIC_SESSION
            DcmDsdService_WRITE_DATA_BY_IDENTIFIER: DcmDsdSidTabServiceId=46, DcmDsdSidTabSubfuncAvail=0, DcmDsdSidTabSecurityLevelRef=DcmDspSecurityRow_Programming_HDD
      DcmDsl
        DcmDslProtocol
          DcmDslProtocolRow_DCM_UDS_ON_FLEXRAY (DcmDslProtocolRow): DcmDslProtocolID=DCM_UDS_ON_FLEXRAY, DcmDslProtocolRowUsed=1, DcmDslProtocolTransType=TYPE1, DcmSendRespPendOnTransToBoot=1
            14 x DcmDslConnection:
              DcmDslConnection_0xF0
                DcmDslMainConnection: DcmDslProtocolRxTesterSourceAddr=240
                  DcmDslProtocolRx_0xF0_fu (DcmDslProtocolRx): DcmDslProtocolRxAddrType=DCM_FUNCTIONAL_TYPE
                  DcmDslProtocolRx_0xF0_ph (DcmDslProtocolRx): DcmDslProtocolRxAddrType=DCM_PHYSICAL_TYPE
                  DcmDslProtocolTx_0xF0 (DcmDslProtocolTx)
              DcmDslConnection_0xF1
                DcmDslMainConnection: DcmDslProtocolRxTesterSourceAddr=241
                  DcmDslProtocolRx_0xF1_fu (DcmDslProtocolRx): DcmDslProtocolRxAddrType=DCM_FUNCTIONAL_TYPE
                  DcmDslProtocolRx_0xF1_ph (DcmDslProtocolRx): DcmDslProtocolRxAddrType=DCM_PHYSICAL_TYPE
                  DcmDslProtocolTx_0xF1 (DcmDslProtocolTx)
              DcmDslConnection_0xF2
                DcmDslMainConnection: DcmDslProtocolRxTesterSourceAddr=242
                  DcmDslProtocolRx_0xF2_fu (DcmDslProtocolRx): DcmDslProtocolRxAddrType=DCM_FUNCTIONAL_TYPE
                  DcmDslProtocolRx_0xF2_ph (DcmDslProtocolRx): DcmDslProtocolRxAddrType=DCM_PHYSICAL_TYPE
                  DcmDslProtocolTx_0xF2 (DcmDslProtocolTx)
              DcmDslConnection_0xF3
                DcmDslMainConnection: DcmDslProtocolRxTesterSourceAddr=243
                  DcmDslProtocolRx_0xF3_fu (DcmDslProtocolRx): DcmDslProtocolRxAddrType=DCM_FUNCTIONAL_TYPE
                  DcmDslProtocolRx_0xF3_ph (DcmDslProtocolRx): DcmDslProtocolRxAddrType=DCM_PHYSICAL_TYPE
                  DcmDslProtocolTx_0xF3 (DcmDslProtocolTx)
              DcmDslConnection_0xF4
                DcmDslMainConnection: DcmDslProtocolRxTesterSourceAddr=244
                  DcmDslProtocolRx_0xF4_fu (DcmDslProtocolRx): DcmDslProtocolRxAddrType=DCM_FUNCTIONAL_TYPE
                  DcmDslProtocolRx_0xF4_ph (DcmDslProtocolRx): DcmDslProtocolRxAddrType=DCM_PHYSICAL_TYPE
                  DcmDslProtocolTx_0xF4 (DcmDslProtocolTx)
              DcmDslConnection_0xF5
                DcmDslMainConnection: DcmDslProtocolRxTesterSourceAddr=245
                  DcmDslProtocolRx_0xF5_fu (DcmDslProtocolRx): DcmDslProtocolRxAddrType=DCM_FUNCTIONAL_TYPE
                  DcmDslProtocolRx_0xF5_ph (DcmDslProtocolRx): DcmDslProtocolRxAddrType=DCM_PHYSICAL_TYPE
                  DcmDslProtocolTx_0xF5 (DcmDslProtocolTx)
              DcmDslConnection_0xF6
                DcmDslMainConnection: DcmDslProtocolRxTesterSourceAddr=246
                  DcmDslProtocolRx_0xF6_fu (DcmDslProtocolRx): DcmDslProtocolRxAddrType=DCM_FUNCTIONAL_TYPE
                  DcmDslProtocolRx_0xF6_ph (DcmDslProtocolRx): DcmDslProtocolRxAddrType=DCM_PHYSICAL_TYPE
                  DcmDslProtocolTx_0xF6 (DcmDslProtocolTx)
              DcmDslConnection_0xF7
                DcmDslMainConnection: DcmDslProtocolRxTesterSourceAddr=247
                  DcmDslProtocolRx_0xF7_fu (DcmDslProtocolRx): DcmDslProtocolRxAddrType=DCM_FUNCTIONAL_TYPE
                  DcmDslProtocolRx_0xF7_ph (DcmDslProtocolRx): DcmDslProtocolRxAddrType=DCM_PHYSICAL_TYPE
                  DcmDslProtocolTx_0xF7 (DcmDslProtocolTx)
              DcmDslConnection_0xF8
                DcmDslMainConnection: DcmDslProtocolRxTesterSourceAddr=248
                  DcmDslProtocolRx_0xF8_fu (DcmDslProtocolRx): DcmDslProtocolRxAddrType=DCM_FUNCTIONAL_TYPE
                  DcmDslProtocolRx_0xF8_ph (DcmDslProtocolRx): DcmDslProtocolRxAddrType=DCM_PHYSICAL_TYPE
                  DcmDslProtocolTx_0xF8 (DcmDslProtocolTx)
              DcmDslConnection_0xF9
                DcmDslMainConnection: DcmDslProtocolRxTesterSourceAddr=249
                  DcmDslProtocolRx_0xF9_fu (DcmDslProtocolRx): DcmDslProtocolRxAddrType=DCM_FUNCTIONAL_TYPE
                  DcmDslProtocolRx_0xF9_ph (DcmDslProtocolRx): DcmDslProtocolRxAddrType=DCM_PHYSICAL_TYPE
                  DcmDslProtocolTx_0xF9 (DcmDslProtocolTx)
              DcmDslConnection_0xFA
                DcmDslMainConnection: DcmDslProtocolRxTesterSourceAddr=250
                  DcmDslProtocolRx_0xFA_fu (DcmDslProtocolRx): DcmDslProtocolRxAddrType=DCM_FUNCTIONAL_TYPE
                  DcmDslProtocolRx_0xFA_ph (DcmDslProtocolRx): DcmDslProtocolRxAddrType=DCM_PHYSICAL_TYPE
                  DcmDslProtocolTx_0xFA (DcmDslProtocolTx)
              DcmDslConnection_0xFB
                DcmDslMainConnection: DcmDslProtocolRxTesterSourceAddr=251
                  DcmDslProtocolRx_0xFB_fu (DcmDslProtocolRx): DcmDslProtocolRxAddrType=DCM_FUNCTIONAL_TYPE
                  DcmDslProtocolRx_0xFB_ph (DcmDslProtocolRx): DcmDslProtocolRxAddrType=DCM_PHYSICAL_TYPE
                  DcmDslProtocolTx_0xFB (DcmDslProtocolTx)
              DcmDslConnection_0xFC
                DcmDslMainConnection: DcmDslProtocolRxTesterSourceAddr=252
                  DcmDslProtocolRx_0xFC_fu (DcmDslProtocolRx): DcmDslProtocolRxAddrType=DCM_FUNCTIONAL_TYPE
                  DcmDslProtocolRx_0xFC_ph (DcmDslProtocolRx): DcmDslProtocolRxAddrType=DCM_PHYSICAL_TYPE
                  DcmDslProtocolTx_0xFC (DcmDslProtocolTx)
              DcmDslConnection_0xFD
                DcmDslMainConnection: DcmDslProtocolRxTesterSourceAddr=253
                  DcmDslProtocolRx_0xFD_fu (DcmDslProtocolRx): DcmDslProtocolRxAddrType=DCM_FUNCTIONAL_TYPE
                  DcmDslProtocolRx_0xFD_ph (DcmDslProtocolRx): DcmDslProtocolRxAddrType=DCM_PHYSICAL_TYPE
                  DcmDslProtocolTx_0xFD (DcmDslProtocolTx)
      DcmDsp: DcmDspDataDefaultEndianness=BIG_ENDIAN, DcmDspMaxDidToRead=1, DcmResponseToEcuReset=BEFORE_RESET
        4 x DcmDspCommonAuthorization:
          DcmDspCommonAuthorization_1f05440b: DcmDspCommonAuthorizationSecurityLevelRef=DcmDspSecurityRow_Programming_HDD, DcmDspCommonAuthorizationSessionRef=DcmDspSessionRow_PROGRAMMING_SESSION
          DcmDspCommonAuthorization_af67410c: DcmDspCommonAuthorizationSessionRef=DcmDspSessionRow_DEFAULT_SESSION, DcmDspCommonAuthorizationSessionRef=DcmDspSessionRow_EXTENDED_DIAGNOSTIC_SESSION, DcmDspCommonAuthorizationSessionRef=DcmDspSessionRow_PROGRAMMING_SESSION
          DcmDspCommonAuthorization_d884a83: DcmDspCommonAuthorizationSessionRef=DcmDspSessionRow_EXTENDED_DIAGNOSTIC_SESSION
          DcmDspCommonAuthorization_eabf1d27: DcmDspCommonAuthorizationSessionRef=DcmDspSessionRow_DEFAULT_SESSION, DcmDspCommonAuthorizationSessionRef=DcmDspSessionRow_EXTENDED_DIAGNOSTIC_SESSION
        80 x DcmDspData:
          DcmDspData_ActiveDiagnosticSession: DcmDspDataConditionCheckReadFncUsed=0, DcmDspDataReadFnc=Prog_ReadDataByIdentifierReadActiveDiagnosticSession, DcmDspDataSize=8, DcmDspDataType=UINT8_N, DcmDspDataUsePort=USE_DATA_SYNCH_FNC
          DcmDspData_EcuSerialNumber: DcmDspDataConditionCheckReadFncUsed=0, DcmDspDataReadFnc=Dlog_ReadDataByIdentifierEcuSerialNumber, DcmDspDataSize=80, DcmDspDataType=UINT8_N, DcmDspDataUsePort=USE_DATA_SYNCH_FNC
          DcmDspData_EnergySavingState: DcmDspDataConditionCheckReadFncUsed=0, DcmDspDataReadFnc=Prog_ReadDataByIdentifierEnergyState, DcmDspDataSize=8, DcmDspDataType=UINT8_N, DcmDspDataUsePort=USE_DATA_SYNCH_FNC
          DcmDspData_EthPhyLinkState: DcmDspDataSize=24, DcmDspDataType=UINT8_N
          DcmDspData_ExtendedEnergySavingState: DcmDspDataConditionCheckReadFncUsed=0, DcmDspDataReadFnc=Prog_ReadDataByIdentifierEnergyStateExtension, DcmDspDataSize=8, DcmDspDataType=UINT8_N, DcmDspDataUsePort=USE_DATA_SYNCH_FNC
          DcmDspData_FlashTimingParameter: DcmDspDataConditionCheckReadFncUsed=0, DcmDspDataReadFnc=Dlog_ReadDataByIdentifierFlashTimingParameter, DcmDspDataSize=96, DcmDspDataType=UINT8_N, DcmDspDataUsePort=USE_DATA_SYNCH_FNC
          DcmDspData_Herstelldatum: DcmDspDataConditionCheckReadFncUsed=0, DcmDspDataReadFnc=Dlog_ReadDataByIdentifierManufacturingDate, DcmDspDataSize=24, DcmDspDataType=UINT8_N, DcmDspDataUsePort=USE_DATA_SYNCH_FNC
          DcmDspData_MemoryAddress: DcmDspDataConditionCheckReadFncUsed=0, DcmDspDataReadFnc=Prog_ReadDataByIdentifierReadMemoryAddress, DcmDspDataSize=48, DcmDspDataType=UINT8_N, DcmDspDataUsePort=USE_DATA_SYNCH_FNC
          DcmDspData_MemorySegmentationTable: DcmDspDataConditionCheckReadFnc=Dlog_ConditionCheckMemorySegmentationTable, DcmDspDataConditionCheckReadFncUsed=1, DcmDspDataReadDataLengthFnc=Dlog_ReadDataLengthMemorySegmentationTable, DcmDspDataReadFnc=Dlog_ReadDataByIdentifierMemorySegmentationTable, DcmDspDataType=UINT8_DYN, DcmDspDataUsePort=USE_DATA_ASYNCH_FNC
          DcmDspData_ProgrammingCounter: DcmDspDataConditionCheckReadFncUsed=0, DcmDspDataReadFnc=Dlog_ReadDataByIdentifierProgrammingCounter, DcmDspDataSize=32, DcmDspDataType=UINT8_N, DcmDspDataUsePort=USE_DATA_SYNCH_FNC
          DcmDspData_ProgrammingCounterMaxValue: DcmDspDataConditionCheckReadFncUsed=0, DcmDspDataReadFnc=Dlog_ReadDataByIdentifierProgrammingCounterMaxValue, DcmDspDataSize=16, DcmDspDataType=UINT8_N, DcmDspDataUsePort=USE_DATA_SYNCH_FNC
          DcmDspData_ReadActiveSessionState: DcmDspDataConditionCheckReadFncUsed=0, DcmDspDataReadFnc=Prog_ReadDataByIdentifierReadActiveSessionState, DcmDspDataSize=32, DcmDspDataType=UINT8_N, DcmDspDataUsePort=USE_DATA_SYNCH_FNC
          DcmDspData_Readhwmodificationindex: DcmDspDataSize=16, DcmDspDataType=UINT8_N
          DcmDspData_SvkAktuell: DcmDspDataConditionCheckReadFnc=Dlog_ConditionCheckSvkCurrent, DcmDspDataConditionCheckReadFncUsed=1, DcmDspDataReadDataLengthFnc=Dlog_ReadDataLengthSvkCurrent, DcmDspDataReadFnc=Dlog_ReadDataByIdentifierSvkCurrent, DcmDspDataType=UINT8_DYN, DcmDspDataUsePort=USE_DATA_ASYNCH_FNC
          DcmDspData_SvkBackup{01..03}: DcmDspDataConditionCheckReadFnc=Dlog_ConditionCheckSvkBackup{01..03}, DcmDspDataConditionCheckReadFncUsed=1, DcmDspDataReadDataLengthFnc=Dlog_ReadDataLengthSvkBackup{01..03}, DcmDspDataReadFnc=Dlog_ReadDataByIdentifierSvkBackup{01..03}, DcmDspDataType=UINT8_N, DcmDspDataUsePort=USE_DATA_ASYNCH_FNC
          DcmDspData_SvkBackup{04..61}: DcmDspDataType=UINT8_N
          DcmDspData_SvkSysSupplier: DcmDspDataConditionCheckReadFnc=Dlog_ConditionCheckSvkSysSupplier, DcmDspDataConditionCheckReadFncUsed=1, DcmDspDataReadDataLengthFnc=Dlog_ReadDataLengthSvkSysSupplier, DcmDspDataReadFnc=Dlog_ReadDataByIdentifierSvkSysSupplier, DcmDspDataType=UINT8_N, DcmDspDataUsePort=USE_DATA_ASYNCH_FNC
          DcmDspData_SvkWerk: DcmDspDataConditionCheckReadFnc=Dlog_ConditionCheckSvkPlant, DcmDspDataConditionCheckReadFncUsed=1, DcmDspDataReadDataLengthFnc=Dlog_ReadDataLengthSvkPlant, DcmDspDataReadFnc=Dlog_ReadDataByIdentifierSvkPlant, DcmDspDataType=UINT8_N, DcmDspDataUsePort=USE_DATA_ASYNCH_FNC
          DcmDspData_SwfkDeleteSupported: DcmDspDataConditionCheckReadFncUsed=0, DcmDspDataReadFnc=Dlog_ReadDataByIdentifierSwfkDeleteSupported, DcmDspDataSize=8, DcmDspDataType=UINT8_N, DcmDspDataUsePort=USE_DATA_SYNCH_FNC
          DcmDspData_Vin: DcmDspDataConditionCheckReadFnc=Dlog_ConditionCheckVin, DcmDspDataConditionCheckReadFncUsed=1, DcmDspDataReadFnc=Dlog_ReadDataByIdentifierVin, DcmDspDataSize=136, DcmDspDataType=UINT8_N, DcmDspDataUsePort=USE_DATA_ASYNCH_FNC, DcmDspDataWriteFnc=Dlog_WriteDataByIdentifierVin
          DcmDspData_WdbiFp: DcmDspDataConditionCheckReadFncUsed=0, DcmDspDataType=UINT8_DYN, DcmDspDataUsePort=USE_DATA_SYNCH_FNC, DcmDspDataWriteFnc=Dlog_WriteDataByIdentifierFingerprint
        80 x DcmDspDid, all with DcmDspDidUsed=1:
          DcmDspDid_ActiveDiagnosticSession: DcmDspDidIdentifier=61830, DcmDspDidInfoRef=DcmDspDidInfo_ActiveDiagnosticSession
            DcmDspDidSignal_ActiveDiagnosticSession (DcmDspDidSignal): DcmDspDidDataPos=0, DcmDspDidDataRef=DcmDspData_ActiveDiagnosticSession
          DcmDspDid_EcuSerialNumber: DcmDspDidIdentifier=61836, DcmDspDidInfoRef=DcmDspDidInfo_EcuSerialNumber
            DcmDspDidSignal_EcuSerialNumber (DcmDspDidSignal): DcmDspDidDataPos=0, DcmDspDidDataRef=DcmDspData_EcuSerialNumber
          DcmDspDid_EnergySavingState: DcmDspDidIdentifier=4106, DcmDspDidInfoRef=DcmDspDidInfo_EnergySavingState
            DcmDspDidSignal_EnergySavingState (DcmDspDidSignal): DcmDspDidDataPos=0, DcmDspDidDataRef=DcmDspData_EnergySavingState
          DcmDspDid_EthPhyLinkState: DcmDspDidIdentifier=6146, DcmDspDidInfoRef=DcmDspDidInfo_EthPhyLinkState
            DcmDspDidSignal_EthPhyLinkState (DcmDspDidSignal): DcmDspDidDataPos=0, DcmDspDidDataRef=DcmDspData_EthPhyLinkState
          DcmDspDid_ExtendedEnergySavingState: DcmDspDidIdentifier=4110, DcmDspDidInfoRef=DcmDspDidInfo_ExtendedEnergySavingState
            DcmDspDidSignal_ExtendedEnergySavingState (DcmDspDidSignal): DcmDspDidDataPos=0, DcmDspDidDataRef=DcmDspData_ExtendedEnergySavingState
          DcmDspDid_FlashTimingParameter: DcmDspDidIdentifier=9476, DcmDspDidInfoRef=DcmDspDidInfo_FlashTimingParameter
            DcmDspDidSignal_FlashTimingParameter (DcmDspDidSignal): DcmDspDidDataPos=0, DcmDspDidDataRef=DcmDspData_FlashTimingParameter
          DcmDspDid_Herstelldatum: DcmDspDidIdentifier=61835, DcmDspDidInfoRef=DcmDspDidInfo_Herstelldatum
            DcmDspDidSignal_Herstelldatum (DcmDspDidSignal): DcmDspDidDataPos=0, DcmDspDidDataRef=DcmDspData_Herstelldatum
          DcmDspDid_MemoryAddress: DcmDspDidIdentifier=9478, DcmDspDidInfoRef=DcmDspDidInfo_MemoryAddress
            DcmDspDidSignal_MemoryAddress (DcmDspDidSignal): DcmDspDidDataPos=0, DcmDspDidDataRef=DcmDspData_MemoryAddress
          DcmDspDid_MemorySegmentationTable: DcmDspDidIdentifier=9473, DcmDspDidInfoRef=DcmDspDidInfo_MemorySegmentationTable
            DcmDspDidSignal_MemorySegmentationTable (DcmDspDidSignal): DcmDspDidDataPos=0, DcmDspDidDataRef=DcmDspData_MemorySegmentationTable
          DcmDspDid_ProgrammingCounter: DcmDspDidIdentifier=9474, DcmDspDidInfoRef=DcmDspDidInfo_ProgrammingCounter
            DcmDspDidSignal_ProgrammingCounter (DcmDspDidSignal): DcmDspDidDataPos=0, DcmDspDidDataRef=DcmDspData_ProgrammingCounter
          DcmDspDid_ProgrammingCounterMaxValue: DcmDspDidIdentifier=9475, DcmDspDidInfoRef=DcmDspDidInfo_ProgrammingCounterMaxValue
            DcmDspDidSignal_ProgrammingCounterMaxValue (DcmDspDidSignal): DcmDspDidDataPos=0, DcmDspDidDataRef=DcmDspData_ProgrammingCounterMaxValue
          DcmDspDid_ReadActiveSessionState: DcmDspDidIdentifier=61696, DcmDspDidInfoRef=DcmDspDidInfo_ReadActiveSessionState
            DcmDspDidSignal_ReadActiveSessionState (DcmDspDidSignal): DcmDspDidDataPos=0, DcmDspDidDataRef=DcmDspData_ReadActiveSessionState
          DcmDspDid_Readhwmodificationindex: DcmDspDidIdentifier=61778, DcmDspDidInfoRef=DcmDspDidInfo_Readhwmodificationindex
            DcmDspDidSignal_Readhwmodificationindex (DcmDspDidSignal): DcmDspDidDataPos=0, DcmDspDidDataRef=DcmDspData_Readhwmodificationindex
          DcmDspDid_SvkAktuell: DcmDspDidIdentifier=61697, DcmDspDidInfoRef=DcmDspDidInfo_SvkAktuell
            DcmDspDidSignal_SvkAktuell (DcmDspDidSignal): DcmDspDidDataPos=0, DcmDspDidDataRef=DcmDspData_SvkAktuell
          DcmDspDid_SvkBackup01: DcmDspDidIdentifier=61700, DcmDspDidInfoRef=DcmDspDidInfo_SvkBackup01
            DcmDspDidSignal_SvkBackup01 (DcmDspDidSignal): DcmDspDidDataPos=0, DcmDspDidDataRef=DcmDspData_SvkBackup01
          DcmDspDid_SvkBackup02: DcmDspDidIdentifier=61701, DcmDspDidInfoRef=DcmDspDidInfo_SvkBackup02
            DcmDspDidSignal_SvkBackup02 (DcmDspDidSignal): DcmDspDidDataPos=0, DcmDspDidDataRef=DcmDspData_SvkBackup02
          DcmDspDid_SvkBackup03: DcmDspDidIdentifier=61702, DcmDspDidInfoRef=DcmDspDidInfo_SvkBackup03
            DcmDspDidSignal_SvkBackup03 (DcmDspDidSignal): DcmDspDidDataPos=0, DcmDspDidDataRef=DcmDspData_SvkBackup03
          DcmDspDid_SvkBackup04: DcmDspDidIdentifier=61703, DcmDspDidInfoRef=DcmDspDidInfo_SvkBackup04
            DcmDspDidSignal_SvkBackup04 (DcmDspDidSignal): DcmDspDidDataPos=0, DcmDspDidDataRef=DcmDspData_SvkBackup04
          DcmDspDid_SvkBackup05: DcmDspDidIdentifier=61704, DcmDspDidInfoRef=DcmDspDidInfo_SvkBackup05
            DcmDspDidSignal_SvkBackup05 (DcmDspDidSignal): DcmDspDidDataPos=0, DcmDspDidDataRef=DcmDspData_SvkBackup05
          DcmDspDid_SvkBackup06: DcmDspDidIdentifier=61705, DcmDspDidInfoRef=DcmDspDidInfo_SvkBackup06
            DcmDspDidSignal_SvkBackup06 (DcmDspDidSignal): DcmDspDidDataPos=0, DcmDspDidDataRef=DcmDspData_SvkBackup06
          DcmDspDid_SvkBackup07: DcmDspDidIdentifier=61706, DcmDspDidInfoRef=DcmDspDidInfo_SvkBackup07
            DcmDspDidSignal_SvkBackup07 (DcmDspDidSignal): DcmDspDidDataPos=0, DcmDspDidDataRef=DcmDspData_SvkBackup07
          DcmDspDid_SvkBackup08: DcmDspDidIdentifier=61707, DcmDspDidInfoRef=DcmDspDidInfo_SvkBackup08
            DcmDspDidSignal_SvkBackup08 (DcmDspDidSignal): DcmDspDidDataPos=0, DcmDspDidDataRef=DcmDspData_SvkBackup08
          DcmDspDid_SvkBackup09: DcmDspDidIdentifier=61708, DcmDspDidInfoRef=DcmDspDidInfo_SvkBackup09
            DcmDspDidSignal_SvkBackup09 (DcmDspDidSignal): DcmDspDidDataPos=0, DcmDspDidDataRef=DcmDspData_SvkBackup09
          DcmDspDid_SvkBackup10: DcmDspDidIdentifier=61709, DcmDspDidInfoRef=DcmDspDidInfo_SvkBackup10
            DcmDspDidSignal_SvkBackup10 (DcmDspDidSignal): DcmDspDidDataPos=0, DcmDspDidDataRef=DcmDspData_SvkBackup10
          DcmDspDid_SvkBackup11: DcmDspDidIdentifier=61710, DcmDspDidInfoRef=DcmDspDidInfo_SvkBackup11
            DcmDspDidSignal_SvkBackup11 (DcmDspDidSignal): DcmDspDidDataPos=0, DcmDspDidDataRef=DcmDspData_SvkBackup11
          DcmDspDid_SvkBackup12: DcmDspDidIdentifier=61711, DcmDspDidInfoRef=DcmDspDidInfo_SvkBackup12
            DcmDspDidSignal_SvkBackup12 (DcmDspDidSignal): DcmDspDidDataPos=0, DcmDspDidDataRef=DcmDspData_SvkBackup12
          DcmDspDid_SvkBackup13: DcmDspDidIdentifier=61712, DcmDspDidInfoRef=DcmDspDidInfo_SvkBackup13
            DcmDspDidSignal_SvkBackup13 (DcmDspDidSignal): DcmDspDidDataPos=0, DcmDspDidDataRef=DcmDspData_SvkBackup13
          DcmDspDid_SvkBackup14: DcmDspDidIdentifier=61713, DcmDspDidInfoRef=DcmDspDidInfo_SvkBackup14
            DcmDspDidSignal_SvkBackup14 (DcmDspDidSignal): DcmDspDidDataPos=0, DcmDspDidDataRef=DcmDspData_SvkBackup14
          DcmDspDid_SvkBackup15: DcmDspDidIdentifier=61714, DcmDspDidInfoRef=DcmDspDidInfo_SvkBackup15
            DcmDspDidSignal_SvkBackup15 (DcmDspDidSignal): DcmDspDidDataPos=0, DcmDspDidDataRef=DcmDspData_SvkBackup15
          DcmDspDid_SvkBackup16: DcmDspDidIdentifier=61715, DcmDspDidInfoRef=DcmDspDidInfo_SvkBackup16
            DcmDspDidSignal_SvkBackup16 (DcmDspDidSignal): DcmDspDidDataPos=0, DcmDspDidDataRef=DcmDspData_SvkBackup16
          DcmDspDid_SvkBackup17: DcmDspDidIdentifier=61716, DcmDspDidInfoRef=DcmDspDidInfo_SvkBackup17
            DcmDspDidSignal_SvkBackup17 (DcmDspDidSignal): DcmDspDidDataPos=0, DcmDspDidDataRef=DcmDspData_SvkBackup17
          DcmDspDid_SvkBackup18: DcmDspDidIdentifier=61717, DcmDspDidInfoRef=DcmDspDidInfo_SvkBackup18
            DcmDspDidSignal_SvkBackup18 (DcmDspDidSignal): DcmDspDidDataPos=0, DcmDspDidDataRef=DcmDspData_SvkBackup18
          DcmDspDid_SvkBackup19: DcmDspDidIdentifier=61718, DcmDspDidInfoRef=DcmDspDidInfo_SvkBackup19
            DcmDspDidSignal_SvkBackup19 (DcmDspDidSignal): DcmDspDidDataPos=0, DcmDspDidDataRef=DcmDspData_SvkBackup19
          DcmDspDid_SvkBackup20: DcmDspDidIdentifier=61719, DcmDspDidInfoRef=DcmDspDidInfo_SvkBackup20
            DcmDspDidSignal_SvkBackup20 (DcmDspDidSignal): DcmDspDidDataPos=0, DcmDspDidDataRef=DcmDspData_SvkBackup20
          DcmDspDid_SvkBackup21: DcmDspDidIdentifier=61720, DcmDspDidInfoRef=DcmDspDidInfo_SvkBackup21
            DcmDspDidSignal_SvkBackup21 (DcmDspDidSignal): DcmDspDidDataPos=0, DcmDspDidDataRef=DcmDspData_SvkBackup21
          DcmDspDid_SvkBackup22: DcmDspDidIdentifier=61721, DcmDspDidInfoRef=DcmDspDidInfo_SvkBackup22
            DcmDspDidSignal_SvkBackup22 (DcmDspDidSignal): DcmDspDidDataPos=0, DcmDspDidDataRef=DcmDspData_SvkBackup22
          DcmDspDid_SvkBackup23: DcmDspDidIdentifier=61722, DcmDspDidInfoRef=DcmDspDidInfo_SvkBackup23
            DcmDspDidSignal_SvkBackup23 (DcmDspDidSignal): DcmDspDidDataPos=0, DcmDspDidDataRef=DcmDspData_SvkBackup23
          DcmDspDid_SvkBackup24: DcmDspDidIdentifier=61723, DcmDspDidInfoRef=DcmDspDidInfo_SvkBackup24
            DcmDspDidSignal_SvkBackup24 (DcmDspDidSignal): DcmDspDidDataPos=0, DcmDspDidDataRef=DcmDspData_SvkBackup24
          DcmDspDid_SvkBackup25: DcmDspDidIdentifier=61724, DcmDspDidInfoRef=DcmDspDidInfo_SvkBackup25
            DcmDspDidSignal_SvkBackup25 (DcmDspDidSignal): DcmDspDidDataPos=0, DcmDspDidDataRef=DcmDspData_SvkBackup25
          DcmDspDid_SvkBackup26: DcmDspDidIdentifier=61725, DcmDspDidInfoRef=DcmDspDidInfo_SvkBackup26
            DcmDspDidSignal_SvkBackup26 (DcmDspDidSignal): DcmDspDidDataPos=0, DcmDspDidDataRef=DcmDspData_SvkBackup26
          DcmDspDid_SvkBackup27: DcmDspDidIdentifier=61726, DcmDspDidInfoRef=DcmDspDidInfo_SvkBackup27
            DcmDspDidSignal_SvkBackup27 (DcmDspDidSignal): DcmDspDidDataPos=0, DcmDspDidDataRef=DcmDspData_SvkBackup27
          DcmDspDid_SvkBackup28: DcmDspDidIdentifier=61727, DcmDspDidInfoRef=DcmDspDidInfo_SvkBackup28
            DcmDspDidSignal_SvkBackup28 (DcmDspDidSignal): DcmDspDidDataPos=0, DcmDspDidDataRef=DcmDspData_SvkBackup28
          DcmDspDid_SvkBackup29: DcmDspDidIdentifier=61728, DcmDspDidInfoRef=DcmDspDidInfo_SvkBackup29
            DcmDspDidSignal_SvkBackup29 (DcmDspDidSignal): DcmDspDidDataPos=0, DcmDspDidDataRef=DcmDspData_SvkBackup29
          DcmDspDid_SvkBackup30: DcmDspDidIdentifier=61729, DcmDspDidInfoRef=DcmDspDidInfo_SvkBackup30
            DcmDspDidSignal_SvkBackup30 (DcmDspDidSignal): DcmDspDidDataPos=0, DcmDspDidDataRef=DcmDspData_SvkBackup30
          DcmDspDid_SvkBackup31: DcmDspDidIdentifier=61730, DcmDspDidInfoRef=DcmDspDidInfo_SvkBackup31
            DcmDspDidSignal_SvkBackup31 (DcmDspDidSignal): DcmDspDidDataPos=0, DcmDspDidDataRef=DcmDspData_SvkBackup31
          DcmDspDid_SvkBackup32: DcmDspDidIdentifier=61731, DcmDspDidInfoRef=DcmDspDidInfo_SvkBackup32
            DcmDspDidSignal_SvkBackup32 (DcmDspDidSignal): DcmDspDidDataPos=0, DcmDspDidDataRef=DcmDspData_SvkBackup32
          DcmDspDid_SvkBackup33: DcmDspDidIdentifier=61732, DcmDspDidInfoRef=DcmDspDidInfo_SvkBackup33
            DcmDspDidSignal_SvkBackup33 (DcmDspDidSignal): DcmDspDidDataPos=0, DcmDspDidDataRef=DcmDspData_SvkBackup33
          DcmDspDid_SvkBackup34: DcmDspDidIdentifier=61733, DcmDspDidInfoRef=DcmDspDidInfo_SvkBackup34
            DcmDspDidSignal_SvkBackup34 (DcmDspDidSignal): DcmDspDidDataPos=0, DcmDspDidDataRef=DcmDspData_SvkBackup34
          DcmDspDid_SvkBackup35: DcmDspDidIdentifier=61734, DcmDspDidInfoRef=DcmDspDidInfo_SvkBackup35
            DcmDspDidSignal_SvkBackup35 (DcmDspDidSignal): DcmDspDidDataPos=0, DcmDspDidDataRef=DcmDspData_SvkBackup35
          DcmDspDid_SvkBackup36: DcmDspDidIdentifier=61735, DcmDspDidInfoRef=DcmDspDidInfo_SvkBackup36
            DcmDspDidSignal_SvkBackup36 (DcmDspDidSignal): DcmDspDidDataPos=0, DcmDspDidDataRef=DcmDspData_SvkBackup36
          DcmDspDid_SvkBackup37: DcmDspDidIdentifier=61736, DcmDspDidInfoRef=DcmDspDidInfo_SvkBackup37
            DcmDspDidSignal_SvkBackup37 (DcmDspDidSignal): DcmDspDidDataPos=0, DcmDspDidDataRef=DcmDspData_SvkBackup37
          DcmDspDid_SvkBackup38: DcmDspDidIdentifier=61737, DcmDspDidInfoRef=DcmDspDidInfo_SvkBackup38
            DcmDspDidSignal_SvkBackup38 (DcmDspDidSignal): DcmDspDidDataPos=0, DcmDspDidDataRef=DcmDspData_SvkBackup38
          DcmDspDid_SvkBackup39: DcmDspDidIdentifier=61738, DcmDspDidInfoRef=DcmDspDidInfo_SvkBackup39
            DcmDspDidSignal_SvkBackup39 (DcmDspDidSignal): DcmDspDidDataPos=0, DcmDspDidDataRef=DcmDspData_SvkBackup39
          DcmDspDid_SvkBackup40: DcmDspDidIdentifier=61739, DcmDspDidInfoRef=DcmDspDidInfo_SvkBackup40
            DcmDspDidSignal_SvkBackup40 (DcmDspDidSignal): DcmDspDidDataPos=0, DcmDspDidDataRef=DcmDspData_SvkBackup40
          DcmDspDid_SvkBackup41: DcmDspDidIdentifier=61740, DcmDspDidInfoRef=DcmDspDidInfo_SvkBackup41
            DcmDspDidSignal_SvkBackup41 (DcmDspDidSignal): DcmDspDidDataPos=0, DcmDspDidDataRef=DcmDspData_SvkBackup41
          DcmDspDid_SvkBackup42: DcmDspDidIdentifier=61741, DcmDspDidInfoRef=DcmDspDidInfo_SvkBackup42
            DcmDspDidSignal_SvkBackup42 (DcmDspDidSignal): DcmDspDidDataPos=0, DcmDspDidDataRef=DcmDspData_SvkBackup42
          DcmDspDid_SvkBackup43: DcmDspDidIdentifier=61742, DcmDspDidInfoRef=DcmDspDidInfo_SvkBackup43
            DcmDspDidSignal_SvkBackup43 (DcmDspDidSignal): DcmDspDidDataPos=0, DcmDspDidDataRef=DcmDspData_SvkBackup43
          DcmDspDid_SvkBackup44: DcmDspDidIdentifier=61743, DcmDspDidInfoRef=DcmDspDidInfo_SvkBackup44
            DcmDspDidSignal_SvkBackup44 (DcmDspDidSignal): DcmDspDidDataPos=0, DcmDspDidDataRef=DcmDspData_SvkBackup44
          DcmDspDid_SvkBackup45: DcmDspDidIdentifier=61744, DcmDspDidInfoRef=DcmDspDidInfo_SvkBackup45
            DcmDspDidSignal_SvkBackup45 (DcmDspDidSignal): DcmDspDidDataPos=0, DcmDspDidDataRef=DcmDspData_SvkBackup45
          DcmDspDid_SvkBackup46: DcmDspDidIdentifier=61745, DcmDspDidInfoRef=DcmDspDidInfo_SvkBackup46
            DcmDspDidSignal_SvkBackup46 (DcmDspDidSignal): DcmDspDidDataPos=0, DcmDspDidDataRef=DcmDspData_SvkBackup46
          DcmDspDid_SvkBackup47: DcmDspDidIdentifier=61746, DcmDspDidInfoRef=DcmDspDidInfo_SvkBackup47
            DcmDspDidSignal_SvkBackup47 (DcmDspDidSignal): DcmDspDidDataPos=0, DcmDspDidDataRef=DcmDspData_SvkBackup47
          DcmDspDid_SvkBackup48: DcmDspDidIdentifier=61747, DcmDspDidInfoRef=DcmDspDidInfo_SvkBackup48
            DcmDspDidSignal_SvkBackup48 (DcmDspDidSignal): DcmDspDidDataPos=0, DcmDspDidDataRef=DcmDspData_SvkBackup48
          DcmDspDid_SvkBackup49: DcmDspDidIdentifier=61748, DcmDspDidInfoRef=DcmDspDidInfo_SvkBackup49
            DcmDspDidSignal_SvkBackup49 (DcmDspDidSignal): DcmDspDidDataPos=0, DcmDspDidDataRef=DcmDspData_SvkBackup49
          DcmDspDid_SvkBackup50: DcmDspDidIdentifier=61749, DcmDspDidInfoRef=DcmDspDidInfo_SvkBackup50
            DcmDspDidSignal_SvkBackup50 (DcmDspDidSignal): DcmDspDidDataPos=0, DcmDspDidDataRef=DcmDspData_SvkBackup50
          DcmDspDid_SvkBackup51: DcmDspDidIdentifier=61750, DcmDspDidInfoRef=DcmDspDidInfo_SvkBackup51
            DcmDspDidSignal_SvkBackup51 (DcmDspDidSignal): DcmDspDidDataPos=0, DcmDspDidDataRef=DcmDspData_SvkBackup51
          DcmDspDid_SvkBackup52: DcmDspDidIdentifier=61751, DcmDspDidInfoRef=DcmDspDidInfo_SvkBackup52
            DcmDspDidSignal_SvkBackup52 (DcmDspDidSignal): DcmDspDidDataPos=0, DcmDspDidDataRef=DcmDspData_SvkBackup52
          DcmDspDid_SvkBackup53: DcmDspDidIdentifier=61752, DcmDspDidInfoRef=DcmDspDidInfo_SvkBackup53
            DcmDspDidSignal_SvkBackup53 (DcmDspDidSignal): DcmDspDidDataPos=0, DcmDspDidDataRef=DcmDspData_SvkBackup53
          DcmDspDid_SvkBackup54: DcmDspDidIdentifier=61753, DcmDspDidInfoRef=DcmDspDidInfo_SvkBackup54
            DcmDspDidSignal_SvkBackup54 (DcmDspDidSignal): DcmDspDidDataPos=0, DcmDspDidDataRef=DcmDspData_SvkBackup54
          DcmDspDid_SvkBackup55: DcmDspDidIdentifier=61754, DcmDspDidInfoRef=DcmDspDidInfo_SvkBackup55
            DcmDspDidSignal_SvkBackup55 (DcmDspDidSignal): DcmDspDidDataPos=0, DcmDspDidDataRef=DcmDspData_SvkBackup55
          DcmDspDid_SvkBackup56: DcmDspDidIdentifier=61755, DcmDspDidInfoRef=DcmDspDidInfo_SvkBackup56
            DcmDspDidSignal_SvkBackup56 (DcmDspDidSignal): DcmDspDidDataPos=0, DcmDspDidDataRef=DcmDspData_SvkBackup56
          DcmDspDid_SvkBackup57: DcmDspDidIdentifier=61756, DcmDspDidInfoRef=DcmDspDidInfo_SvkBackup57
            DcmDspDidSignal_SvkBackup57 (DcmDspDidSignal): DcmDspDidDataPos=0, DcmDspDidDataRef=DcmDspData_SvkBackup57
          DcmDspDid_SvkBackup58: DcmDspDidIdentifier=61757, DcmDspDidInfoRef=DcmDspDidInfo_SvkBackup58
            DcmDspDidSignal_SvkBackup58 (DcmDspDidSignal): DcmDspDidDataPos=0, DcmDspDidDataRef=DcmDspData_SvkBackup58
          DcmDspDid_SvkBackup59: DcmDspDidIdentifier=61758, DcmDspDidInfoRef=DcmDspDidInfo_SvkBackup59
            DcmDspDidSignal_SvkBackup59 (DcmDspDidSignal): DcmDspDidDataPos=0, DcmDspDidDataRef=DcmDspData_SvkBackup59
          DcmDspDid_SvkBackup60: DcmDspDidIdentifier=61759, DcmDspDidInfoRef=DcmDspDidInfo_SvkBackup60
            DcmDspDidSignal_SvkBackup60 (DcmDspDidSignal): DcmDspDidDataPos=0, DcmDspDidDataRef=DcmDspData_SvkBackup60
          DcmDspDid_SvkBackup61: DcmDspDidIdentifier=61760, DcmDspDidInfoRef=DcmDspDidInfo_SvkBackup61
            DcmDspDidSignal_SvkBackup61 (DcmDspDidSignal): DcmDspDidDataPos=0, DcmDspDidDataRef=DcmDspData_SvkBackup61
          DcmDspDid_SvkSysSupplier: DcmDspDidIdentifier=61698, DcmDspDidInfoRef=DcmDspDidInfo_SvkSysSupplier
            DcmDspDidSignal_SvkSysSupplier (DcmDspDidSignal): DcmDspDidDataPos=0, DcmDspDidDataRef=DcmDspData_SvkSysSupplier
          DcmDspDid_SvkWerk: DcmDspDidIdentifier=61699, DcmDspDidInfoRef=DcmDspDidInfo_SvkWerk
            DcmDspDidSignal_SvkWerk (DcmDspDidSignal): DcmDspDidDataPos=0, DcmDspDidDataRef=DcmDspData_SvkWerk
          DcmDspDid_SwfkDeleteSupported: DcmDspDidIdentifier=9479, DcmDspDidInfoRef=DcmDspDidInfo_SwfkDeleteSupported
            DcmDspDidSignal_SwfkDeleteSupported (DcmDspDidSignal): DcmDspDidDataPos=0, DcmDspDidDataRef=DcmDspData_SwfkDeleteSupported
          DcmDspDid_Vin: DcmDspDidIdentifier=61840, DcmDspDidInfoRef=DcmDspDidInfo_Vin
            DcmDspDidSignal_Vin (DcmDspDidSignal): DcmDspDidDataPos=0, DcmDspDidDataRef=DcmDspData_Vin
          DcmDspDid_WdbiFp: DcmDspDidIdentifier=61786, DcmDspDidInfoRef=DcmDspDidInfo_WdbiFp
            DcmDspDidSignal_WdbiFp (DcmDspDidSignal): DcmDspDidDataPos=0, DcmDspDidDataRef=DcmDspData_WdbiFp
        80 x DcmDspDidInfo, all with DcmDspDidDynamicallyDefined=0:
          DcmDspDidInfo_ActiveDiagnosticSession
            DcmDspDidRead: DcmDspDidReadSessionRef=DcmDspSessionRow_DEFAULT_SESSION, DcmDspDidReadSessionRef=DcmDspSessionRow_EXTENDED_DIAGNOSTIC_SESSION
          DcmDspDidInfo_EcuSerialNumber
            DcmDspDidRead: DcmDspDidReadSessionRef=DcmDspSessionRow_EXTENDED_DIAGNOSTIC_SESSION, DcmDspDidReadSessionRef=DcmDspSessionRow_DEFAULT_SESSION
          DcmDspDidInfo_EnergySavingState
            DcmDspDidRead:
              DcmDspDidReadSessionRef = DcmDspSessionRow_EXTENDED_DIAGNOSTIC_SESSION
              DcmDspDidReadSessionRef = DcmDspSessionRow_PROGRAMMING_SESSION
              DcmDspDidReadSessionRef = DcmDspSessionRow_DEFAULT_SESSION
          DcmDspDidInfo_EthPhyLinkState
            DcmDspDidRead: DcmDspDidReadSessionRef=DcmDspSessionRow_DEFAULT_SESSION, DcmDspDidReadSessionRef=DcmDspSessionRow_EXTENDED_DIAGNOSTIC_SESSION
          DcmDspDidInfo_ExtendedEnergySavingState
            DcmDspDidRead:
              DcmDspDidReadSessionRef = DcmDspSessionRow_EXTENDED_DIAGNOSTIC_SESSION
              DcmDspDidReadSessionRef = DcmDspSessionRow_PROGRAMMING_SESSION
              DcmDspDidReadSessionRef = DcmDspSessionRow_DEFAULT_SESSION
          DcmDspDidInfo_FlashTimingParameter
            DcmDspDidRead:
              DcmDspDidReadSessionRef = DcmDspSessionRow_PROGRAMMING_SESSION
              DcmDspDidReadSessionRef = DcmDspSessionRow_DEFAULT_SESSION
              DcmDspDidReadSessionRef = DcmDspSessionRow_EXTENDED_DIAGNOSTIC_SESSION
          DcmDspDidInfo_Herstelldatum
            DcmDspDidRead: DcmDspDidReadSessionRef=DcmDspSessionRow_EXTENDED_DIAGNOSTIC_SESSION, DcmDspDidReadSessionRef=DcmDspSessionRow_DEFAULT_SESSION
          DcmDspDidInfo_MemoryAddress
            DcmDspDidRead:
              DcmDspDidReadSessionRef = DcmDspSessionRow_PROGRAMMING_SESSION
              DcmDspDidReadSessionRef = DcmDspSessionRow_DEFAULT_SESSION
              DcmDspDidReadSessionRef = DcmDspSessionRow_EXTENDED_DIAGNOSTIC_SESSION
          DcmDspDidInfo_MemorySegmentationTable
            DcmDspDidRead:
              DcmDspDidReadSessionRef = DcmDspSessionRow_DEFAULT_SESSION
              DcmDspDidReadSessionRef = DcmDspSessionRow_EXTENDED_DIAGNOSTIC_SESSION
              DcmDspDidReadSessionRef = DcmDspSessionRow_PROGRAMMING_SESSION
          DcmDspDidInfo_ProgrammingCounter
            DcmDspDidRead:
              DcmDspDidReadSessionRef = DcmDspSessionRow_DEFAULT_SESSION
              DcmDspDidReadSessionRef = DcmDspSessionRow_PROGRAMMING_SESSION
              DcmDspDidReadSessionRef = DcmDspSessionRow_EXTENDED_DIAGNOSTIC_SESSION
          DcmDspDidInfo_ProgrammingCounterMaxValue
            DcmDspDidRead:
              DcmDspDidReadSessionRef = DcmDspSessionRow_EXTENDED_DIAGNOSTIC_SESSION
              DcmDspDidReadSessionRef = DcmDspSessionRow_PROGRAMMING_SESSION
              DcmDspDidReadSessionRef = DcmDspSessionRow_DEFAULT_SESSION
          DcmDspDidInfo_ReadActiveSessionState
            DcmDspDidRead: DcmDspDidReadSessionRef=DcmDspSessionRow_DEFAULT_SESSION, DcmDspDidReadSessionRef=DcmDspSessionRow_EXTENDED_DIAGNOSTIC_SESSION
          DcmDspDidInfo_Readhwmodificationindex
            DcmDspDidRead:
              DcmDspDidReadSessionRef = DcmDspSessionRow_EXTENDED_DIAGNOSTIC_SESSION
              DcmDspDidReadSessionRef = DcmDspSessionRow_PROGRAMMING_SESSION
              DcmDspDidReadSessionRef = DcmDspSessionRow_DEFAULT_SESSION
          DcmDspDidInfo_SvkAktuell
            DcmDspDidRead:
              DcmDspDidReadSessionRef = DcmDspSessionRow_PROGRAMMING_SESSION
              DcmDspDidReadSessionRef = DcmDspSessionRow_EXTENDED_DIAGNOSTIC_SESSION
              DcmDspDidReadSessionRef = DcmDspSessionRow_DEFAULT_SESSION
          DcmDspDidInfo_SvkBackup01
            DcmDspDidRead:
              DcmDspDidReadSessionRef = DcmDspSessionRow_EXTENDED_DIAGNOSTIC_SESSION
              DcmDspDidReadSessionRef = DcmDspSessionRow_PROGRAMMING_SESSION
              DcmDspDidReadSessionRef = DcmDspSessionRow_DEFAULT_SESSION
          DcmDspDidInfo_SvkBackup02
            DcmDspDidRead:
              DcmDspDidReadSessionRef = DcmDspSessionRow_EXTENDED_DIAGNOSTIC_SESSION
              DcmDspDidReadSessionRef = DcmDspSessionRow_PROGRAMMING_SESSION
              DcmDspDidReadSessionRef = DcmDspSessionRow_DEFAULT_SESSION
          DcmDspDidInfo_SvkBackup03
            DcmDspDidRead:
              DcmDspDidReadSessionRef = DcmDspSessionRow_DEFAULT_SESSION
              DcmDspDidReadSessionRef = DcmDspSessionRow_EXTENDED_DIAGNOSTIC_SESSION
              DcmDspDidReadSessionRef = DcmDspSessionRow_PROGRAMMING_SESSION
          DcmDspDidInfo_SvkBackup04
            DcmDspDidRead:
              DcmDspDidReadSessionRef = DcmDspSessionRow_EXTENDED_DIAGNOSTIC_SESSION
              DcmDspDidReadSessionRef = DcmDspSessionRow_PROGRAMMING_SESSION
              DcmDspDidReadSessionRef = DcmDspSessionRow_DEFAULT_SESSION
          DcmDspDidInfo_SvkBackup05
            DcmDspDidRead:
              DcmDspDidReadSessionRef = DcmDspSessionRow_PROGRAMMING_SESSION
              DcmDspDidReadSessionRef = DcmDspSessionRow_DEFAULT_SESSION
              DcmDspDidReadSessionRef = DcmDspSessionRow_EXTENDED_DIAGNOSTIC_SESSION
          DcmDspDidInfo_SvkBackup06
            DcmDspDidRead:
              DcmDspDidReadSessionRef = DcmDspSessionRow_EXTENDED_DIAGNOSTIC_SESSION
              DcmDspDidReadSessionRef = DcmDspSessionRow_PROGRAMMING_SESSION
              DcmDspDidReadSessionRef = DcmDspSessionRow_DEFAULT_SESSION
          DcmDspDidInfo_SvkBackup07
            DcmDspDidRead:
              DcmDspDidReadSessionRef = DcmDspSessionRow_EXTENDED_DIAGNOSTIC_SESSION
              DcmDspDidReadSessionRef = DcmDspSessionRow_PROGRAMMING_SESSION
              DcmDspDidReadSessionRef = DcmDspSessionRow_DEFAULT_SESSION
          DcmDspDidInfo_SvkBackup08
            DcmDspDidRead:
              DcmDspDidReadSessionRef = DcmDspSessionRow_PROGRAMMING_SESSION
              DcmDspDidReadSessionRef = DcmDspSessionRow_EXTENDED_DIAGNOSTIC_SESSION
              DcmDspDidReadSessionRef = DcmDspSessionRow_DEFAULT_SESSION
          DcmDspDidInfo_SvkBackup09
            DcmDspDidRead:
              DcmDspDidReadSessionRef = DcmDspSessionRow_PROGRAMMING_SESSION
              DcmDspDidReadSessionRef = DcmDspSessionRow_DEFAULT_SESSION
              DcmDspDidReadSessionRef = DcmDspSessionRow_EXTENDED_DIAGNOSTIC_SESSION
          DcmDspDidInfo_SvkBackup10
            DcmDspDidRead:
              DcmDspDidReadSessionRef = DcmDspSessionRow_EXTENDED_DIAGNOSTIC_SESSION
              DcmDspDidReadSessionRef = DcmDspSessionRow_DEFAULT_SESSION
              DcmDspDidReadSessionRef = DcmDspSessionRow_PROGRAMMING_SESSION
          DcmDspDidInfo_SvkBackup11
            DcmDspDidRead:
              DcmDspDidReadSessionRef = DcmDspSessionRow_DEFAULT_SESSION
              DcmDspDidReadSessionRef = DcmDspSessionRow_EXTENDED_DIAGNOSTIC_SESSION
              DcmDspDidReadSessionRef = DcmDspSessionRow_PROGRAMMING_SESSION
          DcmDspDidInfo_SvkBackup12
            DcmDspDidRead:
              DcmDspDidReadSessionRef = DcmDspSessionRow_PROGRAMMING_SESSION
              DcmDspDidReadSessionRef = DcmDspSessionRow_EXTENDED_DIAGNOSTIC_SESSION
              DcmDspDidReadSessionRef = DcmDspSessionRow_DEFAULT_SESSION
          DcmDspDidInfo_SvkBackup13
            DcmDspDidRead:
              DcmDspDidReadSessionRef = DcmDspSessionRow_EXTENDED_DIAGNOSTIC_SESSION
              DcmDspDidReadSessionRef = DcmDspSessionRow_DEFAULT_SESSION
              DcmDspDidReadSessionRef = DcmDspSessionRow_PROGRAMMING_SESSION
          DcmDspDidInfo_SvkBackup14
            DcmDspDidRead:
              DcmDspDidReadSessionRef = DcmDspSessionRow_EXTENDED_DIAGNOSTIC_SESSION
              DcmDspDidReadSessionRef = DcmDspSessionRow_DEFAULT_SESSION
              DcmDspDidReadSessionRef = DcmDspSessionRow_PROGRAMMING_SESSION
          DcmDspDidInfo_SvkBackup15
            DcmDspDidRead:
              DcmDspDidReadSessionRef = DcmDspSessionRow_EXTENDED_DIAGNOSTIC_SESSION
              DcmDspDidReadSessionRef = DcmDspSessionRow_PROGRAMMING_SESSION
              DcmDspDidReadSessionRef = DcmDspSessionRow_DEFAULT_SESSION
          DcmDspDidInfo_SvkBackup16
            DcmDspDidRead:
              DcmDspDidReadSessionRef = DcmDspSessionRow_EXTENDED_DIAGNOSTIC_SESSION
              DcmDspDidReadSessionRef = DcmDspSessionRow_PROGRAMMING_SESSION
              DcmDspDidReadSessionRef = DcmDspSessionRow_DEFAULT_SESSION
          DcmDspDidInfo_SvkBackup17
            DcmDspDidRead:
              DcmDspDidReadSessionRef = DcmDspSessionRow_DEFAULT_SESSION
              DcmDspDidReadSessionRef = DcmDspSessionRow_PROGRAMMING_SESSION
              DcmDspDidReadSessionRef = DcmDspSessionRow_EXTENDED_DIAGNOSTIC_SESSION
          DcmDspDidInfo_SvkBackup18
            DcmDspDidRead:
              DcmDspDidReadSessionRef = DcmDspSessionRow_PROGRAMMING_SESSION
              DcmDspDidReadSessionRef = DcmDspSessionRow_DEFAULT_SESSION
              DcmDspDidReadSessionRef = DcmDspSessionRow_EXTENDED_DIAGNOSTIC_SESSION
          DcmDspDidInfo_SvkBackup19
            DcmDspDidRead:
              DcmDspDidReadSessionRef = DcmDspSessionRow_EXTENDED_DIAGNOSTIC_SESSION
              DcmDspDidReadSessionRef = DcmDspSessionRow_DEFAULT_SESSION
              DcmDspDidReadSessionRef = DcmDspSessionRow_PROGRAMMING_SESSION
          DcmDspDidInfo_SvkBackup20
            DcmDspDidRead:
              DcmDspDidReadSessionRef = DcmDspSessionRow_PROGRAMMING_SESSION
              DcmDspDidReadSessionRef = DcmDspSessionRow_DEFAULT_SESSION
              DcmDspDidReadSessionRef = DcmDspSessionRow_EXTENDED_DIAGNOSTIC_SESSION
          DcmDspDidInfo_SvkBackup21
            DcmDspDidRead:
              DcmDspDidReadSessionRef = DcmDspSessionRow_EXTENDED_DIAGNOSTIC_SESSION
              DcmDspDidReadSessionRef = DcmDspSessionRow_DEFAULT_SESSION
              DcmDspDidReadSessionRef = DcmDspSessionRow_PROGRAMMING_SESSION
          DcmDspDidInfo_SvkBackup22
            DcmDspDidRead:
              DcmDspDidReadSessionRef = DcmDspSessionRow_DEFAULT_SESSION
              DcmDspDidReadSessionRef = DcmDspSessionRow_PROGRAMMING_SESSION
              DcmDspDidReadSessionRef = DcmDspSessionRow_EXTENDED_DIAGNOSTIC_SESSION
          DcmDspDidInfo_SvkBackup23
            DcmDspDidRead:
              DcmDspDidReadSessionRef = DcmDspSessionRow_PROGRAMMING_SESSION
              DcmDspDidReadSessionRef = DcmDspSessionRow_EXTENDED_DIAGNOSTIC_SESSION
              DcmDspDidReadSessionRef = DcmDspSessionRow_DEFAULT_SESSION
          DcmDspDidInfo_SvkBackup24
            DcmDspDidRead:
              DcmDspDidReadSessionRef = DcmDspSessionRow_EXTENDED_DIAGNOSTIC_SESSION
              DcmDspDidReadSessionRef = DcmDspSessionRow_PROGRAMMING_SESSION
              DcmDspDidReadSessionRef = DcmDspSessionRow_DEFAULT_SESSION
          DcmDspDidInfo_SvkBackup25
            DcmDspDidRead:
              DcmDspDidReadSessionRef = DcmDspSessionRow_DEFAULT_SESSION
              DcmDspDidReadSessionRef = DcmDspSessionRow_PROGRAMMING_SESSION
              DcmDspDidReadSessionRef = DcmDspSessionRow_EXTENDED_DIAGNOSTIC_SESSION
          DcmDspDidInfo_SvkBackup26
            DcmDspDidRead:
              DcmDspDidReadSessionRef = DcmDspSessionRow_PROGRAMMING_SESSION
              DcmDspDidReadSessionRef = DcmDspSessionRow_EXTENDED_DIAGNOSTIC_SESSION
              DcmDspDidReadSessionRef = DcmDspSessionRow_DEFAULT_SESSION
          DcmDspDidInfo_SvkBackup27
            DcmDspDidRead:
              DcmDspDidReadSessionRef = DcmDspSessionRow_EXTENDED_DIAGNOSTIC_SESSION
              DcmDspDidReadSessionRef = DcmDspSessionRow_PROGRAMMING_SESSION
              DcmDspDidReadSessionRef = DcmDspSessionRow_DEFAULT_SESSION
          DcmDspDidInfo_SvkBackup28
            DcmDspDidRead:
              DcmDspDidReadSessionRef = DcmDspSessionRow_DEFAULT_SESSION
              DcmDspDidReadSessionRef = DcmDspSessionRow_EXTENDED_DIAGNOSTIC_SESSION
              DcmDspDidReadSessionRef = DcmDspSessionRow_PROGRAMMING_SESSION
          DcmDspDidInfo_SvkBackup29
            DcmDspDidRead:
              DcmDspDidReadSessionRef = DcmDspSessionRow_EXTENDED_DIAGNOSTIC_SESSION
              DcmDspDidReadSessionRef = DcmDspSessionRow_PROGRAMMING_SESSION
              DcmDspDidReadSessionRef = DcmDspSessionRow_DEFAULT_SESSION
          DcmDspDidInfo_SvkBackup30
            DcmDspDidRead:
              DcmDspDidReadSessionRef = DcmDspSessionRow_DEFAULT_SESSION
              DcmDspDidReadSessionRef = DcmDspSessionRow_PROGRAMMING_SESSION
              DcmDspDidReadSessionRef = DcmDspSessionRow_EXTENDED_DIAGNOSTIC_SESSION
          DcmDspDidInfo_SvkBackup31
            DcmDspDidRead:
              DcmDspDidReadSessionRef = DcmDspSessionRow_DEFAULT_SESSION
              DcmDspDidReadSessionRef = DcmDspSessionRow_PROGRAMMING_SESSION
              DcmDspDidReadSessionRef = DcmDspSessionRow_EXTENDED_DIAGNOSTIC_SESSION
          DcmDspDidInfo_SvkBackup32
            DcmDspDidRead:
              DcmDspDidReadSessionRef = DcmDspSessionRow_EXTENDED_DIAGNOSTIC_SESSION
              DcmDspDidReadSessionRef = DcmDspSessionRow_DEFAULT_SESSION
              DcmDspDidReadSessionRef = DcmDspSessionRow_PROGRAMMING_SESSION
          DcmDspDidInfo_SvkBackup33
            DcmDspDidRead:
              DcmDspDidReadSessionRef = DcmDspSessionRow_EXTENDED_DIAGNOSTIC_SESSION
              DcmDspDidReadSessionRef = DcmDspSessionRow_DEFAULT_SESSION
              DcmDspDidReadSessionRef = DcmDspSessionRow_PROGRAMMING_SESSION
          DcmDspDidInfo_SvkBackup34
            DcmDspDidRead:
              DcmDspDidReadSessionRef = DcmDspSessionRow_EXTENDED_DIAGNOSTIC_SESSION
              DcmDspDidReadSessionRef = DcmDspSessionRow_DEFAULT_SESSION
              DcmDspDidReadSessionRef = DcmDspSessionRow_PROGRAMMING_SESSION
          DcmDspDidInfo_SvkBackup35
            DcmDspDidRead:
              DcmDspDidReadSessionRef = DcmDspSessionRow_EXTENDED_DIAGNOSTIC_SESSION
              DcmDspDidReadSessionRef = DcmDspSessionRow_DEFAULT_SESSION
              DcmDspDidReadSessionRef = DcmDspSessionRow_PROGRAMMING_SESSION
          DcmDspDidInfo_SvkBackup36
            DcmDspDidRead:
              DcmDspDidReadSessionRef = DcmDspSessionRow_DEFAULT_SESSION
              DcmDspDidReadSessionRef = DcmDspSessionRow_PROGRAMMING_SESSION
              DcmDspDidReadSessionRef = DcmDspSessionRow_EXTENDED_DIAGNOSTIC_SESSION
          DcmDspDidInfo_SvkBackup37
            DcmDspDidRead:
              DcmDspDidReadSessionRef = DcmDspSessionRow_DEFAULT_SESSION
              DcmDspDidReadSessionRef = DcmDspSessionRow_PROGRAMMING_SESSION
              DcmDspDidReadSessionRef = DcmDspSessionRow_EXTENDED_DIAGNOSTIC_SESSION
          DcmDspDidInfo_SvkBackup38
            DcmDspDidRead:
              DcmDspDidReadSessionRef = DcmDspSessionRow_DEFAULT_SESSION
              DcmDspDidReadSessionRef = DcmDspSessionRow_EXTENDED_DIAGNOSTIC_SESSION
              DcmDspDidReadSessionRef = DcmDspSessionRow_PROGRAMMING_SESSION
          DcmDspDidInfo_SvkBackup39
            DcmDspDidRead:
              DcmDspDidReadSessionRef = DcmDspSessionRow_EXTENDED_DIAGNOSTIC_SESSION
              DcmDspDidReadSessionRef = DcmDspSessionRow_DEFAULT_SESSION
              DcmDspDidReadSessionRef = DcmDspSessionRow_PROGRAMMING_SESSION
          DcmDspDidInfo_SvkBackup40
            DcmDspDidRead:
              DcmDspDidReadSessionRef = DcmDspSessionRow_EXTENDED_DIAGNOSTIC_SESSION
              DcmDspDidReadSessionRef = DcmDspSessionRow_PROGRAMMING_SESSION
              DcmDspDidReadSessionRef = DcmDspSessionRow_DEFAULT_SESSION
          DcmDspDidInfo_SvkBackup41
            DcmDspDidRead:
              DcmDspDidReadSessionRef = DcmDspSessionRow_DEFAULT_SESSION
              DcmDspDidReadSessionRef = DcmDspSessionRow_PROGRAMMING_SESSION
              DcmDspDidReadSessionRef = DcmDspSessionRow_EXTENDED_DIAGNOSTIC_SESSION
          DcmDspDidInfo_SvkBackup42
            DcmDspDidRead:
              DcmDspDidReadSessionRef = DcmDspSessionRow_DEFAULT_SESSION
              DcmDspDidReadSessionRef = DcmDspSessionRow_EXTENDED_DIAGNOSTIC_SESSION
              DcmDspDidReadSessionRef = DcmDspSessionRow_PROGRAMMING_SESSION
          DcmDspDidInfo_SvkBackup43
            DcmDspDidRead:
              DcmDspDidReadSessionRef = DcmDspSessionRow_PROGRAMMING_SESSION
              DcmDspDidReadSessionRef = DcmDspSessionRow_EXTENDED_DIAGNOSTIC_SESSION
              DcmDspDidReadSessionRef = DcmDspSessionRow_DEFAULT_SESSION
          DcmDspDidInfo_SvkBackup44
            DcmDspDidRead:
              DcmDspDidReadSessionRef = DcmDspSessionRow_EXTENDED_DIAGNOSTIC_SESSION
              DcmDspDidReadSessionRef = DcmDspSessionRow_PROGRAMMING_SESSION
              DcmDspDidReadSessionRef = DcmDspSessionRow_DEFAULT_SESSION
          DcmDspDidInfo_SvkBackup45
            DcmDspDidRead:
              DcmDspDidReadSessionRef = DcmDspSessionRow_PROGRAMMING_SESSION
              DcmDspDidReadSessionRef = DcmDspSessionRow_DEFAULT_SESSION
              DcmDspDidReadSessionRef = DcmDspSessionRow_EXTENDED_DIAGNOSTIC_SESSION
          DcmDspDidInfo_SvkBackup46
            DcmDspDidRead:
              DcmDspDidReadSessionRef = DcmDspSessionRow_DEFAULT_SESSION
              DcmDspDidReadSessionRef = DcmDspSessionRow_PROGRAMMING_SESSION
              DcmDspDidReadSessionRef = DcmDspSessionRow_EXTENDED_DIAGNOSTIC_SESSION
          DcmDspDidInfo_SvkBackup47
            DcmDspDidRead:
              DcmDspDidReadSessionRef = DcmDspSessionRow_DEFAULT_SESSION
              DcmDspDidReadSessionRef = DcmDspSessionRow_EXTENDED_DIAGNOSTIC_SESSION
              DcmDspDidReadSessionRef = DcmDspSessionRow_PROGRAMMING_SESSION
          DcmDspDidInfo_SvkBackup48
            DcmDspDidRead:
              DcmDspDidReadSessionRef = DcmDspSessionRow_PROGRAMMING_SESSION
              DcmDspDidReadSessionRef = DcmDspSessionRow_DEFAULT_SESSION
              DcmDspDidReadSessionRef = DcmDspSessionRow_EXTENDED_DIAGNOSTIC_SESSION
          DcmDspDidInfo_SvkBackup49
            DcmDspDidRead:
              DcmDspDidReadSessionRef = DcmDspSessionRow_DEFAULT_SESSION
              DcmDspDidReadSessionRef = DcmDspSessionRow_PROGRAMMING_SESSION
              DcmDspDidReadSessionRef = DcmDspSessionRow_EXTENDED_DIAGNOSTIC_SESSION
          DcmDspDidInfo_SvkBackup50
            DcmDspDidRead:
              DcmDspDidReadSessionRef = DcmDspSessionRow_PROGRAMMING_SESSION
              DcmDspDidReadSessionRef = DcmDspSessionRow_DEFAULT_SESSION
              DcmDspDidReadSessionRef = DcmDspSessionRow_EXTENDED_DIAGNOSTIC_SESSION
          DcmDspDidInfo_SvkBackup51
            DcmDspDidRead:
              DcmDspDidReadSessionRef = DcmDspSessionRow_DEFAULT_SESSION
              DcmDspDidReadSessionRef = DcmDspSessionRow_EXTENDED_DIAGNOSTIC_SESSION
              DcmDspDidReadSessionRef = DcmDspSessionRow_PROGRAMMING_SESSION
          DcmDspDidInfo_SvkBackup52
            DcmDspDidRead:
              DcmDspDidReadSessionRef = DcmDspSessionRow_DEFAULT_SESSION
              DcmDspDidReadSessionRef = DcmDspSessionRow_EXTENDED_DIAGNOSTIC_SESSION
              DcmDspDidReadSessionRef = DcmDspSessionRow_PROGRAMMING_SESSION
          DcmDspDidInfo_SvkBackup53
            DcmDspDidRead:
              DcmDspDidReadSessionRef = DcmDspSessionRow_DEFAULT_SESSION
              DcmDspDidReadSessionRef = DcmDspSessionRow_EXTENDED_DIAGNOSTIC_SESSION
              DcmDspDidReadSessionRef = DcmDspSessionRow_PROGRAMMING_SESSION
          DcmDspDidInfo_SvkBackup54
            DcmDspDidRead:
              DcmDspDidReadSessionRef = DcmDspSessionRow_EXTENDED_DIAGNOSTIC_SESSION
              DcmDspDidReadSessionRef = DcmDspSessionRow_DEFAULT_SESSION
              DcmDspDidReadSessionRef = DcmDspSessionRow_PROGRAMMING_SESSION
          DcmDspDidInfo_SvkBackup55
            DcmDspDidRead:
              DcmDspDidReadSessionRef = DcmDspSessionRow_DEFAULT_SESSION
              DcmDspDidReadSessionRef = DcmDspSessionRow_EXTENDED_DIAGNOSTIC_SESSION
              DcmDspDidReadSessionRef = DcmDspSessionRow_PROGRAMMING_SESSION
          DcmDspDidInfo_SvkBackup56
            DcmDspDidRead:
              DcmDspDidReadSessionRef = DcmDspSessionRow_DEFAULT_SESSION
              DcmDspDidReadSessionRef = DcmDspSessionRow_PROGRAMMING_SESSION
              DcmDspDidReadSessionRef = DcmDspSessionRow_EXTENDED_DIAGNOSTIC_SESSION
          DcmDspDidInfo_SvkBackup57
            DcmDspDidRead:
              DcmDspDidReadSessionRef = DcmDspSessionRow_EXTENDED_DIAGNOSTIC_SESSION
              DcmDspDidReadSessionRef = DcmDspSessionRow_DEFAULT_SESSION
              DcmDspDidReadSessionRef = DcmDspSessionRow_PROGRAMMING_SESSION
          DcmDspDidInfo_SvkBackup58
            DcmDspDidRead:
              DcmDspDidReadSessionRef = DcmDspSessionRow_EXTENDED_DIAGNOSTIC_SESSION
              DcmDspDidReadSessionRef = DcmDspSessionRow_PROGRAMMING_SESSION
              DcmDspDidReadSessionRef = DcmDspSessionRow_DEFAULT_SESSION
          DcmDspDidInfo_SvkBackup59
            DcmDspDidRead:
              DcmDspDidReadSessionRef = DcmDspSessionRow_DEFAULT_SESSION
              DcmDspDidReadSessionRef = DcmDspSessionRow_EXTENDED_DIAGNOSTIC_SESSION
              DcmDspDidReadSessionRef = DcmDspSessionRow_PROGRAMMING_SESSION
          DcmDspDidInfo_SvkBackup60
            DcmDspDidRead:
              DcmDspDidReadSessionRef = DcmDspSessionRow_DEFAULT_SESSION
              DcmDspDidReadSessionRef = DcmDspSessionRow_EXTENDED_DIAGNOSTIC_SESSION
              DcmDspDidReadSessionRef = DcmDspSessionRow_PROGRAMMING_SESSION
          DcmDspDidInfo_SvkBackup61
            DcmDspDidRead:
              DcmDspDidReadSessionRef = DcmDspSessionRow_DEFAULT_SESSION
              DcmDspDidReadSessionRef = DcmDspSessionRow_EXTENDED_DIAGNOSTIC_SESSION
              DcmDspDidReadSessionRef = DcmDspSessionRow_PROGRAMMING_SESSION
          DcmDspDidInfo_SvkSysSupplier
            DcmDspDidRead:
              DcmDspDidReadSessionRef = DcmDspSessionRow_EXTENDED_DIAGNOSTIC_SESSION
              DcmDspDidReadSessionRef = DcmDspSessionRow_DEFAULT_SESSION
              DcmDspDidReadSessionRef = DcmDspSessionRow_PROGRAMMING_SESSION
          DcmDspDidInfo_SvkWerk
            DcmDspDidRead:
              DcmDspDidReadSessionRef = DcmDspSessionRow_PROGRAMMING_SESSION
              DcmDspDidReadSessionRef = DcmDspSessionRow_DEFAULT_SESSION
              DcmDspDidReadSessionRef = DcmDspSessionRow_EXTENDED_DIAGNOSTIC_SESSION
          DcmDspDidInfo_SwfkDeleteSupported
            DcmDspDidRead:
              DcmDspDidReadSessionRef = DcmDspSessionRow_PROGRAMMING_SESSION
              DcmDspDidReadSessionRef = DcmDspSessionRow_DEFAULT_SESSION
              DcmDspDidReadSessionRef = DcmDspSessionRow_EXTENDED_DIAGNOSTIC_SESSION
          DcmDspDidInfo_Vin
            DcmDspDidRead: DcmDspDidReadSessionRef=DcmDspSessionRow_EXTENDED_DIAGNOSTIC_SESSION, DcmDspDidReadSessionRef=DcmDspSessionRow_DEFAULT_SESSION
            DcmDspDidWrite: DcmDspDidWriteSecurityLevelRef=DcmDspSecurityRow_Programming_HDD, DcmDspDidWriteSessionRef=DcmDspSessionRow_PROGRAMMING_SESSION
          DcmDspDidInfo_WdbiFp
            DcmDspDidWrite: DcmDspDidWriteSecurityLevelRef=DcmDspSecurityRow_Programming_HDD, DcmDspDidWriteSessionRef=DcmDspSessionRow_PROGRAMMING_SESSION
        23 x DcmDspRoutine, all with DcmDspRoutineUsePort=0:
          DcmDspRoutine_ActivateZgwApplicationmode: DcmDspRoutineIdentifier=4111, DcmDspRoutineUsed=1, DcmDspCommonAuthorizationRef=DcmDspCommonAuthorization_af67410c
            DcmDspStartRoutine_START_ActivateZgwApplicationmode (DcmDspStartRoutine): DcmDspStartRoutineFnc=EthDiagMM_RoutineControlDeActivateParallelFlashModeStart
          DcmDspRoutine_ActivateZgwFlashmode: DcmDspRoutineIdentifier=4110, DcmDspRoutineUsed=1, DcmDspCommonAuthorizationRef=DcmDspCommonAuthorization_af67410c
            DcmDspStartRoutine_START_ActivateZgwFlashmode (DcmDspStartRoutine): DcmDspStartRoutineFnc=EthDiagMM_RoutineControlActivateParallelFlashModeStart
          DcmDspRoutine_CheckHttpConnection: DcmDspRoutineIdentifier=4130, DcmDspRoutineUsed=1, DcmDspCommonAuthorizationRef=DcmDspCommonAuthorization_af67410c
            DcmDspStartRoutine_START_CheckHttpConnection (DcmDspStartRoutine)
              DcmDspStartRoutineIn_START_CheckHttpConnection (DcmDspStartRoutineIn)
                DcmDspStartRoutineInSignal_ServerUrl (DcmDspStartRoutineInSignal): DcmDspRoutineSignalPos=32
                DcmDspStartRoutineInSignal_TimeOutTime (DcmDspStartRoutineInSignal): DcmDspRoutineSignalEndianness=BIG_ENDIAN, DcmDspRoutineSignalLength=32, DcmDspRoutineSignalPos=0, DcmDspRoutineSignalType=UINT32
              DcmDspStartRoutineOut_START_CheckHttpConnection (DcmDspStartRoutineOut)
                DcmDspStartRoutineOutSignal_HttpConnectionStatus (DcmDspStartRoutineOutSignal): DcmDspRoutineSignalEndianness=BIG_ENDIAN, DcmDspRoutineSignalLength=8, DcmDspRoutineSignalPos=0, DcmDspRoutineSignalType=UINT8
                DcmDspStartRoutineOutSignal_HttpResponseCode (DcmDspStartRoutineOutSignal): DcmDspRoutineSignalEndianness=BIG_ENDIAN, DcmDspRoutineSignalLength=16, DcmDspRoutineSignalPos=8, DcmDspRoutineSignalType=UINT16
          DcmDspRoutine_ControlExtendedEnergySavingState: DcmDspRoutineIdentifier=4099, DcmDspRoutineUsed=1, DcmDspCommonAuthorizationRef=DcmDspCommonAuthorization_d884a83
            DcmDspStartRoutine_START_ControlExtendedEnergySavingState (DcmDspStartRoutine): DcmDspStartRoutineFnc=Prog_RoutineControlSetEnergyStateExtension
              DcmDspStartRoutineIn_START_ControlExtendedEnergySavingState (DcmDspStartRoutineIn)
                DcmDspStartRoutineInSignal_ExtendedOperatingMode (DcmDspStartRoutineInSignal): DcmDspRoutineSignalLength=8, DcmDspRoutineSignalPos=0, DcmDspRoutineSignalType=UINT8
          DcmDspRoutine_ControlUpdateMode: DcmDspRoutineIdentifier=16391, DcmDspRoutineUsed=1, DcmDspCommonAuthorizationRef=DcmDspCommonAuthorization_1f05440b
            DcmDspStartRoutine_START_ControlUpdateMode (DcmDspStartRoutine)
              DcmDspStartRoutineIn_START_ControlUpdateMode (DcmDspStartRoutineIn)
                DcmDspStartRoutineInSignal_Updatemode (DcmDspStartRoutineInSignal): DcmDspRoutineSignalEndianness=BIG_ENDIAN, DcmDspRoutineSignalLength=8, DcmDspRoutineSignalPos=0, DcmDspRoutineSignalType=UINT8
          DcmDspRoutine_DeleteSwPackage: DcmDspRoutineIdentifier=544, DcmDspRoutineUsed=1, DcmDspCommonAuthorizationRef=DcmDspCommonAuthorization_1f05440b
            DcmDspStartRoutine_START_DeleteSwPackage (DcmDspStartRoutine): DcmDspStartRoutineFnc=Prog_RoutineControlDeleteSwPackage
              DcmDspStartRoutineIn_START_DeleteSwPackage (DcmDspStartRoutineIn)
                DcmDspStartRoutineInSignal_DataIn (DcmDspStartRoutineInSignal): DcmDspRoutineSignalLength=72, DcmDspRoutineSignalPos=0, DcmDspRoutineSignalType=VARIABLE_LENGTH
              DcmDspStartRoutineOut_START_DeleteSwPackage (DcmDspStartRoutineOut)
                DcmDspStartRoutineOutSignal_Status (DcmDspStartRoutineOutSignal): DcmDspRoutineSignalLength=8, DcmDspRoutineSignalPos=0, DcmDspRoutineSignalType=UINT8
          DcmDspRoutine_Energiesparmode: DcmDspRoutineIdentifier=3852, DcmDspRoutineUsed=1, DcmDspCommonAuthorizationRef=DcmDspCommonAuthorization_eabf1d27
            DcmDspStartRoutine_START_Energiesparmode (DcmDspStartRoutine): DcmDspStartRoutineFnc=Prog_RoutineControlSetEnergyState
              DcmDspStartRoutineIn_START_Energiesparmode (DcmDspStartRoutineIn)
                DcmDspStartRoutineInSignal_OperatingMode (DcmDspStartRoutineInSignal): DcmDspRoutineSignalLength=8, DcmDspRoutineSignalPos=0, DcmDspRoutineSignalType=UINT8
          DcmDspRoutine_EthArlTable: DcmDspRoutineIdentifier=4162, DcmDspRoutineUsed=1, DcmDspCommonAuthorizationRef=DcmDspCommonAuthorization_eabf1d27
            DcmDspStartRoutine_START_EthArlTable (DcmDspStartRoutine)
              DcmDspStartRoutineIn_START_EthArlTable (DcmDspStartRoutineIn)
                DcmDspStartRoutineInSignal_PortIndex (DcmDspStartRoutineInSignal): DcmDspRoutineSignalEndianness=BIG_ENDIAN, DcmDspRoutineSignalLength=8, DcmDspRoutineSignalPos=0, DcmDspRoutineSignalType=UINT8
              DcmDspStartRoutineOut_START_EthArlTable (DcmDspStartRoutineOut)
                DcmDspStartRoutineOutSignal_StatArlVlanIdEntries (DcmDspStartRoutineOutSignal): DcmDspRoutineSignalPos=8
                DcmDspStartRoutineOutSignal_StatNumArlVlanIdEntriesWert (DcmDspStartRoutineOutSignal): DcmDspRoutineSignalEndianness=BIG_ENDIAN, DcmDspRoutineSignalLength=8, DcmDspRoutineSignalPos=0, DcmDspRoutineSignalType=UINT8
          DcmDspRoutine_EthArpTable: DcmDspRoutineIdentifier=4163, DcmDspRoutineUsed=1, DcmDspCommonAuthorizationRef=DcmDspCommonAuthorization_eabf1d27
            DcmDspStartRoutine_START_EthArpTable (DcmDspStartRoutine)
              DcmDspStartRoutineIn_START_EthArpTable (DcmDspStartRoutineIn)
                DcmDspStartRoutineInSignal_ArpTableForIpAddress (DcmDspStartRoutineInSignal): DcmDspRoutineSignalPos=8
                DcmDspStartRoutineInSignal_IpVersion (DcmDspStartRoutineInSignal): DcmDspRoutineSignalEndianness=BIG_ENDIAN, DcmDspRoutineSignalLength=8, DcmDspRoutineSignalPos=0, DcmDspRoutineSignalType=UINT8
              DcmDspStartRoutineOut_START_EthArpTable (DcmDspStartRoutineOut)
                DcmDspStartRoutineOutSignal_StatArpIpMacEntries (DcmDspStartRoutineOutSignal): DcmDspRoutineSignalPos=8
                DcmDspStartRoutineOutSignal_StatNumArpEntriesWert (DcmDspStartRoutineOutSignal): DcmDspRoutineSignalEndianness=BIG_ENDIAN, DcmDspRoutineSignalLength=8, DcmDspRoutineSignalPos=0, DcmDspRoutineSignalType=UINT8
          DcmDspRoutine_EthExtendedArlTable: DcmDspRoutineIdentifier=4174, DcmDspRoutineUsed=1, DcmDspCommonAuthorizationRef=DcmDspCommonAuthorization_eabf1d27
            DcmDspStartRoutine_START_EthExtendedArlTable (DcmDspStartRoutine)
              DcmDspStartRoutineOut_START_EthExtendedArlTable (DcmDspStartRoutineOut)
                DcmDspStartRoutineOutSignal_StatExtendedArlVlanIdEntries (DcmDspStartRoutineOutSignal): DcmDspRoutineSignalPos=8
                DcmDspStartRoutineOutSignal_StatNumArlVlanIdEntriesWert (DcmDspStartRoutineOutSignal): DcmDspRoutineSignalEndianness=BIG_ENDIAN, DcmDspRoutineSignalLength=8, DcmDspRoutineSignalPos=0, DcmDspRoutineSignalType=UINT8
          DcmDspRoutine_EthGetDhcpStatus: DcmDspRoutineIdentifier=4175, DcmDspRoutineUsed=1, DcmDspCommonAuthorizationRef=DcmDspCommonAuthorization_af67410c
            DcmDspStartRoutine_START_EthGetDhcpStatus (DcmDspStartRoutine)
              DcmDspStartRoutineIn_START_EthGetDhcpStatus (DcmDspStartRoutineIn)
                DcmDspStartRoutineInSignal_NwInterfaceIndex (DcmDspStartRoutineInSignal): DcmDspRoutineSignalEndianness=BIG_ENDIAN, DcmDspRoutineSignalLength=8, DcmDspRoutineSignalPos=0, DcmDspRoutineSignalType=UINT8
              DcmDspStartRoutineOut_START_EthGetDhcpStatus (DcmDspStartRoutineOut)
                DcmDspStartRoutineOutSignal_StatDhcpClientState (DcmDspStartRoutineOutSignal): DcmDspRoutineSignalEndianness=BIG_ENDIAN, DcmDspRoutineSignalLength=8, DcmDspRoutineSignalPos=0, DcmDspRoutineSignalType=UINT8
          DcmDspRoutine_EthIpConfiguration: DcmDspRoutineIdentifier=4165, DcmDspRoutineUsed=1, DcmDspCommonAuthorizationRef=DcmDspCommonAuthorization_eabf1d27
            DcmDspStartRoutine_START_EthIpConfiguration (DcmDspStartRoutine)
              DcmDspStartRoutineIn_START_EthIpConfiguration (DcmDspStartRoutineIn)
                DcmDspStartRoutineInSignal_InternalExternalAddress (DcmDspStartRoutineInSignal): DcmDspRoutineSignalEndianness=BIG_ENDIAN, DcmDspRoutineSignalLength=8, DcmDspRoutineSignalPos=0, DcmDspRoutineSignalType=UINT8
                DcmDspStartRoutineInSignal_TriggerGratuitousArp (DcmDspStartRoutineInSignal): DcmDspRoutineSignalEndianness=BIG_ENDIAN, DcmDspRoutineSignalLength=8, DcmDspRoutineSignalPos=8, DcmDspRoutineSignalType=UINT8
              DcmDspStartRoutineOut_START_EthIpConfiguration (DcmDspStartRoutineOut)
                DcmDspStartRoutineOutSignal_EcuType (DcmDspStartRoutineOutSignal): DcmDspRoutineSignalEndianness=BIG_ENDIAN, DcmDspRoutineSignalLength=8, DcmDspRoutineSignalPos=0, DcmDspRoutineSignalType=UINT8
                DcmDspStartRoutineOutSignal_StatEthIpConfiguration (DcmDspStartRoutineOutSignal): DcmDspRoutineSignalPos=8
          DcmDspRoutine_EthPhyIdentifier: DcmDspRoutineIdentifier=4167, DcmDspRoutineUsed=1, DcmDspCommonAuthorizationRef=DcmDspCommonAuthorization_eabf1d27
            DcmDspStartRoutine_START_EthPhyIdentifier (DcmDspStartRoutine)
              DcmDspStartRoutineIn_START_EthPhyIdentifier (DcmDspStartRoutineIn)
                DcmDspStartRoutineInSignal_PortIndex (DcmDspStartRoutineInSignal): DcmDspRoutineSignalEndianness=BIG_ENDIAN, DcmDspRoutineSignalLength=8, DcmDspRoutineSignalPos=0, DcmDspRoutineSignalType=UINT8
              DcmDspStartRoutineOut_START_EthPhyIdentifier (DcmDspStartRoutineOut)
                DcmDspStartRoutineOutSignal_StatOuiData (DcmDspStartRoutineOutSignal): DcmDspRoutineSignalEndianness=BIG_ENDIAN, DcmDspRoutineSignalLength=48, DcmDspRoutineSignalPos=0, DcmDspRoutineSignalType=VARIABLE_LENGTH
          DcmDspRoutine_ExternalHsfz: DcmDspRoutineIdentifier=4131, DcmDspRoutineUsed=1, DcmDspCommonAuthorizationRef=DcmDspCommonAuthorization_eabf1d27
            DcmDspStartRoutine_START_ExternalHsfz (DcmDspStartRoutine): DcmDspStartRoutineFnc=EthDiagMM_RoutineControlSetDiagIfcStart
              DcmDspStartRoutineIn_START_ExternalHsfz (DcmDspStartRoutineIn)
                DcmDspStartRoutineInSignal_Activation (DcmDspStartRoutineInSignal): DcmDspRoutineSignalLength=8, DcmDspRoutineSignalPos=0, DcmDspRoutineSignalType=UINT8
          DcmDspRoutine_GetActualConfig: DcmDspRoutineIdentifier=4113, DcmDspRoutineUsed=1, DcmDspCommonAuthorizationRef=DcmDspCommonAuthorization_af67410c
            DcmDspStartRoutine_START_GetActualConfig (DcmDspStartRoutine): DcmDspStartRoutineFnc=EthDiagMM_RoutineControlGetActualConfigStart
              DcmDspStartRoutineOut_START_GetActualConfig (DcmDspStartRoutineOut)
                DcmDspStartRoutineOutSignal_EcuAddress (DcmDspStartRoutineOutSignal): DcmDspRoutineSignalLength=8, DcmDspRoutineSignalPos=8, DcmDspRoutineSignalType=UINT8
                DcmDspStartRoutineOutSignal_StatIdsWert (DcmDspStartRoutineOutSignal): DcmDspRoutineSignalLength=8, DcmDspRoutineSignalPos=0, DcmDspRoutineSignalType=UINT8
          DcmDspRoutine_HttpUpdateRoutine
            DcmDspRequestRoutineResults_RESULT_HttpUpdateRoutine (DcmDspRequestRoutineResults)
              RESULT_HttpUpdateRoutine_OUT (DcmDspRequestRoutineResultsOut)
                DcmDspRequestRoutineResultsOutSignal_AnzahlItems (DcmDspRequestRoutineResultsOutSignal): DcmDspRoutineSignalEndianness=BIG_ENDIAN, DcmDspRoutineSignalLength=8, DcmDspRoutineSignalPos=0, DcmDspRoutineSignalType=UINT8
                DcmDspRequestRoutineResultsOutSignal_StatusEintrag (DcmDspRequestRoutineResultsOutSignal): DcmDspRoutineSignalPos=8
          DcmDspRoutine_RcCm: DcmDspRoutineIdentifier=514, DcmDspRoutineUsed=1, DcmDspCommonAuthorizationRef=DcmDspCommonAuthorization_1f05440b
            DcmDspStartRoutine_START_RcCm (DcmDspStartRoutine): DcmDspStartRoutineFnc=Prog_RoutineControlCheckMemory
              DcmDspStartRoutineIn_START_RcCm (DcmDspStartRoutineIn)
                3 x DcmDspStartRoutineInSignal:
                  DcmDspStartRoutineInSignal_DataIn: DcmDspRoutineSignalType=VARIABLE_LENGTH
                  DcmDspStartRoutineInSignal_Method: DcmDspRoutineSignalLength=8, DcmDspRoutineSignalPos=0, DcmDspRoutineSignalType=UINT8
                  DcmDspStartRoutineInSignal_RcCmIcvRcoStruct: DcmDspRoutineSignalPos=0
              DcmDspStartRoutineOut_START_RcCm (DcmDspStartRoutineOut)
                DcmDspStartRoutineOutSignal_Result (DcmDspStartRoutineOutSignal): DcmDspRoutineSignalLength=8, DcmDspRoutineSignalPos=0, DcmDspRoutineSignalType=UINT8
                DcmDspStartRoutineOutSignal_StatRoutineStatus (DcmDspStartRoutineOutSignal): DcmDspRoutineSignalEndianness=BIG_ENDIAN, DcmDspRoutineSignalLength=8, DcmDspRoutineSignalPos=0, DcmDspRoutineSignalType=UINT8
          DcmDspRoutine_RcCpd: DcmDspRoutineIdentifier=65281, DcmDspRoutineUsed=1, DcmDspCommonAuthorizationRef=DcmDspCommonAuthorization_1f05440b
            DcmDspStartRoutine_START_RcCpd (DcmDspStartRoutine): DcmDspStartRoutineFnc=Prog_RoutineControlCheckProgDependency
              DcmDspStartRoutineOut_START_RcCpd (DcmDspStartRoutineOut)
                DcmDspStartRoutineOutSignal_Result (DcmDspStartRoutineOutSignal): DcmDspRoutineSignalLength=8, DcmDspRoutineSignalPos=0, DcmDspRoutineSignalType=UINT8
                DcmDspStartRoutineOutSignal_StatRoutineStatus (DcmDspStartRoutineOutSignal): DcmDspRoutineSignalEndianness=BIG_ENDIAN, DcmDspRoutineSignalLength=8, DcmDspRoutineSignalPos=0, DcmDspRoutineSignalType=UINT8
          DcmDspRoutine_RcEm: DcmDspRoutineIdentifier=65280, DcmDspRoutineUsed=1, DcmDspCommonAuthorizationRef=DcmDspCommonAuthorization_1f05440b
            DcmDspStartRoutine_START_RcEm (DcmDspStartRoutine): DcmDspStartRoutineFnc=Prog_RoutineControlEraseMemory
              DcmDspStartRoutineIn_START_RcEm (DcmDspStartRoutineIn)
                4 x DcmDspStartRoutineInSignal:
                  DcmDspStartRoutineInSignal_DataIn: DcmDspRoutineSignalPos=16, DcmDspRoutineSignalType=VARIABLE_LENGTH
                  DcmDspStartRoutineInSignal_FormatIdentifier: DcmDspRoutineSignalLength=8, DcmDspRoutineSignalPos=8, DcmDspRoutineSignalType=UINT8
                  DcmDspStartRoutineInSignal_Method: DcmDspRoutineSignalLength=8, DcmDspRoutineSignalPos=0, DcmDspRoutineSignalType=UINT8
                  DcmDspStartRoutineInSignal_RcEmIeRco: DcmDspRoutineSignalPos=0
              DcmDspStartRoutineOut_START_RcEm (DcmDspStartRoutineOut)
                DcmDspStartRoutineOutSignal_Result (DcmDspStartRoutineOutSignal): DcmDspRoutineSignalLength=8, DcmDspRoutineSignalPos=0, DcmDspRoutineSignalType=UINT8
                DcmDspStartRoutineOutSignal_StatRoutineStatus (DcmDspStartRoutineOutSignal): DcmDspRoutineSignalEndianness=BIG_ENDIAN, DcmDspRoutineSignalLength=8, DcmDspRoutineSignalPos=0, DcmDspRoutineSignalType=UINT8
          DcmDspRoutine_RcRswedi: DcmDspRoutineIdentifier=517, DcmDspRoutineUsed=1, DcmDspCommonAuthorizationRef=DcmDspCommonAuthorization_eabf1d27
            DcmDspStartRoutine_START_RcRswedi (DcmDspStartRoutine): DcmDspStartRoutineFnc=Dlog_RoutineControlStartReadDevelopmentInfoField
              DcmDspStartRoutineIn_START_RcRswedi (DcmDspStartRoutineIn)
                DcmDspStartRoutineInSignal_DataIn (DcmDspStartRoutineInSignal): DcmDspRoutineSignalLength=64, DcmDspRoutineSignalPos=0, DcmDspRoutineSignalType=VARIABLE_LENGTH
              DcmDspStartRoutineOut_START_RcRswedi (DcmDspStartRoutineOut)
                DcmDspStartRoutineOutSignal_DataOut (DcmDspStartRoutineOutSignal): DcmDspRoutineSignalPos=0, DcmDspRoutineSignalType=VARIABLE_LENGTH
          DcmDspRoutine_RequestPreferredProtocol: DcmDspRoutineIdentifier=4129, DcmDspRoutineUsed=1, DcmDspCommonAuthorizationRef=DcmDspCommonAuthorization_af67410c
            DcmDspStartRoutine_START_RequestPreferredProtocol (DcmDspStartRoutine)
              DcmDspStartRoutineIn_START_RequestPreferredProtocol (DcmDspStartRoutineIn)
                DcmDspStartRoutineInSignal_SgbmId (DcmDspStartRoutineInSignal): DcmDspRoutineSignalEndianness=BIG_ENDIAN, DcmDspRoutineSignalLength=64, DcmDspRoutineSignalPos=0, DcmDspRoutineSignalType=VARIABLE_LENGTH
              DcmDspStartRoutineOut_START_RequestPreferredProtocol (DcmDspStartRoutineOut)
                DcmDspStartRoutineOutSignal_AnzahlItems (DcmDspStartRoutineOutSignal): DcmDspRoutineSignalEndianness=BIG_ENDIAN, DcmDspRoutineSignalLength=8, DcmDspRoutineSignalPos=0, DcmDspRoutineSignalType=UINT8
                DcmDspStartRoutineOutSignal_FpRpp31011021Eopfld (DcmDspStartRoutineOutSignal): DcmDspRoutineSignalPos=8
          DcmDspRoutine_ResetAktivierungsleitung: DcmDspRoutineIdentifier=4132, DcmDspRoutineUsed=1, DcmDspCommonAuthorizationRef=DcmDspCommonAuthorization_af67410c
            DcmDspStartRoutine_START_ResetAktivierungsleitung (DcmDspStartRoutine)
          DcmDspRoutine_SetDefaultBus: DcmDspRoutineIdentifier=4112, DcmDspRoutineUsed=1, DcmDspCommonAuthorizationRef=DcmDspCommonAuthorization_af67410c
            DcmDspStartRoutine_START_SetDefaultBus (DcmDspStartRoutine): DcmDspStartRoutineFnc=EthDiagMM_RoutineControlSetDiagIfcStart
              DcmDspStartRoutineIn_START_SetDefaultBus (DcmDspStartRoutineIn)
                DcmDspStartRoutineInSignal_ZustandDefaultBus (DcmDspStartRoutineInSignal): DcmDspRoutineSignalLength=8, DcmDspRoutineSignalPos=0, DcmDspRoutineSignalType=UINT8
        DcmDspSecurity
          DcmDspSecurityRow_Programming_HDD (DcmDspSecurityRow):
            DcmDspSecurityADRSize = 4
            DcmDspSecurityAttemptCounterEnabled = 0
            DcmDspSecurityCompareKeyFnc = Prog_CompareKey
            DcmDspSecurityDelayTime = 0.0
            DcmDspSecurityDelayTimeOnBoot = 0.0
            DcmDspSecurityGetSeedFnc = Prog_GetSeed
            DcmDspSecurityLevel = 9
            DcmDspSecuritySeedSize = 8
            DcmDspSecurityUsePort = USE_ASYNCH_FNC
        DcmDspSession
          3 x DcmDspSessionRow, all with DcmDspSessionForBoot=DCM_NO_BOOT:
            DcmDspSessionRow_DEFAULT_SESSION: DcmDspSessionLevel=1, DcmDspSessionP2ServerMax=0.05, DcmDspSessionP2StarServerMax=5.0
            DcmDspSessionRow_EXTENDED_DIAGNOSTIC_SESSION: DcmDspSessionLevel=3, DcmDspSessionP2StarServerMax=5.0
            DcmDspSessionRow_PROGRAMMING_SESSION: DcmDspSessionLevel=2
    DcmGeneral: DcmRespondAllRequest=0
