AUTOSAR XML (schema 4-2-2)
package /BMW/Units
  5 x unit, all with offset-si-to-unit=0.0:
    ampere: display-name=A, factor-si-to-unit=1.0, physical-dimension=ampere
    degree_per_second: display-name=°/s, factor-si-to-unit=3.141592653589793, physical-dimension=degree_per_second
    kilometer_per_hour: display-name=km/h, factor-si-to-unit=1000.0, physical-dimension=kilometer_per_hour
    kilonewton: display-name=kN, factor-si-to-unit=1000.0, physical-dimension=kilonewton
    kilowatt: display-name=kW, factor-si-to-unit=1000.0, physical-dimension=kilowatt
package /BMW/Units/PhysicalDimensions
  5 x physical dimension, all with temperature-exp=0, molar-amount-exp=0, luminous-intensity-exp=0:
    ampere: length-exp=0, mass-exp=0, time-exp=0, current-exp=1
    degree_per_second: length-exp=0, mass-exp=0, time-exp=-1, current-exp=0
    kilometer_per_hour: length-exp=0, mass-exp=0, time-exp=-1, current-exp=0
    kilonewton: length-exp=1, mass-exp=1, time-exp=-2, current-exp=0
    kilowatt: length-exp=2, mass-exp=1, time-exp=-3, current-exp=0
