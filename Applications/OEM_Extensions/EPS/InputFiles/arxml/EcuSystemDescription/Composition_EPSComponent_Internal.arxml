AUTOSAR XML (schema 4-2-2)
package /BMW/Boardnet/Ecus/EcuComposition/EPSComposition
  composition sw component type EPSComponent
