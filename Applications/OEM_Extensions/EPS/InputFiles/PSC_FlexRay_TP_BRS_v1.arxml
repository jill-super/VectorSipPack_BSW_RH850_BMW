AUTOSAR XML (schema 4-2-2)
package /ActiveEcuC
  module config Dcm: implementation-config-variant=VARIANT-PRE-COMPILE, module-description=Dcm_Impl
    DcmConfigSet
      DcmDsl
        DcmDslProtocol
          DcmDslProtocolRow:
            DcmDslProtocolID = DCM_UDS_ON_CAN
            DcmDslProtocolPriority = 0
            DcmSendRespPendOnTransToBoot = true
            DcmTimStrP2ServerAdjust = 0
            DcmTimStrP2StarServerAdjust = 0
            DcmDslProtocolRxBufferID = (unset)
            DcmDslProtocolSIDTable = (unset)
            DcmDslProtocolTxBufferID = (unset)
            14 x DcmDslConnection:
              TN_0x00F1
                DcmDslMainConnection: DcmDslProtocolRxTesterSourceAddr=241
                  PT_TL_BRC_FR_32_TxF1_0xDF_PP_TL_BRC_FR_32_TxF1_0xDF_Rx_c0e3388d_6409b170 (DcmDslProtocolRx):
                    DcmDslProtocolRxAddrType = DCM_FUNCTIONAL_TYPE
                    DcmDslProtocolRxPduId = 1
                    DcmDslProtocolRxPduRef = EcucPduCollection/PT_TL_BRC_FR_32_TxF1_0xDF_PP_TL_BRC_FR_32_TxF1_0xDF_Rx_c0e3388d_6409b170
                  PT_TL_MST_GW_TRNSM_FR_254_00980001_TxF1_PP_TL_MST_GW_TRNSM_FR_254_00980001_TxF1_Rx_c0e3388d_6409b170 (DcmDslProtocolRx):
                    DcmDslProtocolRxAddrType = DCM_PHYSICAL_TYPE
                    DcmDslProtocolRxPduId = 15
                    DcmDslProtocolRxPduRef = EcucPduCollection/PT_TL_MST_GW_TRNSM_FR_254_00980001_TxF1_PP_TL_MST_GW_TRNSM_FR_254_00980001_TxF1_Rx_c0e3388d_6409b170
                  PT_TL_ECU_TRNSM_FR_32_00BC0001_RxF1_PP_TL_ECU_TRNSM_FR_32_00BC0001_RxF1_Tx_c0e3388d_6409b170 (DcmDslProtocolTx):
                    DcmDslTxConfirmationPduId = 1
                    DcmDslProtocolTxPduRef = EcucPduCollection/PT_TL_ECU_TRNSM_FR_32_00BC0001_RxF1_PP_TL_ECU_TRNSM_FR_32_00BC0001_RxF1_Tx_c0e3388d_6409b170
              TN_0x00F0
                DcmDslMainConnection: DcmDslProtocolRxTesterSourceAddr=240
                  PT_TL_MST_GW_TRNSM_FR_254_00980001_TxF0_PP_TL_MST_GW_TRNSM_FR_254_00980001_TxF0_Rx_c0e3388d_6409b170 (DcmDslProtocolRx):
                    DcmDslProtocolRxAddrType = DCM_PHYSICAL_TYPE
                    DcmDslProtocolRxPduId = 14
                    DcmDslProtocolRxPduRef = EcucPduCollection/PT_TL_MST_GW_TRNSM_FR_254_00980001_TxF0_PP_TL_MST_GW_TRNSM_FR_254_00980001_TxF0_Rx_c0e3388d_6409b170
                  PT_TL_ECU_TRNSM_FR_32_00BC0001_RxF0_PP_TL_ECU_TRNSM_FR_32_00BC0001_RxF0_Tx_c0e3388d_6409b170 (DcmDslProtocolTx):
                    DcmDslTxConfirmationPduId = 0
                    DcmDslProtocolTxPduRef = EcucPduCollection/PT_TL_ECU_TRNSM_FR_32_00BC0001_RxF0_PP_TL_ECU_TRNSM_FR_32_00BC0001_RxF0_Tx_c0e3388d_6409b170
                  PT_TL_BRC_FR_32_TxF0_0xDF_PP_TL_BRC_FR_32_TxF0_0xDF_Rx_c0e3388d_6409b170 (DcmDslProtocolRx):
                    DcmDslProtocolRxAddrType = DCM_FUNCTIONAL_TYPE
                    DcmDslProtocolRxPduId = 0
                    DcmDslProtocolRxPduRef = EcucPduCollection/PT_TL_BRC_FR_32_TxF0_0xDF_PP_TL_BRC_FR_32_TxF0_0xDF_Rx_c0e3388d_6409b170
              TN_0x00F5
                DcmDslMainConnection: DcmDslProtocolRxTesterSourceAddr=245
                  PT_TL_MST_GW_TRNSM_FR_254_00980001_TxF5_PP_TL_MST_GW_TRNSM_FR_254_00980001_TxF5_Rx_c0e3388d_6409b170 (DcmDslProtocolRx):
                    DcmDslProtocolRxAddrType = DCM_PHYSICAL_TYPE
                    DcmDslProtocolRxPduId = 19
                    DcmDslProtocolRxPduRef = EcucPduCollection/PT_TL_MST_GW_TRNSM_FR_254_00980001_TxF5_PP_TL_MST_GW_TRNSM_FR_254_00980001_TxF5_Rx_c0e3388d_6409b170
                  PT_TL_ECU_TRNSM_FR_32_00BC0001_RxF5_PP_TL_ECU_TRNSM_FR_32_00BC0001_RxF5_Tx_c0e3388d_6409b170 (DcmDslProtocolTx):
                    DcmDslTxConfirmationPduId = 5
                    DcmDslProtocolTxPduRef = EcucPduCollection/PT_TL_ECU_TRNSM_FR_32_00BC0001_RxF5_PP_TL_ECU_TRNSM_FR_32_00BC0001_RxF5_Tx_c0e3388d_6409b170
                  PT_TL_BRC_FR_32_TxF5_0xDF_PP_TL_BRC_FR_32_TxF5_0xDF_Rx_c0e3388d_6409b170 (DcmDslProtocolRx):
                    DcmDslProtocolRxAddrType = DCM_FUNCTIONAL_TYPE
                    DcmDslProtocolRxPduId = 5
                    DcmDslProtocolRxPduRef = EcucPduCollection/PT_TL_BRC_FR_32_TxF5_0xDF_PP_TL_BRC_FR_32_TxF5_0xDF_Rx_c0e3388d_6409b170
              TN_0x00F4
                DcmDslMainConnection: DcmDslProtocolRxTesterSourceAddr=244
                  PT_TL_ECU_TRNSM_FR_32_00BC0001_RxF4_PP_TL_ECU_TRNSM_FR_32_00BC0001_RxF4_Tx_c0e3388d_6409b170 (DcmDslProtocolTx):
                    DcmDslTxConfirmationPduId = 4
                    DcmDslProtocolTxPduRef = EcucPduCollection/PT_TL_ECU_TRNSM_FR_32_00BC0001_RxF4_PP_TL_ECU_TRNSM_FR_32_00BC0001_RxF4_Tx_c0e3388d_6409b170
                  PT_TL_MST_GW_TRNSM_FR_254_00980001_TxF4_PP_TL_MST_GW_TRNSM_FR_254_00980001_TxF4_Rx_c0e3388d_6409b170 (DcmDslProtocolRx):
                    DcmDslProtocolRxAddrType = DCM_PHYSICAL_TYPE
                    DcmDslProtocolRxPduId = 18
                    DcmDslProtocolRxPduRef = EcucPduCollection/PT_TL_MST_GW_TRNSM_FR_254_00980001_TxF4_PP_TL_MST_GW_TRNSM_FR_254_00980001_TxF4_Rx_c0e3388d_6409b170
                  PT_TL_BRC_FR_32_TxF4_0xDF_PP_TL_BRC_FR_32_TxF4_0xDF_Rx_c0e3388d_6409b170 (DcmDslProtocolRx):
                    DcmDslProtocolRxAddrType = DCM_FUNCTIONAL_TYPE
                    DcmDslProtocolRxPduId = 4
                    DcmDslProtocolRxPduRef = EcucPduCollection/PT_TL_BRC_FR_32_TxF4_0xDF_PP_TL_BRC_FR_32_TxF4_0xDF_Rx_c0e3388d_6409b170
              TN_0x00F3
                DcmDslMainConnection: DcmDslProtocolRxTesterSourceAddr=243
                  PT_TL_ECU_TRNSM_FR_32_00BC0001_RxF3_PP_TL_ECU_TRNSM_FR_32_00BC0001_RxF3_Tx_c0e3388d_6409b170 (DcmDslProtocolTx):
                    DcmDslTxConfirmationPduId = 3
                    DcmDslProtocolTxPduRef = EcucPduCollection/PT_TL_ECU_TRNSM_FR_32_00BC0001_RxF3_PP_TL_ECU_TRNSM_FR_32_00BC0001_RxF3_Tx_c0e3388d_6409b170
                  PT_TL_MST_GW_TRNSM_FR_254_00980001_TxF3_PP_TL_MST_GW_TRNSM_FR_254_00980001_TxF3_Rx_c0e3388d_6409b170 (DcmDslProtocolRx):
                    DcmDslProtocolRxAddrType = DCM_PHYSICAL_TYPE
                    DcmDslProtocolRxPduId = 17
                    DcmDslProtocolRxPduRef = EcucPduCollection/PT_TL_MST_GW_TRNSM_FR_254_00980001_TxF3_PP_TL_MST_GW_TRNSM_FR_254_00980001_TxF3_Rx_c0e3388d_6409b170
                  PT_TL_BRC_FR_32_TxF3_0xDF_PP_TL_BRC_FR_32_TxF3_0xDF_Rx_c0e3388d_6409b170 (DcmDslProtocolRx):
                    DcmDslProtocolRxAddrType = DCM_FUNCTIONAL_TYPE
                    DcmDslProtocolRxPduId = 3
                    DcmDslProtocolRxPduRef = EcucPduCollection/PT_TL_BRC_FR_32_TxF3_0xDF_PP_TL_BRC_FR_32_TxF3_0xDF_Rx_c0e3388d_6409b170
              TN_0x00F2
                DcmDslMainConnection: DcmDslProtocolRxTesterSourceAddr=242
                  PT_TL_MST_GW_TRNSM_FR_254_00980001_TxF2_PP_TL_MST_GW_TRNSM_FR_254_00980001_TxF2_Rx_c0e3388d_6409b170 (DcmDslProtocolRx):
                    DcmDslProtocolRxAddrType = DCM_PHYSICAL_TYPE
                    DcmDslProtocolRxPduId = 16
                    DcmDslProtocolRxPduRef = EcucPduCollection/PT_TL_MST_GW_TRNSM_FR_254_00980001_TxF2_PP_TL_MST_GW_TRNSM_FR_254_00980001_TxF2_Rx_c0e3388d_6409b170
                  PT_TL_ECU_TRNSM_FR_32_00BC0001_RxF2_PP_TL_ECU_TRNSM_FR_32_00BC0001_RxF2_Tx_c0e3388d_6409b170 (DcmDslProtocolTx):
                    DcmDslTxConfirmationPduId = 2
                    DcmDslProtocolTxPduRef = EcucPduCollection/PT_TL_ECU_TRNSM_FR_32_00BC0001_RxF2_PP_TL_ECU_TRNSM_FR_32_00BC0001_RxF2_Tx_c0e3388d_6409b170
                  PT_TL_BRC_FR_32_TxF2_0xDF_PP_TL_BRC_FR_32_TxF2_0xDF_Rx_c0e3388d_6409b170 (DcmDslProtocolRx):
                    DcmDslProtocolRxAddrType = DCM_FUNCTIONAL_TYPE
                    DcmDslProtocolRxPduId = 2
                    DcmDslProtocolRxPduRef = EcucPduCollection/PT_TL_BRC_FR_32_TxF2_0xDF_PP_TL_BRC_FR_32_TxF2_0xDF_Rx_c0e3388d_6409b170
              TN_0x00FA
                DcmDslMainConnection: DcmDslProtocolRxTesterSourceAddr=250
                  PT_TL_ECU_TRNSM_FR_32_00BC0001_RxFA_PP_TL_ECU_TRNSM_FR_32_00BC0001_RxFA_Tx_c0e3388d_6409b170 (DcmDslProtocolTx):
                    DcmDslTxConfirmationPduId = 10
                    DcmDslProtocolTxPduRef = EcucPduCollection/PT_TL_ECU_TRNSM_FR_32_00BC0001_RxFA_PP_TL_ECU_TRNSM_FR_32_00BC0001_RxFA_Tx_c0e3388d_6409b170
                  PT_TL_BRC_FR_32_TxFA_0xDF_PP_TL_BRC_FR_32_TxFA_0xDF_Rx_c0e3388d_6409b170 (DcmDslProtocolRx):
                    DcmDslProtocolRxAddrType = DCM_FUNCTIONAL_TYPE
                    DcmDslProtocolRxPduId = 10
                    DcmDslProtocolRxPduRef = EcucPduCollection/PT_TL_BRC_FR_32_TxFA_0xDF_PP_TL_BRC_FR_32_TxFA_0xDF_Rx_c0e3388d_6409b170
                  PT_TL_MST_GW_TRNSM_FR_254_00980001_TxFA_PP_TL_MST_GW_TRNSM_FR_254_00980001_TxFA_Rx_c0e3388d_6409b170 (DcmDslProtocolRx):
                    DcmDslProtocolRxAddrType = DCM_PHYSICAL_TYPE
                    DcmDslProtocolRxPduId = 24
                    DcmDslProtocolRxPduRef = EcucPduCollection/PT_TL_MST_GW_TRNSM_FR_254_00980001_TxFA_PP_TL_MST_GW_TRNSM_FR_254_00980001_TxFA_Rx_c0e3388d_6409b170
              TN_0x00FD
                DcmDslMainConnection: DcmDslProtocolRxTesterSourceAddr=253
                  PT_TL_ECU_TRNSM_FR_32_00BC0001_RxFD_PP_TL_ECU_TRNSM_FR_32_00BC0001_RxFD_Tx_c0e3388d_6409b170 (DcmDslProtocolTx):
                    DcmDslTxConfirmationPduId = 13
                    DcmDslProtocolTxPduRef = EcucPduCollection/PT_TL_ECU_TRNSM_FR_32_00BC0001_RxFD_PP_TL_ECU_TRNSM_FR_32_00BC0001_RxFD_Tx_c0e3388d_6409b170
                  PT_TL_MST_GW_TRNSM_FR_254_00980001_TxFD_PP_TL_MST_GW_TRNSM_FR_254_00980001_TxFD_Rx_c0e3388d_6409b170 (DcmDslProtocolRx):
                    DcmDslProtocolRxAddrType = DCM_PHYSICAL_TYPE
                    DcmDslProtocolRxPduId = 27
                    DcmDslProtocolRxPduRef = EcucPduCollection/PT_TL_MST_GW_TRNSM_FR_254_00980001_TxFD_PP_TL_MST_GW_TRNSM_FR_254_00980001_TxFD_Rx_c0e3388d_6409b170
                  PT_TL_BRC_FR_32_TxFD_0xDF_PP_TL_BRC_FR_32_TxFD_0xDF_Rx_c0e3388d_6409b170 (DcmDslProtocolRx):
                    DcmDslProtocolRxAddrType = DCM_FUNCTIONAL_TYPE
                    DcmDslProtocolRxPduId = 13
                    DcmDslProtocolRxPduRef = EcucPduCollection/PT_TL_BRC_FR_32_TxFD_0xDF_PP_TL_BRC_FR_32_TxFD_0xDF_Rx_c0e3388d_6409b170
              TN_0x00FC
                DcmDslMainConnection: DcmDslProtocolRxTesterSourceAddr=252
                  PT_TL_BRC_FR_32_TxFC_0xDF_PP_TL_BRC_FR_32_TxFC_0xDF_Rx_c0e3388d_6409b170 (DcmDslProtocolRx):
                    DcmDslProtocolRxAddrType = DCM_FUNCTIONAL_TYPE
                    DcmDslProtocolRxPduId = 12
                    DcmDslProtocolRxPduRef = EcucPduCollection/PT_TL_BRC_FR_32_TxFC_0xDF_PP_TL_BRC_FR_32_TxFC_0xDF_Rx_c0e3388d_6409b170
                  PT_TL_ECU_TRNSM_FR_32_00BC0001_RxFC_PP_TL_ECU_TRNSM_FR_32_00BC0001_RxFC_Tx_c0e3388d_6409b170 (DcmDslProtocolTx):
                    DcmDslTxConfirmationPduId = 12
                    DcmDslProtocolTxPduRef = EcucPduCollection/PT_TL_ECU_TRNSM_FR_32_00BC0001_RxFC_PP_TL_ECU_TRNSM_FR_32_00BC0001_RxFC_Tx_c0e3388d_6409b170
                  PT_TL_MST_GW_TRNSM_FR_254_00980001_TxFC_PP_TL_MST_GW_TRNSM_FR_254_00980001_TxFC_Rx_c0e3388d_6409b170 (DcmDslProtocolRx):
                    DcmDslProtocolRxAddrType = DCM_PHYSICAL_TYPE
                    DcmDslProtocolRxPduId = 26
                    DcmDslProtocolRxPduRef = EcucPduCollection/PT_TL_MST_GW_TRNSM_FR_254_00980001_TxFC_PP_TL_MST_GW_TRNSM_FR_254_00980001_TxFC_Rx_c0e3388d_6409b170
              TN_0x00FB
                DcmDslMainConnection: DcmDslProtocolRxTesterSourceAddr=251
                  PT_TL_MST_GW_TRNSM_FR_254_00980001_TxFB_PP_TL_MST_GW_TRNSM_FR_254_00980001_TxFB_Rx_c0e3388d_6409b170 (DcmDslProtocolRx):
                    DcmDslProtocolRxAddrType = DCM_PHYSICAL_TYPE
                    DcmDslProtocolRxPduId = 25
                    DcmDslProtocolRxPduRef = EcucPduCollection/PT_TL_MST_GW_TRNSM_FR_254_00980001_TxFB_PP_TL_MST_GW_TRNSM_FR_254_00980001_TxFB_Rx_c0e3388d_6409b170
                  PT_TL_BRC_FR_32_TxFB_0xDF_PP_TL_BRC_FR_32_TxFB_0xDF_Rx_c0e3388d_6409b170 (DcmDslProtocolRx):
                    DcmDslProtocolRxAddrType = DCM_FUNCTIONAL_TYPE
                    DcmDslProtocolRxPduId = 11
                    DcmDslProtocolRxPduRef = EcucPduCollection/PT_TL_BRC_FR_32_TxFB_0xDF_PP_TL_BRC_FR_32_TxFB_0xDF_Rx_c0e3388d_6409b170
                  PT_TL_ECU_TRNSM_FR_32_00BC0001_RxFB_PP_TL_ECU_TRNSM_FR_32_00BC0001_RxFB_Tx_c0e3388d_6409b170 (DcmDslProtocolTx):
                    DcmDslTxConfirmationPduId = 11
                    DcmDslProtocolTxPduRef = EcucPduCollection/PT_TL_ECU_TRNSM_FR_32_00BC0001_RxFB_PP_TL_ECU_TRNSM_FR_32_00BC0001_RxFB_Tx_c0e3388d_6409b170
              TN_0x00F9
                DcmDslMainConnection: DcmDslProtocolRxTesterSourceAddr=249
                  PT_TL_BRC_FR_32_TxF9_0xDF_PP_TL_BRC_FR_32_TxF9_0xDF_Rx_c0e3388d_6409b170 (DcmDslProtocolRx):
                    DcmDslProtocolRxAddrType = DCM_FUNCTIONAL_TYPE
                    DcmDslProtocolRxPduId = 9
                    DcmDslProtocolRxPduRef = EcucPduCollection/PT_TL_BRC_FR_32_TxF9_0xDF_PP_TL_BRC_FR_32_TxF9_0xDF_Rx_c0e3388d_6409b170
                  PT_TL_MST_GW_TRNSM_FR_254_00980001_TxF9_PP_TL_MST_GW_TRNSM_FR_254_00980001_TxF9_Rx_c0e3388d_6409b170 (DcmDslProtocolRx):
                    DcmDslProtocolRxAddrType = DCM_PHYSICAL_TYPE
                    DcmDslProtocolRxPduId = 23
                    DcmDslProtocolRxPduRef = EcucPduCollection/PT_TL_MST_GW_TRNSM_FR_254_00980001_TxF9_PP_TL_MST_GW_TRNSM_FR_254_00980001_TxF9_Rx_c0e3388d_6409b170
                  PT_TL_ECU_TRNSM_FR_32_00BC0001_RxF9_PP_TL_ECU_TRNSM_FR_32_00BC0001_RxF9_Tx_c0e3388d_6409b170 (DcmDslProtocolTx):
                    DcmDslTxConfirmationPduId = 9
                    DcmDslProtocolTxPduRef = EcucPduCollection/PT_TL_ECU_TRNSM_FR_32_00BC0001_RxF9_PP_TL_ECU_TRNSM_FR_32_00BC0001_RxF9_Tx_c0e3388d_6409b170
              TN_0x00F8
                DcmDslMainConnection: DcmDslProtocolRxTesterSourceAddr=248
                  PT_TL_BRC_FR_32_TxF8_0xDF_PP_TL_BRC_FR_32_TxF8_0xDF_Rx_c0e3388d_6409b170 (DcmDslProtocolRx):
                    DcmDslProtocolRxAddrType = DCM_FUNCTIONAL_TYPE
                    DcmDslProtocolRxPduId = 8
                    DcmDslProtocolRxPduRef = EcucPduCollection/PT_TL_BRC_FR_32_TxF8_0xDF_PP_TL_BRC_FR_32_TxF8_0xDF_Rx_c0e3388d_6409b170
                  PT_TL_MST_GW_TRNSM_FR_254_00980001_TxF8_PP_TL_MST_GW_TRNSM_FR_254_00980001_TxF8_Rx_c0e3388d_6409b170 (DcmDslProtocolRx):
                    DcmDslProtocolRxAddrType = DCM_PHYSICAL_TYPE
                    DcmDslProtocolRxPduId = 22
                    DcmDslProtocolRxPduRef = EcucPduCollection/PT_TL_MST_GW_TRNSM_FR_254_00980001_TxF8_PP_TL_MST_GW_TRNSM_FR_254_00980001_TxF8_Rx_c0e3388d_6409b170
                  PT_TL_ECU_TRNSM_FR_32_00BC0001_RxF8_PP_TL_ECU_TRNSM_FR_32_00BC0001_RxF8_Tx_c0e3388d_6409b170 (DcmDslProtocolTx):
                    DcmDslTxConfirmationPduId = 8
                    DcmDslProtocolTxPduRef = EcucPduCollection/PT_TL_ECU_TRNSM_FR_32_00BC0001_RxF8_PP_TL_ECU_TRNSM_FR_32_00BC0001_RxF8_Tx_c0e3388d_6409b170
              TN_0x00F7
                DcmDslMainConnection: DcmDslProtocolRxTesterSourceAddr=247
                  PT_TL_ECU_TRNSM_FR_32_00BC0001_RxF7_PP_TL_ECU_TRNSM_FR_32_00BC0001_RxF7_Tx_c0e3388d_6409b170 (DcmDslProtocolTx):
                    DcmDslTxConfirmationPduId = 7
                    DcmDslProtocolTxPduRef = EcucPduCollection/PT_TL_ECU_TRNSM_FR_32_00BC0001_RxF7_PP_TL_ECU_TRNSM_FR_32_00BC0001_RxF7_Tx_c0e3388d_6409b170
                  PT_TL_MST_GW_TRNSM_FR_254_00980001_TxF7_PP_TL_MST_GW_TRNSM_FR_254_00980001_TxF7_Rx_c0e3388d_6409b170 (DcmDslProtocolRx):
                    DcmDslProtocolRxAddrType = DCM_PHYSICAL_TYPE
                    DcmDslProtocolRxPduId = 21
                    DcmDslProtocolRxPduRef = EcucPduCollection/PT_TL_MST_GW_TRNSM_FR_254_00980001_TxF7_PP_TL_MST_GW_TRNSM_FR_254_00980001_TxF7_Rx_c0e3388d_6409b170
                  PT_TL_BRC_FR_32_TxF7_0xDF_PP_TL_BRC_FR_32_TxF7_0xDF_Rx_c0e3388d_6409b170 (DcmDslProtocolRx):
                    DcmDslProtocolRxAddrType = DCM_FUNCTIONAL_TYPE
                    DcmDslProtocolRxPduId = 7
                    DcmDslProtocolRxPduRef = EcucPduCollection/PT_TL_BRC_FR_32_TxF7_0xDF_PP_TL_BRC_FR_32_TxF7_0xDF_Rx_c0e3388d_6409b170
              TN_0x00F6
                DcmDslMainConnection: DcmDslProtocolRxTesterSourceAddr=246
                  PT_TL_ECU_TRNSM_FR_32_00BC0001_RxF6_PP_TL_ECU_TRNSM_FR_32_00BC0001_RxF6_Tx_c0e3388d_6409b170 (DcmDslProtocolTx):
                    DcmDslTxConfirmationPduId = 6
                    DcmDslProtocolTxPduRef = EcucPduCollection/PT_TL_ECU_TRNSM_FR_32_00BC0001_RxF6_PP_TL_ECU_TRNSM_FR_32_00BC0001_RxF6_Tx_c0e3388d_6409b170
                  PT_TL_MST_GW_TRNSM_FR_254_00980001_TxF6_PP_TL_MST_GW_TRNSM_FR_254_00980001_TxF6_Rx_c0e3388d_6409b170 (DcmDslProtocolRx):
                    DcmDslProtocolRxAddrType = DCM_PHYSICAL_TYPE
                    DcmDslProtocolRxPduId = 20
                    DcmDslProtocolRxPduRef = EcucPduCollection/PT_TL_MST_GW_TRNSM_FR_254_00980001_TxF6_PP_TL_MST_GW_TRNSM_FR_254_00980001_TxF6_Rx_c0e3388d_6409b170
                  PT_TL_BRC_FR_32_TxF6_0xDF_PP_TL_BRC_FR_32_TxF6_0xDF_Rx_c0e3388d_6409b170 (DcmDslProtocolRx):
                    DcmDslProtocolRxAddrType = DCM_FUNCTIONAL_TYPE
                    DcmDslProtocolRxPduId = 6
                    DcmDslProtocolRxPduRef = EcucPduCollection/PT_TL_BRC_FR_32_TxF6_0xDF_PP_TL_BRC_FR_32_TxF6_0xDF_Rx_c0e3388d_6409b170
  module config EcuC: implementation-config-variant=VARIANT-PRE-COMPILE, module-description=EcuC_Impl
    EcucPduCollection: PduIdTypeEnum=UINT16, PduLengthTypeEnum=UINT16
      42 x Pdu, all with J1939Requestable=false:
        PT_TL_ECU_TRNSM_FR_32_00BC0001_RxF9_PP_TL_ECU_TRNSM_FR_32_00BC0001_RxF9_Tx_c0e3388d_6409b170: PduLength=65535  # TL_ECU_TRNSM_FR_32_00BC0001_RxF9
        PT_TL_ECU_TRNSM_FR_32_00BC0001_RxF2_PP_TL_ECU_TRNSM_FR_32_00BC0001_RxF2_Tx_c0e3388d_6409b170: PduLength=65535  # TL_ECU_TRNSM_FR_32_00BC0001_RxF2
        PT_TL_BRC_FR_32_TxF6_0xDF_PP_TL_BRC_FR_32_TxF6_0xDF_Rx_c0e3388d_6409b170: PduLength=24  # TL_BRC_FR_32_TxF6_0xDF
        PT_TL_BRC_FR_32_TxFC_0xDF_PP_TL_BRC_FR_32_TxFC_0xDF_Rx_c0e3388d_6409b170: PduLength=24  # TL_BRC_FR_32_TxFC_0xDF
        PT_TL_MST_GW_TRNSM_FR_254_00980001_TxFD_PP_TL_MST_GW_TRNSM_FR_254_00980001_TxFD_Rx_c0e3388d_6409b170: PduLength=65535  # TL_MST_GW_TRNSM_FR_254_00980001_TxFD
        PT_TL_MST_GW_TRNSM_FR_254_00980001_TxFC_PP_TL_MST_GW_TRNSM_FR_254_00980001_TxFC_Rx_c0e3388d_6409b170: PduLength=65535  # TL_MST_GW_TRNSM_FR_254_00980001_TxFC
        PT_TL_ECU_TRNSM_FR_32_00BC0001_RxF3_PP_TL_ECU_TRNSM_FR_32_00BC0001_RxF3_Tx_c0e3388d_6409b170: PduLength=65535  # TL_ECU_TRNSM_FR_32_00BC0001_RxF3
        PT_TL_MST_GW_TRNSM_FR_254_00980001_TxF1_PP_TL_MST_GW_TRNSM_FR_254_00980001_TxF1_Rx_c0e3388d_6409b170: PduLength=65535  # TL_MST_GW_TRNSM_FR_254_00980001_TxF1
        PT_TL_MST_GW_TRNSM_FR_254_00980001_TxF0_PP_TL_MST_GW_TRNSM_FR_254_00980001_TxF0_Rx_c0e3388d_6409b170: PduLength=65535  # TL_MST_GW_TRNSM_FR_254_00980001_TxF0
        PT_TL_BRC_FR_32_TxF7_0xDF_PP_TL_BRC_FR_32_TxF7_0xDF_Rx_c0e3388d_6409b170: PduLength=24  # TL_BRC_FR_32_TxF7_0xDF
        PT_TL_MST_GW_TRNSM_FR_254_00980001_TxF5_PP_TL_MST_GW_TRNSM_FR_254_00980001_TxF5_Rx_c0e3388d_6409b170: PduLength=65535  # TL_MST_GW_TRNSM_FR_254_00980001_TxF5
        PT_TL_MST_GW_TRNSM_FR_254_00980001_TxF4_PP_TL_MST_GW_TRNSM_FR_254_00980001_TxF4_Rx_c0e3388d_6409b170: PduLength=65535  # TL_MST_GW_TRNSM_FR_254_00980001_TxF4
        PT_TL_MST_GW_TRNSM_FR_254_00980001_TxF9_PP_TL_MST_GW_TRNSM_FR_254_00980001_TxF9_Rx_c0e3388d_6409b170: PduLength=65535  # TL_MST_GW_TRNSM_FR_254_00980001_TxF9
        PT_TL_MST_GW_TRNSM_FR_254_00980001_TxF8_PP_TL_MST_GW_TRNSM_FR_254_00980001_TxF8_Rx_c0e3388d_6409b170: PduLength=65535  # TL_MST_GW_TRNSM_FR_254_00980001_TxF8
        PT_TL_BRC_FR_32_TxF4_0xDF_PP_TL_BRC_FR_32_TxF4_0xDF_Rx_c0e3388d_6409b170: PduLength=24  # TL_BRC_FR_32_TxF4_0xDF
        PT_TL_BRC_FR_32_TxF1_0xDF_PP_TL_BRC_FR_32_TxF1_0xDF_Rx_c0e3388d_6409b170: PduLength=24  # TL_BRC_FR_32_TxF1_0xDF
        PT_TL_ECU_TRNSM_FR_32_00BC0001_RxF0_PP_TL_ECU_TRNSM_FR_32_00BC0001_RxF0_Tx_c0e3388d_6409b170: PduLength=65535  # TL_ECU_TRNSM_FR_32_00BC0001_RxF0
        PT_TL_ECU_TRNSM_FR_32_00BC0001_RxF7_PP_TL_ECU_TRNSM_FR_32_00BC0001_RxF7_Tx_c0e3388d_6409b170: PduLength=65535  # TL_ECU_TRNSM_FR_32_00BC0001_RxF7
        PT_TL_ECU_TRNSM_FR_32_00BC0001_RxFA_PP_TL_ECU_TRNSM_FR_32_00BC0001_RxFA_Tx_c0e3388d_6409b170: PduLength=65535  # TL_ECU_TRNSM_FR_32_00BC0001_RxFA
        PT_TL_BRC_FR_32_TxF2_0xDF_PP_TL_BRC_FR_32_TxF2_0xDF_Rx_c0e3388d_6409b170: PduLength=24  # TL_BRC_FR_32_TxF2_0xDF
        PT_TL_ECU_TRNSM_FR_32_00BC0001_RxF6_PP_TL_ECU_TRNSM_FR_32_00BC0001_RxF6_Tx_c0e3388d_6409b170: PduLength=65535  # TL_ECU_TRNSM_FR_32_00BC0001_RxF6
        PT_TL_ECU_TRNSM_FR_32_00BC0001_RxFC_PP_TL_ECU_TRNSM_FR_32_00BC0001_RxFC_Tx_c0e3388d_6409b170: PduLength=65535  # TL_ECU_TRNSM_FR_32_00BC0001_RxFC
        PT_TL_ECU_TRNSM_FR_32_00BC0001_RxF5_PP_TL_ECU_TRNSM_FR_32_00BC0001_RxF5_Tx_c0e3388d_6409b170: PduLength=65535  # TL_ECU_TRNSM_FR_32_00BC0001_RxF5
        PT_TL_BRC_FR_32_TxF9_0xDF_PP_TL_BRC_FR_32_TxF9_0xDF_Rx_c0e3388d_6409b170: PduLength=24  # TL_BRC_FR_32_TxF9_0xDF
        PT_TL_BRC_FR_32_TxFA_0xDF_PP_TL_BRC_FR_32_TxFA_0xDF_Rx_c0e3388d_6409b170: PduLength=24  # TL_BRC_FR_32_TxFA_0xDF
        PT_TL_ECU_TRNSM_FR_32_00BC0001_RxFD_PP_TL_ECU_TRNSM_FR_32_00BC0001_RxFD_Tx_c0e3388d_6409b170: PduLength=65535  # TL_ECU_TRNSM_FR_32_00BC0001_RxFD
        PT_TL_MST_GW_TRNSM_FR_254_00980001_TxFA_PP_TL_MST_GW_TRNSM_FR_254_00980001_TxFA_Rx_c0e3388d_6409b170: PduLength=65535  # TL_MST_GW_TRNSM_FR_254_00980001_TxFA
        PT_TL_MST_GW_TRNSM_FR_254_00980001_TxFB_PP_TL_MST_GW_TRNSM_FR_254_00980001_TxFB_Rx_c0e3388d_6409b170: PduLength=65535  # TL_MST_GW_TRNSM_FR_254_00980001_TxFB
        PT_TL_BRC_FR_32_TxF8_0xDF_PP_TL_BRC_FR_32_TxF8_0xDF_Rx_c0e3388d_6409b170: PduLength=24  # TL_BRC_FR_32_TxF8_0xDF
        PT_TL_BRC_FR_32_TxF3_0xDF_PP_TL_BRC_FR_32_TxF3_0xDF_Rx_c0e3388d_6409b170: PduLength=24  # TL_BRC_FR_32_TxF3_0xDF
        PT_TL_MST_GW_TRNSM_FR_254_00980001_TxF3_PP_TL_MST_GW_TRNSM_FR_254_00980001_TxF3_Rx_c0e3388d_6409b170: PduLength=65535  # TL_MST_GW_TRNSM_FR_254_00980001_TxF3
        PT_TL_MST_GW_TRNSM_FR_254_00980001_TxF7_PP_TL_MST_GW_TRNSM_FR_254_00980001_TxF7_Rx_c0e3388d_6409b170: PduLength=65535  # TL_MST_GW_TRNSM_FR_254_00980001_TxF7
        PT_TL_MST_GW_TRNSM_FR_254_00980001_TxF2_PP_TL_MST_GW_TRNSM_FR_254_00980001_TxF2_Rx_c0e3388d_6409b170: PduLength=65535  # TL_MST_GW_TRNSM_FR_254_00980001_TxF2
        PT_TL_MST_GW_TRNSM_FR_254_00980001_TxF6_PP_TL_MST_GW_TRNSM_FR_254_00980001_TxF6_Rx_c0e3388d_6409b170: PduLength=65535  # TL_MST_GW_TRNSM_FR_254_00980001_TxF6
        PT_TL_ECU_TRNSM_FR_32_00BC0001_RxF4_PP_TL_ECU_TRNSM_FR_32_00BC0001_RxF4_Tx_c0e3388d_6409b170: PduLength=65535  # TL_ECU_TRNSM_FR_32_00BC0001_RxF4
        PT_TL_BRC_FR_32_TxFB_0xDF_PP_TL_BRC_FR_32_TxFB_0xDF_Rx_c0e3388d_6409b170: PduLength=24  # TL_BRC_FR_32_TxFB_0xDF
        PT_TL_ECU_TRNSM_FR_32_00BC0001_RxFB_PP_TL_ECU_TRNSM_FR_32_00BC0001_RxFB_Tx_c0e3388d_6409b170: PduLength=65535  # TL_ECU_TRNSM_FR_32_00BC0001_RxFB
        PT_TL_ECU_TRNSM_FR_32_00BC0001_RxF8_PP_TL_ECU_TRNSM_FR_32_00BC0001_RxF8_Tx_c0e3388d_6409b170: PduLength=65535  # TL_ECU_TRNSM_FR_32_00BC0001_RxF8
        PT_TL_BRC_FR_32_TxFD_0xDF_PP_TL_BRC_FR_32_TxFD_0xDF_Rx_c0e3388d_6409b170: PduLength=24  # TL_BRC_FR_32_TxFD_0xDF
        PT_TL_ECU_TRNSM_FR_32_00BC0001_RxF1_PP_TL_ECU_TRNSM_FR_32_00BC0001_RxF1_Tx_c0e3388d_6409b170: PduLength=65535  # TL_ECU_TRNSM_FR_32_00BC0001_RxF1
        PT_TL_BRC_FR_32_TxF0_0xDF_PP_TL_BRC_FR_32_TxF0_0xDF_Rx_c0e3388d_6409b170: PduLength=24  # TL_BRC_FR_32_TxF0_0xDF
        PT_TL_BRC_FR_32_TxF5_0xDF_PP_TL_BRC_FR_32_TxF5_0xDF_Rx_c0e3388d_6409b170: PduLength=24  # TL_BRC_FR_32_TxF5_0xDF
    EcucGeneral: CPUType=CPU32Bit, SizeOfInt=Size32Bit, ByteOrder=LITTLE_ENDIAN, BitOrder=LSB_to_MSB
      PostbuildLoadable
      BswInitialization
        8 x InitFunction:
          Dcm_Init: Header=Dcm.h, InitPhase=INIT_TWO_POST_NVMREADALL, ConfigType=Dcm_ConfigType, ConfigPtrName=NULL_PTR, ConfigPtrClass=DCM_CONST, ModuleRef=Dcm
          Dcm_InitMemory: Header=Dcm.h, InitPhase=INIT_MEMORY, ModuleRef=Dcm
          FrIf_InitMemory: Header=FrIf.h, InitPhase=INIT_MEMORY, ModuleRef=FrIf
          FrIf_Init: Header=FrIf.h, InitPhase=INIT_TWO_IF, ConfigType=FrIf_ConfigType, ConfigPtrName=&FrIf_Config, ConfigPtrClass=FRIF_CONST, ModuleRef=FrIf
          FrTp_InitMemory: Header=FrTp.h, InitPhase=INIT_MEMORY, ModuleRef=FrTp
          FrTp_Init: Header=FrTp.h, InitPhase=INIT_TWO_TP, ConfigType=FrTp_ConfigType, ConfigPtrName=&FrTp_Config, ConfigPtrClass=FRTP_CONST, ModuleRef=FrTp
          PduR_Init: Header=PduR.h, InitPhase=INIT_TWO_COM, ConfigType=PduR_PBConfigType, ConfigPtrName=PduR_Config_Ptr, ConfigPtrClass=PDUR_INIT_DATA, ModuleRef=PduR
          PduR_InitMemory: Header=PduR.h, InitPhase=INIT_MEMORY, ModuleRef=PduR
  module config FrTp: implementation-config-variant=VARIANT-PRE-COMPILE, module-description=FrTp_Impl
    FrTpGeneral:
      FrTpAckRt = false
      FrTpChanNum = 1
      FrTpChangeParamApi = false
      FrTpDevErrorDetect = true
      FrTpFullDuplexEnable = true
      FrTpMainFuncCycle = 0.005
      FrTpTransmitCancellation = false
      FrTpUnknownMsgLength = false
      FrTpVersionInfoApi = false
      FrTpRxIndEarlierThanTxConf = false
      FrTpInstanceId = 0
      FrTpMultiPurposeTp = false
      FrTpRxChanNum = 28
      FrTpTxChanNum = 14
      FrTpRuntimeMeasurementSupport = false
      FrTpReceiveCancellation = false
    FrTpMultipleConfig
      4 x FrTpConnection, all with FrTpBandwidthLimitation=false, FrTpConCtrlRef=TPCC:
        TL_BRC_FR_32_TxF1_0xDFTN_0x00F1_241_TN_0x0039_41: FrTpLa=223, FrTpMultipleReceiverCon=true, FrTpRa=241, FrTpRxPduPoolRef=FrTpMultipleConfig/RxPduPool_TL_BRC_FR_32_Tp
          TL_BRC_FR_32_TxF1_0xDF (FrTpRxSdu): FrTpRxSduId=1, FrTpRxSduRef=EcucPduCollection/PT_TL_BRC_FR_32_TxF1_0xDF_PP_TL_BRC_FR_32_TxF1_0xDF_Rx_c0e3388d_6409b170
        TL_BRC_FR_32_TxF2_0xDFTN_0x00F2_242_TN_0x0039_41: FrTpLa=223, FrTpMultipleReceiverCon=true, FrTpRa=242, FrTpRxPduPoolRef=FrTpMultipleConfig/RxPduPool_TL_BRC_FR_32_Tp
          TL_BRC_FR_32_TxF2_0xDF (FrTpRxSdu): FrTpRxSduId=2, FrTpRxSduRef=EcucPduCollection/PT_TL_BRC_FR_32_TxF2_0xDF_PP_TL_BRC_FR_32_TxF2_0xDF_Rx_c0e3388d_6409b170
        TL_MST_GW_TRNSM_FR_254_00980001_TxF1TN_0x00F1_241_TN_0x0039_41: FrTpLa=41, FrTpMultipleReceiverCon=false, FrTpRa=241, FrTpRxPduPoolRef=FrTpMultipleConfig/RxPduPool_TL_MST_GW_TRNSM_FR_254_00980001_Tp, FrTpTxPduPoolRef=FrTpMultipleConfig/TxPduPool_TL_ECU_TRNSM_FR_32_00BC0001_Tp
          TL_MST_GW_TRNSM_FR_254_00980001_TxF1 (FrTpRxSdu):
            FrTpRxSduId = 15
            FrTpRxSduRef = EcucPduCollection/PT_TL_MST_GW_TRNSM_FR_254_00980001_TxF1_PP_TL_MST_GW_TRNSM_FR_254_00980001_TxF1_Rx_c0e3388d_6409b170
          TL_ECU_TRNSM_FR_32_00BC0001_RxF1 (FrTpTxSdu): FrTpTxSduId=1, FrTpTxSduRef=EcucPduCollection/PT_TL_ECU_TRNSM_FR_32_00BC0001_RxF1_PP_TL_ECU_TRNSM_FR_32_00BC0001_RxF1_Tx_c0e3388d_6409b170
        TL_MST_GW_TRNSM_FR_254_00980001_TxF0TN_0x00F0_240_TN_0x0039_41: FrTpLa=41, FrTpMultipleReceiverCon=false, FrTpRa=240, FrTpRxPduPoolRef=FrTpMultipleConfig/RxPduPool_TL_MST_GW_TRNSM_FR_254_00980001_Tp, FrTpTxPduPoolRef=FrTpMultipleConfig/TxPduPool_TL_ECU_TRNSM_FR_32_00BC0001_Tp
          TL_MST_GW_TRNSM_FR_254_00980001_TxF0 (FrTpRxSdu):
            FrTpRxSduId = 14
            FrTpRxSduRef = EcucPduCollection/PT_TL_MST_GW_TRNSM_FR_254_00980001_TxF0_PP_TL_MST_GW_TRNSM_FR_254_00980001_TxF0_Rx_c0e3388d_6409b170
          TL_ECU_TRNSM_FR_32_00BC0001_RxF0 (FrTpTxSdu): FrTpTxSduId=0, FrTpTxSduRef=EcucPduCollection/PT_TL_ECU_TRNSM_FR_32_00BC0001_RxF0_PP_TL_ECU_TRNSM_FR_32_00BC0001_RxF0_Tx_c0e3388d_6409b170
      TPCC (FrTpConnectionControl):
        FrTpAckType = FRTP_ACK_WITH_RT
        FrTpMaxAr = 2
        FrTpMaxAs = 2
        FrTpMaxBufferSize = 4096
        FrTpMaxNbrOfNPduPerCycle = 1
        FrTpMaxRn = 2
        FrTpTimeBr = 0.005
        FrTpTimeBuffer = 0
        FrTpTimeFrIf = 0
        FrTpTimeoutAr = 0.9
        FrTpTimeoutAs = 0.285
        FrTpTimeoutBs = 1
        FrTpTimeoutCr = 1.3
        FrTpMaxFCWait = 19
        FrTpMaxFrIf = 0
        FrTpSCexp = 0
        FrTpTimeCs = 0.005
      5 x FrTpConnection, all with FrTpBandwidthLimitation=false, FrTpConCtrlRef=TPCC:
        TL_BRC_FR_32_TxF0_0xDFTN_0x00F0_240_TN_0x0039_41: FrTpLa=223, FrTpMultipleReceiverCon=true, FrTpRa=240, FrTpRxPduPoolRef=FrTpMultipleConfig/RxPduPool_TL_BRC_FR_32_Tp
          TL_BRC_FR_32_TxF0_0xDF (FrTpRxSdu): FrTpRxSduId=0, FrTpRxSduRef=EcucPduCollection/PT_TL_BRC_FR_32_TxF0_0xDF_PP_TL_BRC_FR_32_TxF0_0xDF_Rx_c0e3388d_6409b170
        TL_MST_GW_TRNSM_FR_254_00980001_TxF3TN_0x00F3_243_TN_0x0039_41: FrTpLa=41, FrTpMultipleReceiverCon=false, FrTpRa=243, FrTpRxPduPoolRef=FrTpMultipleConfig/RxPduPool_TL_MST_GW_TRNSM_FR_254_00980001_Tp, FrTpTxPduPoolRef=FrTpMultipleConfig/TxPduPool_TL_ECU_TRNSM_FR_32_00BC0001_Tp
          TL_ECU_TRNSM_FR_32_00BC0001_RxF3 (FrTpTxSdu): FrTpTxSduId=3, FrTpTxSduRef=EcucPduCollection/PT_TL_ECU_TRNSM_FR_32_00BC0001_RxF3_PP_TL_ECU_TRNSM_FR_32_00BC0001_RxF3_Tx_c0e3388d_6409b170
          TL_MST_GW_TRNSM_FR_254_00980001_TxF3 (FrTpRxSdu):
            FrTpRxSduId = 17
            FrTpRxSduRef = EcucPduCollection/PT_TL_MST_GW_TRNSM_FR_254_00980001_TxF3_PP_TL_MST_GW_TRNSM_FR_254_00980001_TxF3_Rx_c0e3388d_6409b170
        TL_MST_GW_TRNSM_FR_254_00980001_TxF2TN_0x00F2_242_TN_0x0039_41: FrTpLa=41, FrTpMultipleReceiverCon=false, FrTpRa=242, FrTpRxPduPoolRef=FrTpMultipleConfig/RxPduPool_TL_MST_GW_TRNSM_FR_254_00980001_Tp, FrTpTxPduPoolRef=FrTpMultipleConfig/TxPduPool_TL_ECU_TRNSM_FR_32_00BC0001_Tp
          TL_MST_GW_TRNSM_FR_254_00980001_TxF2 (FrTpRxSdu):
            FrTpRxSduId = 16
            FrTpRxSduRef = EcucPduCollection/PT_TL_MST_GW_TRNSM_FR_254_00980001_TxF2_PP_TL_MST_GW_TRNSM_FR_254_00980001_TxF2_Rx_c0e3388d_6409b170
          TL_ECU_TRNSM_FR_32_00BC0001_RxF2 (FrTpTxSdu): FrTpTxSduId=2, FrTpTxSduRef=EcucPduCollection/PT_TL_ECU_TRNSM_FR_32_00BC0001_RxF2_PP_TL_ECU_TRNSM_FR_32_00BC0001_RxF2_Tx_c0e3388d_6409b170
        TL_MST_GW_TRNSM_FR_254_00980001_TxF4TN_0x00F4_244_TN_0x0039_41: FrTpLa=41, FrTpMultipleReceiverCon=false, FrTpRa=244, FrTpRxPduPoolRef=FrTpMultipleConfig/RxPduPool_TL_MST_GW_TRNSM_FR_254_00980001_Tp, FrTpTxPduPoolRef=FrTpMultipleConfig/TxPduPool_TL_ECU_TRNSM_FR_32_00BC0001_Tp
          TL_ECU_TRNSM_FR_32_00BC0001_RxF4 (FrTpTxSdu): FrTpTxSduId=4, FrTpTxSduRef=EcucPduCollection/PT_TL_ECU_TRNSM_FR_32_00BC0001_RxF4_PP_TL_ECU_TRNSM_FR_32_00BC0001_RxF4_Tx_c0e3388d_6409b170
          TL_MST_GW_TRNSM_FR_254_00980001_TxF4 (FrTpRxSdu):
            FrTpRxSduId = 18
            FrTpRxSduRef = EcucPduCollection/PT_TL_MST_GW_TRNSM_FR_254_00980001_TxF4_PP_TL_MST_GW_TRNSM_FR_254_00980001_TxF4_Rx_c0e3388d_6409b170
        TL_MST_GW_TRNSM_FR_254_00980001_TxF5TN_0x00F5_245_TN_0x0039_41: FrTpLa=41, FrTpMultipleReceiverCon=false, FrTpRa=245, FrTpRxPduPoolRef=FrTpMultipleConfig/RxPduPool_TL_MST_GW_TRNSM_FR_254_00980001_Tp, FrTpTxPduPoolRef=FrTpMultipleConfig/TxPduPool_TL_ECU_TRNSM_FR_32_00BC0001_Tp
          TL_ECU_TRNSM_FR_32_00BC0001_RxF5 (FrTpTxSdu): FrTpTxSduId=5, FrTpTxSduRef=EcucPduCollection/PT_TL_ECU_TRNSM_FR_32_00BC0001_RxF5_PP_TL_ECU_TRNSM_FR_32_00BC0001_RxF5_Tx_c0e3388d_6409b170
          TL_MST_GW_TRNSM_FR_254_00980001_TxF5 (FrTpRxSdu):
            FrTpRxSduId = 19
            FrTpRxSduRef = EcucPduCollection/PT_TL_MST_GW_TRNSM_FR_254_00980001_TxF5_PP_TL_MST_GW_TRNSM_FR_254_00980001_TxF5_Rx_c0e3388d_6409b170
      RxPduPool_TL_BRC_FR_32_Tp (FrTpRxPduPool)
        RxPduPool_TL_BRC_FR_32_Tp (FrTpRxPdu): FrTpRxPduId=0
      9 x FrTpConnection, all with FrTpBandwidthLimitation=false, FrTpConCtrlRef=TPCC:
        TL_MST_GW_TRNSM_FR_254_00980001_TxFDTN_0x00FD_253_TN_0x0039_41: FrTpLa=41, FrTpMultipleReceiverCon=false, FrTpRa=253, FrTpRxPduPoolRef=FrTpMultipleConfig/RxPduPool_TL_MST_GW_TRNSM_FR_254_00980001_Tp, FrTpTxPduPoolRef=FrTpMultipleConfig/TxPduPool_TL_ECU_TRNSM_FR_32_00BC0001_Tp
          TL_ECU_TRNSM_FR_32_00BC0001_RxFD (FrTpTxSdu): FrTpTxSduId=13, FrTpTxSduRef=EcucPduCollection/PT_TL_ECU_TRNSM_FR_32_00BC0001_RxFD_PP_TL_ECU_TRNSM_FR_32_00BC0001_RxFD_Tx_c0e3388d_6409b170
          TL_MST_GW_TRNSM_FR_254_00980001_TxFD (FrTpRxSdu):
            FrTpRxSduId = 27
            FrTpRxSduRef = EcucPduCollection/PT_TL_MST_GW_TRNSM_FR_254_00980001_TxFD_PP_TL_MST_GW_TRNSM_FR_254_00980001_TxFD_Rx_c0e3388d_6409b170
        TL_BRC_FR_32_TxFD_0xDFTN_0x00FD_253_TN_0x0039_41: FrTpLa=223, FrTpMultipleReceiverCon=true, FrTpRa=253, FrTpRxPduPoolRef=FrTpMultipleConfig/RxPduPool_TL_BRC_FR_32_Tp
          TL_BRC_FR_32_TxFD_0xDF (FrTpRxSdu): FrTpRxSduId=13, FrTpRxSduRef=EcucPduCollection/PT_TL_BRC_FR_32_TxFD_0xDF_PP_TL_BRC_FR_32_TxFD_0xDF_Rx_c0e3388d_6409b170
        TL_MST_GW_TRNSM_FR_254_00980001_TxFATN_0x00FA_250_TN_0x0039_41: FrTpLa=41, FrTpMultipleReceiverCon=false, FrTpRa=250, FrTpRxPduPoolRef=FrTpMultipleConfig/RxPduPool_TL_MST_GW_TRNSM_FR_254_00980001_Tp, FrTpTxPduPoolRef=FrTpMultipleConfig/TxPduPool_TL_ECU_TRNSM_FR_32_00BC0001_Tp
          TL_MST_GW_TRNSM_FR_254_00980001_TxFA (FrTpRxSdu):
            FrTpRxSduId = 24
            FrTpRxSduRef = EcucPduCollection/PT_TL_MST_GW_TRNSM_FR_254_00980001_TxFA_PP_TL_MST_GW_TRNSM_FR_254_00980001_TxFA_Rx_c0e3388d_6409b170
          TL_ECU_TRNSM_FR_32_00BC0001_RxFA (FrTpTxSdu): FrTpTxSduId=10, FrTpTxSduRef=EcucPduCollection/PT_TL_ECU_TRNSM_FR_32_00BC0001_RxFA_PP_TL_ECU_TRNSM_FR_32_00BC0001_RxFA_Tx_c0e3388d_6409b170
        TL_MST_GW_TRNSM_FR_254_00980001_TxFBTN_0x00FB_251_TN_0x0039_41: FrTpLa=41, FrTpMultipleReceiverCon=false, FrTpRa=251, FrTpRxPduPoolRef=FrTpMultipleConfig/RxPduPool_TL_MST_GW_TRNSM_FR_254_00980001_Tp, FrTpTxPduPoolRef=FrTpMultipleConfig/TxPduPool_TL_ECU_TRNSM_FR_32_00BC0001_Tp
          TL_MST_GW_TRNSM_FR_254_00980001_TxFB (FrTpRxSdu):
            FrTpRxSduId = 25
            FrTpRxSduRef = EcucPduCollection/PT_TL_MST_GW_TRNSM_FR_254_00980001_TxFB_PP_TL_MST_GW_TRNSM_FR_254_00980001_TxFB_Rx_c0e3388d_6409b170
          TL_ECU_TRNSM_FR_32_00BC0001_RxFB (FrTpTxSdu): FrTpTxSduId=11, FrTpTxSduRef=EcucPduCollection/PT_TL_ECU_TRNSM_FR_32_00BC0001_RxFB_PP_TL_ECU_TRNSM_FR_32_00BC0001_RxFB_Tx_c0e3388d_6409b170
        TL_MST_GW_TRNSM_FR_254_00980001_TxFCTN_0x00FC_252_TN_0x0039_41: FrTpLa=41, FrTpMultipleReceiverCon=false, FrTpRa=252, FrTpRxPduPoolRef=FrTpMultipleConfig/RxPduPool_TL_MST_GW_TRNSM_FR_254_00980001_Tp, FrTpTxPduPoolRef=FrTpMultipleConfig/TxPduPool_TL_ECU_TRNSM_FR_32_00BC0001_Tp
          TL_ECU_TRNSM_FR_32_00BC0001_RxFC (FrTpTxSdu): FrTpTxSduId=12, FrTpTxSduRef=EcucPduCollection/PT_TL_ECU_TRNSM_FR_32_00BC0001_RxFC_PP_TL_ECU_TRNSM_FR_32_00BC0001_RxFC_Tx_c0e3388d_6409b170
          TL_MST_GW_TRNSM_FR_254_00980001_TxFC (FrTpRxSdu):
            FrTpRxSduId = 26
            FrTpRxSduRef = EcucPduCollection/PT_TL_MST_GW_TRNSM_FR_254_00980001_TxFC_PP_TL_MST_GW_TRNSM_FR_254_00980001_TxFC_Rx_c0e3388d_6409b170
        TL_BRC_FR_32_TxFB_0xDFTN_0x00FB_251_TN_0x0039_41: FrTpLa=223, FrTpMultipleReceiverCon=true, FrTpRa=251, FrTpRxPduPoolRef=FrTpMultipleConfig/RxPduPool_TL_BRC_FR_32_Tp
          TL_BRC_FR_32_TxFB_0xDF (FrTpRxSdu): FrTpRxSduId=11, FrTpRxSduRef=EcucPduCollection/PT_TL_BRC_FR_32_TxFB_0xDF_PP_TL_BRC_FR_32_TxFB_0xDF_Rx_c0e3388d_6409b170
        TL_BRC_FR_32_TxFA_0xDFTN_0x00FA_250_TN_0x0039_41: FrTpLa=223, FrTpMultipleReceiverCon=true, FrTpRa=250, FrTpRxPduPoolRef=FrTpMultipleConfig/RxPduPool_TL_BRC_FR_32_Tp
          TL_BRC_FR_32_TxFA_0xDF (FrTpRxSdu): FrTpRxSduId=10, FrTpRxSduRef=EcucPduCollection/PT_TL_BRC_FR_32_TxFA_0xDF_PP_TL_BRC_FR_32_TxFA_0xDF_Rx_c0e3388d_6409b170
        TL_BRC_FR_32_TxFC_0xDFTN_0x00FC_252_TN_0x0039_41: FrTpLa=223, FrTpMultipleReceiverCon=true, FrTpRa=252, FrTpRxPduPoolRef=FrTpMultipleConfig/RxPduPool_TL_BRC_FR_32_Tp
          TL_BRC_FR_32_TxFC_0xDF (FrTpRxSdu): FrTpRxSduId=12, FrTpRxSduRef=EcucPduCollection/PT_TL_BRC_FR_32_TxFC_0xDF_PP_TL_BRC_FR_32_TxFC_0xDF_Rx_c0e3388d_6409b170
        TL_MST_GW_TRNSM_FR_254_00980001_TxF8TN_0x00F8_248_TN_0x0039_41: FrTpLa=41, FrTpMultipleReceiverCon=false, FrTpRa=248, FrTpRxPduPoolRef=FrTpMultipleConfig/RxPduPool_TL_MST_GW_TRNSM_FR_254_00980001_Tp, FrTpTxPduPoolRef=FrTpMultipleConfig/TxPduPool_TL_ECU_TRNSM_FR_32_00BC0001_Tp
          TL_ECU_TRNSM_FR_32_00BC0001_RxF8 (FrTpTxSdu): FrTpTxSduId=8, FrTpTxSduRef=EcucPduCollection/PT_TL_ECU_TRNSM_FR_32_00BC0001_RxF8_PP_TL_ECU_TRNSM_FR_32_00BC0001_RxF8_Tx_c0e3388d_6409b170
          TL_MST_GW_TRNSM_FR_254_00980001_TxF8 (FrTpRxSdu):
            FrTpRxSduId = 22
            FrTpRxSduRef = EcucPduCollection/PT_TL_MST_GW_TRNSM_FR_254_00980001_TxF8_PP_TL_MST_GW_TRNSM_FR_254_00980001_TxF8_Rx_c0e3388d_6409b170
      TxPduPool_TL_ECU_TRNSM_FR_32_00BC0001_Tp (FrTpTxPduPool)
        TxPduPool_TL_ECU_TRNSM_FR_32_00BC0001_Tp (FrTpTxPdu): FrTpTxConfirmationPduId=0
      TL_BRC_FR_32_TxF9_0xDFTN_0x00F9_249_TN_0x0039_41 (FrTpConnection):
        FrTpBandwidthLimitation = false
        FrTpLa = 223
        FrTpMultipleReceiverCon = true
        FrTpRa = 249
        FrTpConCtrlRef = TPCC
        FrTpRxPduPoolRef = FrTpMultipleConfig/RxPduPool_TL_BRC_FR_32_Tp
        TL_BRC_FR_32_TxF9_0xDF (FrTpRxSdu): FrTpRxSduId=9, FrTpRxSduRef=EcucPduCollection/PT_TL_BRC_FR_32_TxF9_0xDF_PP_TL_BRC_FR_32_TxF9_0xDF_Rx_c0e3388d_6409b170
      TL_MST_GW_TRNSM_FR_254_00980001_TxF9TN_0x00F9_249_TN_0x0039_41 (FrTpConnection):
        FrTpBandwidthLimitation = false
        FrTpLa = 41
        FrTpMultipleReceiverCon = false
        FrTpRa = 249
        FrTpConCtrlRef = TPCC
        FrTpRxPduPoolRef = FrTpMultipleConfig/RxPduPool_TL_MST_GW_TRNSM_FR_254_00980001_Tp
        FrTpTxPduPoolRef = FrTpMultipleConfig/TxPduPool_TL_ECU_TRNSM_FR_32_00BC0001_Tp
        TL_MST_GW_TRNSM_FR_254_00980001_TxF9 (FrTpRxSdu):
          FrTpRxSduId = 23
          FrTpRxSduRef = EcucPduCollection/PT_TL_MST_GW_TRNSM_FR_254_00980001_TxF9_PP_TL_MST_GW_TRNSM_FR_254_00980001_TxF9_Rx_c0e3388d_6409b170
        TL_ECU_TRNSM_FR_32_00BC0001_RxF9 (FrTpTxSdu): FrTpTxSduId=9, FrTpTxSduRef=EcucPduCollection/PT_TL_ECU_TRNSM_FR_32_00BC0001_RxF9_PP_TL_ECU_TRNSM_FR_32_00BC0001_RxF9_Tx_c0e3388d_6409b170
      RxPduPool_TL_MST_GW_TRNSM_FR_254_00980001_Tp (FrTpRxPduPool)
        RxPduPool_TL_MST_GW_TRNSM_FR_254_00980001_Tp (FrTpRxPdu): FrTpRxPduId=1
      8 x FrTpConnection, all with FrTpBandwidthLimitation=false, FrTpConCtrlRef=TPCC:
        TL_MST_GW_TRNSM_FR_254_00980001_TxF6TN_0x00F6_246_TN_0x0039_41: FrTpLa=41, FrTpMultipleReceiverCon=false, FrTpRa=246, FrTpRxPduPoolRef=FrTpMultipleConfig/RxPduPool_TL_MST_GW_TRNSM_FR_254_00980001_Tp, FrTpTxPduPoolRef=FrTpMultipleConfig/TxPduPool_TL_ECU_TRNSM_FR_32_00BC0001_Tp
          TL_ECU_TRNSM_FR_32_00BC0001_RxF6 (FrTpTxSdu): FrTpTxSduId=6, FrTpTxSduRef=EcucPduCollection/PT_TL_ECU_TRNSM_FR_32_00BC0001_RxF6_PP_TL_ECU_TRNSM_FR_32_00BC0001_RxF6_Tx_c0e3388d_6409b170
          TL_MST_GW_TRNSM_FR_254_00980001_TxF6 (FrTpRxSdu):
            FrTpRxSduId = 20
            FrTpRxSduRef = EcucPduCollection/PT_TL_MST_GW_TRNSM_FR_254_00980001_TxF6_PP_TL_MST_GW_TRNSM_FR_254_00980001_TxF6_Rx_c0e3388d_6409b170
        TL_MST_GW_TRNSM_FR_254_00980001_TxF7TN_0x00F7_247_TN_0x0039_41: FrTpLa=41, FrTpMultipleReceiverCon=false, FrTpRa=247, FrTpRxPduPoolRef=FrTpMultipleConfig/RxPduPool_TL_MST_GW_TRNSM_FR_254_00980001_Tp, FrTpTxPduPoolRef=FrTpMultipleConfig/TxPduPool_TL_ECU_TRNSM_FR_32_00BC0001_Tp
          TL_ECU_TRNSM_FR_32_00BC0001_RxF7 (FrTpTxSdu): FrTpTxSduId=7, FrTpTxSduRef=EcucPduCollection/PT_TL_ECU_TRNSM_FR_32_00BC0001_RxF7_PP_TL_ECU_TRNSM_FR_32_00BC0001_RxF7_Tx_c0e3388d_6409b170
          TL_MST_GW_TRNSM_FR_254_00980001_TxF7 (FrTpRxSdu):
            FrTpRxSduId = 21
            FrTpRxSduRef = EcucPduCollection/PT_TL_MST_GW_TRNSM_FR_254_00980001_TxF7_PP_TL_MST_GW_TRNSM_FR_254_00980001_TxF7_Rx_c0e3388d_6409b170
        TL_BRC_FR_32_TxF7_0xDFTN_0x00F7_247_TN_0x0039_41: FrTpLa=223, FrTpMultipleReceiverCon=true, FrTpRa=247, FrTpRxPduPoolRef=FrTpMultipleConfig/RxPduPool_TL_BRC_FR_32_Tp
          TL_BRC_FR_32_TxF7_0xDF (FrTpRxSdu): FrTpRxSduId=7, FrTpRxSduRef=EcucPduCollection/PT_TL_BRC_FR_32_TxF7_0xDF_PP_TL_BRC_FR_32_TxF7_0xDF_Rx_c0e3388d_6409b170
        TL_BRC_FR_32_TxF6_0xDFTN_0x00F6_246_TN_0x0039_41: FrTpLa=223, FrTpMultipleReceiverCon=true, FrTpRa=246, FrTpRxPduPoolRef=FrTpMultipleConfig/RxPduPool_TL_BRC_FR_32_Tp
          TL_BRC_FR_32_TxF6_0xDF (FrTpRxSdu): FrTpRxSduId=6, FrTpRxSduRef=EcucPduCollection/PT_TL_BRC_FR_32_TxF6_0xDF_PP_TL_BRC_FR_32_TxF6_0xDF_Rx_c0e3388d_6409b170
        TL_BRC_FR_32_TxF8_0xDFTN_0x00F8_248_TN_0x0039_41: FrTpLa=223, FrTpMultipleReceiverCon=true, FrTpRa=248, FrTpRxPduPoolRef=FrTpMultipleConfig/RxPduPool_TL_BRC_FR_32_Tp
          TL_BRC_FR_32_TxF8_0xDF (FrTpRxSdu): FrTpRxSduId=8, FrTpRxSduRef=EcucPduCollection/PT_TL_BRC_FR_32_TxF8_0xDF_PP_TL_BRC_FR_32_TxF8_0xDF_Rx_c0e3388d_6409b170
        TL_BRC_FR_32_TxF4_0xDFTN_0x00F4_244_TN_0x0039_41: FrTpLa=223, FrTpMultipleReceiverCon=true, FrTpRa=244, FrTpRxPduPoolRef=FrTpMultipleConfig/RxPduPool_TL_BRC_FR_32_Tp
          TL_BRC_FR_32_TxF4_0xDF (FrTpRxSdu): FrTpRxSduId=4, FrTpRxSduRef=EcucPduCollection/PT_TL_BRC_FR_32_TxF4_0xDF_PP_TL_BRC_FR_32_TxF4_0xDF_Rx_c0e3388d_6409b170
        TL_BRC_FR_32_TxF3_0xDFTN_0x00F3_243_TN_0x0039_41: FrTpLa=223, FrTpMultipleReceiverCon=true, FrTpRa=243, FrTpRxPduPoolRef=FrTpMultipleConfig/RxPduPool_TL_BRC_FR_32_Tp
          TL_BRC_FR_32_TxF3_0xDF (FrTpRxSdu): FrTpRxSduId=3, FrTpRxSduRef=EcucPduCollection/PT_TL_BRC_FR_32_TxF3_0xDF_PP_TL_BRC_FR_32_TxF3_0xDF_Rx_c0e3388d_6409b170
        TL_BRC_FR_32_TxF5_0xDFTN_0x00F5_245_TN_0x0039_41: FrTpLa=223, FrTpMultipleReceiverCon=true, FrTpRa=245, FrTpRxPduPoolRef=FrTpMultipleConfig/RxPduPool_TL_BRC_FR_32_Tp
          TL_BRC_FR_32_TxF5_0xDF (FrTpRxSdu): FrTpRxSduId=5, FrTpRxSduRef=EcucPduCollection/PT_TL_BRC_FR_32_TxF5_0xDF_PP_TL_BRC_FR_32_TxF5_0xDF_Rx_c0e3388d_6409b170
  module config PduR: implementation-config-variant=VARIANT-PRE-COMPILE, module-description=PduR_Impl
    PduRGeneral: PduRDevErrorDetect=true, PduRVersionInfoApi=false, PduRMetaDataSupport=false, PduRPduCallback=false
      PduRGeneration:
        PduROutOfBoundsWriteProtectionStrategy = NONE
        PduROutOfBoundsWriteSanitizer = false
        PduROutOfBoundsReadSanitizer = false
        PduRNumericalDataTypeMinimizationStrategy = WITH_CAST
        PduRReduceConstantData2Define = false
        PduRBoolDataInArrayOfStructStrategy = BITMASKING
        PduRDeduplicateIndirectedData = true
        PduRDataDeduplicationStrategy = WITH_CAST
        PduRReduceBoolDataByNegationThreshold = 2
        PduRReduceBoolDataByNumericalComparisonThreshold = 2
        PduRReduceBoolDataByNumericalRelationThreshold = 2
        PduRReduceBoolDataByNumericalOperandStrategy = WITH_ANY_VALUE
        PduRReduceNumericalDataByOffsetThreshold = 2
        PduRReduceNumericalDataByArraySubtractionThreshold = 2
        PduRReduceDataByStreaming = false
        PduRShortSymbols = false
        PduRInterfacesForDeactivatedData = false
        PduRReferringKeysInComments = false
    PduRRoutingTables: PduRConfigurationId=0
      PduRRoutingTable
        42 x PduRRoutingPath, all with PduRRoutingPathCommunicationType=TRANSPORT_PROTOCOL:
          PduRRoutingPath
            PduRDestPdu:
              PduRDestPduDirection = RECEIVE
              PduRDestPduRoutingType = API_FORWARDING
              PduRDestPduRef = EcucPduCollection/PT_TL_BRC_FR_32_TxF0_0xDF_PP_TL_BRC_FR_32_TxF0_0xDF_Rx_c0e3388d_6409b170
              PduRDestPduPduRBswModulesRef = Dcm
            PduRSrcPdu:
              PduRSrcPduDirection = RECEIVE
              PduRSrcPduRef = EcucPduCollection/PT_TL_BRC_FR_32_TxF0_0xDF_PP_TL_BRC_FR_32_TxF0_0xDF_Rx_c0e3388d_6409b170
              PduRSrcPduPduRBswModulesRef = FrTp
          PduRRoutingPath_001
            PduRDestPdu_1 (PduRDestPdu):
              PduRDestPduDirection = RECEIVE
              PduRDestPduRoutingType = API_FORWARDING
              PduRDestPduRef = EcucPduCollection/PT_TL_BRC_FR_32_TxF1_0xDF_PP_TL_BRC_FR_32_TxF1_0xDF_Rx_c0e3388d_6409b170
              PduRDestPduPduRBswModulesRef = Dcm
            PduRSrcPdu_1 (PduRSrcPdu):
              PduRSrcPduDirection = RECEIVE
              PduRSrcPduRef = EcucPduCollection/PT_TL_BRC_FR_32_TxF1_0xDF_PP_TL_BRC_FR_32_TxF1_0xDF_Rx_c0e3388d_6409b170
              PduRSrcPduPduRBswModulesRef = FrTp
          PduRRoutingPath_002
            PduRDestPdu_2 (PduRDestPdu):
              PduRDestPduDirection = RECEIVE
              PduRDestPduRoutingType = API_FORWARDING
              PduRDestPduRef = EcucPduCollection/PT_TL_BRC_FR_32_TxF2_0xDF_PP_TL_BRC_FR_32_TxF2_0xDF_Rx_c0e3388d_6409b170
              PduRDestPduPduRBswModulesRef = Dcm
            PduRSrcPdu_2 (PduRSrcPdu):
              PduRSrcPduDirection = RECEIVE
              PduRSrcPduRef = EcucPduCollection/PT_TL_BRC_FR_32_TxF2_0xDF_PP_TL_BRC_FR_32_TxF2_0xDF_Rx_c0e3388d_6409b170
              PduRSrcPduPduRBswModulesRef = FrTp
          PduRRoutingPath_003
            PduRDestPdu_3 (PduRDestPdu):
              PduRDestPduDirection = RECEIVE
              PduRDestPduRoutingType = API_FORWARDING
              PduRDestPduRef = EcucPduCollection/PT_TL_BRC_FR_32_TxF3_0xDF_PP_TL_BRC_FR_32_TxF3_0xDF_Rx_c0e3388d_6409b170
              PduRDestPduPduRBswModulesRef = Dcm
            PduRSrcPdu_3 (PduRSrcPdu):
              PduRSrcPduDirection = RECEIVE
              PduRSrcPduRef = EcucPduCollection/PT_TL_BRC_FR_32_TxF3_0xDF_PP_TL_BRC_FR_32_TxF3_0xDF_Rx_c0e3388d_6409b170
              PduRSrcPduPduRBswModulesRef = FrTp
          PduRRoutingPath_004
            PduRDestPdu_4 (PduRDestPdu):
              PduRDestPduDirection = RECEIVE
              PduRDestPduRoutingType = API_FORWARDING
              PduRDestPduRef = EcucPduCollection/PT_TL_BRC_FR_32_TxF4_0xDF_PP_TL_BRC_FR_32_TxF4_0xDF_Rx_c0e3388d_6409b170
              PduRDestPduPduRBswModulesRef = Dcm
            PduRSrcPdu_4 (PduRSrcPdu):
              PduRSrcPduDirection = RECEIVE
              PduRSrcPduRef = EcucPduCollection/PT_TL_BRC_FR_32_TxF4_0xDF_PP_TL_BRC_FR_32_TxF4_0xDF_Rx_c0e3388d_6409b170
              PduRSrcPduPduRBswModulesRef = FrTp
          PduRRoutingPath_005
            PduRDestPdu_5 (PduRDestPdu):
              PduRDestPduDirection = RECEIVE
              PduRDestPduRoutingType = API_FORWARDING
              PduRDestPduRef = EcucPduCollection/PT_TL_BRC_FR_32_TxF5_0xDF_PP_TL_BRC_FR_32_TxF5_0xDF_Rx_c0e3388d_6409b170
              PduRDestPduPduRBswModulesRef = Dcm
            PduRSrcPdu_5 (PduRSrcPdu):
              PduRSrcPduDirection = RECEIVE
              PduRSrcPduRef = EcucPduCollection/PT_TL_BRC_FR_32_TxF5_0xDF_PP_TL_BRC_FR_32_TxF5_0xDF_Rx_c0e3388d_6409b170
              PduRSrcPduPduRBswModulesRef = FrTp
          PduRRoutingPath_006
            PduRDestPdu_6 (PduRDestPdu):
              PduRDestPduDirection = RECEIVE
              PduRDestPduRoutingType = API_FORWARDING
              PduRDestPduRef = EcucPduCollection/PT_TL_BRC_FR_32_TxF6_0xDF_PP_TL_BRC_FR_32_TxF6_0xDF_Rx_c0e3388d_6409b170
              PduRDestPduPduRBswModulesRef = Dcm
            PduRSrcPdu_6 (PduRSrcPdu):
              PduRSrcPduDirection = RECEIVE
              PduRSrcPduRef = EcucPduCollection/PT_TL_BRC_FR_32_TxF6_0xDF_PP_TL_BRC_FR_32_TxF6_0xDF_Rx_c0e3388d_6409b170
              PduRSrcPduPduRBswModulesRef = FrTp
          PduRRoutingPath_007
            PduRDestPdu_7 (PduRDestPdu):
              PduRDestPduDirection = RECEIVE
              PduRDestPduRoutingType = API_FORWARDING
              PduRDestPduRef = EcucPduCollection/PT_TL_BRC_FR_32_TxF7_0xDF_PP_TL_BRC_FR_32_TxF7_0xDF_Rx_c0e3388d_6409b170
              PduRDestPduPduRBswModulesRef = Dcm
            PduRSrcPdu_7 (PduRSrcPdu):
              PduRSrcPduDirection = RECEIVE
              PduRSrcPduRef = EcucPduCollection/PT_TL_BRC_FR_32_TxF7_0xDF_PP_TL_BRC_FR_32_TxF7_0xDF_Rx_c0e3388d_6409b170
              PduRSrcPduPduRBswModulesRef = FrTp
          PduRRoutingPath_008
            PduRDestPdu_8 (PduRDestPdu):
              PduRDestPduDirection = RECEIVE
              PduRDestPduRoutingType = API_FORWARDING
              PduRDestPduRef = EcucPduCollection/PT_TL_BRC_FR_32_TxF8_0xDF_PP_TL_BRC_FR_32_TxF8_0xDF_Rx_c0e3388d_6409b170
              PduRDestPduPduRBswModulesRef = Dcm
            PduRSrcPdu_8 (PduRSrcPdu):
              PduRSrcPduDirection = RECEIVE
              PduRSrcPduRef = EcucPduCollection/PT_TL_BRC_FR_32_TxF8_0xDF_PP_TL_BRC_FR_32_TxF8_0xDF_Rx_c0e3388d_6409b170
              PduRSrcPduPduRBswModulesRef = FrTp
          PduRRoutingPath_009
            PduRDestPdu_9 (PduRDestPdu):
              PduRDestPduDirection = RECEIVE
              PduRDestPduRoutingType = API_FORWARDING
              PduRDestPduRef = EcucPduCollection/PT_TL_BRC_FR_32_TxF9_0xDF_PP_TL_BRC_FR_32_TxF9_0xDF_Rx_c0e3388d_6409b170
              PduRDestPduPduRBswModulesRef = Dcm
            PduRSrcPdu_9 (PduRSrcPdu):
              PduRSrcPduDirection = RECEIVE
              PduRSrcPduRef = EcucPduCollection/PT_TL_BRC_FR_32_TxF9_0xDF_PP_TL_BRC_FR_32_TxF9_0xDF_Rx_c0e3388d_6409b170
              PduRSrcPduPduRBswModulesRef = FrTp
          PduRRoutingPath_010
            PduRDestPdu_10 (PduRDestPdu):
              PduRDestPduDirection = RECEIVE
              PduRDestPduRoutingType = API_FORWARDING
              PduRDestPduRef = EcucPduCollection/PT_TL_BRC_FR_32_TxFA_0xDF_PP_TL_BRC_FR_32_TxFA_0xDF_Rx_c0e3388d_6409b170
              PduRDestPduPduRBswModulesRef = Dcm
            PduRSrcPdu_10 (PduRSrcPdu):
              PduRSrcPduDirection = RECEIVE
              PduRSrcPduRef = EcucPduCollection/PT_TL_BRC_FR_32_TxFA_0xDF_PP_TL_BRC_FR_32_TxFA_0xDF_Rx_c0e3388d_6409b170
              PduRSrcPduPduRBswModulesRef = FrTp
          PduRRoutingPath_011
            PduRDestPdu_11 (PduRDestPdu):
              PduRDestPduDirection = RECEIVE
              PduRDestPduRoutingType = API_FORWARDING
              PduRDestPduRef = EcucPduCollection/PT_TL_BRC_FR_32_TxFB_0xDF_PP_TL_BRC_FR_32_TxFB_0xDF_Rx_c0e3388d_6409b170
              PduRDestPduPduRBswModulesRef = Dcm
            PduRSrcPdu_11 (PduRSrcPdu):
              PduRSrcPduDirection = RECEIVE
              PduRSrcPduRef = EcucPduCollection/PT_TL_BRC_FR_32_TxFB_0xDF_PP_TL_BRC_FR_32_TxFB_0xDF_Rx_c0e3388d_6409b170
              PduRSrcPduPduRBswModulesRef = FrTp
          PduRRoutingPath_012
            PduRDestPdu_12 (PduRDestPdu):
              PduRDestPduDirection = RECEIVE
              PduRDestPduRoutingType = API_FORWARDING
              PduRDestPduRef = EcucPduCollection/PT_TL_BRC_FR_32_TxFC_0xDF_PP_TL_BRC_FR_32_TxFC_0xDF_Rx_c0e3388d_6409b170
              PduRDestPduPduRBswModulesRef = Dcm
            PduRSrcPdu_12 (PduRSrcPdu):
              PduRSrcPduDirection = RECEIVE
              PduRSrcPduRef = EcucPduCollection/PT_TL_BRC_FR_32_TxFC_0xDF_PP_TL_BRC_FR_32_TxFC_0xDF_Rx_c0e3388d_6409b170
              PduRSrcPduPduRBswModulesRef = FrTp
          PduRRoutingPath_013
            PduRDestPdu_13 (PduRDestPdu):
              PduRDestPduDirection = RECEIVE
              PduRDestPduRoutingType = API_FORWARDING
              PduRDestPduRef = EcucPduCollection/PT_TL_BRC_FR_32_TxFD_0xDF_PP_TL_BRC_FR_32_TxFD_0xDF_Rx_c0e3388d_6409b170
              PduRDestPduPduRBswModulesRef = Dcm
            PduRSrcPdu_13 (PduRSrcPdu):
              PduRSrcPduDirection = RECEIVE
              PduRSrcPduRef = EcucPduCollection/PT_TL_BRC_FR_32_TxFD_0xDF_PP_TL_BRC_FR_32_TxFD_0xDF_Rx_c0e3388d_6409b170
              PduRSrcPduPduRBswModulesRef = FrTp
          PduRRoutingPath_014
            PduRDestPdu_14 (PduRDestPdu):
              PduRDestPduDirection = TRANSMIT
              PduRDestPduRoutingType = API_FORWARDING
              PduRDestPduRef = EcucPduCollection/PT_TL_ECU_TRNSM_FR_32_00BC0001_RxF0_PP_TL_ECU_TRNSM_FR_32_00BC0001_RxF0_Tx_c0e3388d_6409b170
              PduRDestPduPduRBswModulesRef = FrTp
            PduRSrcPdu_14 (PduRSrcPdu):
              PduRSrcPduDirection = TRANSMIT
              PduRSrcPduRef = EcucPduCollection/PT_TL_ECU_TRNSM_FR_32_00BC0001_RxF0_PP_TL_ECU_TRNSM_FR_32_00BC0001_RxF0_Tx_c0e3388d_6409b170
              PduRSrcPduPduRBswModulesRef = Dcm
          PduRRoutingPath_015
            PduRDestPdu_15 (PduRDestPdu):
              PduRDestPduDirection = TRANSMIT
              PduRDestPduRoutingType = API_FORWARDING
              PduRDestPduRef = EcucPduCollection/PT_TL_ECU_TRNSM_FR_32_00BC0001_RxF1_PP_TL_ECU_TRNSM_FR_32_00BC0001_RxF1_Tx_c0e3388d_6409b170
              PduRDestPduPduRBswModulesRef = FrTp
            PduRSrcPdu_15 (PduRSrcPdu):
              PduRSrcPduDirection = TRANSMIT
              PduRSrcPduRef = EcucPduCollection/PT_TL_ECU_TRNSM_FR_32_00BC0001_RxF1_PP_TL_ECU_TRNSM_FR_32_00BC0001_RxF1_Tx_c0e3388d_6409b170
              PduRSrcPduPduRBswModulesRef = Dcm
          PduRRoutingPath_016
            PduRDestPdu_16 (PduRDestPdu):
              PduRDestPduDirection = TRANSMIT
              PduRDestPduRoutingType = API_FORWARDING
              PduRDestPduRef = EcucPduCollection/PT_TL_ECU_TRNSM_FR_32_00BC0001_RxF2_PP_TL_ECU_TRNSM_FR_32_00BC0001_RxF2_Tx_c0e3388d_6409b170
              PduRDestPduPduRBswModulesRef = FrTp
            PduRSrcPdu_16 (PduRSrcPdu):
              PduRSrcPduDirection = TRANSMIT
              PduRSrcPduRef = EcucPduCollection/PT_TL_ECU_TRNSM_FR_32_00BC0001_RxF2_PP_TL_ECU_TRNSM_FR_32_00BC0001_RxF2_Tx_c0e3388d_6409b170
              PduRSrcPduPduRBswModulesRef = Dcm
          PduRRoutingPath_017
            PduRDestPdu_17 (PduRDestPdu):
              PduRDestPduDirection = TRANSMIT
              PduRDestPduRoutingType = API_FORWARDING
              PduRDestPduRef = EcucPduCollection/PT_TL_ECU_TRNSM_FR_32_00BC0001_RxF3_PP_TL_ECU_TRNSM_FR_32_00BC0001_RxF3_Tx_c0e3388d_6409b170
              PduRDestPduPduRBswModulesRef = FrTp
            PduRSrcPdu_17 (PduRSrcPdu):
              PduRSrcPduDirection = TRANSMIT
              PduRSrcPduRef = EcucPduCollection/PT_TL_ECU_TRNSM_FR_32_00BC0001_RxF3_PP_TL_ECU_TRNSM_FR_32_00BC0001_RxF3_Tx_c0e3388d_6409b170
              PduRSrcPduPduRBswModulesRef = Dcm
          PduRRoutingPath_018
            PduRDestPdu_18 (PduRDestPdu):
              PduRDestPduDirection = TRANSMIT
              PduRDestPduRoutingType = API_FORWARDING
              PduRDestPduRef = EcucPduCollection/PT_TL_ECU_TRNSM_FR_32_00BC0001_RxF4_PP_TL_ECU_TRNSM_FR_32_00BC0001_RxF4_Tx_c0e3388d_6409b170
              PduRDestPduPduRBswModulesRef = FrTp
            PduRSrcPdu_18 (PduRSrcPdu):
              PduRSrcPduDirection = TRANSMIT
              PduRSrcPduRef = EcucPduCollection/PT_TL_ECU_TRNSM_FR_32_00BC0001_RxF4_PP_TL_ECU_TRNSM_FR_32_00BC0001_RxF4_Tx_c0e3388d_6409b170
              PduRSrcPduPduRBswModulesRef = Dcm
          PduRRoutingPath_019
            PduRDestPdu_19 (PduRDestPdu):
              PduRDestPduDirection = TRANSMIT
              PduRDestPduRoutingType = API_FORWARDING
              PduRDestPduRef = EcucPduCollection/PT_TL_ECU_TRNSM_FR_32_00BC0001_RxF5_PP_TL_ECU_TRNSM_FR_32_00BC0001_RxF5_Tx_c0e3388d_6409b170
              PduRDestPduPduRBswModulesRef = FrTp
            PduRSrcPdu_19 (PduRSrcPdu):
              PduRSrcPduDirection = TRANSMIT
              PduRSrcPduRef = EcucPduCollection/PT_TL_ECU_TRNSM_FR_32_00BC0001_RxF5_PP_TL_ECU_TRNSM_FR_32_00BC0001_RxF5_Tx_c0e3388d_6409b170
              PduRSrcPduPduRBswModulesRef = Dcm
          PduRRoutingPath_020
            PduRDestPdu_20 (PduRDestPdu):
              PduRDestPduDirection = TRANSMIT
              PduRDestPduRoutingType = API_FORWARDING
              PduRDestPduRef = EcucPduCollection/PT_TL_ECU_TRNSM_FR_32_00BC0001_RxF6_PP_TL_ECU_TRNSM_FR_32_00BC0001_RxF6_Tx_c0e3388d_6409b170
              PduRDestPduPduRBswModulesRef = FrTp
            PduRSrcPdu_20 (PduRSrcPdu):
              PduRSrcPduDirection = TRANSMIT
              PduRSrcPduRef = EcucPduCollection/PT_TL_ECU_TRNSM_FR_32_00BC0001_RxF6_PP_TL_ECU_TRNSM_FR_32_00BC0001_RxF6_Tx_c0e3388d_6409b170
              PduRSrcPduPduRBswModulesRef = Dcm
          PduRRoutingPath_021
            PduRDestPdu_21 (PduRDestPdu):
              PduRDestPduDirection = TRANSMIT
              PduRDestPduRoutingType = API_FORWARDING
              PduRDestPduRef = EcucPduCollection/PT_TL_ECU_TRNSM_FR_32_00BC0001_RxF7_PP_TL_ECU_TRNSM_FR_32_00BC0001_RxF7_Tx_c0e3388d_6409b170
              PduRDestPduPduRBswModulesRef = FrTp
            PduRSrcPdu_21 (PduRSrcPdu):
              PduRSrcPduDirection = TRANSMIT
              PduRSrcPduRef = EcucPduCollection/PT_TL_ECU_TRNSM_FR_32_00BC0001_RxF7_PP_TL_ECU_TRNSM_FR_32_00BC0001_RxF7_Tx_c0e3388d_6409b170
              PduRSrcPduPduRBswModulesRef = Dcm
          PduRRoutingPath_022
            PduRDestPdu_22 (PduRDestPdu):
              PduRDestPduDirection = TRANSMIT
              PduRDestPduRoutingType = API_FORWARDING
              PduRDestPduRef = EcucPduCollection/PT_TL_ECU_TRNSM_FR_32_00BC0001_RxF8_PP_TL_ECU_TRNSM_FR_32_00BC0001_RxF8_Tx_c0e3388d_6409b170
              PduRDestPduPduRBswModulesRef = FrTp
            PduRSrcPdu_22 (PduRSrcPdu):
              PduRSrcPduDirection = TRANSMIT
              PduRSrcPduRef = EcucPduCollection/PT_TL_ECU_TRNSM_FR_32_00BC0001_RxF8_PP_TL_ECU_TRNSM_FR_32_00BC0001_RxF8_Tx_c0e3388d_6409b170
              PduRSrcPduPduRBswModulesRef = Dcm
          PduRRoutingPath_023
            PduRDestPdu_23 (PduRDestPdu):
              PduRDestPduDirection = TRANSMIT
              PduRDestPduRoutingType = API_FORWARDING
              PduRDestPduRef = EcucPduCollection/PT_TL_ECU_TRNSM_FR_32_00BC0001_RxF9_PP_TL_ECU_TRNSM_FR_32_00BC0001_RxF9_Tx_c0e3388d_6409b170
              PduRDestPduPduRBswModulesRef = FrTp
            PduRSrcPdu_23 (PduRSrcPdu):
              PduRSrcPduDirection = TRANSMIT
              PduRSrcPduRef = EcucPduCollection/PT_TL_ECU_TRNSM_FR_32_00BC0001_RxF9_PP_TL_ECU_TRNSM_FR_32_00BC0001_RxF9_Tx_c0e3388d_6409b170
              PduRSrcPduPduRBswModulesRef = Dcm
          PduRRoutingPath_024
            PduRDestPdu_24 (PduRDestPdu):
              PduRDestPduDirection = TRANSMIT
              PduRDestPduRoutingType = API_FORWARDING
              PduRDestPduRef = EcucPduCollection/PT_TL_ECU_TRNSM_FR_32_00BC0001_RxFA_PP_TL_ECU_TRNSM_FR_32_00BC0001_RxFA_Tx_c0e3388d_6409b170
              PduRDestPduPduRBswModulesRef = FrTp
            PduRSrcPdu_24 (PduRSrcPdu):
              PduRSrcPduDirection = TRANSMIT
              PduRSrcPduRef = EcucPduCollection/PT_TL_ECU_TRNSM_FR_32_00BC0001_RxFA_PP_TL_ECU_TRNSM_FR_32_00BC0001_RxFA_Tx_c0e3388d_6409b170
              PduRSrcPduPduRBswModulesRef = Dcm
          PduRRoutingPath_025
            PduRDestPdu_25 (PduRDestPdu):
              PduRDestPduDirection = TRANSMIT
              PduRDestPduRoutingType = API_FORWARDING
              PduRDestPduRef = EcucPduCollection/PT_TL_ECU_TRNSM_FR_32_00BC0001_RxFB_PP_TL_ECU_TRNSM_FR_32_00BC0001_RxFB_Tx_c0e3388d_6409b170
              PduRDestPduPduRBswModulesRef = FrTp
            PduRSrcPdu_25 (PduRSrcPdu):
              PduRSrcPduDirection = TRANSMIT
              PduRSrcPduRef = EcucPduCollection/PT_TL_ECU_TRNSM_FR_32_00BC0001_RxFB_PP_TL_ECU_TRNSM_FR_32_00BC0001_RxFB_Tx_c0e3388d_6409b170
              PduRSrcPduPduRBswModulesRef = Dcm
          PduRRoutingPath_026
            PduRDestPdu_26 (PduRDestPdu):
              PduRDestPduDirection = TRANSMIT
              PduRDestPduRoutingType = API_FORWARDING
              PduRDestPduRef = EcucPduCollection/PT_TL_ECU_TRNSM_FR_32_00BC0001_RxFC_PP_TL_ECU_TRNSM_FR_32_00BC0001_RxFC_Tx_c0e3388d_6409b170
              PduRDestPduPduRBswModulesRef = FrTp
            PduRSrcPdu_26 (PduRSrcPdu):
              PduRSrcPduDirection = TRANSMIT
              PduRSrcPduRef = EcucPduCollection/PT_TL_ECU_TRNSM_FR_32_00BC0001_RxFC_PP_TL_ECU_TRNSM_FR_32_00BC0001_RxFC_Tx_c0e3388d_6409b170
              PduRSrcPduPduRBswModulesRef = Dcm
          PduRRoutingPath_027
            PduRDestPdu_27 (PduRDestPdu):
              PduRDestPduDirection = TRANSMIT
              PduRDestPduRoutingType = API_FORWARDING
              PduRDestPduRef = EcucPduCollection/PT_TL_ECU_TRNSM_FR_32_00BC0001_RxFD_PP_TL_ECU_TRNSM_FR_32_00BC0001_RxFD_Tx_c0e3388d_6409b170
              PduRDestPduPduRBswModulesRef = FrTp
            PduRSrcPdu_27 (PduRSrcPdu):
              PduRSrcPduDirection = TRANSMIT
              PduRSrcPduRef = EcucPduCollection/PT_TL_ECU_TRNSM_FR_32_00BC0001_RxFD_PP_TL_ECU_TRNSM_FR_32_00BC0001_RxFD_Tx_c0e3388d_6409b170
              PduRSrcPduPduRBswModulesRef = Dcm
          PduRRoutingPath_028
            PduRDestPdu_28 (PduRDestPdu):
              PduRDestPduDirection = RECEIVE
              PduRDestPduRoutingType = API_FORWARDING
              PduRDestPduRef = EcucPduCollection/PT_TL_MST_GW_TRNSM_FR_254_00980001_TxF0_PP_TL_MST_GW_TRNSM_FR_254_00980001_TxF0_Rx_c0e3388d_6409b170
              PduRDestPduPduRBswModulesRef = Dcm
            PduRSrcPdu_28 (PduRSrcPdu):
              PduRSrcPduDirection = RECEIVE
              PduRSrcPduRef = EcucPduCollection/PT_TL_MST_GW_TRNSM_FR_254_00980001_TxF0_PP_TL_MST_GW_TRNSM_FR_254_00980001_TxF0_Rx_c0e3388d_6409b170
              PduRSrcPduPduRBswModulesRef = FrTp
          PduRRoutingPath_029
            PduRDestPdu_29 (PduRDestPdu):
              PduRDestPduDirection = RECEIVE
              PduRDestPduRoutingType = API_FORWARDING
              PduRDestPduRef = EcucPduCollection/PT_TL_MST_GW_TRNSM_FR_254_00980001_TxF1_PP_TL_MST_GW_TRNSM_FR_254_00980001_TxF1_Rx_c0e3388d_6409b170
              PduRDestPduPduRBswModulesRef = Dcm
            PduRSrcPdu_29 (PduRSrcPdu):
              PduRSrcPduDirection = RECEIVE
              PduRSrcPduRef = EcucPduCollection/PT_TL_MST_GW_TRNSM_FR_254_00980001_TxF1_PP_TL_MST_GW_TRNSM_FR_254_00980001_TxF1_Rx_c0e3388d_6409b170
              PduRSrcPduPduRBswModulesRef = FrTp
          PduRRoutingPath_030
            PduRDestPdu_30 (PduRDestPdu):
              PduRDestPduDirection = RECEIVE
              PduRDestPduRoutingType = API_FORWARDING
              PduRDestPduRef = EcucPduCollection/PT_TL_MST_GW_TRNSM_FR_254_00980001_TxF2_PP_TL_MST_GW_TRNSM_FR_254_00980001_TxF2_Rx_c0e3388d_6409b170
              PduRDestPduPduRBswModulesRef = Dcm
            PduRSrcPdu_30 (PduRSrcPdu):
              PduRSrcPduDirection = RECEIVE
              PduRSrcPduRef = EcucPduCollection/PT_TL_MST_GW_TRNSM_FR_254_00980001_TxF2_PP_TL_MST_GW_TRNSM_FR_254_00980001_TxF2_Rx_c0e3388d_6409b170
              PduRSrcPduPduRBswModulesRef = FrTp
          PduRRoutingPath_031
            PduRDestPdu_31 (PduRDestPdu):
              PduRDestPduDirection = RECEIVE
              PduRDestPduRoutingType = API_FORWARDING
              PduRDestPduRef = EcucPduCollection/PT_TL_MST_GW_TRNSM_FR_254_00980001_TxF3_PP_TL_MST_GW_TRNSM_FR_254_00980001_TxF3_Rx_c0e3388d_6409b170
              PduRDestPduPduRBswModulesRef = Dcm
            PduRSrcPdu_31 (PduRSrcPdu):
              PduRSrcPduDirection = RECEIVE
              PduRSrcPduRef = EcucPduCollection/PT_TL_MST_GW_TRNSM_FR_254_00980001_TxF3_PP_TL_MST_GW_TRNSM_FR_254_00980001_TxF3_Rx_c0e3388d_6409b170
              PduRSrcPduPduRBswModulesRef = FrTp
          PduRRoutingPath_032
            PduRDestPdu_32 (PduRDestPdu):
              PduRDestPduDirection = RECEIVE
              PduRDestPduRoutingType = API_FORWARDING
              PduRDestPduRef = EcucPduCollection/PT_TL_MST_GW_TRNSM_FR_254_00980001_TxF4_PP_TL_MST_GW_TRNSM_FR_254_00980001_TxF4_Rx_c0e3388d_6409b170
              PduRDestPduPduRBswModulesRef = Dcm
            PduRSrcPdu_32 (PduRSrcPdu):
              PduRSrcPduDirection = RECEIVE
              PduRSrcPduRef = EcucPduCollection/PT_TL_MST_GW_TRNSM_FR_254_00980001_TxF4_PP_TL_MST_GW_TRNSM_FR_254_00980001_TxF4_Rx_c0e3388d_6409b170
              PduRSrcPduPduRBswModulesRef = FrTp
          PduRRoutingPath_033
            PduRDestPdu_33 (PduRDestPdu):
              PduRDestPduDirection = RECEIVE
              PduRDestPduRoutingType = API_FORWARDING
              PduRDestPduRef = EcucPduCollection/PT_TL_MST_GW_TRNSM_FR_254_00980001_TxF5_PP_TL_MST_GW_TRNSM_FR_254_00980001_TxF5_Rx_c0e3388d_6409b170
              PduRDestPduPduRBswModulesRef = Dcm
            PduRSrcPdu_33 (PduRSrcPdu):
              PduRSrcPduDirection = RECEIVE
              PduRSrcPduRef = EcucPduCollection/PT_TL_MST_GW_TRNSM_FR_254_00980001_TxF5_PP_TL_MST_GW_TRNSM_FR_254_00980001_TxF5_Rx_c0e3388d_6409b170
              PduRSrcPduPduRBswModulesRef = FrTp
          PduRRoutingPath_034
            PduRDestPdu_34 (PduRDestPdu):
              PduRDestPduDirection = RECEIVE
              PduRDestPduRoutingType = API_FORWARDING
              PduRDestPduRef = EcucPduCollection/PT_TL_MST_GW_TRNSM_FR_254_00980001_TxF6_PP_TL_MST_GW_TRNSM_FR_254_00980001_TxF6_Rx_c0e3388d_6409b170
              PduRDestPduPduRBswModulesRef = Dcm
            PduRSrcPdu_34 (PduRSrcPdu):
              PduRSrcPduDirection = RECEIVE
              PduRSrcPduRef = EcucPduCollection/PT_TL_MST_GW_TRNSM_FR_254_00980001_TxF6_PP_TL_MST_GW_TRNSM_FR_254_00980001_TxF6_Rx_c0e3388d_6409b170
              PduRSrcPduPduRBswModulesRef = FrTp
          PduRRoutingPath_035
            PduRDestPdu_35 (PduRDestPdu):
              PduRDestPduDirection = RECEIVE
              PduRDestPduRoutingType = API_FORWARDING
              PduRDestPduRef = EcucPduCollection/PT_TL_MST_GW_TRNSM_FR_254_00980001_TxF7_PP_TL_MST_GW_TRNSM_FR_254_00980001_TxF7_Rx_c0e3388d_6409b170
              PduRDestPduPduRBswModulesRef = Dcm
            PduRSrcPdu_35 (PduRSrcPdu):
              PduRSrcPduDirection = RECEIVE
              PduRSrcPduRef = EcucPduCollection/PT_TL_MST_GW_TRNSM_FR_254_00980001_TxF7_PP_TL_MST_GW_TRNSM_FR_254_00980001_TxF7_Rx_c0e3388d_6409b170
              PduRSrcPduPduRBswModulesRef = FrTp
          PduRRoutingPath_036
            PduRDestPdu_36 (PduRDestPdu):
              PduRDestPduDirection = RECEIVE
              PduRDestPduRoutingType = API_FORWARDING
              PduRDestPduRef = EcucPduCollection/PT_TL_MST_GW_TRNSM_FR_254_00980001_TxF8_PP_TL_MST_GW_TRNSM_FR_254_00980001_TxF8_Rx_c0e3388d_6409b170
              PduRDestPduPduRBswModulesRef = Dcm
            PduRSrcPdu_36 (PduRSrcPdu):
              PduRSrcPduDirection = RECEIVE
              PduRSrcPduRef = EcucPduCollection/PT_TL_MST_GW_TRNSM_FR_254_00980001_TxF8_PP_TL_MST_GW_TRNSM_FR_254_00980001_TxF8_Rx_c0e3388d_6409b170
              PduRSrcPduPduRBswModulesRef = FrTp
          PduRRoutingPath_037
            PduRDestPdu_37 (PduRDestPdu):
              PduRDestPduDirection = RECEIVE
              PduRDestPduRoutingType = API_FORWARDING
              PduRDestPduRef = EcucPduCollection/PT_TL_MST_GW_TRNSM_FR_254_00980001_TxF9_PP_TL_MST_GW_TRNSM_FR_254_00980001_TxF9_Rx_c0e3388d_6409b170
              PduRDestPduPduRBswModulesRef = Dcm
            PduRSrcPdu_37 (PduRSrcPdu):
              PduRSrcPduDirection = RECEIVE
              PduRSrcPduRef = EcucPduCollection/PT_TL_MST_GW_TRNSM_FR_254_00980001_TxF9_PP_TL_MST_GW_TRNSM_FR_254_00980001_TxF9_Rx_c0e3388d_6409b170
              PduRSrcPduPduRBswModulesRef = FrTp
          PduRRoutingPath_038
            PduRDestPdu_38 (PduRDestPdu):
              PduRDestPduDirection = RECEIVE
              PduRDestPduRoutingType = API_FORWARDING
              PduRDestPduRef = EcucPduCollection/PT_TL_MST_GW_TRNSM_FR_254_00980001_TxFA_PP_TL_MST_GW_TRNSM_FR_254_00980001_TxFA_Rx_c0e3388d_6409b170
              PduRDestPduPduRBswModulesRef = Dcm
            PduRSrcPdu_38 (PduRSrcPdu):
              PduRSrcPduDirection = RECEIVE
              PduRSrcPduRef = EcucPduCollection/PT_TL_MST_GW_TRNSM_FR_254_00980001_TxFA_PP_TL_MST_GW_TRNSM_FR_254_00980001_TxFA_Rx_c0e3388d_6409b170
              PduRSrcPduPduRBswModulesRef = FrTp
          PduRRoutingPath_039
            PduRDestPdu_39 (PduRDestPdu):
              PduRDestPduDirection = RECEIVE
              PduRDestPduRoutingType = API_FORWARDING
              PduRDestPduRef = EcucPduCollection/PT_TL_MST_GW_TRNSM_FR_254_00980001_TxFB_PP_TL_MST_GW_TRNSM_FR_254_00980001_TxFB_Rx_c0e3388d_6409b170
              PduRDestPduPduRBswModulesRef = Dcm
            PduRSrcPdu_39 (PduRSrcPdu):
              PduRSrcPduDirection = RECEIVE
              PduRSrcPduRef = EcucPduCollection/PT_TL_MST_GW_TRNSM_FR_254_00980001_TxFB_PP_TL_MST_GW_TRNSM_FR_254_00980001_TxFB_Rx_c0e3388d_6409b170
              PduRSrcPduPduRBswModulesRef = FrTp
          PduRRoutingPath_040
            PduRDestPdu_40 (PduRDestPdu):
              PduRDestPduDirection = RECEIVE
              PduRDestPduRoutingType = API_FORWARDING
              PduRDestPduRef = EcucPduCollection/PT_TL_MST_GW_TRNSM_FR_254_00980001_TxFC_PP_TL_MST_GW_TRNSM_FR_254_00980001_TxFC_Rx_c0e3388d_6409b170
              PduRDestPduPduRBswModulesRef = Dcm
            PduRSrcPdu_40 (PduRSrcPdu):
              PduRSrcPduDirection = RECEIVE
              PduRSrcPduRef = EcucPduCollection/PT_TL_MST_GW_TRNSM_FR_254_00980001_TxFC_PP_TL_MST_GW_TRNSM_FR_254_00980001_TxFC_Rx_c0e3388d_6409b170
              PduRSrcPduPduRBswModulesRef = FrTp
          PduRRoutingPath_041
            PduRDestPdu_41 (PduRDestPdu):
              PduRDestPduDirection = RECEIVE
              PduRDestPduRoutingType = API_FORWARDING
              PduRDestPduRef = EcucPduCollection/PT_TL_MST_GW_TRNSM_FR_254_00980001_TxFD_PP_TL_MST_GW_TRNSM_FR_254_00980001_TxFD_Rx_c0e3388d_6409b170
              PduRDestPduPduRBswModulesRef = Dcm
            PduRSrcPdu_41 (PduRSrcPdu):
              PduRSrcPduDirection = RECEIVE
              PduRSrcPduRef = EcucPduCollection/PT_TL_MST_GW_TRNSM_FR_254_00980001_TxFD_PP_TL_MST_GW_TRNSM_FR_254_00980001_TxFD_Rx_c0e3388d_6409b170
              PduRSrcPduPduRBswModulesRef = FrTp
    Dcm (PduRBswModules):
      PduRCancelReceive = false
      PduRCancelTransmit = false
      PduRChangeParameterRequestApi = false
      PduRCommunicationInterface = false
      PduRLowerModule = false
      PduRTransportProtocol = true
      PduRTriggertransmit = false
      PduRTxConfirmation = false
      PduRUpperModule = true
      PduRUseTag = true
      PduRBswModuleRef = Dcm
    FrTp (PduRBswModules):
      PduRCancelReceive = false
      PduRCancelTransmit = false
      PduRChangeParameterRequestApi = false
      PduRCommunicationInterface = false
      PduRLowerModule = true
      PduRTransportProtocol = true
      PduRTriggertransmit = false
      PduRTxConfirmation = false
      PduRUpperModule = false
      PduRUseTag = false
      PduRBswModuleRef = FrTp
