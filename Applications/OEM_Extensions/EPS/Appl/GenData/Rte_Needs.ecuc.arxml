AUTOSAR XML (schema 4-0-3)
package /DaVinci_Project
  module config Rte
    21 x RteBswModuleInstance:
      BswM
        BswM_MainFunctionTimingEvent0 (RteBswEventToTaskMapping): RteBswUsedOsEventRef=Rte_Ev_Cyclic2_OsTask_BSW_ASIL_0_2ms, RteBswUsedOsAlarmRef=Os/Rte_Al_TE2_OsTask_BSW_ASIL_0_2ms
      Com
        Com_MainFunctionRxTimingEvent0 (RteBswEventToTaskMapping): RteBswUsedOsEventRef=Rte_Ev_Cyclic2_OsTask_BSW_ASIL_0_10ms, RteBswUsedOsAlarmRef=Os/Rte_Al_TE2_OsTask_BSW_ASIL_0_10ms
        Com_MainFunctionTxTimingEvent0 (RteBswEventToTaskMapping): RteBswUsedOsEventRef=Rte_Ev_Cyclic2_OsTask_BSW_ASIL_0_5ms, RteBswUsedOsAlarmRef=Os/Rte_Al_TE2_OsTask_BSW_ASIL_0_5ms
      ComM
        ComM_MainFunction_0TimingEvent0 (RteBswEventToTaskMapping): RteBswUsedOsEventRef=Rte_Ev_Cyclic2_OsTask_BSW_ASIL_0_20ms, RteBswUsedOsAlarmRef=Os/Rte_Al_TE2_OsTask_BSW_ASIL_0_20ms
      Dcm
        Dcm_MainFunctionTimingEvent0 (RteBswEventToTaskMapping): RteBswUsedOsEventRef=Rte_Ev_Cyclic2_OsTask_BSW_ASIL_0_5ms, RteBswUsedOsAlarmRef=Os/Rte_Al_TE2_OsTask_BSW_ASIL_0_5ms
      Dem
        Dem_MasterMainFunctionTimingEvent0 (RteBswEventToTaskMapping): RteBswUsedOsEventRef=Rte_Ev_Cyclic2_OsTask_BSW_ASIL_0_10ms, RteBswUsedOsAlarmRef=Os/Rte_Al_TE2_OsTask_BSW_ASIL_0_10ms
        Dem_SatelliteMainFunctionTimingEvent0 (RteBswEventToTaskMapping): RteBswUsedOsEventRef=Rte_Ev_Cyclic2_OsTask_BSW_ASIL_0_10ms, RteBswUsedOsAlarmRef=Os/Rte_Al_TE2_OsTask_BSW_ASIL_0_10ms
      Det
      EcuM
        EcuM_MainFunctionTimingEvent0 (RteBswEventToTaskMapping): RteBswUsedOsEventRef=Rte_Ev_Cyclic2_OsTask_BSW_ASIL_0_10ms, RteBswUsedOsAlarmRef=Os/Rte_Al_TE2_OsTask_BSW_ASIL_0_10ms
      Fee
        Fee_30_SmallSector_MainFunctionTimingEvent0 (RteBswEventToTaskMapping):
          RteBswUsedOsEventRef = Rte_Ev_Run_Fee_30_SmallSector_Fee_30_SmallSector_MainFunction
          RteBswUsedOsAlarmRef = Os/Rte_Al_TE_Fee_30_SmallSector_Fee_30_SmallSector_MainFunction
      Fls
        Fls_MainFunctionTimingEvent0 (RteBswEventToTaskMapping): RteBswUsedOsEventRef=Rte_Ev_Cyclic2_OsTask_LowPrioNvm_0_10ms, RteBswUsedOsAlarmRef=Os/Rte_Al_TE2_OsTask_LowPrioNvm_0_10ms
      Fr
      FrIf
        FrIf_MainFunction_0TimingEvent0 (RteBswEventToTaskMapping): RteBswUsedOsEventRef=Rte_Ev_Cyclic2_Default_BSW_Sync_Task_0_5ms, RteBswUsedOsAlarmRef=Os/Rte_Al_TE2_Default_BSW_Sync_Task_0_5ms
      FrSM
        FrSM_MainFunction_0TimingEvent0 (RteBswEventToTaskMapping): RteBswUsedOsEventRef=Rte_Ev_Cyclic2_Default_BSW_Sync_Task_0_5ms, RteBswUsedOsAlarmRef=Os/Rte_Al_TE2_Default_BSW_Sync_Task_0_5ms
      FrTp
        FrTp_MainFunctionTimingEvent0 (RteBswEventToTaskMapping): RteBswUsedOsEventRef=Rte_Ev_Cyclic2_Default_BSW_Sync_Task_0_5ms, RteBswUsedOsAlarmRef=Os/Rte_Al_TE2_Default_BSW_Sync_Task_0_5ms
      IpduM
        IpduM_MainFunctionRxTimingEvent0 (RteBswEventToTaskMapping): RteBswUsedOsEventRef=Rte_Ev_Cyclic2_OsTask_BSW_ASIL_0_10ms, RteBswUsedOsAlarmRef=Os/Rte_Al_TE2_OsTask_BSW_ASIL_0_10ms
        IpduM_MainFunctionTxTimingEvent0 (RteBswEventToTaskMapping): RteBswUsedOsEventRef=Rte_Ev_Cyclic2_OsTask_BSW_ASIL_0_10ms, RteBswUsedOsAlarmRef=Os/Rte_Al_TE2_OsTask_BSW_ASIL_0_10ms
      Mcu
      NvM
        NvM_MainFunctionTimingEvent0 (RteBswEventToTaskMapping): RteBswUsedOsEventRef=Rte_Ev_Cyclic2_OsTask_LowPrioNvm_0_10ms, RteBswUsedOsAlarmRef=Os/Rte_Al_TE2_OsTask_LowPrioNvm_0_10ms
      PduR
      Port
      WdgM
        WdgM_MainFunctionTimingEvent0 (RteBswEventToTaskMapping): RteBswUsedOsEventRef=Rte_Ev_Cyclic2_OsTask_BSW_ASIL_0_10ms, RteBswUsedOsAlarmRef=Os/Rte_Al_TE2_OsTask_BSW_ASIL_0_10ms
      Wdg
      Xcp
        3 x RteBswEventToTaskMapping:
          FrXcp_MainFunctionRxTimingEvent0: RteBswUsedOsEventRef=Rte_Ev_Cyclic2_Default_BSW_Sync_Task_0_5ms, RteBswUsedOsAlarmRef=Os/Rte_Al_TE2_Default_BSW_Sync_Task_0_5ms
          FrXcp_MainFunctionTxTimingEvent0: RteBswUsedOsEventRef=Rte_Ev_Cyclic2_Default_BSW_Sync_Task_0_5ms, RteBswUsedOsAlarmRef=Os/Rte_Al_TE2_Default_BSW_Sync_Task_0_5ms
          Xcp_MainFunctionTimingEvent0: RteBswUsedOsEventRef=Rte_Ev_Cyclic2_OsTask_BSW_ASIL_0_5ms, RteBswUsedOsAlarmRef=Os/Rte_Al_TE2_OsTask_BSW_ASIL_0_5ms
    21 x RteSwComponentInstance:
      BMW_Application_Connector_Dummy_EcuSwComposition
        4 x RteEventToTaskMapping:
          DRT_BMW_Vin_Rx_Wrapper_NO_VECH_7_NO_VECH_7: RteUsedOsEventRef=Rte_Ev_Run_BMW_Application_Connector_Dummy_BMW_Vin_Rx_Wrapper
          DRET_BMW_Vin_Rx_Wrapper_NO_VECH_7_NO_VECH_7: RteUsedOsEventRef=Rte_Ev_Run_BMW_Application_Connector_Dummy_BMW_Vin_Rx_Wrapper
          MST_Dlog_FirstStart_Dummy_0: RteUsedOsEventRef=Rte_Ev_Run_BMW_Application_Connector_Dummy_Dlog_FirstStart_Dummy
          MST_Dlog_FirstStart_Dummy_1: RteUsedOsEventRef=Rte_Ev_Run_BMW_Application_Connector_Dummy_Dlog_FirstStart_Dummy
      BMW_Application_Main_EcuSwComposition
        6 x RteEventToTaskMapping:
          MST_Dcm_BAC4_EcuReset_0: RteUsedOsEventRef=Rte_Ev_Run_BMW_Application_Main_Dcm_BAC4_EcuReset_Execute
          MST_Dcm_BAC4_EcuReset_Hard_0: RteUsedOsEventRef=Rte_Ev_Run_BMW_Application_Main_Dcm_BAC4_EcuReset_Hard
          MST_Runnable_0: RteUsedOsEventRef=Rte_Ev_Run_BMW_Application_Main_Dcm_BAC4_Jump2Boot
          MST_Dcm_BAC4_RapidShutdownDisable_0: RteUsedOsEventRef=Rte_Ev_Run_BMW_Application_Main_Dcm_BAC4_RapidShutdownDisable
          MST_Dcm_BAC4_RapidShutdownEnable_0: RteUsedOsEventRef=Rte_Ev_Run_BMW_Application_Main_Dcm_BAC4_RapidShutdownEnable
          TMT_Xcp_Event_Runnable: RteUsedOsEventRef=Rte_Ev_Run_BMW_Application_Main_Xcp_Event_Runnable, RteUsedOsAlarmRef=Os/Rte_Al_TE_BMW_Application_Main_Xcp_Event_Runnable
      Bs_EcuSwComposition
        dre_LifeCycleRequest (RteEventToTaskMapping): RteUsedOsEventRef=Rte_Ev_Run_Bs_Bs_LifeCycleModeRequest
      BswM_EcuSwComposition
        Timer_BswM_MainFunction (RteEventToTaskMapping): RteUsedOsEventRef=Rte_Ev_Cyclic2_OsTask_BSW_ASIL_0_2ms, RteUsedOsAlarmRef=Os/Rte_Al_TE2_OsTask_BSW_ASIL_0_2ms
        DataReceivedEvent_BswM_Read_SWCModeReq_StdDiag_CommunicationModeDeclarationGroup_Request_SWCModeReq_StdDiag_Communicati_699d3eef (RteEventToTaskMapping): RteUsedOsEventRef=Rte_Ev_Run_BswM_BswM_Read_SWCModeReq_StdDiag_CommunicationModeDeclarationGroup
      ComM_EcuSwComposition
        Timer_ComM_MainFunction_0 (RteEventToTaskMapping): RteUsedOsEventRef=Rte_Ev_Cyclic2_OsTask_BSW_ASIL_0_20ms, RteUsedOsAlarmRef=Os/Rte_Al_TE2_OsTask_BSW_ASIL_0_20ms
      Darh_EcuSwComposition
        LifeCycleRequest (RteEventToTaskMapping): RteUsedOsEventRef=Rte_Ev_Run_Darh_LifeCycleHandler
        TimingEvent (RteEventToTaskMapping): RteUsedOsEventRef=Rte_Ev_Run1_Darh_QueueHandler, RteUsedOsAlarmRef=Os/Rte_Al_TE_Darh_QueueHandler
      Dcm_EcuSwComposition
        Timer_Dcm_MainFunction (RteEventToTaskMapping): RteUsedOsEventRef=Rte_Ev_Cyclic2_OsTask_BSW_ASIL_0_5ms, RteUsedOsAlarmRef=Os/Rte_Al_TE2_OsTask_BSW_ASIL_0_5ms
      DemMaster_0_EcuSwComposition
        Timer_Dem_MasterMainFunction (RteEventToTaskMapping): RteUsedOsEventRef=Rte_Ev_Cyclic2_OsTask_BSW_ASIL_0_10ms, RteUsedOsAlarmRef=Os/Rte_Al_TE2_OsTask_BSW_ASIL_0_10ms
      DemSatellite_0_EcuSwComposition
        Timer_Dem_SatelliteMainFunction (RteEventToTaskMapping): RteUsedOsEventRef=Rte_Ev_Cyclic2_OsTask_BSW_ASIL_0_10ms, RteUsedOsAlarmRef=Os/Rte_Al_TE2_OsTask_BSW_ASIL_0_10ms
      DemWrapper_EcuSwComposition
      Det_EcuSwComposition
      Dlog_EcuSwComposition
        LifeCycleModeSwitchedAck (RteEventToTaskMapping): RteUsedOsEventRef=Rte_Ev_Run_Dlog_Dlog_ModeSwitchAckLifeCycle
        LifeCycleRequest (RteEventToTaskMapping): RteUsedOsEventRef=Rte_Ev_Run_Dlog_Dlog_ModeSwitchRequestLifeCycle
      EcuM_EcuSwComposition
        Timer_EcuM_MainFunction (RteEventToTaskMapping): RteUsedOsEventRef=Rte_Ev_Cyclic2_OsTask_BSW_ASIL_0_10ms, RteUsedOsAlarmRef=Os/Rte_Al_TE2_OsTask_BSW_ASIL_0_10ms
      IntegrationSample_EcuSwComposition
        7 x RteEventToTaskMapping:
          IntegrationSample_SimpleTimer_TimingEvent: RteUsedOsEventRef=Rte_Ev_Run_IntegrationSample_IntegrationSampleTimerFunction, RteUsedOsAlarmRef=Os/Rte_Al_TE_IntegrationSample_IntegrationSampleTimerFunction
          EcuRunState: RteUsedOsEventRef=Rte_Ev_Run_IntegrationSample_R_IntegrationSample_EcuRunStateHandler
          DRE_SGG_Rx_CON_VEH: RteUsedOsEventRef=Rte_Ev_Run_IntegrationSample_R_Receive_SGG_Rx_CON_VEH
          DRE_SIG_MILE_KM_816_R: RteUsedOsEventRef=Rte_Ev_Run_IntegrationSample_R_Receive_SIG_MILE_KM_816_R
          DRE_VehicleStatus: RteUsedOsEventRef=Rte_Ev_Run_IntegrationSample_R_Receive_VehicleStatus
          DRET_SGG_Rx_CON_VEH: RteUsedOsEventRef=Rte_Ev_Run_IntegrationSample_R_Timeout_SGG_Rx_CON_VEH
          DRET_VehicleStatus: RteUsedOsEventRef=Rte_Ev_Run_IntegrationSample_R_Timeout_VehicleStatus
      NvM_EcuSwComposition
        Timer_NvM_MainFunction (RteEventToTaskMapping): RteUsedOsEventRef=Rte_Ev_Cyclic2_OsTask_LowPrioNvm_0_10ms, RteUsedOsAlarmRef=Os/Rte_Al_TE2_OsTask_LowPrioNvm_0_10ms
      Omc_EcuSwComposition
        LifeCycleRequest (RteEventToTaskMapping): RteUsedOsEventRef=Rte_Ev_Run_Omc_LifeCycleHandler
      Os_OsCore_CORE0_swc_EcuSwComposition
      StdDiag_EcuSwComposition
        3 x RteEventToTaskMapping:
          LifeCycleRequest: RteUsedOsEventRef=Rte_Ev_Run_StdDiag_LifeCycleHandler
          Event_SessionChange_DefaultSession: RteUsedOsEventRef=Rte_Ev_Run1_StdDiag_SessionChange_DefaultSession
          Event_SessionChange_OtherSession: RteUsedOsEventRef=Rte_Ev_Run1_StdDiag_SessionChange_OtherSession
      Stm_EcuSwComposition
        8 x RteEventToTaskMapping:
          DRET_Runnable_ErrorCentralErrorLock_CentralErrorLockRx_centralErrorLock: RteUsedOsEventRef=Rte_Ev_Run_Stm_Runnable_ErrorCentralErrorLock
          DRET_Runnable_ErrorEnergyMode_EnergyModeRx_energyState: RteUsedOsEventRef=Rte_Ev_Run_Stm_Runnable_ErrorEnergyMode
          DRET_Runnable_ErrorVehicleState_VehicleStateRx_VehicleState: RteUsedOsEventRef=Rte_Ev_Run_Stm_Runnable_ErrorVehicleState
          MST_Runnable_InitialCELSupervision_0: RteUsedOsEventRef=Rte_Ev_Run1_Stm_Runnable_InitialCELSupervision
          DRT_Runnable_ReceiveCentralErrorLock_CentralErrorLockRx_centralErrorLock: RteUsedOsEventRef=Rte_Ev_Run_Stm_Runnable_ReceiveCentralErrorLock
          DRT_Runnable_ReceiveEnergyMode_EnergyModeRx_energyState: RteUsedOsEventRef=Rte_Ev_Run_Stm_Runnable_ReceiveEnergyMode
          DRT_Runnable_ReceiveVehicleState_VehicleStateRx_VehicleState: RteUsedOsEventRef=Rte_Ev_Run_Stm_Runnable_ReceiveVehicleState
          MST_Runnable_StopCentralErrorLockSupervision_0: RteUsedOsEventRef=Rte_Ev_Run1_Stm_Runnable_StopCentralErrorLockSupervision
      SysTime_EcuSwComposition
        3 x RteEventToTaskMapping:
          LifeCycleRequest: RteUsedOsEventRef=Rte_Ev_Run_SysTime_LifeCycleHandler
          TimingEvent: RteUsedOsEventRef=Rte_Ev_Run1_SysTime_MainFunction, RteUsedOsAlarmRef=Os/Rte_Al_TE_SysTime_MainFunction
          SysTimeRx: RteUsedOsEventRef=Rte_Ev_Run1_SysTime_ReceiveSignal
      WdgM_OsApplication_ASIL_EcuSwComposition
        Timer_WdgM_MainFunction (RteEventToTaskMapping): RteUsedOsEventRef=Rte_Ev_Cyclic2_OsTask_BSW_ASIL_0_10ms, RteUsedOsAlarmRef=Os/Rte_Al_TE2_OsTask_BSW_ASIL_0_10ms
    RteOsInteraction
      11 x RteUsedOsActivation, all with RteExpectedActivationOffset=0:
        Rte_Al_TE_Darh_QueueHandler: RteActivationOsAlarmRef=Os/Rte_Al_TE_Darh_QueueHandler, RteActivationOsTaskRef=Default_BAC_Appl_BMW_Task
        Rte_Al_TE_SysTime_MainFunction: RteActivationOsAlarmRef=Os/Rte_Al_TE_SysTime_MainFunction, RteActivationOsTaskRef=Default_BAC_Appl_BMW_Task
        Rte_Al_TE2_Default_BSW_Sync_Task_0_5ms: RteActivationOsAlarmRef=Os/Rte_Al_TE2_Default_BSW_Sync_Task_0_5ms, RteActivationOsTaskRef=Default_BSW_Sync_Task
        Rte_Al_TE_BMW_Application_Main_Xcp_Event_Runnable: RteActivationOsAlarmRef=Os/Rte_Al_TE_BMW_Application_Main_Xcp_Event_Runnable, RteActivationOsTaskRef=Default_RTE_Mode_switch_Task
        Rte_Al_TE_IntegrationSample_IntegrationSampleTimerFunction: RteActivationOsAlarmRef=Os/Rte_Al_TE_IntegrationSample_IntegrationSampleTimerFunction, RteActivationOsTaskRef=Default_RTE_Mode_switch_Task
        Rte_Al_TE2_OsTask_BSW_ASIL_0_10ms: RteActivationOsAlarmRef=Os/Rte_Al_TE2_OsTask_BSW_ASIL_0_10ms, RteActivationOsTaskRef=OsTask_BSW_ASIL
        Rte_Al_TE2_OsTask_BSW_ASIL_0_20ms: RteActivationOsAlarmRef=Os/Rte_Al_TE2_OsTask_BSW_ASIL_0_20ms, RteActivationOsTaskRef=OsTask_BSW_ASIL
        Rte_Al_TE2_OsTask_BSW_ASIL_0_2ms: RteActivationOsAlarmRef=Os/Rte_Al_TE2_OsTask_BSW_ASIL_0_2ms, RteActivationOsTaskRef=OsTask_BSW_ASIL
        Rte_Al_TE2_OsTask_BSW_ASIL_0_5ms: RteActivationOsAlarmRef=Os/Rte_Al_TE2_OsTask_BSW_ASIL_0_5ms, RteActivationOsTaskRef=OsTask_BSW_ASIL
        Rte_Al_TE2_OsTask_LowPrioNvm_0_10ms: RteActivationOsAlarmRef=Os/Rte_Al_TE2_OsTask_LowPrioNvm_0_10ms, RteActivationOsTaskRef=OsTask_LowPrioNvm
        Rte_Al_TE_Fee_30_SmallSector_Fee_30_SmallSector_MainFunction: RteActivationOsAlarmRef=Os/Rte_Al_TE_Fee_30_SmallSector_Fee_30_SmallSector_MainFunction, RteActivationOsTaskRef=OsTask_LowPrioNvm
  module config NvM
  module config Os
    Default_BAC_Appl_BMW_Task (OsTask):
      OsTaskActivation = 1
      OsTaskPriority = 58
      OsTaskSchedule = FULL
      OsTaskEventRef = Rte_Ev_MS_Default_BAC_Appl_BMW_Task
      OsTaskEventRef = Rte_Ev_Run1_Darh_QueueHandler
      OsTaskEventRef = Rte_Ev_Run1_SysTime_MainFunction
      OsTaskEventRef = Rte_Ev_Run_Darh_LifeCycleHandler
      OsTaskAccessingApplication = OsApplication_ASIL
      OsTaskAccessingApplication = SystemApplication_OsCore_CORE0
    Rte_Al_TE_Darh_QueueHandler (OsAlarm): OsAlarmCounterRef=SystemTimer, OsAlarmAccessingApplication=OsApplication_ASIL, OsAlarmAccessingApplication=SystemApplication_OsCore_CORE0
      OsAlarmAction
        OsAlarmSetEvent: OsAlarmSetEventRef=Rte_Ev_Run1_Darh_QueueHandler, OsAlarmSetEventTaskRef=Default_BAC_Appl_BMW_Task
    Rte_Al_TE_SysTime_MainFunction (OsAlarm): OsAlarmCounterRef=SystemTimer, OsAlarmAccessingApplication=OsApplication_ASIL, OsAlarmAccessingApplication=SystemApplication_OsCore_CORE0
      OsAlarmAction
        OsAlarmSetEvent: OsAlarmSetEventRef=Rte_Ev_Run1_SysTime_MainFunction, OsAlarmSetEventTaskRef=Default_BAC_Appl_BMW_Task
    Default_BSW_Sync_Task (OsTask):
      OsTaskActivation = 1
      OsTaskPriority = 65
      OsTaskSchedule = FULL
      OsTaskEventRef = Rte_Ev_Cyclic2_Default_BSW_Sync_Task_0_5ms
      OsTaskAccessingApplication = OsApplication_QM
      OsTaskAccessingApplication = SystemApplication_OsCore_CORE0
    Rte_Al_TE2_Default_BSW_Sync_Task_0_5ms (OsAlarm): OsAlarmCounterRef=SystemTimer, OsAlarmAccessingApplication=OsApplication_QM, OsAlarmAccessingApplication=SystemApplication_OsCore_CORE0
      OsAlarmAction
        OsAlarmSetEvent: OsAlarmSetEventRef=Rte_Ev_Cyclic2_Default_BSW_Sync_Task_0_5ms, OsAlarmSetEventTaskRef=Default_BSW_Sync_Task
    Default_RTE_Mode_switch_Task (OsTask):
      OsTaskActivation = 1
      OsTaskPriority = 10
      OsTaskSchedule = FULL
      OsTaskEventRef = Rte_Ev_MS_Default_RTE_Mode_switch_Task
      OsTaskEventRef = Rte_Ev_Run1_StdDiag_SessionChange_DefaultSession
      OsTaskEventRef = Rte_Ev_Run1_StdDiag_SessionChange_OtherSession
      OsTaskEventRef = Rte_Ev_Run1_Stm_Runnable_InitialCELSupervision
      OsTaskEventRef = Rte_Ev_Run1_Stm_Runnable_StopCentralErrorLockSupervision
      OsTaskEventRef = Rte_Ev_Run1_SysTime_ReceiveSignal
      OsTaskEventRef = Rte_Ev_Run_BMW_Application_Connector_Dummy_BMW_Vin_Rx_Wrapper
      OsTaskEventRef = Rte_Ev_Run_BMW_Application_Connector_Dummy_Dlog_FirstStart_Dummy
      OsTaskEventRef = Rte_Ev_Run_BMW_Application_Main_Dcm_BAC4_EcuReset_Execute
      OsTaskEventRef = Rte_Ev_Run_BMW_Application_Main_Dcm_BAC4_EcuReset_Hard
      OsTaskEventRef = Rte_Ev_Run_BMW_Application_Main_Dcm_BAC4_Jump2Boot
      OsTaskEventRef = Rte_Ev_Run_BMW_Application_Main_Dcm_BAC4_RapidShutdownDisable
      OsTaskEventRef = Rte_Ev_Run_BMW_Application_Main_Dcm_BAC4_RapidShutdownEnable
      OsTaskEventRef = Rte_Ev_Run_BMW_Application_Main_Xcp_Event_Runnable
      OsTaskEventRef = Rte_Ev_Run_Bs_Bs_LifeCycleModeRequest
      OsTaskEventRef = Rte_Ev_Run_Dlog_Dlog_ModeSwitchAckLifeCycle
      OsTaskEventRef = Rte_Ev_Run_Dlog_Dlog_ModeSwitchRequestLifeCycle
      OsTaskEventRef = Rte_Ev_Run_IntegrationSample_IntegrationSampleTimerFunction
      OsTaskEventRef = Rte_Ev_Run_IntegrationSample_R_IntegrationSample_EcuRunStateHandler
      OsTaskEventRef = Rte_Ev_Run_IntegrationSample_R_Receive_SGG_Rx_CON_VEH
      OsTaskEventRef = Rte_Ev_Run_IntegrationSample_R_Receive_SIG_MILE_KM_816_R
      OsTaskEventRef = Rte_Ev_Run_IntegrationSample_R_Receive_VehicleStatus
      OsTaskEventRef = Rte_Ev_Run_IntegrationSample_R_Timeout_SGG_Rx_CON_VEH
      OsTaskEventRef = Rte_Ev_Run_IntegrationSample_R_Timeout_VehicleStatus
      OsTaskEventRef = Rte_Ev_Run_Omc_LifeCycleHandler
      OsTaskEventRef = Rte_Ev_Run_StdDiag_LifeCycleHandler
      OsTaskEventRef = Rte_Ev_Run_Stm_Runnable_ErrorCentralErrorLock
      OsTaskEventRef = Rte_Ev_Run_Stm_Runnable_ErrorEnergyMode
      OsTaskEventRef = Rte_Ev_Run_Stm_Runnable_ErrorVehicleState
      OsTaskEventRef = Rte_Ev_Run_Stm_Runnable_ReceiveCentralErrorLock
      OsTaskEventRef = Rte_Ev_Run_Stm_Runnable_ReceiveEnergyMode
      OsTaskEventRef = Rte_Ev_Run_Stm_Runnable_ReceiveVehicleState
      OsTaskEventRef = Rte_Ev_Run_SysTime_LifeCycleHandler
      OsTaskAccessingApplication = OsApplication_ASIL
      OsTaskAccessingApplication = SystemApplication_OsCore_CORE0
    Rte_Al_TE_BMW_Application_Main_Xcp_Event_Runnable (OsAlarm): OsAlarmCounterRef=SystemTimer, OsAlarmAccessingApplication=OsApplication_ASIL, OsAlarmAccessingApplication=SystemApplication_OsCore_CORE0
      OsAlarmAction
        OsAlarmSetEvent: OsAlarmSetEventRef=Rte_Ev_Run_BMW_Application_Main_Xcp_Event_Runnable, OsAlarmSetEventTaskRef=Default_RTE_Mode_switch_Task
    Rte_Al_TE_IntegrationSample_IntegrationSampleTimerFunction (OsAlarm): OsAlarmCounterRef=SystemTimer, OsAlarmAccessingApplication=OsApplication_ASIL, OsAlarmAccessingApplication=SystemApplication_OsCore_CORE0
      OsAlarmAction
        OsAlarmSetEvent: OsAlarmSetEventRef=Rte_Ev_Run_IntegrationSample_IntegrationSampleTimerFunction, OsAlarmSetEventTaskRef=Default_RTE_Mode_switch_Task
    OsTask_BSW_ASIL (OsTask):
      OsTaskActivation = 1
      OsTaskPriority = 60
      OsTaskSchedule = FULL
      OsTaskEventRef = Rte_Ev_Cyclic2_OsTask_BSW_ASIL_0_10ms
      OsTaskEventRef = Rte_Ev_Cyclic2_OsTask_BSW_ASIL_0_20ms
      OsTaskEventRef = Rte_Ev_Cyclic2_OsTask_BSW_ASIL_0_2ms
      OsTaskEventRef = Rte_Ev_Cyclic2_OsTask_BSW_ASIL_0_5ms
      OsTaskEventRef = Rte_Ev_Run_BswM_BswM_Read_SWCModeReq_StdDiag_CommunicationModeDeclarationGroup
      OsTaskAccessingApplication = OsApplication_QM
      OsTaskAccessingApplication = SystemApplication_OsCore_CORE0
    4 x OsAlarm, all with OsAlarmCounterRef=SystemTimer, OsAlarmAccessingApplication=OsApplication_QM, OsAlarmAccessingApplication=SystemApplication_OsCore_CORE0:
      Rte_Al_TE2_OsTask_BSW_ASIL_0_10ms
        OsAlarmAction
          OsAlarmSetEvent: OsAlarmSetEventRef=Rte_Ev_Cyclic2_OsTask_BSW_ASIL_0_10ms, OsAlarmSetEventTaskRef=OsTask_BSW_ASIL
      Rte_Al_TE2_OsTask_BSW_ASIL_0_20ms
        OsAlarmAction
          OsAlarmSetEvent: OsAlarmSetEventRef=Rte_Ev_Cyclic2_OsTask_BSW_ASIL_0_20ms, OsAlarmSetEventTaskRef=OsTask_BSW_ASIL
      Rte_Al_TE2_OsTask_BSW_ASIL_0_2ms
        OsAlarmAction
          OsAlarmSetEvent: OsAlarmSetEventRef=Rte_Ev_Cyclic2_OsTask_BSW_ASIL_0_2ms, OsAlarmSetEventTaskRef=OsTask_BSW_ASIL
      Rte_Al_TE2_OsTask_BSW_ASIL_0_5ms
        OsAlarmAction
          OsAlarmSetEvent: OsAlarmSetEventRef=Rte_Ev_Cyclic2_OsTask_BSW_ASIL_0_5ms, OsAlarmSetEventTaskRef=OsTask_BSW_ASIL
    OsTask_LowPrioNvm (OsTask):
      OsTaskActivation = 1
      OsTaskPriority = 20
      OsTaskSchedule = FULL
      OsTaskEventRef = Rte_Ev_Cyclic2_OsTask_LowPrioNvm_0_10ms
      OsTaskEventRef = Rte_Ev_Run_Fee_30_SmallSector_Fee_30_SmallSector_MainFunction
      OsTaskAccessingApplication = OsApplication_ASIL
      OsTaskAccessingApplication = OsApplication_QM
    Rte_Al_TE2_OsTask_LowPrioNvm_0_10ms (OsAlarm): OsAlarmCounterRef=SystemTimer, OsAlarmAccessingApplication=OsApplication_ASIL, OsAlarmAccessingApplication=OsApplication_QM
      OsAlarmAction
        OsAlarmSetEvent: OsAlarmSetEventRef=Rte_Ev_Cyclic2_OsTask_LowPrioNvm_0_10ms, OsAlarmSetEventTaskRef=OsTask_LowPrioNvm
    Rte_Al_TE_Fee_30_SmallSector_Fee_30_SmallSector_MainFunction (OsAlarm): OsAlarmCounterRef=SystemTimer, OsAlarmAccessingApplication=OsApplication_ASIL, OsAlarmAccessingApplication=OsApplication_QM
      OsAlarmAction
        OsAlarmSetEvent: OsAlarmSetEventRef=Rte_Ev_Run_Fee_30_SmallSector_Fee_30_SmallSector_MainFunction, OsAlarmSetEventTaskRef=OsTask_LowPrioNvm
    45 x OsEvent:
      Rte_Ev_Cyclic2_Default_BSW_Sync_Task_0_5ms
      Rte_Ev_Cyclic2_OsTask_BSW_ASIL_0_10ms
      Rte_Ev_Cyclic2_OsTask_BSW_ASIL_0_20ms
      Rte_Ev_Cyclic2_OsTask_BSW_ASIL_0_2ms
      Rte_Ev_Cyclic2_OsTask_BSW_ASIL_0_5ms
      Rte_Ev_Cyclic2_OsTask_LowPrioNvm_0_10ms
      Rte_Ev_MS_Default_BAC_Appl_BMW_Task: OsEventMask=4
      Rte_Ev_MS_Default_RTE_Mode_switch_Task: OsEventMask=4
      Rte_Ev_Run1_Darh_QueueHandler
      Rte_Ev_Run1_StdDiag_SessionChange_DefaultSession
      Rte_Ev_Run1_StdDiag_SessionChange_OtherSession
      Rte_Ev_Run1_Stm_Runnable_InitialCELSupervision
      Rte_Ev_Run1_Stm_Runnable_StopCentralErrorLockSupervision
      Rte_Ev_Run1_SysTime_MainFunction
      Rte_Ev_Run1_SysTime_ReceiveSignal
      Rte_Ev_Run_BMW_Application_Connector_Dummy_BMW_Vin_Rx_Wrapper
      Rte_Ev_Run_BMW_Application_Connector_Dummy_Dlog_FirstStart_Dummy
      Rte_Ev_Run_BMW_Application_Main_Dcm_BAC4_EcuReset_Execute
      Rte_Ev_Run_BMW_Application_Main_Dcm_BAC4_EcuReset_Hard
      Rte_Ev_Run_BMW_Application_Main_Dcm_BAC4_Jump2Boot
      Rte_Ev_Run_BMW_Application_Main_Dcm_BAC4_RapidShutdownDisable
      Rte_Ev_Run_BMW_Application_Main_Dcm_BAC4_RapidShutdownEnable
      Rte_Ev_Run_BMW_Application_Main_Xcp_Event_Runnable
      Rte_Ev_Run_Bs_Bs_LifeCycleModeRequest
      Rte_Ev_Run_BswM_BswM_Read_SWCModeReq_StdDiag_CommunicationModeDeclarationGroup
      Rte_Ev_Run_Darh_LifeCycleHandler
      Rte_Ev_Run_Dlog_Dlog_ModeSwitchAckLifeCycle
      Rte_Ev_Run_Dlog_Dlog_ModeSwitchRequestLifeCycle
      Rte_Ev_Run_Fee_30_SmallSector_Fee_30_SmallSector_MainFunction
      Rte_Ev_Run_IntegrationSample_IntegrationSampleTimerFunction
      Rte_Ev_Run_IntegrationSample_R_IntegrationSample_EcuRunStateHandler
      Rte_Ev_Run_IntegrationSample_R_Receive_SGG_Rx_CON_VEH
      Rte_Ev_Run_IntegrationSample_R_Receive_SIG_MILE_KM_816_R
      Rte_Ev_Run_IntegrationSample_R_Receive_VehicleStatus
      Rte_Ev_Run_IntegrationSample_R_Timeout_SGG_Rx_CON_VEH
      Rte_Ev_Run_IntegrationSample_R_Timeout_VehicleStatus
      Rte_Ev_Run_Omc_LifeCycleHandler
      Rte_Ev_Run_StdDiag_LifeCycleHandler
      Rte_Ev_Run_Stm_Runnable_ErrorCentralErrorLock
      Rte_Ev_Run_Stm_Runnable_ErrorEnergyMode
      Rte_Ev_Run_Stm_Runnable_ErrorVehicleState
      Rte_Ev_Run_Stm_Runnable_ReceiveCentralErrorLock
      Rte_Ev_Run_Stm_Runnable_ReceiveEnergyMode
      Rte_Ev_Run_Stm_Runnable_ReceiveVehicleState
      Rte_Ev_Run_SysTime_LifeCycleHandler
    3 x OsApplication:
      OsApplication_ASIL: OsTrusted=true, OsAppTaskRef=Default_BSW_Sync_Task, OsAppAlarmRef=Os/Rte_Al_TE2_Default_BSW_Sync_Task_0_5ms, OsAppTaskRef=OsTask_BSW_ASIL, OsAppAlarmRef=Os/Rte_Al_TE2_OsTask_BSW_ASIL_0_10ms, OsAppAlarmRef=Os/Rte_Al_TE2_OsTask_BSW_ASIL_0_20ms, OsAppAlarmRef=Os/Rte_Al_TE2_OsTask_BSW_ASIL_0_2ms, OsAppAlarmRef=Os/Rte_Al_TE2_OsTask_BSW_ASIL_0_5ms
      OsApplication_QM: OsTrusted=false, OsAppTaskRef=Default_BAC_Appl_BMW_Task, OsAppAlarmRef=Os/Rte_Al_TE_Darh_QueueHandler, OsAppAlarmRef=Os/Rte_Al_TE_SysTime_MainFunction, OsAppTaskRef=Default_RTE_Mode_switch_Task, OsAppAlarmRef=Os/Rte_Al_TE_BMW_Application_Main_Xcp_Event_Runnable, OsAppAlarmRef=Os/Rte_Al_TE_IntegrationSample_IntegrationSampleTimerFunction
      SystemApplication_OsCore_CORE0: OsTrusted=true, OsAppTaskRef=OsTask_LowPrioNvm, OsAppAlarmRef=Os/Rte_Al_TE2_OsTask_LowPrioNvm_0_10ms, OsAppAlarmRef=Os/Rte_Al_TE_Fee_30_SmallSector_Fee_30_SmallSector_MainFunction
  ecuc value collection DaVinci_Project: ecuc-values=[Com, Rte, Os, NvM]
