AUTOSAR XML (schema 4-3-0)
# \copyright BMW AG 2015 - 2016
package /BMW/Platform/Dlog/CompuMethods
  compu method CM_DlogHistoryType: 0=DLOG_HISTORY_SYSTEMSUPPLIER, 1=DLOG_HISTORY_PLANT, 2=DLOG_HISTORY_BACKUP_01, 3=DLOG_HISTORY_BACKUP_02, 4=DLOG_HISTORY_BACKUP_03, else DLOG_HISTORY_SYSTEMSUPPLIER
package /BMW/Platform/Dlog/DataTypeMappingSets
  data type mapping set DlogTypeMappings: mode-request-type-map{implementation-data-type=Dlog_LifeCycleRequestType, mode-group=Dlog_LifeCycle}
package /BMW/Platform/Dlog/ImplementationDataTypes
  4 x impl type:
    Dlog_LifeCycleRequestType: compu {0=DLOG_INITIALIZED, 1=DLOG_RUNNING, 2=DLOG_STOPPED}, implementation-data-type=uint8
    Dlog_ProgIdArrayType: category=ARRAY
      element Dlog_ProgIdSubArrayType: array-size=8, array-size-semantics=FIXED-SIZE, implementation-data-type=uint8
    Dlog_SgbmIdArrayType: category=ARRAY
      element SubSgbmIdType: array-size=8, array-size-semantics=FIXED-SIZE, implementation-data-type=uint8
    Dlog_SignatureArrayType: category=ARRAY
      element SubSignatureArrayType: array-size=260, array-size-semantics=FIXED-SIZE, implementation-data-type=uint8
package /BMW/Platform/Dlog/ModeDeclarationGroups
  mode declaration group Dlog_LifeCycle: category=EXPLICIT_ORDER, initial-mode=DLOG_STOPPED, on-transition-value=3
    mode DLOG_INITIALIZED: value=0
    mode DLOG_RUNNING: value=1
    mode DLOG_STOPPED: value=2
package /BMW/Platform/Dlog/PortInterfaces
  client server interface EcuInfo
    operation GetEcuId: possible-error=EcuInfo/E_NOT_OK
      arg ecuId: type=uint8, direction=OUT, server-argument-impl-policy=USE-ARGUMENT-TYPE
    operation GetVin: possible-error=EcuInfo/E_NOT_OK
      arg Vin: type=Dlog_VinArrayType, direction=OUT, server-argument-impl-policy=USE-ARRAY-BASE-TYPE
    error E_NOT_OK: error-code=1
  mode switch interface ILifeCycle
    mode group Mode: type=Dlog_LifeCycle
  sender receiver interface ILifeCycleRequest: is-service=true
    data requestMode: type=Dlog_LifeCycleRequestType
  sender receiver interface ProgId
    data progId: type=Dlog_ProgIdArrayType
  client server interface SweSignatureAccess
    5 x operation, all with possible-error=SweSignatureAccess/E_NOT_OK:
      GetNumSig
        arg sweId: type=uint8, direction=IN
        arg numSig: type=uint8, direction=OUT
      GetSigStart
        arg sweId: type=uint8, direction=IN
        arg blkNum: type=uint8, direction=IN
        arg address: type=uint32, direction=OUT
      GetSigLength
        arg sweId: type=uint8, direction=IN
        arg blkNum: type=uint8, direction=IN
        arg length: type=uint32, direction=OUT
      GetSignature
        arg sweId: type=uint8, direction=IN
        arg signature: type=Dlog_SignatureArrayType, direction=OUT
      GetNumSwe
        arg numSwe: type=uint8, direction=OUT
    error E_NOT_OK: error-code=1
