AUTOSAR XML (schema 4-3-0)
# \copyright BMW AG 2015 - 2017
package /BMW/Platform/StdDiag/Darh/ImplementationDataTypes
  impl type Darh_RoeStateType: compu {0=DARH_ROE_STOPPED, 1=DARH_ROE_STARTED, 2=DARH_ROE_UNKNOWN}, implementation-data-type=uint8
package /BMW/Platform/StdDiag/Darh/PortInterfaces
  client server interface RoeStateInterface
    operation GetRoeState: possible-error=RoeStateInterface/E_NOT_OK
      arg RoeState: type=Darh_RoeStateType, direction=OUT
    error E_NOT_OK: error-code=1
package /BMW/Platform/StdDiag/Omc/PortInterfaces
  client server interface OmcModesCallouts
    operation AllowOpModeSwitch: possible-error=[OmcModesCallouts/E_NOT_OK, E_RUNNING]
      4 x arg, all with direction=IN, server-argument-impl-policy=USE-ARGUMENT-TYPE:
        OperatingMode: type=Omc_OperatingModeType
        ExtendedOperatingMode: type=Omc_ExtendedOperatingModeType
        NewOperatingMode: type=Omc_OperatingModeType
        NewExtendedOperatingMode: type=Omc_ExtendedOperatingModeType
    operation OpModeSwitchCancelled: possible-error=[OmcModesCallouts/E_OK, E_RUNNING]
      4 x arg, all with direction=IN, server-argument-impl-policy=USE-ARGUMENT-TYPE:
        OperatingMode: type=Omc_OperatingModeType
        ExtendedOperatingMode: type=Omc_ExtendedOperatingModeType
        RequestedOperatingMode: type=Omc_OperatingModeType
        RequestedExtendedOperatingMode: type=Omc_ExtendedOperatingModeType
    error E_OK: error-code=0
    error E_NOT_OK: error-code=1
    error E_RUNNING: error-code=10
  client server interface OmcModesCalloutsResult
    operation OpModeSwitchAllowedResult: possible-error=OmcModesCalloutsResult/E_OK
      arg Result: type=boolean, direction=IN, server-argument-impl-policy=USE-ARGUMENT-TYPE
    operation OpModeSwitchCancelledAck: possible-error=OmcModesCalloutsResult/E_OK
    error E_OK: error-code=0
  mode switch interface ExtendedOperatingModeNotification
    mode group currentExtendedOperatingMode: type=OmcExtendedOperatingMode
  mode switch interface OperatingModeNotification
    mode group currentOperatingMode: type=OmcOperatingMode
package /BMW/Platform/StdDiag/Omc/ModeDeclarationGroups
  mode declaration group OmcExtendedOperatingMode: category=EXPLICIT_ORDER, initial-mode=OMC_MODE_EXTENSION_NORMAL, on-transition-value=254
    17 x mode:
      OMC_MODE_EXTENSION_NORMAL: value=0
      OMC_MODE_EXTENSION_{1..14}: value={1..14}
      OMC_MODE_EXTENSION_SAVE_ENERGY: value=15
      OMC_MODE_EXTENSION_INVALID: value=255
  mode declaration group OmcOperatingMode: category=EXPLICIT_ORDER, initial-mode=OMC_MODE_NORMAL, on-transition-value=255
    4 x mode:
      OMC_MODE_NORMAL: value=0
      OMC_MODE_ASSEMBLY: value=1
      OMC_MODE_TRANSPORT: value=2
      OMC_MODE_BMW_FLASH: value=3
package /BMW/Platform/StdDiag/Omc/ImplementationDataTypes
  impl type Omc_ExtendedOperatingModeType: compu {0=OMC_MODE_EXTENSION_NORMAL, 1..14=OMC_MODE_EXTENSION_1..OMC_MODE_EXTENSION_14, 15=OMC_MODE_EXTENSION_SAVE_ENERGY, 255=OMC_MODE_EXTENSION_INVALID}, implementation-data-type=uint8
  impl type Omc_OperatingModeType: compu {0=OMC_MODE_NORMAL, 1=OMC_MODE_ASSEMBLY, 2=OMC_MODE_TRANSPORT, 3=OMC_MODE_BMW_FLASH}, implementation-data-type=uint8
package /BMW/Platform/StdDiag/Omc/DataTypeMappingSets
  data type mapping set Omc_DataTypeMappingSets
    mode-request-type-maps:
      implementation-data-type=Omc_OperatingModeType, mode-group=OmcOperatingMode
      implementation-data-type=Omc_ExtendedOperatingModeType, mode-group=OmcExtendedOperatingMode
package /BMW/Platform/StdDiag/Stm/PortInterfaces
  mode switch interface VehicleStateModeInterface
    mode group currentVehicleStateMode: type=Stm_VehicleStateMode
package /BMW/Platform/StdDiag/Stm/ModeDeclarationGroups
  mode declaration group Stm_VehicleStateMode: initial-mode=STM_VEHICLE_STATE_UNAVAILABLE
    10 x mode:
      STM_VEHICLE_STATE_PARKING_BN_NOK
      STM_VEHICLE_STATE_PARKING_BN_OK
      STM_VEHICLE_STATE_CUSTOMER_ABSENT
      STM_VEHICLE_STATE_LIVING
      STM_VEHICLE_STATE_CHECK_ANALYS_DIAGNOSTICS
      STM_VEHICLE_STATE_READINESS_TO_DRIVE_INIT
      STM_VEHICLE_STATE_DRIVE
      STM_VEHICLE_STATE_READINESS_TO_DRIVE_STOP
      STM_VEHICLE_STATE_UNAVAILABLE
      STM_VEHICLE_STATE_INVALID
package /BMW/Platform/StdDiag/Stm/ImplementationDataTypes
  impl type Stm_VehicleStateType: compu {1=STM_VEHICLE_STATE_PARKING_BN_NOK, 2=STM_VEHICLE_STATE_PARKING_BN_OK, 3=STM_VEHICLE_STATE_CUSTOMER_ABSENT, 5=STM_VEHICLE_STATE_LIVING, 7=STM_VEHICLE_STATE_CHECK_ANALYS_DIAGNOSTICS, 8=STM_VEHICLE_STATE_READINESS_TO_DRIVE_INIT, 10=STM_VEHICLE_STATE_DRIVE, 12=STM_VEHICLE_STATE_READINESS_TO_DRIVE_STOP, 14=STM_VEHICLE_STATE_UNAVAILABLE, 15=STM_VEHICLE_STATE_INVALID}, implementation-data-type=uint8
package /BMW/Platform/StdDiag/Stm/DataTypeMappingSets
  data type mapping set Stm_VehicleStatModeRequestTypeMap: mode-request-type-map{implementation-data-type=Stm_VehicleStateType, mode-group=Stm_VehicleStateMode}
package /BMW/Platform/StdDiag/Dcm/ImplementationDataTypes
  10 x impl type:
    Dcm_SesCtrlType: compu {0x01=DCM_DEFAULT_SESSION, 0x02=DCM_PROGRAMMING_SESSION, 0x03=DCM_EXTENDED_DIAGNOSTIC_SESSION, 0x04=DCM_SAFETY_SYSTEM_DIAGNOSTIC_SESSION, 0x41=DCM_CODING_SESSION, 0x42=DCM_SWT_SESSION}, range raw 0x01..0x42, implementation-data-type=uint8
    Dcm_OpStatusType: compu {0x00=DCM_INITIAL, 0x01=DCM_PENDING, 0x02=DCM_CANCEL, 0x03=DCM_FORCE_RCRRP_OK}, range raw 0x00..0x03, implementation-data-type=uint8
    Dcm_ConfirmationStatusType: compu {0x00=DCM_RES_POS_OK, 0x01=DCM_RES_POS_NOT_OK, 0x02=DCM_RES_NEG_OK, 0x03=DCM_RES_NEG_NOT_OK}, range raw 0x00..0x03, implementation-data-type=uint8
    Dcm_NegativeResponseCodeType:
      compu {0x8F=DCM_E_BRAKESWITCH_NOTCLOSED, 0x21=DCM_E_BUSYREPEATREQUEST, 0x22=DCM_E_CONDITIONSNOTCORRECT, 0x84=DCM_E_ENGINEISNOTRUNNING, 0x83=DCM_E_ENGINEISRUNNING, 0x85=DCM_E_ENGINERUNTIMETOOLOW, 0x36=DCM_E_EXCEEDNUMBEROFATTEMPTS, 0x26=DCM_E_FAILUREPREVENTSEXECUTIONOFREQUESTEDACTION, 0x72=DCM_E_GENERALPROGRAMMINGFAILURE, 0x10=DCM_E_GENERALREJECT, 0x13=DCM_E_INCORRECTMESSAGELENGTHORINVALIDFORMAT, 0x35=DCM_E_INVALIDKEY, 0x25=DCM_E_NORESPONSEFROMSUBNETCOMPONENT, 0x31=DCM_E_REQUESTOUTOFRANGE, 0x24=DCM_E_REQUESTSEQUENCEERROR, 0x37=DCM_E_REQUIREDTIMEDELAYNOTEXPIRED, 0x14=DCM_E_RESPONSETOOLONG, 0x81=DCM_E_RPMTOOHIGH, 0x82=DCM_E_RPMTOOLOW, 0x33=DCM_E_SECURITYACCESSDENIED, 0x11=DCM_E_SERVICENOTSUPPORTED, 0x7F=DCM_E_SERVICENOTSUPPORTEDINACTIVESESSION, 0x90=DCM_E_SHIFTERLEVERNOTINPARK, 0x12=DCM_E_SUBFUNCTIONNOTSUPPORTED, 0x7E=DCM_E_SUBFUNCTIONNOTSUPPORTEDINACTIVESESSION, 0x86=DCM_E_TEMPERATURETOOHIGH, 0x87=DCM_E_TEMPERATURETOOLOW, 0x8A=DCM_E_THROTTLE_PEDALTOOHIGH, 0x8B=DCM_E_THROTTLE_PEDALTOOLOW, 0x91=DCM_E_TORQUECONVERTERCLUTCHLOCKED, 0x71=DCM_E_TRANSFERDATASUSPENDED, 0x8D=DCM_E_TRANSMISSIONRANGENOTINGEAR, 0x8C=DCM_E_TRANSMISSIONRANGENOTINNEUTRAL, 0x70=DCM_E_UPLOADDOWNLOADNOTACCEPTED, 0x88=DCM_E_VEHICLESPEEDTOOHIGH, 0x89=DCM_E_VEHICLESPEEDTOOLOW, 0x92=DCM_E_VOLTAGETOOHIGH, 0x93=DCM_E_VOLTAGETOOLOW, 0x73=DCM_E_WRONGBLOCKSEQUENCECOUNTER, 0xF0=DCM_E_VMSCNC_0, 0xF1=DCM_E_VMSCNC_1, 0xF2=DCM_E_VMSCNC_2, 0xF3=DCM_E_VMSCNC_3, 0xF4=DCM_E_VMSCNC_4, 0xF5=DCM_E_VMSCNC_5, 0xF6=DCM_E_VMSCNC_6, 0xF7=DCM_E_VMSCNC_7, 0xF8=DCM_E_VMSCNC_8, 0xF9=DCM_E_VMSCNC_9, 0xFA=DCM_E_VMSCNC_A, 0xFB=DCM_E_VMSCNC_B, 0xFC=DCM_E_VMSCNC_C, 0xFD=DCM_E_VMSCNC_D, 0xFE=DCM_E_VMSCNC_E}
      range raw 0x10..0xFE
      implementation-data-type=uint8
    UpDownloadPrePostProcessing_ArrayType: category=ARRAY
      element data: array-size=273, array-size-semantics=FIXED-SIZE, implementation-data-type=uint8
    RequestDataArray: category=ARRAY
      element RequestDataArray: array-size=1024, array-size-semantics=FIXED-SIZE, implementation-data-type=uint8
    DiagCommLoopback_ArrayType: category=ARRAY
      element data: array-size=1024, array-size-semantics=FIXED-SIZE, implementation-data-type=uint8
    CheckProgrammingPreconditions_ArrayType: category=ARRAY
      element data: array-size=256, array-size-semantics=FIXED-SIZE, implementation-data-type=uint8
    ActiveSessionState_ArrayType: category=ARRAY
      element data: array-size=4, array-size-semantics=FIXED-SIZE, implementation-data-type=uint8
    SgbdIndex_ArrayType: category=ARRAY
      element data: array-size=3, array-size-semantics=FIXED-SIZE, implementation-data-type=uint8
package /BMW/Platform/StdDiag/Dcm/PortInterfaces
  8 x client server interface, all with is-service=true:
    ServiceRequestNotification
      operation Indication: possible-error=[ServiceRequestNotification/E_OK, ServiceRequestNotification/E_NOT_OK, E_REQUEST_NOT_ACCEPTED]
        6 x arg:
          SID: type=uint8, direction=IN
          RequestData: type=RequestDataArray, direction=IN
          DataSize: type=uint16, direction=IN
          ReqType: type=uint8, direction=IN
          SourceAddress: type=uint16, direction=IN
          ErrorCode: type=Dcm_NegativeResponseCodeType, direction=OUT
      operation Confirmation: possible-error=[ServiceRequestNotification/E_OK, ServiceRequestNotification/E_NOT_OK]
        4 x arg, all with direction=IN:
          SID: type=uint8
          ReqType: type=uint8
          SourceAddress: type=uint16
          ConfirmationStatus: type=Dcm_ConfirmationStatusType
      error E_OK: error-code=0
      error E_NOT_OK: error-code=1
      error E_REQUEST_NOT_ACCEPTED: error-code=8
    DataServices_ActiveSessionState
      operation ReadData: possible-error=[DataServices_ActiveSessionState/E_OK, DataServices_ActiveSessionState/E_NOT_OK]
        arg Data: type=ActiveSessionState_ArrayType, direction=OUT
      operation ConditionCheckRead: possible-error=[DataServices_ActiveSessionState/E_OK, DataServices_ActiveSessionState/E_NOT_OK]
        arg ErrorCode: type=Dcm_NegativeResponseCodeType, direction=OUT
      error E_OK: error-code=0
      error E_NOT_OK: error-code=1
    DataServices_SgbdIndex
      operation ReadData: possible-error=[DataServices_SgbdIndex/E_OK, DataServices_SgbdIndex/E_NOT_OK]
        arg Data: type=SgbdIndex_ArrayType, direction=OUT
      error E_OK: error-code=0
      error E_NOT_OK: error-code=1
    RoutineServices_UpDownloadPrePostProcessing
      operation Start: possible-error=[RoutineServices_UpDownloadPrePostProcessing/DCM_E_PENDING, RoutineServices_UpDownloadPrePostProcessing/E_NOT_OK, RoutineServices_UpDownloadPrePostProcessing/DCM_E_FORCE_RCRRP]
        5 x arg:
          Data: type=UpDownloadPrePostProcessing_ArrayType, direction=IN, server-argument-impl-policy=USE-ARRAY-BASE-TYPE
          OpStatus: type=Dcm_OpStatusType, direction=IN
          Result: type=uint8, direction=OUT, server-argument-impl-policy=USE-ARRAY-BASE-TYPE
          currentDataLength: type=uint16, direction=IN
          ErrorCode: type=Dcm_NegativeResponseCodeType, direction=OUT
      error E_NOT_OK: error-code=1
      error DCM_E_PENDING: error-code=10
      error DCM_E_FORCE_RCRRP: error-code=12
    RoutineServices_DiagCommLoopback
      operation Start: possible-error=[RoutineServices_DiagCommLoopback/E_OK, RoutineServices_DiagCommLoopback/E_NOT_OK, RoutineServices_DiagCommLoopback/DCM_E_PENDING, RoutineServices_DiagCommLoopback/DCM_E_FORCE_RCRRP]
        5 x arg:
          dataIn: type=DiagCommLoopback_ArrayType, direction=IN
          OpStatus: type=Dcm_OpStatusType, direction=IN
          dataOut: type=DiagCommLoopback_ArrayType, direction=OUT
          currentDataLength: type=uint16, direction=INOUT
          ErrorCode: type=Dcm_NegativeResponseCodeType, direction=OUT
      4 x error:
        E_OK: error-code=0
        E_NOT_OK: error-code=1
        DCM_E_PENDING: error-code=10
        DCM_E_FORCE_RCRRP: error-code=12
    RoutineServices_CheckProgrammingPreconditions
      operation Start: possible-error=[RoutineServices_CheckProgrammingPreconditions/E_OK, RoutineServices_CheckProgrammingPreconditions/E_NOT_OK, RoutineServices_CheckProgrammingPreconditions/DCM_E_PENDING, RoutineServices_CheckProgrammingPreconditions/DCM_E_FORCE_RCRRP]
        4 x arg:
          OpStatus: type=Dcm_OpStatusType, direction=IN
          dataOut: type=CheckProgrammingPreconditions_ArrayType, direction=OUT
          currentDataLength: type=uint16, direction=OUT
          ErrorCode: type=Dcm_NegativeResponseCodeType, direction=OUT
      4 x error:
        E_OK: error-code=0
        E_NOT_OK: error-code=1
        DCM_E_PENDING: error-code=10
        DCM_E_FORCE_RCRRP: error-code=12
    StdDiagDCMServices
      operation GetSesCtrlType: possible-error=[StdDiagDCMServices/E_OK, StdDiagDCMServices/E_NOT_OK]
        arg SesCtrlType: type=Dcm_SesCtrlType, direction=OUT
      error E_OK: error-code=0
      error E_NOT_OK: error-code=1
    RoutineServices_ClearDTCSecondaryErrorMemory
      operation Start: possible-error=[RoutineServices_ClearDTCSecondaryErrorMemory/DCM_E_PENDING, RoutineServices_ClearDTCSecondaryErrorMemory/E_NOT_OK, RoutineServices_ClearDTCSecondaryErrorMemory/DCM_E_FORCE_RCRRP]
        arg OpStatus: type=Dcm_OpStatusType, direction=IN
        arg ErrorCode: type=Dcm_NegativeResponseCodeType, direction=OUT
      error E_NOT_OK: error-code=1
      error DCM_E_PENDING: error-code=10
      error DCM_E_FORCE_RCRRP: error-code=12
package /BMW/Platform/StdDiag/Dem/ImplementationDataTypes
  impl type Dem_DTCOriginType: compu {0x01=DEM_DTC_ORIGIN_PRIMARY_MEMORY, 0x02=DEM_DTC_ORIGIN_MIRROR_MEMORY, 0x03=DEM_DTC_ORIGIN_PERMANENT_MEMORY, 4=DEM_DTC_ORIGIN_USERDEFINED_MEMORY_BMWSecondaryErrorMemory}, range raw 0x01..4, implementation-data-type=uint8
  impl type Dem_DTCFormatType: compu {0=DEM_DTC_FORMAT_OBD, 1=DEM_DTC_FORMAT_UDS, 2=DEM_DTC_FORMAT_J1939}, range raw 0..2, implementation-data-type=uint8
package /BMW/Platform/StdDiag/Dem/PortInterfaces
  client server interface CddIf: is-service=true
    operation ClearDTC: possible-error=[CddIf/E_OK, DEM_CLEAR_WRONG_DTC, DEM_CLEAR_WRONG_DTCORIGIN, DEM_CLEAR_FAILED, DEM_CLEAR_PENDING, DEM_CLEAR_BUSY, DEM_CLEAR_MEMORY_ERROR]
      arg DTC: type=uint32, direction=IN, server-argument-impl-policy=USE-ARGUMENT-TYPE
      arg DTCFormat: type=Dem_DTCFormatType, direction=IN, server-argument-impl-policy=USE-ARGUMENT-TYPE
      arg DTCOrigin: type=Dem_DTCOriginType, direction=IN, server-argument-impl-policy=USE-ARGUMENT-TYPE
    7 x error:
      E_OK: error-code=0
      DEM_CLEAR_WRONG_DTC: error-code=1
      DEM_CLEAR_WRONG_DTCORIGIN: error-code=2
      DEM_CLEAR_FAILED: error-code=3
      DEM_CLEAR_PENDING: error-code=4
      DEM_CLEAR_BUSY: error-code=5
      DEM_CLEAR_MEMORY_ERROR: error-code=6
  client server interface EnableCondition: is-service=true
    operation SetEnableCondition: possible-error=[EnableCondition/E_OK, EnableCondition/E_NOT_OK]
      arg ConditionFulfilled: type=boolean, direction=IN, server-argument-impl-policy=USE-ARGUMENT-TYPE
    error E_OK: error-code=0
    error E_NOT_OK: error-code=1
package /BMW/Platform/StdDiag/Det/PortInterfaces
  client server interface DETService: is-service=true
    operation ReportError: possible-error=DETService/E_OK
      arg InstanceId: type=uint8, direction=IN
      arg ApiId: type=uint8, direction=IN
      arg ErrorId: type=uint8, direction=IN
    error E_OK: error-code=0
