AUTOSAR XML (schema 4-3-0)
# \copyright BMW AG 2016 - 2017
package /BMW/Platform/IntegrationSample/CompuMethods
  compu method CM_StatusEnergyFZM: 1=ENSTATE_OK (StatusEnergyFZM_ENSTATE_OK), 0=ENSTATE_GOOD (StatusEnergyFZM_ENSTATE_GOOD), 2=ENSTATE_SHORTAGE (StatusEnergyFZM_ENSTATE_SHORTAGE), 255=signal_Unfilled (StatusEnergyFZM_signal_Unfilled), 3=ENSTATE_SEVERE_SHORTAGE (StatusEnergyFZM_ENSTATE_SEVERE_SHORTAGE)
package /BMW/Platform/IntegrationSample/DataTypeMappingSets
  data type mapping set IntegrationSampleModemappingEcuRunState: mode-request-type-map{implementation-data-type=IntegrationSample_EcuRunStateModeRequestType, mode-group=IntegrationSample_EcuRunState}
  data type mapping set IntegrationSampleModemappingSimpleTimerMode: mode-request-type-map{implementation-data-type=IntegrationSample_SimpleTimerStateType, mode-group=IntegrationSample_SimpleTimerState}
package /BMW/Platform/IntegrationSample/ImplementationDataTypes
  8 x impl type:
    IS_ST_CON_VEH_Type: compu {1=IS_VEHICLE_STATE__PARKING_BN_NOK, 2=IS_VEHICLE_STATE__PARKING_BN_OK, 3=IS_VEHICLE_STATE__CUSTOMER_ABSENT, 5=IS_VEHICLE_STATE__LIVING, 7=IS_VEHICLE_STATE__CHECK_ANALYS_DIAGNOSTICS, 8=IS_VEHICLE_STATE__READINESS_TO_DRIVE_INIT, 10=IS_VEHICLE_STATE__DRIVE, 12=IS_VEHICLE_STATE__READINESS_TO_DRIVE_STOP, 14=IS_VEHICLE_STATE__UNAVAILABLE, 15=IS_VEHICLE_STATE__INVALID}, implementation-data-type=uint8
    IntegrationSample_CON_VEH_Type: category=STRUCTURE
      element IntegrationSample_ST_CON_VEH: implementation-data-type=uint8
      element IntegrationSample_CTR_FKTN_PRTNT: implementation-data-type=uint32
      element IntegrationSample_CTR_BS_PRTNT: implementation-data-type=uint8
    IntegrationSample_EcuRunStateModeRequestType: compu {0=IntegrationSample_INVALID_STATE, 1=IntegrationSample_BSW_START, 2=IntegrationSample_STARTUP, 3=IntegrationSample_NORMAL_OPERATION, 4=IntegrationSample_SHUTDOWN}, implementation-data-type=uint8
    IntegrationSample_SimpleTimerStateType: compu {0=IntegrationSample_Timer_FIRE, 1=IntegrationSample_Timer_IDLE, 2=IntegrationSample_Timer_RUNNING}, implementation-data-type=uint8
    MileageKilometreType: category=STRUCTURE
      element mileageKilometre: implementation-data-type=uint32
    VehicleState_Type: category=STRUCTURE
      element statusEnergyFZM: compu-method=CM_StatusEnergyFZM, implementation-data-type=StatusEnergyFZM_Type
      element statusInterlockErrorMemoryFZM: implementation-data-type=StatusInterlockErrorMemoryFZM_Type
    StatusEnergyFZM_Type: compu-method=CM_StatusEnergyFZM, implementation-data-type=uint8
    StatusInterlockErrorMemoryFZM_Type: compu {0=ErrorMemoryUnlock (StatusInterlockErrorMemoryFZM_ErrorMemoryUnlock), 1=ErrorMemoryLock (StatusInterlockErrorMemoryFZM_ErrorMemoryLock), 2=Reserved (StatusInterlockErrorMemoryFZM_Reserved), 255=Signal_Unfilled (StatusInterlockErrorMemoryFZM_Signal_Unfilled)}, implementation-data-type=uint8
package /BMW/Platform/IntegrationSample/ModeDeclarationGroups
  mode declaration group IntegrationSample_EcuRunState: category=EXPLICIT_ORDER, initial-mode=IntegrationSample_BSW_START, on-transition-value=5
    5 x mode:
      IntegrationSample_INVALID_STATE: value=0
      IntegrationSample_BSW_START: value=1
      IntegrationSample_STARTUP: value=2
      IntegrationSample_NORMAL_OPERATION: value=3
      IntegrationSample_SHUTDOWN: value=4
  mode declaration group IntegrationSample_SimpleTimerState: category=EXPLICIT_ORDER, initial-mode=IntegrationSample_Timer_IDLE, on-transition-value=3
    mode IntegrationSample_Timer_IDLE: value=0
    mode IntegrationSample_Timer_RUNNING: value=1
    mode IntegrationSample_Timer_FIRE: value=2
package /BMW/Platform/IntegrationSample/PortInterfaces
  mode switch interface IEcuRunState: is-service=true
    mode group EcuRunStateMode: sw-calibration-access=READ-ONLY, type=IntegrationSample_EcuRunState
  mode switch interface ISimpleTimer
    mode group SimpleTimerMode: sw-calibration-access=READ-ONLY, type=IntegrationSample_SimpleTimerState
  5 x sender receiver interface:
    IEcuRunStateRequest: is-service=true
      data IntegrationSample_EcuRunStateRequestMode: type=IntegrationSample_EcuRunStateModeRequestType
    IntegrationSample_Signal_ST_CON_VEH
      data VehicleState: type=IS_ST_CON_VEH_Type
    SRI_SA_Kilometer_R
      data Notifier: category=STRUCTURE, type=MileageKilometreType, init-value={short-label=value_CrBrLeft1Dot6777215E7CrBrRight, fields=value_1Dot6777215E7:16777215}
    SRI_SGG_CON_VEH_R
      data IntegrationSample_IDT_CON_VEH: type=IntegrationSample_CON_VEH_Type, init-value={short-label=IntegrationSample_InValues_SGG_Rx_CON_VEH, fields=[InV_SGG_Rx_CON_VEH_ST_CON_VEH:0xF, InV_SGG_Rx_CON_VEH_CTR_FKTN_PRTNT:0xFFFFFFFF, InV_SGG_Rx_CON_VEH_CTR_BS_PRTNT:0xF]}
    SRI_FieldNotifierVehicleStatus
      data Notifier: category=STRUCTURE, type=VehicleState_Type
