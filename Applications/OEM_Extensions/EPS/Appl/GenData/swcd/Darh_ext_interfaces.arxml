AUTOSAR XML (schema 4-2-2)
# \copyright BMW AG 2017
package /BMW/Platform/Darh/Dcm/ModeDeclarationGroups
  mode declaration group DcmResponseOnEvent: initial-mode=EVENT_CLEARED
    mode EVENT_STARTED
    mode EVENT_STOPPED
    mode EVENT_CLEARED
package /BMW/Platform/Darh/Dcm/ImplementationDataTypes
  6 x impl type:
    Darh_ErrorQueueDataType: category=ARRAY
      element AuxU8_Darh_ErrorQueueDataType: array-size=21, array-size-semantics=FIXED-SIZE, implementation-data-type=uint8
    Darh_ActivelyReportedErrorListType: category=ARRAY
      element AuxU8_Darh_ActivelyReportedError: array-size=6, array-size-semantics=FIXED-SIZE, implementation-data-type=uint8
    Dcm_RequestData_ArrayType: category=ARRAY
      element AuxU8_Dcm_RequestData_ArrayType: array-size=1024, array-size-semantics=FIXED-SIZE, implementation-data-type=uint8
    Dcm_NegativeResponseCodeType:
      compu {0x8F=DCM_E_BRAKESWITCH_NOTCLOSED, 0x21=DCM_E_BUSYREPEATREQUEST, 0x22=DCM_E_CONDITIONSNOTCORRECT, 0x84=DCM_E_ENGINEISNOTRUNNING, 0x83=DCM_E_ENGINEISRUNNING, 0x85=DCM_E_ENGINERUNTIMETOOLOW, 0x36=DCM_E_EXCEEDNUMBEROFATTEMPTS, 0x26=DCM_E_FAILUREPREVENTSEXECUTIONOFREQUESTEDACTION, 0x72=DCM_E_GENERALPROGRAMMINGFAILURE, 0x10=DCM_E_GENERALREJECT, 0x13=DCM_E_INCORRECTMESSAGELENGTHORINVALIDFORMAT, 0x35=DCM_E_INVALIDKEY, 0x25=DCM_E_NORESPONSEFROMSUBNETCOMPONENT, 0x31=DCM_E_REQUESTOUTOFRANGE, 0x24=DCM_E_REQUESTSEQUENCEERROR, 0x37=DCM_E_REQUIREDTIMEDELAYNOTEXPIRED, 0x14=DCM_E_RESPONSETOOLONG, 0x81=DCM_E_RPMTOOHIGH, 0x82=DCM_E_RPMTOOLOW, 0x33=DCM_E_SECURITYACCESSDENIED, 0x11=DCM_E_SERVICENOTSUPPORTED, 0x7F=DCM_E_SERVICENOTSUPPORTEDINACTIVESESSION, 0x90=DCM_E_SHIFTERLEVERNOTINPARK, 0x12=DCM_E_SUBFUNCTIONNOTSUPPORTED, 0x7E=DCM_E_SUBFUNCTIONNOTSUPPORTEDINACTIVESESSION, 0x86=DCM_E_TEMPERATURETOOHIGH, 0x87=DCM_E_TEMPERATURETOOLOW, 0x8A=DCM_E_THROTTLE_PEDALTOOHIGH, 0x8B=DCM_E_THROTTLE_PEDALTOOLOW, 0x91=DCM_E_TORQUECONVERTERCLUTCHLOCKED, 0x71=DCM_E_TRANSFERDATASUSPENDED, 0x8D=DCM_E_TRANSMISSIONRANGENOTINGEAR, 0x8C=DCM_E_TRANSMISSIONRANGENOTINNEUTRAL, 0x70=DCM_E_UPLOADDOWNLOADNOTACCEPTED, 0x88=DCM_E_VEHICLESPEEDTOOHIGH, 0x89=DCM_E_VEHICLESPEEDTOOLOW, 0x92=DCM_E_VOLTAGETOOHIGH, 0x93=DCM_E_VOLTAGETOOLOW, 0x73=DCM_E_WRONGBLOCKSEQUENCECOUNTER, 0xF0=DCM_E_VMSCNC_0, 0xF1=DCM_E_VMSCNC_1, 0xF2=DCM_E_VMSCNC_2, 0xF3=DCM_E_VMSCNC_3, 0xF4=DCM_E_VMSCNC_4, 0xF5=DCM_E_VMSCNC_5, 0xF6=DCM_E_VMSCNC_6, 0xF7=DCM_E_VMSCNC_7, 0xF8=DCM_E_VMSCNC_8, 0xF9=DCM_E_VMSCNC_9, 0xFA=DCM_E_VMSCNC_A, 0xFB=DCM_E_VMSCNC_B, 0xFC=DCM_E_VMSCNC_C, 0xFD=DCM_E_VMSCNC_D, 0xFE=DCM_E_VMSCNC_E}
      range raw 0x10..0xFE
      implementation-data-type=uint8
    Dcm_ConfirmationStatusType: compu {0=DCM_RES_POS_OK, 1=DCM_RES_POS_NOT_OK, 2=DCM_RES_NEG_OK, 3=DCM_RES_NEG_NOT_OK}, range raw 0x00..0x03, implementation-data-type=uint8
    Dcm_OpStatusType: compu {0=DCM_INITIAL, 1=DCM_PENDING, 2=DCM_CANCEL, 3=DCM_FORCE_RCRRP_OK}, range raw 0x00..0x03, implementation-data-type=uint8
package /BMW/Platform/Darh/Dcm/PortInterfaces
  mode switch interface DcmResponseOnEvent: is-service=true
    mode group currentMode: type=DcmResponseOnEvent
  client server interface DataServices_ActivelyReportedDtc: is-service=true
    operation ReadDataLength: possible-error=DataServices_ActivelyReportedDtc/E_NOT_OK
      arg DataLength: type=uint16, direction=OUT
    operation ReadData: possible-error=DataServices_ActivelyReportedDtc/E_NOT_OK
      arg Data: type=Darh_ActivelyReportedErrorListType, direction=OUT
    operation ConditionCheckRead: possible-error=DataServices_ActivelyReportedDtc/E_NOT_OK
      arg ErrorCode: type=Dcm_NegativeResponseCodeType, direction=OUT
    error DCM_E_PENDING: error-code=10
    error E_NOT_OK: error-code=1
  client server interface RoutineServices_TriggerDTC: is-service=true
    operation Start: possible-error=[RoutineServices_TriggerDTC/E_NOT_OK, RoutineServices_TriggerDTC/DCM_E_PENDING, RoutineServices_TriggerDTC/DCM_E_FORCE_RCRRP]
      7 x arg:
        DTCType: type=uint8, direction=IN
        OpStatus: type=Dcm_OpStatusType, direction=IN
        DTCTypeOut: type=uint8, direction=OUT
        DTCByte{1..3}: type=uint8, direction=OUT
        ErrorCode: type=Dcm_NegativeResponseCodeType, direction=OUT
    error DCM_E_FORCE_RCRRP: error-code=12
    error DCM_E_PENDING: error-code=10
    error E_NOT_OK: error-code=1
  client server interface RoutineServices_StartStopRoutineDiagnoseMaster: is-service=true
    operation Start: possible-error=[RoutineServices_StartStopRoutineDiagnoseMaster/E_NOT_OK, RoutineServices_StartStopRoutineDiagnoseMaster/DCM_E_PENDING, RoutineServices_StartStopRoutineDiagnoseMaster/DCM_E_FORCE_RCRRP]
      arg OpStatus: type=Dcm_OpStatusType, direction=IN
      arg ErrorCode: type=Dcm_NegativeResponseCodeType, direction=OUT
    operation Stop: possible-error=[RoutineServices_StartStopRoutineDiagnoseMaster/E_NOT_OK, RoutineServices_StartStopRoutineDiagnoseMaster/DCM_E_PENDING, RoutineServices_StartStopRoutineDiagnoseMaster/DCM_E_FORCE_RCRRP]
      arg OpStatus: type=Dcm_OpStatusType, direction=IN
      arg ErrorCode: type=Dcm_NegativeResponseCodeType, direction=OUT
    error DCM_E_FORCE_RCRRP: error-code=12
    error DCM_E_PENDING: error-code=10
    error E_NOT_OK: error-code=1
package /BMW/Platform/Darh/Dcm/DataTypeMappingSets
  data type mapping set Dcm_ModeRequestTypeMappings: mode-request-type-map{implementation-data-type=uint8, mode-group=DcmResponseOnEvent}
package /BMW/Platform/Darh/Dem/ImplementationDataTypes
  4 x impl type:
    Dem_EventIdType: range raw 1..72, implementation-data-type=uint16
    Dem_DTCFormatType: compu {0=DEM_DTC_FORMAT_OBD, 1=DEM_DTC_FORMAT_UDS, 2=DEM_DTC_FORMAT_J1939}, range raw 0..2, implementation-data-type=uint8
    Dem_MaxDataValueType: category=ARRAY
      element Dem_MaxDataValueElement: array-size=4, array-size-semantics=FIXED-SIZE, implementation-data-type=uint8
    Dem_EventStatusType: compu {0=DEM_EVENT_STATUS_PASSED, 1=DEM_EVENT_STATUS_FAILED, 2=DEM_EVENT_STATUS_PREPASSED, 3=DEM_EVENT_STATUS_PREFAILED, 4=DEM_EVENT_STATUS_FDC_THRESHOLD_REACHED}, range raw 0..4, implementation-data-type=uint8
package /BMW/Platform/Darh/Dem/PortInterfaces
  4 x client server interface, all with is-service=true:
    Darh_GeneralDiagnosticInfo
      operation GetDTCOfEvent: possible-error=[Darh_GeneralDiagnosticInfo/E_NOT_OK, Darh_GeneralDiagnosticInfo/DEM_E_NO_DTC_AVAILABLE]
        arg EventId: type=Dem_EventIdType, direction=IN
        arg DTCFormat: type=Dem_DTCFormatType, direction=IN
        arg DTCOfEvent: type=uint32, direction=OUT
      operation GetEventFreezeFrameData: possible-error=[Darh_GeneralDiagnosticInfo/E_NOT_OK, DEM_E_NODATAAVAILABLE, DEM_E_WRONG_RECORDNUMBER, DEM_E_WRONG_DIDNUMBER]
        5 x arg:
          EventId: type=Dem_EventIdType, direction=IN
          RecordNumber: type=uint8, direction=IN
          ReportTotalRecord: type=boolean, direction=IN
          DataId: type=uint16, direction=IN
          DestBuffer: type=Dem_MaxDataValueType, direction=OUT
      5 x error:
        E_NOT_OK: error-code=1
        DEM_E_NO_DTC_AVAILABLE: error-code=2
        DEM_E_NODATAAVAILABLE: error-code=48
        DEM_E_WRONG_RECORDNUMBER: error-code=49
        DEM_E_WRONG_DIDNUMBER: error-code=50
    Darh_DiagnosticInfo
      operation GetDTCOfEvent: possible-error=[Darh_DiagnosticInfo/E_NOT_OK, Darh_DiagnosticInfo/DEM_E_NO_DTC_AVAILABLE]
        arg DTCFormat: type=Dem_DTCFormatType, direction=IN
        arg DTCOfEvent: type=uint32, direction=OUT
      error E_NOT_OK: error-code=1
      error DEM_E_NO_DTC_AVAILABLE: error-code=2
    Darh_DiagnosticMonitor
      operation SetEventStatus: possible-error=Darh_DiagnosticMonitor/E_NOT_OK
        arg EventStatus: type=Dem_EventStatusType, direction=IN
      operation ResetEventStatus: possible-error=Darh_DiagnosticMonitor/E_NOT_OK
      error E_NOT_OK: error-code=1
    GeneralCallbackEventDataChanged
      operation EventDataChanged
        arg EventId: type=Dem_EventIdType, direction=IN
package /BMW/Platform/Darh/Det/PortInterfaces
  client server interface DETService: is-service=true
    operation ReportError
      arg InstanceId: type=uint8, direction=IN
      arg ApiId: type=uint8, direction=IN
      arg ErrorId: type=uint8, direction=IN
package /BMW/Platform/Darh/NvM/ImplementationDataTypes
  impl type NvM_SrcPtrType: category=DATA_REFERENCE, sw-pointer-target-props={target-category=VALUE, base-type=void, sw-impl-policy=CONST}
  impl type NvM_RequestResultType: compu {0=NVM_REQ_OK, 1=NVM_REQ_NOT_OK, 2=NVM_REQ_PENDING, 3=NVM_REQ_INTEGRITY_FAILED, 4=NVM_REQ_BLOCK_SKIPPED, 5=NVM_REQ_NV_INVALIDATED, 6=NVM_REQ_CANCELED, 7=NVM_REQ_REDUNDANCY_FAILED, 8=NVM_REQ_RESTORED_FROM_ROM}, range raw 0x00..0x08, implementation-data-type=uint8
  impl type ErrorQueueType: category=STRUCTURE
    element queue: category=ARRAY
      element Darh_QueueElementType: category=STRUCTURE, array-size=5, array-size-semantics=FIXED-SIZE
        element timestamp: implementation-data-type=uint32
        element EventId: implementation-data-type=uint32
    element first: implementation-data-type=uint16
    element size: implementation-data-type=uint16
package /BMW/Platform/Darh/NvM/PortInterfaces
  client server interface NvMNotifyJobFinished: is-service=true
    operation JobFinished: possible-error=E_OK
      arg ServiceId: type=uint8, direction=IN
      arg JobResult: type=NvM_RequestResultType, direction=IN
    error E_OK: error-code=0
  client server interface Darh_NvMService: is-service=true
    operation SetRamBlockStatus: possible-error=Darh_NvMService/E_NOT_OK
      arg BlockChanged: type=boolean, direction=IN
    operation WriteBlock: possible-error=Darh_NvMService/E_NOT_OK
      arg SrcPtr: type=NvM_SrcPtrType, direction=IN
    error E_NOT_OK: error-code=1
package /BMW/Platform/Darh/Tp/ImplementationDataTypes
  impl type Darh_TransmissionArrayType: category=STRUCTURE, dynamic-array-size-profile=VSA_LINEAR
    element size: implementation-data-type=uint16
    element payload: category=ARRAY
      element payloadArray: array-size=23, array-size-handling=ALL-INDICES-SAME-ARRAY-SIZE, array-size-semantics=VARIABLE-SIZE, implementation-data-type=uint8
package /BMW/Platform/Darh/Tp/PortInterfaces
  sender receiver interface Darh_Com: is-service=true
    data data: type=Darh_TransmissionArrayType
