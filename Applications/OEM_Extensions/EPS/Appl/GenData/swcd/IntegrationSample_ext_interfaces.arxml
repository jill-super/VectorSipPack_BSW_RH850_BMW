AUTOSAR XML (schema 4-3-0)
# \copyright BMW AG 2016 - 2017
package /BMW/Platform/IntegrationSample/Dcm/ImplementationDataTypes
  impl type IntegrationSample_Dcm_ConfirmationStatusType: compu {0x00=DCM_RES_POS_OK, 0x01=DCM_RES_POS_NOT_OK, 0x02=DCM_RES_NEG_OK, 0x03=DCM_RES_NEG_NOT_OK}, range raw 0x00..0x03, implementation-data-type=uint8
  impl type IntegrationSample_RequestDataArray: category=ARRAY
    element RequestDataArray: array-size=1024, array-size-semantics=FIXED-SIZE, implementation-data-type=uint8
  impl type IntegrationSample_Dcm_NegativeResponseCodeType:
    compu {0x8F=DCM_E_BRAKESWITCH_NOTCLOSED, 0x21=DCM_E_BUSYREPEATREQUEST, 0x22=DCM_E_CONDITIONSNOTCORRECT, 0x84=DCM_E_ENGINEISNOTRUNNING, 0x83=DCM_E_ENGINEISRUNNING, 0x85=DCM_E_ENGINERUNTIMETOOLOW, 0x36=DCM_E_EXCEEDNUMBEROFATTEMPTS, 0x26=DCM_E_FAILUREPREVENTSEXECUTIONOFREQUESTEDACTION, 0x72=DCM_E_GENERALPROGRAMMINGFAILURE, 0x10=DCM_E_GENERALREJECT, 0x13=DCM_E_INCORRECTMESSAGELENGTHORINVALIDFORMAT, 0x35=DCM_E_INVALIDKEY, 0x25=DCM_E_NORESPONSEFROMSUBNETCOMPONENT, 0x31=DCM_E_REQUESTOUTOFRANGE, 0x24=DCM_E_REQUESTSEQUENCEERROR, 0x37=DCM_E_REQUIREDTIMEDELAYNOTEXPIRED, 0x14=DCM_E_RESPONSETOOLONG, 0x81=DCM_E_RPMTOOHIGH, 0x82=DCM_E_RPMTOOLOW, 0x33=DCM_E_SECURITYACCESSDENIED, 0x11=DCM_E_SERVICENOTSUPPORTED, 0x7F=DCM_E_SERVICENOTSUPPORTEDINACTIVESESSION, 0x90=DCM_E_SHIFTERLEVERNOTINPARK, 0x12=DCM_E_SUBFUNCTIONNOTSUPPORTED, 0x7E=DCM_E_SUBFUNCTIONNOTSUPPORTEDINACTIVESESSION, 0x86=DCM_E_TEMPERATURETOOHIGH, 0x87=DCM_E_TEMPERATURETOOLOW, 0x8A=DCM_E_THROTTLE_PEDALTOOHIGH, 0x8B=DCM_E_THROTTLE_PEDALTOOLOW, 0x91=DCM_E_TORQUECONVERTERCLUTCHLOCKED, 0x71=DCM_E_TRANSFERDATASUSPENDED, 0x8D=DCM_E_TRANSMISSIONRANGENOTINGEAR, 0x8C=DCM_E_TRANSMISSIONRANGENOTINNEUTRAL, 0x70=DCM_E_UPLOADDOWNLOADNOTACCEPTED, 0x88=DCM_E_VEHICLESPEEDTOOHIGH, 0x89=DCM_E_VEHICLESPEEDTOOLOW, 0x92=DCM_E_VOLTAGETOOHIGH, 0x93=DCM_E_VOLTAGETOOLOW, 0x73=DCM_E_WRONGBLOCKSEQUENCECOUNTER, 0xF0=DCM_E_VMSCNC_0, 0xF1=DCM_E_VMSCNC_1, 0xF2=DCM_E_VMSCNC_2, 0xF3=DCM_E_VMSCNC_3, 0xF4=DCM_E_VMSCNC_4, 0xF5=DCM_E_VMSCNC_5, 0xF6=DCM_E_VMSCNC_6, 0xF7=DCM_E_VMSCNC_7, 0xF8=DCM_E_VMSCNC_8, 0xF9=DCM_E_VMSCNC_9, 0xFA=DCM_E_VMSCNC_A, 0xFB=DCM_E_VMSCNC_B, 0xFC=DCM_E_VMSCNC_C, 0xFD=DCM_E_VMSCNC_D, 0xFE=DCM_E_VMSCNC_E}
    range raw 0x10..0xFE
    implementation-data-type=uint8
package /BMW/Platform/IntegrationSample/Dcm/PortInterfaces
  client server interface IntegrationSample_ServiceRequestNotification: is-service=true
    operation Confirmation: possible-error=[IntegrationSample_ServiceRequestNotification/E_OK, IntegrationSample_ServiceRequestNotification/E_NOT_OK]
      4 x arg, all with direction=IN:
        SID: type=uint8  # Value of service identifier
        ReqType: type=uint8  # Addressing type of the request(0=physical request, 1=functional request)
        SourceAddress: type=uint16  # Dcm client description
        ConfirmationStatus: type=IntegrationSample_Dcm_ConfirmationStatusType  # Confirmation of a successful transmission or a transmission error of a diagnostic service.
    operation Indication: possible-error=[IntegrationSample_ServiceRequestNotification/E_OK, IntegrationSample_ServiceRequestNotification/E_NOT_OK, E_REQUEST_NOT_ACCEPTED]
      6 x arg:
        SID: type=uint8, direction=IN  # Value of service identifier
        RequestData: type=IntegrationSample_RequestDataArray, direction=IN  # This parameter contains the complete request data (diagnostic buffer), except the service ID
        DataSize: type=uint16, direction=IN  # This parameter defines how many bytes in the RequestData parameter are valid
        ReqType: type=uint8, direction=IN  # Addressing type of the request(0=physical request, 1=functional request
        SourceAddress: type=uint16, direction=IN  # Dcm client description
        ErrorCode: type=IntegrationSample_Dcm_NegativeResponseCodeType, direction=OUT
    error E_OK: error-code=0  # Operation successful
    error E_NOT_OK: error-code=1
    error E_REQUEST_NOT_ACCEPTED: error-code=8  # no response will be sent
package /BMW/Platform/IntegrationSample/Dem/ImplementationDataTypes
  impl type IntegrationSample_Dem_DataDemDataElementClass_KILOMETER_ArrayType: category=ARRAY
    element DataArrayType: array-size=3, array-size-semantics=FIXED-SIZE, implementation-data-type=uint8
package /BMW/Platform/IntegrationSample/Dem/PortInterfaces
  client server interface IntegrationSample_CSDataServices_DemDataElementClass_KILOMETER: is-service=true
    operation ReadData: possible-error=[IntegrationSample_CSDataServices_DemDataElementClass_KILOMETER/E_OK, IntegrationSample_CSDataServices_DemDataElementClass_KILOMETER/E_NOT_OK]  # The server is not allowed to return E_NOT_OK, but shall always provide a valid data value (e.g. a default/replacement value in an error-case) to Dcm/Dem nevertheless the signature of the operation includes E_NOT_OK to ensure compatibility between server runnable and RTE Call API, since the RTE may return negative Std_Return values in certain cases (e.g. partition of server stopped)
      arg Data: type=IntegrationSample_Dem_DataDemDataElementClass_KILOMETER_ArrayType, direction=OUT
    error E_OK: error-code=0  # Operation successful
    error E_NOT_OK: error-code=1
package /BMW/Platform/IntegrationSample/Stm/ImplementationDataTypes
  impl type IntegrationSample_Stm_CentralErrorLockType: compu {0=STM_CEL_UNLOCKED, 1=STM_CEL_LOCKED, 3=STM_CEL_INVALID}, implementation-data-type=uint8
package /BMW/Platform/IntegrationSample/Stm/PortInterfaces
  sender receiver interface IntegrationSample_CentralErrorLockSignalInterface
    data centralErrorLock: type=IntegrationSample_Stm_CentralErrorLockType
