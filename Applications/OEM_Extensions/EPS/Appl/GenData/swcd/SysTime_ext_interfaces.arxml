AUTOSAR XML (schema 4-3-0)
# \copyright BMW AG 2015 - 2017
package /BMW/Platform/SysTime/Dcm/ImplementationDataTypes
  impl type Array4: category=ARRAY
    element data: array-size=4, array-size-semantics=FIXED-SIZE, implementation-data-type=uint8
package /BMW/Platform/SysTime/Dcm/PortInterfaces
  client server interface DataServices_SystemTime: is-service=true
    operation ReadData: possible-error=E_NOT_OK
      arg Data: type=Array4, direction=OUT
    error E_NOT_OK: error-code=1
package /BMW/Platform/SysTime/Det/PortInterfaces
  client server interface DETService: is-service=true
    operation ReportError: possible-error=E_OK
      arg InstanceId: type=uint8, direction=IN
      arg ApiId: type=uint8, direction=IN
      arg ErrorId: type=uint8, direction=IN
    error E_OK: error-code=0
