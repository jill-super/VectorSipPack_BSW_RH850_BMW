AUTOSAR XML (schema 4-3-0)
package /BMW/Platform/Bs/DataTypeMappingSets
  data type mapping set BsTypeMappings
    mode-request-type-maps:
      implementation-data-type=uint8, mode-group=SecEcuMode
      implementation-data-type=Bs_LifeCycleRequestType, mode-group=Bs_LifeCycle
package /BMW/Platform/Bs/ImplementationDataTypes
  impl type Bs_LifeCycleRequestType: compu {0=BS_INITIALIZED, 1=BS_RUNNING, 2=BS_STOPPED}, implementation-data-type=uint8
  impl type Bs_SfaFeatureSpecificFieldValueType: category=STRUCTURE, dynamic-array-size-profile=VSA_LINEAR
    element size: implementation-data-type=uint32
    element payload: category=ARRAY
      element PayloadType: array-size=256, array-size-handling=ALL-INDICES-SAME-ARRAY-SIZE, array-size-semantics=VARIABLE-SIZE, implementation-data-type=uint8
package /BMW/Platform/Bs/ModeDeclarationGroups
  mode declaration group Bs_LifeCycle: category=EXPLICIT_ORDER, initial-mode=BS_STOPPED, on-transition-value=3
    mode BS_INITIALIZED: value=0
    mode BS_RUNNING: value=1
    mode BS_STOPPED: value=2
  mode declaration group SecEcuMode: category=EXPLICIT_ORDER, initial-mode=FIELD, on-transition-value=3
    mode FIELD: value=0
    mode ENGINEERING: value=1
    mode PLANT: value=2
package /BMW/Platform/Bs/PortInterfaces
  sender receiver interface ActivationState
    data IsActivated: type=boolean, init-value=0
  mode switch interface ILifeCycle
    mode group Mode: type=Bs_LifeCycle
  sender receiver interface ILifeCycleRequest: is-service=true
    data requestMode: type=Bs_LifeCycleRequestType
  sender receiver interface LCSState
    data value: type=uint8
  mode switch interface SecEcuMode
    mode group Mode: type=SecEcuMode
  client server interface SecureFeature
    operation GetFeatureSpecificField: possible-error=E_NOT_OK
      4 x arg, all with server-argument-impl-policy=USE-ARGUMENT-TYPE:
        featureId: type=uint32, direction=IN
        fieldIndex: type=uint32, direction=IN
        tag: type=uint16, direction=OUT
        value: type=Bs_SfaFeatureSpecificFieldValueType, direction=OUT
    operation GetNumberOfFeatureSpecificFields: possible-error=E_NOT_OK
      arg featureId: type=uint32, direction=IN, server-argument-impl-policy=USE-ARGUMENT-TYPE
      arg numberOfFields: type=uint16, direction=OUT, server-argument-impl-policy=USE-ARGUMENT-TYPE
    error E_NOT_OK: error-code=1
