AUTOSAR XML (schema 4-2-2)
# \copyright BMW AG 2015 - 2017
package /BMW/Platform/Omc/Dcm/ImplementationDataTypes
  impl type Dcm_NegativeResponseCodeType: compu {16=DCM_E_GENERALREJECT, 33=DCM_E_BUSYREPEATREQUEST, 34=DCM_E_CONDITIONSNOTCORRECT, 36=DCM_E_REQUESTSEQUENCEERROR, 49=DCM_E_REQUESTOUTOFRANGE, 51=DCM_E_SECURITYACCESSDENIED, 114=DCM_E_GENERALPROGRAMMINGFAILURE, 126=DCM_E_SUBFUNCTIONNOTSUPPORTEDINACTIVESESSION, 129=DCM_E_RPMTOOHIGH, 130=DCM_E_RPMTOOLOW, 131=DCM_E_ENGINEISRUNNING, 132=DCM_E_ENGINEISNOTRUNNING, 133=DCM_E_ENGINERUNTIMETOOLOW, 134=DCM_E_TEMPERATURETOOHIGH, 135=DCM_E_TEMPERATURETOOLOW, 136=DCM_E_VEHICLESPEEDTOOHIGH, 137=DCM_E_VEHICLESPEEDTOOLOW, 138=DCM_E_THROTTLE_PEDALTOOHIGH, 139=DCM_E_THROTTLE_PEDALTOOLOW, 140=DCM_E_TRANSMISSIONRANGENOTINNEUTRAL, 141=DCM_E_TRANSMISSIONRANGENOTINGEAR, 143=DCM_E_BRAKESWITCH_NOTCLOSED, 144=DCM_E_SHIFTERLEVERNOTINPARK, 145=DCM_E_TORQUECONVERTERCLUTCHLOCKED, 146=DCM_E_VOLTAGETOOHIGH, 147=DCM_E_VOLTAGETOOLOW}, implementation-data-type=uint8
  impl type OpStatusType: compu {0=DCM_INITIAL, 1=DCM_PENDING, 2=DCM_CANCEL, 3=DCM_FORCE_RCRRP_OK}, implementation-data-type=uint8
  impl type UInt8_Array1: category=ARRAY
    element data: array-size=1, array-size-semantics=FIXED-SIZE, implementation-data-type=uint8
package /BMW/Platform/Omc/Dcm/PortInterfaces
  4 x client server interface, all with is-service=true:
    DataServices_ExtendedOperatingMode
      operation ConditionCheckRead: possible-error=DataServices_ExtendedOperatingMode/E_NOT_OK
        arg ErrorCode: type=Dcm_NegativeResponseCodeType, direction=OUT, server-argument-impl-policy=USE-ARGUMENT-TYPE
      operation ReadData: possible-error=DataServices_ExtendedOperatingMode/E_NOT_OK
        arg Data: type=UInt8_Array1, direction=OUT, server-argument-impl-policy=USE-ARRAY-BASE-TYPE
      error E_NOT_OK: error-code=1
    DataServices_OperatingMode
      operation ConditionCheckRead: possible-error=DataServices_OperatingMode/E_NOT_OK
        arg ErrorCode: type=Dcm_NegativeResponseCodeType, direction=OUT, server-argument-impl-policy=USE-ARGUMENT-TYPE
      operation ReadData: possible-error=DataServices_OperatingMode/E_NOT_OK
        arg Data: type=UInt8_Array1, direction=OUT, server-argument-impl-policy=USE-ARRAY-BASE-TYPE
      error E_NOT_OK: error-code=1
    RoutineServices_ExtendedOperatingModeControl
      operation Start: possible-error=[RoutineServices_ExtendedOperatingModeControl/DCM_E_PENDING, RoutineServices_ExtendedOperatingModeControl/E_NOT_OK, RoutineServices_ExtendedOperatingModeControl/DCM_E_FORCE_RCRRP]
        arg ExtendedOperatingMode: type=uint8, direction=IN, server-argument-impl-policy=USE-ARGUMENT-TYPE
        arg OpStatus: type=OpStatusType, direction=IN, server-argument-impl-policy=USE-ARGUMENT-TYPE
        arg ErrorCode: type=Dcm_NegativeResponseCodeType, direction=OUT, server-argument-impl-policy=USE-ARGUMENT-TYPE
      error E_NOT_OK: error-code=1
      error DCM_E_PENDING: error-code=10
      error DCM_E_FORCE_RCRRP: error-code=12
    RoutineServices_OperatingModeControl
      operation Start: possible-error=[RoutineServices_OperatingModeControl/DCM_E_PENDING, RoutineServices_OperatingModeControl/E_NOT_OK, RoutineServices_OperatingModeControl/DCM_E_FORCE_RCRRP]
        arg OperatingMode: type=uint8, direction=IN, server-argument-impl-policy=USE-ARGUMENT-TYPE
        arg OpStatus: type=OpStatusType, direction=IN, server-argument-impl-policy=USE-ARGUMENT-TYPE
        arg ErrorCode: type=Dcm_NegativeResponseCodeType, direction=OUT, server-argument-impl-policy=USE-ARGUMENT-TYPE
      error E_NOT_OK: error-code=1
      error DCM_E_PENDING: error-code=10
      error DCM_E_FORCE_RCRRP: error-code=12
package /BMW/Platform/Omc/Dem/ImplementationDataTypes
  impl type Dem_EventStatusType: compu {0=DEM_EVENT_STATUS_PASSED, 1=DEM_EVENT_STATUS_FAILED, 2=DEM_EVENT_STATUS_PREPASSED, 3=DEM_EVENT_STATUS_PREFAILED, 4=DEM_EVENT_STATUS_FDC_THRESHOLD_REACHED}, implementation-data-type=uint8
package /BMW/Platform/Omc/Dem/PortInterfaces
  client server interface CallbackClearEventAllowed: is-service=true
    operation ClearEventAllowed: possible-error=CallbackClearEventAllowed/E_NOT_OK
      arg Allowed: type=boolean, direction=OUT, server-argument-impl-policy=USE-ARGUMENT-TYPE
    error E_NOT_OK: error-code=1
  client server interface EnableCondition: is-service=true
    operation SetEnableCondition: possible-error=EnableCondition/E_NOT_OK
      arg ConditionFulfilled: type=boolean, direction=IN, server-argument-impl-policy=USE-ARGUMENT-TYPE
    error E_NOT_OK: error-code=1
  client server interface Omc_DiagnosticMonitor: is-service=true
    operation SetEventStatus: possible-error=Omc_DiagnosticMonitor/E_NOT_OK
      arg EventStatus: type=Dem_EventStatusType, direction=IN
    operation ResetEventStatus: possible-error=Omc_DiagnosticMonitor/E_NOT_OK
    error E_NOT_OK: error-code=1
package /BMW/Platform/Omc/Det/PortInterfaces
  client server interface DETService: is-service=true
    operation ReportError: possible-error=DETService/E_NOT_OK
      arg InstanceId: type=uint8, direction=IN, server-argument-impl-policy=USE-ARGUMENT-TYPE
      arg ApiId: type=uint8, direction=IN, server-argument-impl-policy=USE-ARGUMENT-TYPE
      arg ErrorId: type=uint8, direction=IN, server-argument-impl-policy=USE-ARGUMENT-TYPE
    error E_NOT_OK: error-code=1
package /BMW/Platform/Omc/NvM/ImplementationDataTypes
  impl type DstPtrType: category=DATA_REFERENCE, sw-pointer-target-props={target-category=VALUE, base-type=void}
  impl type RequestResultType: compu {0=NVM_REQ_OK, 1=NVM_REQ_NOT_OK, 2=NVM_REQ_PENDING, 3=NVM_REQ_INTEGRITY_FAILED, 4=NVM_REQ_BLOCK_SKIPPED, 5=NVM_REQ_NV_INVALIDATED, 6=NVM_REQ_CANCELED, 7=NVM_REQ_REDUNDANCY_FAILED, 8=NVM_REQ_RESTORED_FROM_ROM}, implementation-data-type=uint8
  impl type SrcPtrType: category=DATA_REFERENCE, sw-pointer-target-props={target-category=VALUE, base-type=void, sw-impl-policy=CONST}
package /BMW/Platform/Omc/NvM/PortInterfaces
  client server interface NvMNotifyJobFinished: is-service=true
    operation JobFinished: possible-error=E_OK
      arg ServiceId: type=uint8, direction=IN
      arg JobResult: type=RequestResultType, direction=IN
    error E_OK: error-code=0
  client server interface NvMService_OMC: is-service=true
    operation GetErrorStatus: possible-error=NvMService_OMC/E_NOT_OK
      arg RequestResultPtr: type=RequestResultType, direction=OUT
    operation SetRamBlockStatus: possible-error=NvMService_OMC/E_NOT_OK
      arg BlockChanged: type=boolean, direction=IN
    operation WriteBlock: possible-error=NvMService_OMC/E_NOT_OK
      arg SrcPtr: type=SrcPtrType, direction=IN
    error E_NOT_OK: error-code=1
