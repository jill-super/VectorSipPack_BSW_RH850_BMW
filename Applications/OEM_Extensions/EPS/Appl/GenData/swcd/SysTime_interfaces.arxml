AUTOSAR XML (schema 4-3-0)
# \copyright BMW AG 2015 - 2017
package /BMW/Platform/SysTime/ModeDeclarationGroups
  mode declaration group SysTime_LifeCycle: category=EXPLICIT_ORDER, initial-mode=SYSTIME_STOPPED, on-transition-value=3
    mode SYSTIME_INITIALIZED: value=0
    mode SYSTIME_RUNNING: value=1
    mode SYSTIME_STOPPED: value=2
package /BMW/Platform/SysTime/ImplementationDataTypes
  impl type SysTime_LifeCycleRequestType: compu {0=SYSTIME_INITIALIZED, 1=SYSTIME_RUNNING, 2=SYSTIME_STOPPED}, implementation-data-type=uint8
package /BMW/Platform/SysTime/DataTypeMappingSets
  data type mapping set DataTMappingSet1: mode-request-type-map{implementation-data-type=SysTime_LifeCycleRequestType, mode-group=SysTime_LifeCycle}
package /BMW/Platform/SysTime/PortInterfaces
  sender receiver interface SysTimeRx
    data timeSignal: type=uint32
  sender receiver interface ILifeCycleRequest: is-service=true
    data requestMode: type=SysTime_LifeCycleRequestType
  mode switch interface ILifeCycle
    mode group Mode: type=SysTime_LifeCycle
