AUTOSAR XML (schema 4-3-0)
# \copyright BMW AG 2016 - 2017
package /BMW/Platform/Bs/Csm/ImplementationDataTypes
  7 x impl type:
    Crypto_VerifyResultType: compu {0=CRYPTO_E_VER_OK, 1=CRYPTO_E_VER_NOT_OK}, implementation-data-type=uint8
    Csm_HashDataType_SecureToken: category=ARRAY
      element SubCsm_HashDataType_SecureToken: array-size=260, array-size-semantics=FIXED-SIZE, implementation-data-type=uint8
    Csm_HashResultType_SecureToken: category=ARRAY
      element SubCsm_HashResultType_SecureToken: array-size=32, array-size-semantics=FIXED-SIZE, implementation-data-type=uint8
    Csm_SignatureGenerateDataType_Csr: category=ARRAY
      element SubCsm_SignatureGenerateDataType_Csr: array-size=32, array-size-semantics=FIXED-SIZE, implementation-data-type=uint8
    Csm_SignatureGenerateResultType_Csr: category=ARRAY
      element SubCsm_SignatureGenerateResultType_Csr: array-size=32, array-size-semantics=FIXED-SIZE, implementation-data-type=uint8
    Csm_SignatureVerifyCompareType_SecureToken: category=ARRAY
      element SubCsm_SignatureVerifyCompareType_SecureToken: array-size=32, array-size-semantics=FIXED-SIZE, implementation-data-type=uint8
    Csm_SignatureVerifyDataType_SecureToken: category=ARRAY
      element SubCsm_SignatureVerifyDataType_SecureToken: array-size=32, array-size-semantics=FIXED-SIZE, implementation-data-type=uint8
package /BMW/Platform/Bs/Csm/PortInterfaces
  5 x client server interface, all with is-service=true:
    CsmHash_SecureToken
      operation Hash: possible-error=[CsmHash_SecureToken/CSM_E_BUSY, CsmHash_SecureToken/CSM_E_SMALL_BUFFER, CsmHash_SecureToken/E_NOT_OK]
        4 x arg:
          dataBuffer: type=Csm_HashDataType_SecureToken, direction=IN, server-argument-impl-policy=USE-ARRAY-BASE-TYPE
          dataLength: type=uint32, direction=IN, server-argument-impl-policy=USE-ARGUMENT-TYPE
          resultBuffer: type=Csm_HashResultType_SecureToken, direction=OUT, server-argument-impl-policy=USE-ARRAY-BASE-TYPE
          resultLength: type=uint32, direction=OUT, server-argument-impl-policy=USE-ARGUMENT-TYPE
      error E_NOT_OK: error-code=1
      error CSM_E_BUSY: error-code=2
      error CSM_E_SMALL_BUFFER: error-code=3
    CsmKeyManagement_Certificate
      4 x operation:
        CertificateParse: possible-error=[CsmKeyManagement_Certificate/CSM_E_BUSY, CsmKeyManagement_Certificate/E_NOT_OK]
        CertificateVerify
          arg verifyKeyId: type=uint32, direction=IN, server-argument-impl-policy=USE-ARGUMENT-TYPE
          arg verifyPtr: type=Crypto_VerifyResultType, direction=OUT, server-argument-impl-policy=USE-ARGUMENT-TYPE
        KeyElementGet: possible-error=[CsmKeyManagement_Certificate/CSM_E_BUSY, CsmKeyManagement_Certificate/CSM_E_KEY_NOT_AVAILABLE, CsmKeyManagement_Certificate/CSM_E_KEY_READ_FAIL, CsmKeyManagement_Certificate/CSM_E_SMALL_BUFFER, CsmKeyManagement_Certificate/E_NOT_OK]
          arg keyElementId: type=uint32, direction=IN, server-argument-impl-policy=USE-ARGUMENT-TYPE
          arg keyPtr: type=RCDataArrayType, direction=OUT, server-argument-impl-policy=USE-ARRAY-BASE-TYPE
          arg keyLength: type=uint32, direction=OUT, server-argument-impl-policy=USE-ARGUMENT-TYPE
        KeyElementSet: possible-error=[CsmKeyManagement_Certificate/CSM_E_BUSY, CsmKeyManagement_Certificate/CSM_E_KEY_SIZE_MISMATCH, CsmKeyManagement_Certificate/CSM_E_KEY_WRITE_FAIL, CsmKeyManagement_Certificate/CSM_E_SMALL_BUFFER, CsmKeyManagement_Certificate/E_NOT_OK]
          arg keyElementId: type=uint32, direction=IN, server-argument-impl-policy=USE-ARGUMENT-TYPE
          arg keyPtr: type=RCDataArrayType, direction=IN, server-argument-impl-policy=USE-ARRAY-BASE-TYPE
          arg keyLength: type=uint32, direction=IN, server-argument-impl-policy=USE-ARGUMENT-TYPE
      7 x error:
        E_NOT_OK: error-code=1
        CSM_E_BUSY: error-code=2
        CSM_E_SMALL_BUFFER: error-code=3
        CSM_E_KEY_READ_FAIL: error-code=6
        CSM_E_KEY_WRITE_FAIL: error-code=7
        CSM_E_KEY_NOT_AVAILABLE: error-code=8
        CSM_E_KEY_SIZE_MISMATCH: error-code=10
    CsmKeyManagement_CsrKey
      operation KeyElementGet: possible-error=[CsmKeyManagement_CsrKey/CSM_E_BUSY, CsmKeyManagement_CsrKey/CSM_E_KEY_NOT_AVAILABLE, CsmKeyManagement_CsrKey/CSM_E_KEY_READ_FAIL, CsmKeyManagement_CsrKey/CSM_E_SMALL_BUFFER, CsmKeyManagement_CsrKey/E_NOT_OK]
        arg keyElementId: type=uint32, direction=IN, server-argument-impl-policy=USE-ARGUMENT-TYPE
        arg keyPtr: type=RCDataArrayType, direction=OUT, server-argument-impl-policy=USE-ARRAY-BASE-TYPE
        arg keyLength: type=uint32, direction=OUT, server-argument-impl-policy=USE-ARGUMENT-TYPE
      operation KeyGenerate: possible-error=[CsmKeyManagement_CsrKey/CSM_E_BUSY, CsmKeyManagement_CsrKey/E_NOT_OK]
      7 x error:
        E_NOT_OK: error-code=1
        CSM_E_BUSY: error-code=2
        CSM_E_SMALL_BUFFER: error-code=3
        CSM_E_KEY_READ_FAIL: error-code=6
        CSM_E_KEY_WRITE_FAIL: error-code=7
        CSM_E_KEY_NOT_AVAILABLE: error-code=8
        CSM_E_KEY_SIZE_MISMATCH: error-code=10
    CsmSignatureGenerate_Csr
      operation SignatureGenerate: possible-error=[CsmSignatureGenerate_Csr/E_NOT_OK, CsmSignatureGenerate_Csr/CSM_E_BUSY, CsmSignatureGenerate_Csr/CSM_E_SMALL_BUFFER]
        4 x arg:
          dataBuffer: type=Csm_SignatureGenerateDataType_Csr, direction=IN, server-argument-impl-policy=USE-ARRAY-BASE-TYPE
          dataLength: type=uint32, direction=IN, server-argument-impl-policy=USE-ARGUMENT-TYPE
          resultBuffer: type=Csm_SignatureGenerateResultType_Csr, direction=OUT, server-argument-impl-policy=USE-ARRAY-BASE-TYPE
          resultLength: type=uint32, direction=INOUT, server-argument-impl-policy=USE-ARGUMENT-TYPE
      error E_NOT_OK: error-code=1
      error CSM_E_BUSY: error-code=2
      error CSM_E_SMALL_BUFFER: error-code=3
    CsmSignatureVerify_SecureToken
      operation SignatureVerify: possible-error=[CsmSignatureVerify_SecureToken/CSM_E_BUSY, CsmSignatureVerify_SecureToken/CSM_E_SMALL_BUFFER, CsmSignatureVerify_SecureToken/E_NOT_OK]
        5 x arg:
          dataBuffer: type=Csm_SignatureVerifyDataType_SecureToken, direction=IN, server-argument-impl-policy=USE-ARRAY-BASE-TYPE
          dataLength: type=uint32, direction=IN, server-argument-impl-policy=USE-ARGUMENT-TYPE
          compareBuffer: type=Csm_SignatureVerifyCompareType_SecureToken, direction=IN, server-argument-impl-policy=USE-ARRAY-BASE-TYPE
          compareLength: type=uint32, direction=IN, server-argument-impl-policy=USE-ARGUMENT-TYPE
          resultBuffer: type=Crypto_VerifyResultType, direction=OUT, server-argument-impl-policy=USE-ARGUMENT-TYPE
      error E_NOT_OK: error-code=1
      error CSM_E_BUSY: error-code=2
      error CSM_E_SMALL_BUFFER: error-code=3
package /BMW/Platform/Bs/Dcm/ImplementationDataTypes
  impl type Dcm_NegativeResponseCodeType: compu {16=DCM_E_GENERALREJECT, 19=DCM_E_INCORRECTMESSAGELENGTHORINVALIDFORMAT, 33=DCM_E_BUSYREPEATREQUEST, 34=DCM_E_CONDITIONSNOTCORRECT, 36=DCM_E_REQUESTSEQUENCEERROR, 49=DCM_E_REQUESTOUTOFRANGE, 51=DCM_E_SECURITYACCESSDENIED, 114=DCM_E_GENERALPROGRAMMINGFAILURE, 126=DCM_E_SUBFUNCTIONNOTSUPPORTEDINACTIVESESSION, 129=DCM_E_RPMTOOHIGH, 130=DCM_E_RPMTOOLOW, 131=DCM_E_ENGINEISRUNNING, 132=DCM_E_ENGINEISNOTRUNNING, 133=DCM_E_ENGINERUNTIMETOOLOW, 134=DCM_E_TEMPERATURETOOHIGH, 135=DCM_E_TEMPERATURETOOLOW, 136=DCM_E_VEHICLESPEEDTOOHIGH, 137=DCM_E_VEHICLESPEEDTOOLOW, 138=DCM_E_THROTTLE_PEDALTOOHIGH, 139=DCM_E_THROTTLE_PEDALTOOLOW, 140=DCM_E_TRANSMISSIONRANGENOTINNEUTRAL, 141=DCM_E_TRANSMISSIONRANGENOTINGEAR, 143=DCM_E_BRAKESWITCH_NOTCLOSED, 144=DCM_E_SHIFTERLEVERNOTINPARK, 145=DCM_E_TORQUECONVERTERCLUTCHLOCKED, 146=DCM_E_VOLTAGETOOHIGH, 147=DCM_E_VOLTAGETOOLOW}, implementation-data-type=uint8
  impl type Dcm_OpStatusType: compu {0=DCM_INITIAL, 1=DCM_PENDING, 2=DCM_CANCEL, 3=DCM_FORCE_RCRRP_OK}, implementation-data-type=uint8
  impl type RCDataArrayType: category=ARRAY
    element SubRCDataArrayType: array-size=260, array-size-semantics=FIXED-SIZE, implementation-data-type=uint8
package /BMW/Platform/Bs/Dcm/PortInterfaces
  7 x client server interface, all with is-service=true:
    DataServices_FunctionGroupStatus
      operation ReadData: possible-error=[DataServices_FunctionGroupStatus/E_NOT_OK, DataServices_FunctionGroupStatus/DCM_E_PENDING]
        arg OpStatus: type=Dcm_OpStatusType, direction=IN
        arg Data: type=uint8, direction=OUT, server-argument-impl-policy=USE-ARGUMENT-TYPE
      operation ConditionCheckRead: possible-error=[DataServices_FunctionGroupStatus/E_NOT_OK, DataServices_FunctionGroupStatus/DCM_E_PENDING]
        arg OpStatus: type=Dcm_OpStatusType, direction=IN
        arg ErrorCode: type=Dcm_NegativeResponseCodeType, direction=OUT
      error E_NOT_OK: error-code=1
      error DCM_E_PENDING: error-code=10
    DataServices_ReadWrite
      4 x operation:
        WriteData: possible-error=[DataServices_ReadWrite/DCM_E_PENDING, DataServices_ReadWrite/E_NOT_OK]
          4 x arg:
            Data: type=RCDataArrayType, direction=IN, server-argument-impl-policy=USE-ARRAY-BASE-TYPE
            DataLength: type=uint16, direction=IN, server-argument-impl-policy=USE-ARGUMENT-TYPE
            OpStatus: type=Dcm_OpStatusType, direction=IN, server-argument-impl-policy=USE-ARGUMENT-TYPE
            ErrorCode: type=Dcm_NegativeResponseCodeType, direction=OUT, server-argument-impl-policy=USE-ARGUMENT-TYPE
        ReadData: possible-error=[DataServices_ReadWrite/E_NOT_OK, DataServices_ReadWrite/DCM_E_PENDING]
          arg OpStatus: type=Dcm_OpStatusType, direction=IN
          arg Data: type=RCDataArrayType, direction=OUT
        ReadDataLength: possible-error=[DataServices_ReadWrite/DCM_E_PENDING, DataServices_ReadWrite/E_NOT_OK]
          arg OpStatus: type=Dcm_OpStatusType, direction=IN, server-argument-impl-policy=USE-ARGUMENT-TYPE
          arg DataLength: type=uint16, direction=OUT
        ConditionCheckRead: possible-error=[DataServices_ReadWrite/E_NOT_OK, DataServices_ReadWrite/DCM_E_PENDING]
          arg OpStatus: type=Dcm_OpStatusType, direction=IN
          arg ErrorCode: type=Dcm_NegativeResponseCodeType, direction=OUT
      error E_NOT_OK: error-code=1
      error DCM_E_PENDING: error-code=10
    DataServices_VarLength
      operation ReadData: possible-error=[DataServices_VarLength/E_NOT_OK, DataServices_VarLength/DCM_E_PENDING]
        arg OpStatus: type=Dcm_OpStatusType, direction=IN
        arg Data: type=RCDataArrayType, direction=OUT
      operation ReadDataLength: possible-error=[DataServices_VarLength/DCM_E_PENDING, DataServices_VarLength/E_NOT_OK]
        arg OpStatus: type=Dcm_OpStatusType, direction=IN, server-argument-impl-policy=USE-ARGUMENT-TYPE
        arg DataLength: type=uint16, direction=OUT
      operation ConditionCheckRead: possible-error=[DataServices_VarLength/E_NOT_OK, DataServices_VarLength/DCM_E_PENDING]
        arg OpStatus: type=Dcm_OpStatusType, direction=IN
        arg ErrorCode: type=Dcm_NegativeResponseCodeType, direction=OUT
      error E_NOT_OK: error-code=1
      error DCM_E_PENDING: error-code=10
    RoutineServices_In
      operation Start: possible-error=[RoutineServices_In/E_NOT_OK, RoutineServices_In/DCM_E_PENDING]
        4 x arg:
          DataIn: type=RCDataArrayType, direction=IN
          OpStatus: type=Dcm_OpStatusType, direction=IN
          CurrentDataLength: type=uint16, direction=IN
          ErrorCode: type=Dcm_NegativeResponseCodeType, direction=OUT
      error E_NOT_OK: error-code=1
      error DCM_E_PENDING: error-code=10
    RoutineServices_InOut
      operation Start: possible-error=[RoutineServices_InOut/E_NOT_OK, RoutineServices_InOut/DCM_E_PENDING]
        5 x arg:
          DataIn: type=RCDataArrayType, direction=IN
          OpStatus: type=Dcm_OpStatusType, direction=IN
          DataOut: type=RCDataArrayType, direction=OUT
          CurrentDataLength: type=uint16, direction=INOUT
          ErrorCode: type=Dcm_NegativeResponseCodeType, direction=OUT
      error E_NOT_OK: error-code=1
      error DCM_E_PENDING: error-code=10
    RoutineServices_NoParam
      operation Start: possible-error=[RoutineServices_NoParam/E_NOT_OK, RoutineServices_NoParam/DCM_E_PENDING]
        arg OpStatus: type=Dcm_OpStatusType, direction=IN
        arg ErrorCode: type=Dcm_NegativeResponseCodeType, direction=OUT
      error E_NOT_OK: error-code=1
      error DCM_E_PENDING: error-code=10
    RoutineServices_Out
      operation Start: possible-error=[RoutineServices_Out/E_NOT_OK, RoutineServices_Out/DCM_E_PENDING]
        4 x arg:
          OpStatus: type=Dcm_OpStatusType, direction=IN
          DataOut: type=RCDataArrayType, direction=OUT
          CurrentDataLength: type=uint16, direction=OUT
          ErrorCode: type=Dcm_NegativeResponseCodeType, direction=OUT
      error E_NOT_OK: error-code=1
      error DCM_E_PENDING: error-code=10
package /BMW/Platform/Bs/Dem/ImplementationDataTypes
  impl type Dem_EventStatusType: compu {0=DEM_EVENT_STATUS_PASSED, 1=DEM_EVENT_STATUS_FAILED, 2=DEM_EVENT_STATUS_PREPASSED, 3=DEM_EVENT_STATUS_PREFAILED, 4=DEM_EVENT_STATUS_FDC_THRESHOLD_REACHED}, range raw 0..4, implementation-data-type=uint8
package /BMW/Platform/Bs/Dem/PortInterfaces
  client server interface Bs_DiagnosticMonitor: is-service=true
    operation SetEventStatus: possible-error=Bs_DiagnosticMonitor/E_NOT_OK
      arg EventStatus: type=Dem_EventStatusType, direction=IN, server-argument-impl-policy=USE-ARGUMENT-TYPE
    error E_NOT_OK: error-code=1
package /BMW/Platform/Bs/Det/PortInterfaces
  client server interface Bs_DETService: is-service=true
    operation ReportError: possible-error=Bs_DETService/E_OK
      arg InstanceId: type=uint8, direction=IN
      arg ApiId: type=uint8, direction=IN
      arg ErrorId: type=uint8, direction=IN
    error E_OK: error-code=0
package /BMW/Platform/Bs/Dlog/ImplementationDataTypes
  impl type Dlog_EcuUidArrayType: category=ARRAY
    element Dlog_EcuUidSubArrayType: array-size=16, array-size-semantics=FIXED-SIZE, implementation-data-type=uint8
package /BMW/Platform/Bs/Dlog/PortInterfaces
  client server interface DataServices_EcuUid: is-service=true
    operation ReadData: possible-error=DataServices_EcuUid/E_NOT_OK
      arg Data: type=Dlog_EcuUidArrayType, direction=OUT
    error E_NOT_OK: error-code=1
package /BMW/Platform/Bs/NvM/ImplementationDataTypes
  impl type NvM_DstPtrType: category=DATA_REFERENCE, sw-pointer-target-props={target-category=VALUE, base-type=void}
  impl type NvM_RequestResultType: compu {0=NVM_REQ_OK, 1=NVM_REQ_NOT_OK, 2=NVM_REQ_PENDING, 3=NVM_REQ_INTEGRITY_FAILED, 4=NVM_REQ_BLOCK_SKIPPED, 5=NVM_REQ_NV_INVALIDATED, 6=NVM_REQ_CANCELED, 7=NVM_REQ_REDUNDANCY_FAILED, 8=NVM_REQ_RESTORED_FROM_ROM}, implementation-data-type=uint8
  impl type NvM_SrcPtrType: category=DATA_REFERENCE, sw-pointer-target-props={target-category=VALUE, base-type=void, sw-impl-policy=CONST}
package /BMW/Platform/Bs/NvM/PortInterfaces
  4 x client server interface, all with is-service=true:
    Bs_NvMAdmin
      operation SetBlockProtection: possible-error=Bs_NvMAdmin/E_NOT_OK
        arg ProtectionEnabled: type=boolean, direction=IN
      error E_NOT_OK: error-code=1
    Bs_NvMNotifyInitBlock
      operation InitBlock: possible-error=Bs_NvMNotifyInitBlock/E_OK
      error E_OK: error-code=0
    Bs_NvMNotifyJobFinished
      operation JobFinished: possible-error=Bs_NvMNotifyJobFinished/E_OK
        arg ServiceId: type=uint8, direction=IN
        arg JobResult: type=NvM_RequestResultType, direction=IN
      error E_OK: error-code=0
    Bs_NvMService
      4 x operation, all with possible-error=Bs_NvMService/E_NOT_OK:
        GetErrorStatus
          arg RequestResultPtr: type=NvM_RequestResultType, direction=OUT
        SetRamBlockStatus
          arg BlockChanged: type=boolean, direction=IN
        ReadBlock
          arg DstPtr: type=NvM_DstPtrType, direction=IN
        WriteBlock
          arg SrcPtr: type=NvM_SrcPtrType, direction=IN
      error E_NOT_OK: error-code=1
package /BMW/Platform/Bs/SecOC/ImplementationDataTypes
  impl type SecOC_FreshnessArrayType: category=ARRAY
    element SecOC_FreshnessSubArrayType: array-size=8, array-size-semantics=FIXED-SIZE, implementation-data-type=uint8
package /BMW/Platform/Bs/SecOC/PortInterfaces
  client server interface FreshnessManagement: is-service=true
    operation GetRxFreshnessAuthData: possible-error=[FreshnessManagement/E_OK, E_BUSY, FreshnessManagement/E_NOT_OK]
      8 x arg:
        freshnessValueId: type=uint16, direction=IN, server-argument-impl-policy=USE-ARGUMENT-TYPE
        truncatedFreshnessValue: type=SecOC_FreshnessArrayType, direction=IN, server-argument-impl-policy=USE-ARRAY-BASE-TYPE
        truncatedFreshnessValueLength: type=uint32, direction=IN, server-argument-impl-policy=USE-ARGUMENT-TYPE
        authenticDataFreshnessValue: type=SecOC_FreshnessArrayType, direction=IN, server-argument-impl-policy=USE-ARRAY-BASE-TYPE
        authenticDataFreshnessValueLength: type=uint16, direction=IN, server-argument-impl-policy=USE-ARGUMENT-TYPE
        authVerifyAttempts: type=uint16, direction=IN, server-argument-impl-policy=USE-ARGUMENT-TYPE
        freshnessValue: type=SecOC_FreshnessArrayType, direction=OUT, server-argument-impl-policy=USE-ARRAY-BASE-TYPE
        freshnessValueLength: type=uint32, direction=INOUT, server-argument-impl-policy=USE-ARGUMENT-TYPE
    operation GetTxFreshnessTruncData: possible-error=[FreshnessManagement/E_OK, E_BUSY, FreshnessManagement/E_NOT_OK]
      5 x arg:
        freshnessValueId: type=uint16, direction=IN, server-argument-impl-policy=USE-ARGUMENT-TYPE
        freshnessValue: type=SecOC_FreshnessArrayType, direction=OUT, server-argument-impl-policy=USE-ARRAY-BASE-TYPE
        freshnessValueLength: type=uint32, direction=INOUT, server-argument-impl-policy=USE-ARGUMENT-TYPE
        truncatedFreshnessValue: type=SecOC_FreshnessArrayType, direction=OUT, server-argument-impl-policy=USE-ARRAY-BASE-TYPE
        truncatedFreshnessValueLength: type=uint32, direction=INOUT, server-argument-impl-policy=USE-ARGUMENT-TYPE
    operation SPduTxConfirmation: possible-error=FreshnessManagement/E_OK
      arg freshnessValueId: type=uint16, direction=IN, server-argument-impl-policy=USE-ARGUMENT-TYPE
    error E_NOT_OK: error-code=1
    error E_BUSY: error-code=2
    error E_OK: error-code=0
package /BMW/Platform/Bs/StdDiag/PortInterfaces
  client server interface StdDiag_Adue
    11 x operation:
      UploadPreprocess: possible-error=[E_RUNNING, StdDiag_Adue/E_NOT_OK]
        arg parameter: type=RCDataArrayType, direction=IN, server-argument-impl-policy=USE-ARRAY-BASE-TYPE
        arg parameterSize: type=uint16, direction=IN, server-argument-impl-policy=USE-ARGUMENT-TYPE
        arg errorCode: type=Dcm_NegativeResponseCodeType, direction=OUT, server-argument-impl-policy=USE-ARGUMENT-TYPE
      UploadPostprocess: possible-error=[E_RUNNING, StdDiag_Adue/E_NOT_OK]
        arg parameter: type=RCDataArrayType, direction=IN, server-argument-impl-policy=USE-ARRAY-BASE-TYPE
        arg parameterSize: type=uint16, direction=IN, server-argument-impl-policy=USE-ARGUMENT-TYPE
        arg errorCode: type=Dcm_NegativeResponseCodeType, direction=OUT, server-argument-impl-policy=USE-ARGUMENT-TYPE
      DownloadPreprocess: possible-error=[E_RUNNING, StdDiag_Adue/E_NOT_OK]
        arg parameter: type=RCDataArrayType, direction=IN, server-argument-impl-policy=USE-ARRAY-BASE-TYPE
        arg parameterSize: type=uint16, direction=IN, server-argument-impl-policy=USE-ARGUMENT-TYPE
        arg errorCode: type=Dcm_NegativeResponseCodeType, direction=OUT, server-argument-impl-policy=USE-ARGUMENT-TYPE
      DownloadPostprocess: possible-error=[E_RUNNING, StdDiag_Adue/E_NOT_OK]
        arg parameter: type=RCDataArrayType, direction=IN, server-argument-impl-policy=USE-ARRAY-BASE-TYPE
        arg parameterSize: type=uint16, direction=IN, server-argument-impl-policy=USE-ARGUMENT-TYPE
        arg errorCode: type=Dcm_NegativeResponseCodeType, direction=OUT, server-argument-impl-policy=USE-ARGUMENT-TYPE
      Upload: possible-error=[E_RUNNING, StdDiag_Adue/E_NOT_OK]
        4 x arg:
          blockSequenceCounter: type=uint8, direction=IN, server-argument-impl-policy=USE-ARGUMENT-TYPE
          data: type=RCDataArrayType, direction=OUT, server-argument-impl-policy=USE-ARRAY-BASE-TYPE
          length: type=uint32, direction=IN, server-argument-impl-policy=USE-ARGUMENT-TYPE
          errorCode: type=Dcm_NegativeResponseCodeType, direction=OUT, server-argument-impl-policy=USE-ARGUMENT-TYPE
      Download: possible-error=[E_RUNNING, StdDiag_Adue/E_NOT_OK]
        4 x arg:
          blockSequenceCounter: type=uint8, direction=IN, server-argument-impl-policy=USE-ARGUMENT-TYPE
          data: type=RCDataArrayType, direction=IN, server-argument-impl-policy=USE-ARRAY-BASE-TYPE
          length: type=uint32, direction=IN, server-argument-impl-policy=USE-ARGUMENT-TYPE
          errorCode: type=Dcm_NegativeResponseCodeType, direction=OUT, server-argument-impl-policy=USE-ARGUMENT-TYPE
      RequestUpload: possible-error=[E_RUNNING, StdDiag_Adue/E_NOT_OK]
        4 x arg, all with server-argument-impl-policy=USE-ARGUMENT-TYPE:
          dataFormatIdentifier: type=uint8, direction=IN
          size: type=uint32, direction=IN
          maxBlockLength: type=uint32, direction=OUT
          errorCode: type=Dcm_NegativeResponseCodeType, direction=OUT
      RequestDownload: possible-error=[E_RUNNING, StdDiag_Adue/E_NOT_OK]
        4 x arg, all with server-argument-impl-policy=USE-ARGUMENT-TYPE:
          dataFormatIdentifier: type=uint8, direction=IN
          size: type=uint32, direction=IN
          maxBlockLength: type=uint32, direction=OUT
          errorCode: type=Dcm_NegativeResponseCodeType, direction=OUT
      RequestDownloadExit: possible-error=StdDiag_Adue/E_OK
      RequestUploadExit: possible-error=StdDiag_Adue/E_OK
      CancelOperation: possible-error=StdDiag_Adue/E_OK
    error E_RUNNING: error-code=10
    error E_NOT_OK: error-code=1
    error E_OK: error-code=0
