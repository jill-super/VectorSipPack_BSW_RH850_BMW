AUTOSAR XML (schema 4-3-0)
package /ActiveEcuC
  module config DlogShared: implementation-config-variant=VARIANT-PRE-COMPILE
    DlogSharedGeneral
      Logistic:
        DlogEcuSerialNumberLength = 10
        DlogEcuSerialNumberDefault = 1234567890
        DlogEcuManufactoringDateDefault = 0x03,0x11,0x17
        DlogNumberOfSvkBackups = 3
        DlogHweDevelopmentInfoLength = 10
        DlogSweDevelopmentInfoLength = 16
        DlogProgrammingCounterMaxValue = 1000
        DlogHweTableInitFromRom = true
        ConfigSet
          HweData: ProcessClass=DLOG_PROCESSCLASS_HWEL, Id=1, VersionMajor=1, VersionMinor=0, VersionPatch=0, DevelopmentInfo=HWEDATA
        HWModificationIndex: HWModificationIndex=0, HWModel=DLOG_HWM_A_MUSTER, SupplierInfoFied=0
      MemorySegmentation
        Blocks_32k (Entry): StartAddress=65536, SegmentSize=32768, NumberOfSegments=30
        Blocks_8k (Entry): StartAddress=0, SegmentSize=8192, NumberOfSegments=8
      Swe: SignatureLength=260, MaxNumberOfSwes=16, CrcSkipSize=255, BluSweId=1
        BTLD (SweConfiguration): SweId=0, SweDescriptionTableAddress=358656, SweSignatureAddress=358684, CpuId=0, SweGroup=ALL_OBLIGATORY
          SignatureBlock: StartAddress=32768, Size=325916
          LogisticData: ProcessClass=DLOG_PROCESSCLASS_BTLD, DevelopmentInfo=BTLD
          SweBlock: BlockStartAddress=32768, BlockSize=327680
        ALL_OBLIGATORY (SweGroupConfiguration): GroupType=ALLOBLIGATORY
        APPL (SweConfiguration): SweId=1, SweDescriptionTableAddress=1046784, SweSignatureAddress=1046812, CpuId=0, SweGroup=ALL_OBLIGATORY
          SignatureBlock: StartAddress=360448, Size=686364
          LogisticData: ProcessClass=DLOG_PROCESSCLASS_SWFL, DevelopmentInfo=SWFLAPPL
          SweBlock: BlockStartAddress=360448, BlockSize=688128
      TimingParameter: EraseMemoryTime=100, CheckMemoryTime=60, BootloaderInstallTime=100, AuthentificationTime=10, ResetTime=10, TransferDataTime=60
    DlogSharedPlatform:
      ConvertExtAddress2IntPointer = ((uint32)extAddress)
      ConvertIntPointer2ExtAddress = ((uint32)intPointer)
      FlashPageSize = 256
      FlashErasedByte = 255
      EccErrorState = INVALID
      HandleEccRom = true
      MultiCpuEnable = false
    Dlog_MultiConfig: EcuId=48, ConfigSet=ConfigSet
    CommonPublishedInformation: SwMajorVersion=5, SwMinorVersion=0, SwPatchVersion=3
