AUTOSAR XML (schema 4-3-0)
package /ActiveEcuC
  module config Bm: implementation-config-variant=VARIANT-PRE-COMPILE
    CommonPublishedInformation: SwMajorVersion=5, SwMinorVersion=1, SwPatchVersion=1
    BmGeneral: BmUserFunctionOne=false, BmUserFunctionTwo=false, BmStartupSelect=SWE_CHECK, BmWatchdogTrigger=false
