AUTOSAR XML (schema 4-3-0)
package /ActiveEcuC
  module config DlogClassic: implementation-config-variant=VARIANT-PRE-COMPILE
    CommonPublishedInformation: SwMajorVersion=5, SwMinorVersion=3, SwPatchVersion=1
    Dlog_Features:
      EnableEcuWriteVin = false
      EnableMemSegTableRead = false
      EnableNvMemory = false
      EnableRte = false
      EnableSvkRamMirror = false
      EnableSvkRead = false
      EnableSvkWrite = false
      EnableSweGet = true
      EnableSweInit = true
      EnableTimingParameters = true
      ExceptionHandlerHandleSWEErrors = false
      MemIfDeviceId = 0
      NvmInterface = DLOG_NVM_INTERFACE_NVM
      RteCodingSvkArraySize = 16
      RteSvkArrayMaxSize = 100
      RteUserSvkArrayMaxSize = 100
      SweGetDirectBootAndAppl1Swe = true
      SweGetPerformErrorCheck = true
      SweGetValidFlagBlankCheck = false
      SweGetVerifyCrcChecksum = false
    Dlog_General: DlogUseCoding=false, DlogWatchdogTrigger=WdgIf_SetTriggerCondition(0,100)
    Dlog_User: RomAccessExceptionHandler=0
