AUTOSAR XML (schema 4-3-0)
package /ActiveEcuC
  ecuc value collection ActiveEcuC: ecuc-values=[Bm, Dlog, DlogShared, EcuC, DlogClassic, Crc]
