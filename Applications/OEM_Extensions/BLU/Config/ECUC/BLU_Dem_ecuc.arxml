AUTOSAR XML (schema 4-3-0)
package /ActiveEcuC
  module config Dem: implementation-config-variant=VARIANT-PRE-COMPILE
    DemConfigSet
      3 x DemEventParameter, all with DemEventAvailable=true, DemEventKind=DEM_EVENT_KIND_BSW:
        DemEventParameter_McuConfigSet_MCU_E_CLOCK_FAILED: DemEventId=2
          DemEventClass: DemAgingAllowed=false, DemConsiderPtoStatus=false, DemEventPriority=4, DemFFPrestorageSupported=false, DemOperationCycleRef=DemOperationCycle
            DemDebounceAlgorithmClass
              DemDebounceMonitorInternal
        DemEventParameter_McuConfigSet_MCU_E_WRITE_TIMEOUT_FAILURE: DemEventId=1
          DemEventClass: DemAgingAllowed=false, DemConsiderPtoStatus=false, DemEventPriority=4, DemFFPrestorageSupported=false, DemOperationCycleRef=DemOperationCycle
            DemDebounceAlgorithmClass
              DemDebounceMonitorInternal
        DemEventParameter_McuConfigSet_MCU_E_RESETCONTROLLER_STARTUP_FAILURE: DemEventId=1
          DemEventClass: DemAgingAllowed=false, DemConsiderPtoStatus=false, DemEventPriority=4, DemFFPrestorageSupported=false, DemOperationCycleRef=DemOperationCycle
            DemDebounceAlgorithmClass
              DemDebounceMonitorInternal
    DemGeneral:
      DemAgingCycleCounterProcessing = DEM_PROCESS_AGINGCTR_INTERN
      DemAgingRequieresTestedCycle = false
      DemAvailabilitySupport = DEM_NO_AVAILABILITY
      DemBswErrorBufferSize = 10
      DemClearDTCBehavior = DEM_CLRRESP_NONVOLATILE_FINISH
      DemClearDTCLimitation = DEM_ALL_SUPPORTED_DTCS
      DemDataElementDefaultEndianness = LITTLE_ENDIAN
      DemDebounceCounterBasedSupport = true
      DemDebounceTimeBasedSupport = false
      DemDevErrorDetect = false
      DemDtcStatusAvailabilityMask = 255
      DemEnableConditionSupport = true
      DemEventCombinationSupport = DEM_EVCOMB_DISABLED
      DemEventDisplacementStrategy = DEM_DISPLACEMENT_FULL
      DemEventMemoryEntryStorageTrigger = DEM_STORAGE_ON_TEST_FAILED
      DemGeneralInterfaceSupport = false
      DemMaxNumberEventEntryMirror = 0
      DemMaxNumberEventEntryPermanent = 0
      DemMaxNumberEventEntryPrimary = 8
      DemMaxNumberEventEntrySecondary = 3
      DemMaxNumberPrestoredFF = 0
      DemOBDSupport = DEM_OBD_NO_OBD_SUPPORT
      DemOccurrenceCounterProcessing = DEM_PROCESS_OCCCTR_TF
      DemOperationCycleStatusStorage = true
      DemPTOSupport = false
      DemResetConfirmedBitOnOverflow = true
      DemStatusBitHandlingTestFailedSinceLastClear = DEM_STATUS_BIT_AGING_AND_DISPLACEMENT
      DemStatusBitStorageTestFailed = false
      DemStorageConditionSupport = false
      DemSuppressionSupport = DEM_DTC_SUPPRESSION
      DemTaskTime = 0.01
      DemTriggerDcmReports = false
      DemTriggerDltReports = false
      DemTriggerFiMReports = false
      DemTriggerMonitorInitBeforeClearOk = false
      DemTypeOfDTCSupported = DEM_DTC_TRANSLATION_ISO14229_1
      DemTypeOfFreezeFrameRecordNumeration = DEM_FF_RECNUM_CALCULATED
      DemVersionInfoApi = false
      DemOperationCycleProcessing = DEM_PROCESS_OPCYC_STATE
      DemOperationCycle: DemOperationCycleAutomaticEnd=false, DemOperationCycleAutostart=false, DemOperationCycleType=DEM_OPCYC_POWER
