AUTOSAR XML (schema 4-3-0)
package /ActiveEcuC
  module config EcuC: implementation-config-variant=VARIANT-PRE-COMPILE, module-description=EcuC_Impl
    EcucGeneral:
      EcuCUseStdReturnTypeForRte = true
      DummyFunction = false
      DummyStatement = true
      StructAlignment = Auto
      ArrayAlignment = Auto
      StructInArrayAlignment = Auto
      SizeOfEnum = Size32Bit
      SizeOfROMPointer = Size32Bit
      SizeOfRAMPointer = Size32Bit
      DummyStatementKind = SelfAssignment
      CPUType = CPU32Bit
      SizeOfInt = Size32Bit
      ByteOrder = LITTLE_ENDIAN
      BitOrder = LSB_to_MSB
      AtomicBitAccessInBitfield = false
      AtomicVariableAccess = Atomic32BitAccess
      BitFieldDataType = INT
      EcuCSafeBswChecks = false
      ConditionalGenerating = true
      EcucBswImplementationCodeType = EcuCSourceCode
      BswInitialization
        3 x InitFunction, all with Header=Mcu.h, ModuleRef=Mcu:
          Mcu_Init: InitPhase=INIT_ONE_EARLY, ConfigType=Mcu_ConfigType, ConfigPtrName=McuModuleConfiguration, ConfigPtrClass=MCU_VAR
          Mcu_DistributePllClock: InitPhase=INIT_ONE
          Mcu_InitClock: InitPhase=INIT_ONE_EARLY, AdditionalInitCode=Mcu_InitClock(McuConf_McuClockSettingConfig_McuClockSettingConfig)
