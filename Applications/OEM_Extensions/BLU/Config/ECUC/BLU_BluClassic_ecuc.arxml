AUTOSAR XML (schema 4-3-0)
package /ActiveEcuC
  module config BluClassic: implementation-config-variant=VARIANT-PRE-COMPILE
    CommonPublishedInformation: SwMajorVersion=5, SwMinorVersion=0, SwPatchVersion=2
    BluGeneral:
      BluUserFunctionOneEnable = false
      BluUserFunctionTwoEnable = false
      BluUserFunctionThreeEnable = false
      BluWatchdogTriggerEnable = true
      BluMaxRetryCount = 3
      BluFlashWriteRamBufferLength = 8192
      BluChecksumStartaddress = 360448
      BluChecksumEndaddress = 1048575
      BluChecksumBlockstep = 256
    Bootloader
      BlEraseSegmentDescription_2k (BlEraseSegmentDescription): StartAddress=32768, SegmentSize=8192, NumberOfSegments=4
      BlProgramDescription: BluSourceAddress=589824, BluSourceLength=327680, BluTargetAddress=32768
      BlEraseSegmentDescription_32k (BlEraseSegmentDescription): StartAddress=65536, SegmentSize=32768, NumberOfSegments=9
    BluSwe
      BluSweEraseSegmentDescription: SegmentId=1, StartAddress=1015808, SegmentSize=32768, NumberOfSegments=1
