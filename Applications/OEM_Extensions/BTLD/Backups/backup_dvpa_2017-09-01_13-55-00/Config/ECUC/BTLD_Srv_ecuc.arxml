AUTOSAR XML (schema 4-3-0)
package /ActiveEcuC
  module config Srv: implementation-config-variant=VARIANT-PRE-COMPILE
    General: HandleEccRam=false, HandleEccRom=false, MultiCpuEnable=false
    CommonPublishedInformation: SwMajorVersion=3, SwMinorVersion=1, SwPatchVersion=0
    Features: BootMode=SRV_BM_ENABLED_DCM
