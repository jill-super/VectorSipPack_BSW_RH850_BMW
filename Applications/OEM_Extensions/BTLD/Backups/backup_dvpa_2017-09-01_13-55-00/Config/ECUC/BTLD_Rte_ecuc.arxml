AUTOSAR XML (schema 4-3-0)
package /ActiveEcuC
  module config Rte: implementation-config-variant=VARIANT-PRE-COMPILE, module-description=Rte_Impl
    3 x RteBswModuleInstance:
      EcuM: RteBswImplementationRef=EcuM_Impl, RteBswModuleConfigurationRef=EcuM
        ECUM_EXCLUSIVE_AREA_1 (RteBswExclusiveAreaImpl): RteExclusiveAreaImplMechanism=ALL_INTERRUPT_BLOCKING, RteBswExclusiveAreaRef=ECUM_EXCLUSIVE_AREA_1
        ECUM_EXCLUSIVE_AREA_2 (RteBswExclusiveAreaImpl): RteExclusiveAreaImplMechanism=ALL_INTERRUPT_BLOCKING, RteBswExclusiveAreaRef=ECUM_EXCLUSIVE_AREA_2
        EcuM_MainFunctionTimingEvent0 (RteBswEventToTaskMapping):
          RteBswImmediateRestart = false
          RteBswPositionInTask = 4
          RteBswEventRef = EcuM_MainFunctionTimingEvent0
          RteBswMappedToTaskRef = Default_BSW_Async_Task
          RteBswUsedOsEventRef = Rte_Ev_Cyclic2_Default_BSW_Async_Task_0_10ms
          RteBswUsedOsAlarmRef = Rte_Al_TE2_Default_BSW_Async_Task_0_10ms
        ECUM_EXCLUSIVE_AREA_0 (RteBswExclusiveAreaImpl): RteExclusiveAreaImplMechanism=ALL_INTERRUPT_BLOCKING, RteBswExclusiveAreaRef=ECUM_EXCLUSIVE_AREA_0
      Xcp: RteBswImplementationRef=Xcp_Impl, RteBswModuleConfigurationRef=Xcp
        4 x RteBswExclusiveAreaImpl, all with RteExclusiveAreaImplMechanism=ALL_INTERRUPT_BLOCKING:
          XCP_EXCLUSIVE_AREA_2: RteBswExclusiveAreaRef=XCP_EXCLUSIVE_AREA_2
          FRXCP_EXCLUSIVE_AREA_0: RteBswExclusiveAreaRef=FRXCP_EXCLUSIVE_AREA_0
          CANXCP_EXCLUSIVE_AREA_0: RteBswExclusiveAreaRef=CANXCP_EXCLUSIVE_AREA_0
          FRXCP_EXCLUSIVE_AREA_1: RteBswExclusiveAreaRef=FRXCP_EXCLUSIVE_AREA_1
        Xcp_MainFunctionTimingEvent0 (RteBswEventToTaskMapping):
          RteBswImmediateRestart = false
          RteBswPositionInTask = 9
          RteBswEventRef = Xcp_MainFunctionTimingEvent0
          RteBswMappedToTaskRef = Default_BSW_Async_Task
          RteBswUsedOsEventRef = Rte_Ev_Cyclic2_Default_BSW_Async_Task_0_5ms
          RteBswUsedOsAlarmRef = Rte_Al_TE2_Default_BSW_Async_Task_0_5ms
        4 x RteBswExclusiveAreaImpl, all with RteExclusiveAreaImplMechanism=ALL_INTERRUPT_BLOCKING:
          TCPIPXCP_EXCLUSIVE_AREA_0: RteBswExclusiveAreaRef=TCPIPXCP_EXCLUSIVE_AREA_0
          XCP_EXCLUSIVE_AREA_0: RteBswExclusiveAreaRef=XCP_EXCLUSIVE_AREA_0
          XCP_EXCLUSIVE_AREA_1: RteBswExclusiveAreaRef=XCP_EXCLUSIVE_AREA_1
          FRXCP_EXCLUSIVE_AREA_2: RteBswExclusiveAreaRef=FRXCP_EXCLUSIVE_AREA_2
        FrXcp_MainFunctionRxTimingEvent0 (RteBswEventToTaskMapping):
          RteBswImmediateRestart = false
          RteBswPositionInTask = 14
          RteBswEventRef = FrXcp_MainFunctionRxTimingEvent0
          RteBswMappedToTaskRef = Default_BSW_Async_Task
          RteBswUsedOsEventRef = Rte_Ev_Cyclic2_Default_BSW_Async_Task_0_5ms
          RteBswUsedOsAlarmRef = Rte_Al_TE2_Default_BSW_Async_Task_0_5ms
        FrXcp_MainFunctionTxTimingEvent0 (RteBswEventToTaskMapping):
          RteBswImmediateRestart = false
          RteBswPositionInTask = 16
          RteBswEventRef = FrXcp_MainFunctionTxTimingEvent0
          RteBswMappedToTaskRef = Default_BSW_Async_Task
          RteBswUsedOsEventRef = Rte_Ev_Cyclic2_Default_BSW_Async_Task_0_5ms
          RteBswUsedOsAlarmRef = Rte_Al_TE2_Default_BSW_Async_Task_0_5ms
      Rte: RteBswImplementationRef=Rte_Impl, RteBswModuleConfigurationRef=Rte
    RteBswGeneral: RteSchMVersionInfoApi=false, RteUseComShadowSignalApi=false
    5 x RteBswModuleInstance:
      BswM: RteBswImplementationRef=BswM_Impl, RteBswModuleConfigurationRef=BswM
        BSWM_EXCLUSIVE_AREA_0 (RteBswExclusiveAreaImpl): RteExclusiveAreaImplMechanism=ALL_INTERRUPT_BLOCKING, RteBswExclusiveAreaRef=BSWM_EXCLUSIVE_AREA_0
        BswM_MainFunctionTimingEvent0 (RteBswEventToTaskMapping):
          RteBswImmediateRestart = false
          RteBswPositionInTask = 3
          RteBswEventRef = BswM_MainFunctionTimingEvent0
          RteBswMappedToTaskRef = Default_BSW_Async_Task
          RteBswUsedOsEventRef = Rte_Ev_Cyclic2_Default_BSW_Async_Task_0_5ms
          RteBswUsedOsAlarmRef = Rte_Al_TE2_Default_BSW_Async_Task_0_5ms
      PduR: RteBswImplementationRef=PduR_Impl, RteBswModuleConfigurationRef=PduR
        PDUR_EXCLUSIVE_AREA_1 (RteBswExclusiveAreaImpl): RteExclusiveAreaImplMechanism=ALL_INTERRUPT_BLOCKING, RteBswExclusiveAreaRef=PDUR_EXCLUSIVE_AREA_1
        PDUR_EXCLUSIVE_AREA_0 (RteBswExclusiveAreaImpl): RteExclusiveAreaImplMechanism=ALL_INTERRUPT_BLOCKING, RteBswExclusiveAreaRef=PDUR_EXCLUSIVE_AREA_0
      Det: RteBswImplementationRef=Det_Impl, RteBswModuleConfigurationRef=Det
        DET_EXCLUSIVE_AREA_0 (RteBswExclusiveAreaImpl): RteExclusiveAreaImplMechanism=ALL_INTERRUPT_BLOCKING, RteBswExclusiveAreaRef=DET_EXCLUSIVE_AREA_0
      Fr: RteBswImplementationRef=Fr_Impl, RteBswModuleConfigurationRef=Fr
        FR_EXCLUSIVE_AREA_0 (RteBswExclusiveAreaImpl): RteExclusiveAreaImplMechanism=ALL_INTERRUPT_BLOCKING, RteBswExclusiveAreaRef=FR_EXCLUSIVE_AREA_0
        FR_EXCLUSIVE_AREA_1 (RteBswExclusiveAreaImpl): RteExclusiveAreaImplMechanism=ALL_INTERRUPT_BLOCKING, RteBswExclusiveAreaRef=FR_EXCLUSIVE_AREA_1
      FrSM: RteBswImplementationRef=FrSM_Impl, RteBswModuleConfigurationRef=FrSM
        FRSM_EXCLUSIVE_AREA_2 (RteBswExclusiveAreaImpl): RteExclusiveAreaImplMechanism=ALL_INTERRUPT_BLOCKING, RteBswExclusiveAreaRef=FRSM_EXCLUSIVE_AREA_2
        FRSM_EXCLUSIVE_AREA_1 (RteBswExclusiveAreaImpl): RteExclusiveAreaImplMechanism=ALL_INTERRUPT_BLOCKING, RteBswExclusiveAreaRef=FRSM_EXCLUSIVE_AREA_1
        FrSM_MainFunction_0TimingEvent0 (RteBswEventToTaskMapping):
          RteBswImmediateRestart = false
          RteBswPositionInTask = 13
          RteBswEventRef = FrSM_MainFunction_0TimingEvent0
          RteBswMappedToTaskRef = Default_BSW_Async_Task
          RteBswUsedOsEventRef = Rte_Ev_Cyclic2_Default_BSW_Async_Task_0_5ms
          RteBswUsedOsAlarmRef = Rte_Al_TE2_Default_BSW_Async_Task_0_5ms
        FRSM_EXCLUSIVE_AREA_3 (RteBswExclusiveAreaImpl): RteExclusiveAreaImplMechanism=ALL_INTERRUPT_BLOCKING, RteBswExclusiveAreaRef=FRSM_EXCLUSIVE_AREA_3
        FRSM_EXCLUSIVE_AREA_0 (RteBswExclusiveAreaImpl): RteExclusiveAreaImplMechanism=ALL_INTERRUPT_BLOCKING, RteBswExclusiveAreaRef=FRSM_EXCLUSIVE_AREA_0
    RteInitializationBehavior: RteInitializationStrategy=RTE_INITIALIZATION_STRATEGY_AT_DATA_DECLARATION, RteSectionInitializationPolicy=INIT
    FrIf (RteBswModuleInstance): RteBswImplementationRef=FrIf_Impl, RteBswModuleConfigurationRef=FrIf
      3 x RteBswExclusiveAreaImpl, all with RteExclusiveAreaImplMechanism=ALL_INTERRUPT_BLOCKING:
        FRIF_EXCLUSIVE_AREA_{0..2}: RteBswExclusiveAreaRef=FRIF_EXCLUSIVE_AREA_{0..2}
      FrIf_MainFunction_0TimingEvent0 (RteBswEventToTaskMapping):
        RteBswImmediateRestart = false
        RteBswPositionInTask = 12
        RteBswEventRef = FrIf_MainFunction_0TimingEvent0
        RteBswMappedToTaskRef = Default_BSW_Async_Task
        RteBswUsedOsEventRef = Rte_Ev_Cyclic2_Default_BSW_Async_Task_0_5ms
        RteBswUsedOsAlarmRef = Rte_Al_TE2_Default_BSW_Async_Task_0_5ms
    RteGeneration:
      RteGenerationMode = COMPATIBILITY_MODE
      RteIocInteractionReturnValue = RTE_IOC
      RteValueRangeCheckEnabled = false
      RteCalibrationSupport = NONE
      RteCodeVendorId = 30
      RteDevErrorDetect = false
      RteDevErrorDetectUninit = false
      RteMeasurementSupport = false
      RteOptimizationMode = MEMORY
      RteVfbTraceEnabled = false
    ComM (RteBswModuleInstance): RteBswImplementationRef=ComM_Impl, RteBswModuleConfigurationRef=ComM
      ComM_MainFunction_0TimingEvent0 (RteBswEventToTaskMapping):
        RteBswImmediateRestart = false
        RteBswPositionInTask = 6
        RteBswEventRef = ComM_MainFunction_0TimingEvent0
        RteBswMappedToTaskRef = Default_BSW_Async_Task
        RteBswUsedOsEventRef = Rte_Ev_Cyclic2_Default_BSW_Async_Task_0_20ms
        RteBswUsedOsAlarmRef = Rte_Al_TE2_Default_BSW_Async_Task_0_20ms
      COMM_EXCLUSIVE_AREA_1 (RteBswExclusiveAreaImpl): RteExclusiveAreaImplMechanism=ALL_INTERRUPT_BLOCKING, RteBswExclusiveAreaRef=COMM_EXCLUSIVE_AREA_1
      COMM_EXCLUSIVE_AREA_0 (RteBswExclusiveAreaImpl): RteExclusiveAreaImplMechanism=ALL_INTERRUPT_BLOCKING, RteBswExclusiveAreaRef=COMM_EXCLUSIVE_AREA_0
    RteOsInteraction
      4 x RteUsedOsActivation, all with RteExpectedActivationOffset=0, RteExpectedTickDuration=0, RteActivationOsTaskRef=Default_BSW_Async_Task:
        Rte_Al_TE2_Default_BSW_Async_Task_0_10ms: RteActivationOsAlarmRef=Rte_Al_TE2_Default_BSW_Async_Task_0_10ms
        Rte_Al_TE2_Default_BSW_Async_Task_0_20ms: RteActivationOsAlarmRef=Rte_Al_TE2_Default_BSW_Async_Task_0_20ms
        Rte_Al_TE2_Default_BSW_Async_Task_0_5ms: RteActivationOsAlarmRef=Rte_Al_TE2_Default_BSW_Async_Task_0_5ms
        Rte_Al_TE_DCMGLUE_CyclicTestRunnable: RteActivationOsAlarmRef=Rte_Al_TE_DCMGLUE_CyclicTestRunnable
    4 x RteSwComponentInstance:
      Det_EcuSwComposition: RteSoftwareComponentInstanceRef=Det
      ComM_EcuSwComposition: RteSoftwareComponentInstanceRef=ComM
        13 x RteEventToTaskMapping, all with RteImmediateRestart=false:
          Timer_ComM_MainFunction_0: RtePositionInTask=6, RteEventRef=Timer_ComM_MainFunction_0, RteMappedToTaskRef=Default_BSW_Async_Task, RteUsedOsEventRef=Rte_Ev_Cyclic2_Default_BSW_Async_Task_0_20ms, RteUsedOsAlarmRef=Rte_Al_TE2_Default_BSW_Async_Task_0_20ms
          OpEventGetInhibitionStatus_GetInhibitionStatus_CL_A_FlexRay_5b5a9ac2: RteEventRef=OpEventGetInhibitionStatus_GetInhibitionStatus_CL_A_FlexRay_5b5a9ac2
          OpEventGetInhibitionStatus_GetInhibitionStatus_CW_A_FlexRay_5b5a9ac2: RteEventRef=OpEventGetInhibitionStatus_GetInhibitionStatus_CW_A_FlexRay_5b5a9ac2
          OpEventLimitECUToNoComMode_LimitECUToNoComMode_modeLimitation: RteEventRef=OpEventLimitECUToNoComMode_LimitECUToNoComMode_modeLimitation
          OpEventReadInhibitCounter_ReadInhibitCounter_modeLimitation: RteEventRef=OpEventReadInhibitCounter_ReadInhibitCounter_modeLimitation
          OpEventResetInhibitCounter_ResetInhibitCounter_modeLimitation: RteEventRef=OpEventResetInhibitCounter_ResetInhibitCounter_modeLimitation
          OpEventSetECUGroupClassification_SetECUGroupClassification_modeLimitation: RteEventRef=OpEventSetECUGroupClassification_SetECUGroupClassification_modeLimitation
          OpEventLimitChannelToNoComMode_LimitChannelToNoComMode_CL_A_FlexRay_5b5a9ac2: RteEventRef=OpEventLimitChannelToNoComMode_LimitChannelToNoComMode_CL_A_FlexRay_5b5a9ac2
          OpEventPreventWakeUp_PreventWakeUp_CW_A_FlexRay_5b5a9ac2: RteEventRef=OpEventPreventWakeUp_PreventWakeUp_CW_A_FlexRay_5b5a9ac2
          OpEventRequestComMode_RequestComMode_UR_USR_A_FlexRay_5b5a9ac2: RteEventRef=OpEventRequestComMode_RequestComMode_UR_USR_A_FlexRay_5b5a9ac2
          OpEventGetCurrentComMode_GetCurrentComMode_UR_USR_A_FlexRay_5b5a9ac2: RteEventRef=OpEventGetCurrentComMode_GetCurrentComMode_UR_USR_A_FlexRay_5b5a9ac2
          OpEventGetMaxComMode_GetMaxComMode_UR_USR_A_FlexRay_5b5a9ac2: RteEventRef=OpEventGetMaxComMode_GetMaxComMode_UR_USR_A_FlexRay_5b5a9ac2
          OpEventGetRequestedComMode_GetRequestedComMode_UR_USR_A_FlexRay_5b5a9ac2: RteEventRef=OpEventGetRequestedComMode_GetRequestedComMode_UR_USR_A_FlexRay_5b5a9ac2
      BswM_EcuSwComposition: RteSoftwareComponentInstanceRef=BswM
        Timer_BswM_MainFunction (RteEventToTaskMapping):
          RteImmediateRestart = false
          RtePositionInTask = 3
          RteEventRef = Timer_BswM_MainFunction
          RteMappedToTaskRef = Default_BSW_Async_Task
          RteUsedOsEventRef = Rte_Ev_Cyclic2_Default_BSW_Async_Task_0_5ms
          RteUsedOsAlarmRef = Rte_Al_TE2_Default_BSW_Async_Task_0_5ms
      EcuM_EcuSwComposition: RteSoftwareComponentInstanceRef=EcuM
        8 x RteEventToTaskMapping, all with RteImmediateRestart=false:
          Timer_EcuM_MainFunction: RtePositionInTask=4, RteEventRef=Timer_EcuM_MainFunction, RteMappedToTaskRef=Default_BSW_Async_Task, RteUsedOsEventRef=Rte_Ev_Cyclic2_Default_BSW_Async_Task_0_10ms, RteUsedOsAlarmRef=Rte_Al_TE2_Default_BSW_Async_Task_0_10ms
          OpEventSelectShutdownTarget_SelectShutdownTarget_EcuM_ShutdownTarget: RteEventRef=OpEventSelectShutdownTarget_SelectShutdownTarget_EcuM_ShutdownTarget
          OpEventGetShutdownTarget_GetShutdownTarget_EcuM_ShutdownTarget: RteEventRef=OpEventGetShutdownTarget_GetShutdownTarget_EcuM_ShutdownTarget
          OpEventGetLastShutdownTarget_GetLastShutdownTarget_EcuM_ShutdownTarget: RteEventRef=OpEventGetLastShutdownTarget_GetLastShutdownTarget_EcuM_ShutdownTarget
          OpEventSelectShutdownCause_SelectShutdownCause_EcuM_ShutdownTarget: RteEventRef=OpEventSelectShutdownCause_SelectShutdownCause_EcuM_ShutdownTarget
          OpEventGetShutdownCause_GetShutdownCause_EcuM_ShutdownTarget: RteEventRef=OpEventGetShutdownCause_GetShutdownCause_EcuM_ShutdownTarget
          OpEventSelectBootTarget_SelectBootTarget_EcuM_BootTarget: RteEventRef=OpEventSelectBootTarget_SelectBootTarget_EcuM_BootTarget
          OpEventGetBootTarget_GetBootTarget_EcuM_BootTarget: RteEventRef=OpEventGetBootTarget_GetBootTarget_EcuM_BootTarget
    Fls (RteBswModuleInstance): RteBswImplementationRef=Fls_Impl, RteBswModuleConfigurationRef=Fls
      3 x RteBswExclusiveAreaImpl, all with RteExclusiveAreaImplMechanism=ALL_INTERRUPT_BLOCKING:
        FLS_DRIVERSTATE_DATA_PROTECTION: RteBswExclusiveAreaRef=FLS_DRIVERSTATE_DATA_PROTECTION
        FLS_REGISTER_PROTECTION: RteBswExclusiveAreaRef=FLS_REGISTER_PROTECTION
        FLS_CODE_FLASH_DISABLED: RteBswExclusiveAreaRef=FLS_CODE_FLASH_DISABLED
      Fls_MainFunctionTimingEvent0 (RteBswEventToTaskMapping):
        RteBswImmediateRestart = false
        RteBswPositionInTask = 11
        RteBswEventRef = Fls_MainFunctionTimingEvent0
        RteBswMappedToTaskRef = Default_BSW_Async_Task
        RteBswUsedOsEventRef = Rte_Ev_Cyclic2_Default_BSW_Async_Task_0_10ms
        RteBswUsedOsAlarmRef = Rte_Al_TE2_Default_BSW_Async_Task_0_10ms
    Dcm (RteBswModuleInstance): RteBswImplementationRef=Dcm_Impl, RteBswModuleConfigurationRef=Dcm
      Dcm_MainFunctionTimingEvent0 (RteBswEventToTaskMapping):
        RteBswImmediateRestart = false
        RteBswPositionInTask = 0
        RteBswEventRef = Dcm_MainFunctionTimingEvent0
        RteBswMappedToTaskRef = Default_BSW_Async_Task
        RteBswUsedOsEventRef = Rte_Ev_Cyclic2_Default_BSW_Async_Task_0_5ms
        RteBswUsedOsAlarmRef = Rte_Al_TE2_Default_BSW_Async_Task_0_5ms
      DCM_EXCLUSIVE_AREA_0 (RteBswExclusiveAreaImpl): RteExclusiveAreaImplMechanism=ALL_INTERRUPT_BLOCKING, RteBswExclusiveAreaRef=DCM_EXCLUSIVE_AREA_0
    Os_OsCore_CORE0_swc_EcuSwComposition (RteSwComponentInstance): RteSoftwareComponentInstanceRef=Os_OsCore_CORE0_swc
      4 x RteEventToTaskMapping, all with RteImmediateRestart=false:
        OpEventGetCounterValue_GetCounterValue_OsService_SystemTimer: RteEventRef=OpEventGetCounterValue_GetCounterValue_OsService_SystemTimer
        OpEventGetElapsedValue_GetElapsedValue_OsService_SystemTimer: RteEventRef=OpEventGetElapsedValue_GetElapsedValue_OsService_SystemTimer
        OpEventGetCounterValue_GetCounterValue_OsService_TpCounter_OsCore_CORE0: RteEventRef=OpEventGetCounterValue_GetCounterValue_OsService_TpCounter_OsCore_CORE0
        OpEventGetElapsedValue_GetElapsedValue_OsService_TpCounter_OsCore_CORE0: RteEventRef=OpEventGetElapsedValue_GetElapsedValue_OsService_TpCounter_OsCore_CORE0
    4 x RteBswModuleInstance:
      Mcu: RteBswImplementationRef=Mcu_Impl, RteBswModuleConfigurationRef=Mcu
        MCU_REG_DATA_PROTECTION (RteBswExclusiveAreaImpl): RteExclusiveAreaImplMechanism=ALL_INTERRUPT_BLOCKING, RteBswExclusiveAreaRef=MCU_REG_DATA_PROTECTION
        MCU_REGISTER_PROTECTION (RteBswExclusiveAreaImpl): RteExclusiveAreaImplMechanism=ALL_INTERRUPT_BLOCKING, RteBswExclusiveAreaRef=MCU_REGISTER_PROTECTION
      Port: RteBswImplementationRef=Port_Impl, RteBswModuleConfigurationRef=Port
        7 x RteBswExclusiveAreaImpl, all with RteExclusiveAreaImplMechanism=ALL_INTERRUPT_BLOCKING:
          PORT_SET_PIN_DIR_PROTECTION: RteBswExclusiveAreaRef=PORT_SET_PIN_DIR_PROTECTION
          PORT_SET_PIN_MODE_PROTECTION: RteBswExclusiveAreaRef=PORT_SET_PIN_MODE_PROTECTION
          PORT_SET_TO_DIO_ALT_PROTECTION: RteBswExclusiveAreaRef=PORT_SET_TO_DIO_ALT_PROTECTION
          PORT_INIT_CONFIG_PROTECTION: RteBswExclusiveAreaRef=PORT_INIT_CONFIG_PROTECTION
          PORT_REFRESHPORT_INTERNAL_PROTECTION: RteBswExclusiveAreaRef=PORT_REFRESHPORT_INTERNAL_PROTECTION
          PORT_SET_PIN_DEFAULT_MODE_PROTECTION: RteBswExclusiveAreaRef=PORT_SET_PIN_DEFAULT_MODE_PROTECTION
          PORT_SET_PIN_DEFAULT_DIR_PROTECTION: RteBswExclusiveAreaRef=PORT_SET_PIN_DEFAULT_DIR_PROTECTION
      Fee: RteBswImplementationRef=Fee_Impl, RteBswModuleConfigurationRef=Fee
        Fee_30_SmallSector_MainFunctionTimingEvent0 (RteBswEventToTaskMapping):
          RteBswImmediateRestart = false
          RteBswPositionInTask = 10
          RteBswEventRef = Fee_30_SmallSector_MainFunctionTimingEvent0
          RteBswMappedToTaskRef = Default_BSW_Async_Task
          RteBswUsedOsEventRef = Rte_Ev_Cyclic2_Default_BSW_Async_Task_0_5ms
          RteBswUsedOsAlarmRef = Rte_Al_TE2_Default_BSW_Async_Task_0_5ms
      FrTp: RteBswImplementationRef=FrTp_Impl, RteBswModuleConfigurationRef=FrTp
        FrTp_MainFunctionTimingEvent0 (RteBswEventToTaskMapping):
          RteBswImmediateRestart = false
          RteBswPositionInTask = 15
          RteBswEventRef = FrTp_MainFunctionTimingEvent0
          RteBswMappedToTaskRef = Default_BSW_Async_Task
          RteBswUsedOsEventRef = Rte_Ev_Cyclic2_Default_BSW_Async_Task_0_5ms
          RteBswUsedOsAlarmRef = Rte_Al_TE2_Default_BSW_Async_Task_0_5ms
        3 x RteBswExclusiveAreaImpl, all with RteExclusiveAreaImplMechanism=ALL_INTERRUPT_BLOCKING:
          FRTP_EXCLUSIVE_AREA_{0..2}: RteBswExclusiveAreaRef=FRTP_EXCLUSIVE_AREA_{0..2}
    Dcm_EcuSwComposition (RteSwComponentInstance): RteSoftwareComponentInstanceRef=Dcm
      7 x RteEventToTaskMapping, all with RteImmediateRestart=false:
        Timer_Dcm_MainFunction: RtePositionInTask=0, RteEventRef=Timer_Dcm_MainFunction, RteMappedToTaskRef=Default_BSW_Async_Task, RteUsedOsEventRef=Rte_Ev_Cyclic2_Default_BSW_Async_Task_0_5ms, RteUsedOsAlarmRef=Rte_Al_TE2_Default_BSW_Async_Task_0_5ms
        OpEventGetActiveProtocol_GetActiveProtocol_DCMServices: RteEventRef=OpEventGetActiveProtocol_GetActiveProtocol_DCMServices
        OpEventGetSesCtrlType_GetSesCtrlType_DCMServices: RteEventRef=OpEventGetSesCtrlType_GetSesCtrlType_DCMServices
        OpEventResetToDefaultSession_ResetToDefaultSession_DCMServices: RteEventRef=OpEventResetToDefaultSession_ResetToDefaultSession_DCMServices
        OpEventGetSecurityLevel_GetSecurityLevel_DCMServices: RteEventRef=OpEventGetSecurityLevel_GetSecurityLevel_DCMServices
        OpEventSetActiveDiagnostic_SetActiveDiagnostic_DCMServices: RteEventRef=OpEventSetActiveDiagnostic_SetActiveDiagnostic_DCMServices
        OpEventGetRequestKind_GetRequestKind_DCMServices: RteEventRef=OpEventGetRequestKind_GetRequestKind_DCMServices
    DCMGLUE (RteSwComponentType): RteComponentTypeRef=DCMGLUE, RteImplementationRef=DCMGLUE_Implementation
      ComponentTypeCalibration (RteComponentTypeCalibration): RteCalibrationSupportEnabled=false
    DCMGLUE_EcuSwComposition (RteSwComponentInstance): RteSoftwareComponentInstanceRef=DCMGLUE
      6 x RteEventToTaskMapping, all with RteImmediateRestart=false, RteMappedToTaskRef=Default_BSW_Async_Task:
        MST_DcmDtcControlRunnable_1: RtePositionInTask=1, RteEventRef=MST_DcmDtcControlRunnable_1, RteUsedOsEventRef=Rte_Ev_Run_DCMGLUE_DcmDtcControlRunnable
        MST_DcmDtcControlRunnable_0: RtePositionInTask=1, RteEventRef=MST_DcmDtcControlRunnable_0, RteUsedOsEventRef=Rte_Ev_Run_DCMGLUE_DcmDtcControlRunnable
        MST_DcmSessionControlRunnable_0: RtePositionInTask=5, RteEventRef=MST_DcmSessionControlRunnable_0, RteUsedOsEventRef=Rte_Ev_Run1_DCMGLUE_DcmSessionControlRunnable
        OIT_ProgDcmCompareKeyRunnable_SecurityAccess_UNLOCKED_LVL_09_CompareKey: RtePositionInTask=7, RteEventRef=OIT_ProgDcmCompareKeyRunnable_SecurityAccess_UNLOCKED_LVL_09_CompareKey
        OIT_ProgDcmGetSeedRunnable_SecurityAccess_UNLOCKED_LVL_09_GetSeed: RtePositionInTask=8, RteEventRef=OIT_ProgDcmGetSeedRunnable_SecurityAccess_UNLOCKED_LVL_09_GetSeed
        TMT_CyclicTestRunnable: RtePositionInTask=2, RteEventRef=TMT_CyclicTestRunnable, RteUsedOsEventRef=Rte_Ev_Run_DCMGLUE_CyclicTestRunnable, RteUsedOsAlarmRef=Rte_Al_TE_DCMGLUE_CyclicTestRunnable
