AUTOSAR XML (schema 4-3-0)
package /ActiveEcuC
  module config Dem: implementation-config-variant=VARIANT-PRE-COMPILE
    DemConfigSet
      13 x DemEventParameter, all with DemEventKind=DEM_EVENT_KIND_BSW:
        AutoCreatedDemEvent_McuModuleConfiguration_MCU_E_CLOCK_FAILURE: DemEventAvailable=true, DemEventId=1
          DemEventClass: DemAgingAllowed=true, DemConsiderPtoStatus=false, DemEventPriority=2, DemFFPrestorageSupported=false, DemOperationCycleRef=NON_OBD
            DemDebounceAlgorithmClass
              DemDebounceMonitorInternal
        AutoCreatedDemEvent_McuModuleConfiguration_MCU_E_RESETCONTROLLER_STARTUP_FAILURE: DemEventAvailable=false, DemEventId=2
          DemEventClass: DemAgingAllowed=false, DemConsiderPtoStatus=false, DemEventPriority=2, DemFFPrestorageSupported=false, DemOperationCycleRef=NON_OBD
            DemDebounceAlgorithmClass
              DemDebounceMonitorInternal
        AutoCreatedDemEvent_McuModuleConfiguration_MCU_E_WRITE_TIMEOUT_FAILURE: DemEventAvailable=false, DemEventId=3
          DemEventClass: DemAgingAllowed=false, DemConsiderPtoStatus=false, DemEventPriority=2, DemFFPrestorageSupported=false, DemOperationCycleRef=NON_OBD
            DemDebounceAlgorithmClass
              DemDebounceMonitorInternal
        AutoCreatedDemEvent_FlsConfigSet_FLS_E_COMPARE_FAILED: DemEventAvailable=false, DemEventId=2
          DemEventClass: DemAgingAllowed=false, DemConsiderPtoStatus=false, DemEventPriority=2, DemFFPrestorageSupported=false, DemOperationCycleRef=NON_OBD
            DemDebounceAlgorithmClass
              DemDebounceMonitorInternal
        AutoCreatedDemEvent_FlsConfigSet_FLS_E_ECC_FAILED: DemEventAvailable=false, DemEventId=2
          DemEventClass: DemAgingAllowed=false, DemConsiderPtoStatus=false, DemEventPriority=2, DemFFPrestorageSupported=false, DemOperationCycleRef=NON_OBD
            DemDebounceAlgorithmClass
              DemDebounceMonitorInternal
        AutoCreatedDemEvent_FlsConfigSet_FLS_E_ERASE_FAILED: DemEventAvailable=false, DemEventId=2
          DemEventClass: DemAgingAllowed=false, DemConsiderPtoStatus=false, DemEventPriority=2, DemFFPrestorageSupported=false, DemOperationCycleRef=NON_OBD
            DemDebounceAlgorithmClass
              DemDebounceMonitorInternal
        AutoCreatedDemEvent_FlsConfigSet_FLS_E_HW_FAILURE: DemEventAvailable=false, DemEventId=2
          DemEventClass: DemAgingAllowed=false, DemConsiderPtoStatus=false, DemEventPriority=2, DemFFPrestorageSupported=false, DemOperationCycleRef=NON_OBD
            DemDebounceAlgorithmClass
              DemDebounceMonitorInternal
        AutoCreatedDemEvent_FlsConfigSet_FLS_E_INT_INCONSISTENT: DemEventAvailable=false, DemEventId=2
          DemEventClass: DemAgingAllowed=false, DemConsiderPtoStatus=false, DemEventPriority=2, DemFFPrestorageSupported=false, DemOperationCycleRef=NON_OBD
            DemDebounceAlgorithmClass
              DemDebounceMonitorInternal
        AutoCreatedDemEvent_FlsConfigSet_FLS_E_READ_FAILED: DemEventAvailable=false, DemEventId=2
          DemEventClass: DemAgingAllowed=false, DemConsiderPtoStatus=false, DemEventPriority=2, DemFFPrestorageSupported=false, DemOperationCycleRef=NON_OBD
            DemDebounceAlgorithmClass
              DemDebounceMonitorInternal
        AutoCreatedDemEvent_FlsConfigSet_FLS_E_READ_FAILED_DED: DemEventAvailable=false, DemEventId=2
          DemEventClass: DemAgingAllowed=false, DemConsiderPtoStatus=false, DemEventPriority=2, DemFFPrestorageSupported=false, DemOperationCycleRef=NON_OBD
            DemDebounceAlgorithmClass
              DemDebounceMonitorInternal
        AutoCreatedDemEvent_FlsConfigSet_FLS_E_REG_WRITE_VERIFY: DemEventAvailable=false, DemEventId=2
          DemEventClass: DemAgingAllowed=false, DemConsiderPtoStatus=false, DemEventPriority=2, DemFFPrestorageSupported=false, DemOperationCycleRef=NON_OBD
            DemDebounceAlgorithmClass
              DemDebounceMonitorInternal
        AutoCreatedDemEvent_FlsConfigSet_FLS_E_UNEXPECTED_FLASH_ID: DemEventAvailable=false, DemEventId=2
          DemEventClass: DemAgingAllowed=false, DemConsiderPtoStatus=false, DemEventPriority=2, DemFFPrestorageSupported=false, DemOperationCycleRef=NON_OBD
            DemDebounceAlgorithmClass
              DemDebounceMonitorInternal
        AutoCreatedDemEvent_FlsConfigSet_FLS_E_WRITE_FAILED: DemEventAvailable=false, DemEventId=2
          DemEventClass: DemAgingAllowed=false, DemConsiderPtoStatus=false, DemEventPriority=2, DemFFPrestorageSupported=false, DemOperationCycleRef=NON_OBD
            DemDebounceAlgorithmClass
              DemDebounceMonitorInternal
    DemGeneral:
      DemAgingCycleCounterProcessing = DEM_PROCESS_AGINGCTR_INTERN
      DemAgingRequieresTestedCycle = false
      DemAvailabilitySupport = DEM_NO_AVAILABILITY
      DemBswErrorBufferSize = 0
      DemClearDTCBehavior = DEM_CLRRESP_NONVOLATILE_FINISH
      DemClearDTCLimitation = DEM_ALL_SUPPORTED_DTCS
      DemDataElementDefaultEndianness = LITTLE_ENDIAN
      DemDebounceCounterBasedSupport = true
      DemDebounceTimeBasedSupport = false
      DemDevErrorDetect = false
      DemDtcStatusAvailabilityMask = 255
      DemEnableConditionSupport = true
      DemEventCombinationSupport = DEM_EVCOMB_DISABLED
      DemEventDisplacementStrategy = DEM_DISPLACEMENT_FULL
      DemEventMemoryEntryStorageTrigger = DEM_STORAGE_ON_TEST_FAILED
      DemGeneralInterfaceSupport = false
      DemMaxNumberEventEntryMirror = 0
      DemMaxNumberEventEntryPermanent = 0
      DemMaxNumberEventEntryPrimary = 8
      DemMaxNumberEventEntrySecondary = 3
      DemMaxNumberPrestoredFF = 0
      DemOBDSupport = DEM_OBD_NO_OBD_SUPPORT
      DemOccurrenceCounterProcessing = DEM_PROCESS_OCCCTR_TF
      DemOperationCycleStatusStorage = false
      DemPTOSupport = false
      DemResetConfirmedBitOnOverflow = true
      DemStatusBitHandlingTestFailedSinceLastClear = DEM_STATUS_BIT_AGING_AND_DISPLACEMENT
      DemStatusBitStorageTestFailed = false
      DemStorageConditionSupport = false
      DemSuppressionSupport = DEM_NO_SUPPRESSION
      DemTaskTime = 0.005
      DemTriggerDcmReports = false
      DemTriggerDltReports = false
      DemTriggerFiMReports = false
      DemTriggerMonitorInitBeforeClearOk = false
      DemTypeOfDTCSupported = DEM_DTC_TRANSLATION_ISO14229_1
      DemTypeOfFreezeFrameRecordNumeration = DEM_FF_RECNUM_CALCULATED
      DemVersionInfoApi = false
      NON_OBD (DemOperationCycle): DemOperationCycleAutomaticEnd=false, DemOperationCycleAutostart=false, DemOperationCycleType=DEM_OPCYC_POWER
      OBD (DemOperationCycle): DemOperationCycleAutomaticEnd=false, DemOperationCycleAutostart=false, DemOperationCycleType=DEM_OPCYC_OBD_DCY
