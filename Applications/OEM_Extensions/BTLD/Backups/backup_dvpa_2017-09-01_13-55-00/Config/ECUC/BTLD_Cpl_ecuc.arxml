AUTOSAR XML (schema 4-3-0)
package /ActiveEcuC
  module config Cpl: implementation-config-variant=VARIANT-PRE-COMPILE
    CommonPublishedInformation: SwMajorVersion=3, SwMinorVersion=1, SwPatchVersion=0
    CplSHA: CplSHACodeEnable=true
      CplSHAConfig: CplSHAVariant=CPL_SHA_256
    CplMD5: CplMD5CodeEnable=true
      CplMD5Config
    CplAESEncrypt: CplAESEncryptCodeEnable=true
    CplAESDecrypt: CplAESDecryptCodeEnable=true
    CplCBCMacGenerate: CplCBCMacGenerateCodeEnable=true
    CplCBCMacVerify: CplCBCMacVerifyCodeEnable=true
    CplCbcPkcs5Decrypt: CplCbcPkcs5DecryptCodeEnable=true
    CplCbcDecWithBlockEnc: CplCbcDecWithBlockEncCodeEnable=true
    CplSymKeyExtract: CplSymKeyExtractCodeEnable=false
    CplSSG: CplSSGCodeEnable=true
      CplSSGConfig_RandomGenerate (CplSSGConfig)
      CplSSGConfig_RandomSeed (CplSSGConfig)
    CplSigBMWVerify: CplSigBMWVerifyCodeEnable=true, MaxHashLength=32
      CplSigBMWVrfyConfig_MD5 (CplSigBMWVerifyConfig): KeyLength=128, HashConfig=CalHashConfig_MD5
      CplSigBMWVrfyConfig_SHA (CplSigBMWVerifyConfig): KeyLength=256, HashConfig=CalHashConfig_SHA
    CplPKCS1Verify: CplPKCS1VerifyCodeEnable=false
    CplPBKDF1: CplPBKDF1CodeEnable=false
    CplDifHellmanCalcSecret: CplDifHellmanCalcSecretCodeEnable=false
    CplDESDecrypt: CplDESDecryptCodeEnable=false
    CplDESEncrypt: CplDESEncryptCodeEnable=false
    CplHMacGenerate: CplHMacGenerateCodeEnable=false
    CplHMacVerify: CplHMacVerifyCodeEnable=false
    CplJmpTable: CplJmpTableCreate=true
    CplKeys: CplAsymKeyTableCreate=true, CplSymKeyTableCreate=false
