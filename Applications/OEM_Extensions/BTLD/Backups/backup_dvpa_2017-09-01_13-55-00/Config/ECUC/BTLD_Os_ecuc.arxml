AUTOSAR XML (schema 4-3-0)
package /ActiveEcuC
  module config Os: implementation-config-variant=VARIANT-PRE-COMPILE, module-description=Os_Impl
    OsPublishedInformation: OsKernelVersion=7, OsPlatformName=Rh850
      RH850P1M (OsDerivativeInformation):
        OsMpuAlignment = 4
        OsStackAlignment = 4
        OsExceptionVectorTableAlignment = 512
        OsInterruptVectorTableAlignment = 512
        OsHardwareManuals = RH850/P1x Group Users Manual: Hardware Rev.1.00 Jul, 2015 RH850G3M Users Manual: Software Rev.1.30 Jun 2016 RH850/P1M Safety Application Note Rev.2.00 Release May 19, 2016
        3 x OsHardwareTimer, all with OsHardwareTimerHighResPossible=false, OsHardwareTimerUnit=TAUJ, OsHardwareTimerSize=32, OsHardwareTimerType=TAUJ:
          TAUJ0: OsHardwareTimerBaseAddress=4293197824, OsHardwareTimerId=0
            4 x OsHardwareTimerChannel:
              TAUJ0_CH3: OsHardwareTimerChannelIntSource=136, OsHardwareTimerChannelOffset=3, OsHardwareTimerChannelId=3
              TAUJ0_CH2: OsHardwareTimerChannelIntSource=135, OsHardwareTimerChannelOffset=2, OsHardwareTimerChannelId=2
              TAUJ0_CH1: OsHardwareTimerChannelIntSource=134, OsHardwareTimerChannelOffset=1, OsHardwareTimerChannelId=1
              TAUJ0_CH0: OsHardwareTimerChannelIntSource=133, OsHardwareTimerChannelOffset=0, OsHardwareTimerChannelId=0
          TAUJ1: OsHardwareTimerBaseAddress=4293201920, OsHardwareTimerId=1
            4 x OsHardwareTimerChannel:
              TAUJ1_CH3: OsHardwareTimerChannelIntSource=140, OsHardwareTimerChannelOffset=3, OsHardwareTimerChannelId=3
              TAUJ1_CH0: OsHardwareTimerChannelIntSource=137, OsHardwareTimerChannelOffset=0, OsHardwareTimerChannelId=0
              TAUJ1_CH2: OsHardwareTimerChannelIntSource=139, OsHardwareTimerChannelOffset=2, OsHardwareTimerChannelId=2
              TAUJ1_CH1: OsHardwareTimerChannelIntSource=138, OsHardwareTimerChannelOffset=1, OsHardwareTimerChannelId=1
          TAUJ2: OsHardwareTimerBaseAddress=4293206016, OsHardwareTimerId=2
            4 x OsHardwareTimerChannel:
              TAUJ2_CH1: OsHardwareTimerChannelIntSource=169, OsHardwareTimerChannelOffset=1, OsHardwareTimerChannelId=1
              TAUJ2_CH0: OsHardwareTimerChannelIntSource=168, OsHardwareTimerChannelOffset=0, OsHardwareTimerChannelId=0
              TAUJ2_CH3: OsHardwareTimerChannelIntSource=171, OsHardwareTimerChannelOffset=3, OsHardwareTimerChannelId=3
              TAUJ2_CH2: OsHardwareTimerChannelIntSource=170, OsHardwareTimerChannelOffset=2, OsHardwareTimerChannelId=2
        CORE0 (OsPhysicalCore):
          OsPhysicalCoreId = 0
          OsPhysicalCoreDefaultEntrySymbol = RESET_CORE0
          OsPhysicalCoreType = G3M
          OsPhysicalCoreExceptionSources = 16
          OsPhysicalCoreIsAutostart = true
          OsPhysicalCoreMasterStartAllowed = false
          OsPhysicalCorePrivelegedHwAccess = true
          OsPhysicalCoreStackProtectionUnit = MPU_CORE0
          MPU_CORE0 (OsPhysicalCoreMpu): OsPhysicalCoreMpuId=0, OsPhysicalCoreMpuMaxRegions=12, OsPhysicalCoreMpuType=CoreMpu
        INTC (OsSystemIntCtrl): OsSystemIntCtrlBaseAddress=4294896128, OsSystemIntCtrlMaxPrios=16, OsSystemIntCtrlMaxSources=512, OsSystemIntCtrlPrioOrder=DESC
          5 x OsSystemIntCtrlAddress:
            IPIR: OsSystemIntCtrlAddressValue=0
            INTC2: OsSystemIntCtrlAddressValue=4294946816
            EIBD1: OsSystemIntCtrlAddressValue=0
            INTC1: OsSystemIntCtrlAddressValue=4294896128
            EIBD2: OsSystemIntCtrlAddressValue=0
        OSTM1 (OsHardwareTimer):
          OsHardwareTimerBaseAddress = 4292710400
          OsHardwareTimerHighResPossible = true
          OsHardwareTimerUnit = OSTM
          OsHardwareTimerSize = 32
          OsHardwareTimerId = 1
          OsHardwareTimerType = OSTM
          OSTM1 (OsHardwareTimerChannel): OsHardwareTimerChannelIntSource=75, OsHardwareTimerChannelOffset=0, OsHardwareTimerChannelId=0
        OSTM0 (OsHardwareTimer):
          OsHardwareTimerBaseAddress = 4292706304
          OsHardwareTimerHighResPossible = true
          OsHardwareTimerUnit = OSTM
          OsHardwareTimerSize = 32
          OsHardwareTimerId = 0
          OsHardwareTimerType = OSTM
          OSTM0 (OsHardwareTimerChannel): OsHardwareTimerChannelIntSource=74, OsHardwareTimerChannelOffset=0, OsHardwareTimerChannelId=0
        MPAT (OsMemoryRegionSpecifics)
          6 x OsMemoryRegionAccess:
            SW: OsMemoryRegionAccessRights=W, OsMemoryRegionAccessType=SUPERVISOR
            SX: OsMemoryRegionAccessRights=X, OsMemoryRegionAccessType=SUPERVISOR
            UW: OsMemoryRegionAccessRights=W, OsMemoryRegionAccessType=USER
            UX: OsMemoryRegionAccessRights=X, OsMemoryRegionAccessType=USER
            UR: OsMemoryRegionAccessRights=R, OsMemoryRegionAccessType=USER
            SR: OsMemoryRegionAccessRights=R, OsMemoryRegionAccessType=SUPERVISOR
    Fr_IrqTimer0 (OsIsr):  # Os Interrupt Service Routine PLAIN_TEXT ISR that handles Timer0-interrupt for FlexRay.
      OsIsrCategory = CATEGORY_2
      OsIsrInterruptType = EXTERNAL
      OsIsrInterruptSource = 196
      OsIsrInterruptPriority = 11
      OsIsrStackSize = 1024
      OsIsrEnableNesting = false
    OS_APPMODE_ANY (OsAppMode)
    OSDEFAULTAPPMODE (OsAppMode)
    OsOS:
      OsStackMonitoring = true
      OsStatus = STANDARD
      OsUseGetServiceId = false
      OsUseParameterAccess = false
      OsUseResScheduler = false
      OsForcibleTermination = false
      OsGenerateCalloutStubs = true
      OsGenerateMemMap = COMPLETE
      OsGenerateMemMapForThreads = false
      OsServiceProtection = false
      OsStackUsageMeasurement = false
      OsUseXSignalAsyncApiCalls = false
      OsScalabilityClass = SC1
      OsGenerateMemMapForNearAddressing = false
      OsMasterCore = OsCore_CORE0
      OsSystemTimer = SystemTimer
      OsHooks: OsErrorHook=true, OsPostTaskHook=false, OsPreTaskHook=false, OsShutdownHook=false, OsStartupHook=false, OsPanicHook=true
    Fr_IrqLine0 (OsIsr):  # Os Interrupt Service Routine PLAIN_TEXT ISR that handles Cyclestart-interrupt for FlexRay.
      OsIsrCategory = CATEGORY_2
      OsIsrInterruptType = EXTERNAL
      OsIsrInterruptSource = 194
      OsIsrInterruptPriority = 10
      OsIsrStackSize = 1024
      OsIsrEnableNesting = false
    SystemTimer (OsCounter):
      OsCounterMaxAllowedValue = 1073741823
      OsCounterMinCycle = 1
      OsCounterType = HARDWARE
      OsSecondsPerTick = 1.25E-8
      OsCounterTicksPerBase = 1
      OsCounterAccessingApplication = SystemApplication_OsCore_CORE0
      OsDriver: OsDriverHighResolution=true, OsDriverHardwareTimerChannelRef=OSTM0/OSTM0, OsDriverIsrRef=Os_TimerPitIsr
    OsCore_CORE0 (OsCore):
      OsCoreIsAutostart = true
      OsCoreIsAutosar = true
      OsCoreEntrySymbol = _usr_init
      OsCorePhysicalCoreRef = CORE0
      OsCoreIdleTask = BackgroundTask
      OsCoreSystemApplication = SystemApplication_OsCore_CORE0
      OsCoreEcucCoreRef = EcucCore0
      OsCoreStacks:
        OsCoreKernelStackSize = 1024
        OsCoreStartupStackSize = 1024
        OsCoreShutdownStackSize = 1024
        OsCoreErrorStackSize = 1024
        OsCoreProtectionStackSize = 1024
        OsCoreInitStackSize = 1024
    BackgroundTask (OsTask):
      OsTaskActivation = 1
      OsTaskPriority = 4294967295
      OsTaskSchedule = FULL
      OsTaskStackSharing = false
      OsTaskStackSize = 512
      OsTaskType = AUTO
      OsTaskAccessingApplication = SystemApplication_OsCore_CORE0
      OsTaskAutostart: OsTaskAppModeRef=OS_APPMODE_ANY
    SystemApplication_OsCore_CORE0 (OsApplication):
      OsTrusted = true
      OsTrustedApplicationDelayTimingViolationCall = false
      OsTrustedApplicationWithProtection = false
      OsApplicationIsPrivileged = true
      OsAppUseTrustedFunctionStubs = false
      OsApplicationCoreRef = EcucCore0
      OsAppIsrRef = Os_TimerPitIsr
      OsAppCounterRef = TpCounter_OsCore_CORE0
      OsAppIsrRef = CounterIsr_TpCounter_OsCore_CORE0
      OsAppTaskRef = BackgroundTask
      OsAppAlarmRef = Rte_Al_TE_DCMGLUE_CyclicTestRunnable
      OsApplicationHooks: OsAppErrorHook=false, OsAppShutdownHook=false, OsAppStartupHook=false
    Os_TimerPitIsr (OsIsr):
      OsIsrCategory = CATEGORY_2
      OsIsrInterruptType = EXTERNAL
      OsIsrInterruptSource = 74
      OsIsrInterruptPriority = 0
      OsIsrStackSize = 1024
      OsIsrEnableNesting = false
      OsIsrSpecialFunctionName = Os_TimerHrtIsr
    OsApplication_Core0 (OsApplication):
      OsTrusted = true
      OsTrustedApplicationDelayTimingViolationCall = false
      OsTrustedApplicationWithProtection = false
      OsApplicationIsPrivileged = true
      OsAppUseTrustedFunctionStubs = false
      OsApplicationCoreRef = EcucCore0
      OsAppIsrRef = Fr_IrqLine0
      OsAppIsrRef = Fr_IrqTimer0
      OsAppCounterRef = SystemTimer
      OsAppTaskRef = ShutdownTask
      OsAppTaskRef = Cpl_Task
      OsAppTaskRef = Default_BSW_Async_Task
      OsAppTaskRef = InitTask
      OsAppAlarmRef = Rte_Al_TE2_Default_BSW_Async_Task_0_5ms
      OsAppAlarmRef = Rte_Al_TE2_Default_BSW_Async_Task_0_10ms
      OsAppAlarmRef = Rte_Al_TE2_Default_BSW_Async_Task_0_20ms
      OsApplicationHooks: OsAppErrorHook=false, OsAppShutdownHook=false, OsAppStartupHook=false
    TpCounter_OsCore_CORE0 (OsCounter):
      OsCounterMaxAllowedValue = 1073741823
      OsCounterMinCycle = 1
      OsCounterTicksPerBase = 1
      OsCounterType = HARDWARE
      OsSecondsPerTick = 1.25E-8
      OsCounterAccessingApplication = SystemApplication_OsCore_CORE0
      OsDriver: OsDriverHighResolution=true, OsDriverHardwareTimerChannelRef=OSTM1/OSTM1, OsDriverIsrRef=CounterIsr_TpCounter_OsCore_CORE0
    CounterIsr_TpCounter_OsCore_CORE0 (OsIsr):
      OsIsrCategory = CATEGORY_2
      OsIsrInterruptType = EXTERNAL
      OsIsrInterruptSource = 75
      OsIsrInterruptPriority = 0
      OsIsrStackSize = 1024
      OsIsrEnableNesting = false
      OsIsrSpecialFunctionName = Os_TimerHrtIsr
    OsResource: OsResourceProperty=STANDARD, OsResourceAccessingApplication=SystemApplication_OsCore_CORE0, OsResourceAccessingApplication=OsApplication_Core0
    4 x OsTask, all with OsTaskActivation=1, OsTaskStackSharing=false, OsTaskType=AUTO, OsTaskAccessingApplication=SystemApplication_OsCore_CORE0:
      ShutdownTask: OsTaskPriority=1, OsTaskSchedule=NON, OsTaskStackSize=512, OsTaskResourceRef=OsResource
      Cpl_Task: OsTaskPriority=5, OsTaskSchedule=FULL, OsTaskStackSize=1024, OsTaskResourceRef=OsResource
      Default_BSW_Async_Task: OsTaskPriority=10, OsTaskSchedule=NON, OsTaskStackSize=2048, OsTaskEventRef=Rte_Ev_Cyclic2_Default_BSW_Async_Task_0_10ms, OsTaskEventRef=Rte_Ev_Cyclic2_Default_BSW_Async_Task_0_20ms, OsTaskEventRef=Rte_Ev_Cyclic2_Default_BSW_Async_Task_0_5ms, OsTaskEventRef=Rte_Ev_Run1_DCMGLUE_DcmSessionControlRunnable, OsTaskEventRef=Rte_Ev_Run_DCMGLUE_DcmDtcControlRunnable, OsTaskEventRef=Rte_Ev_Run_DCMGLUE_CyclicTestRunnable
      InitTask: OsTaskPriority=200, OsTaskSchedule=NON, OsTaskStackSize=512
        OsTaskAutostart: OsTaskAppModeRef=OSDEFAULTAPPMODE
    3 x OsAlarm, all with OsAlarmCounterRef=SystemTimer, OsAlarmAccessingApplication=SystemApplication_OsCore_CORE0:
      Rte_Al_TE2_Default_BSW_Async_Task_0_10ms
        OsAlarmAction
          OsAlarmSetEvent: OsAlarmSetEventRef=Rte_Ev_Cyclic2_Default_BSW_Async_Task_0_10ms, OsAlarmSetEventTaskRef=Default_BSW_Async_Task
      Rte_Al_TE2_Default_BSW_Async_Task_0_20ms
        OsAlarmAction
          OsAlarmSetEvent: OsAlarmSetEventRef=Rte_Ev_Cyclic2_Default_BSW_Async_Task_0_20ms, OsAlarmSetEventTaskRef=Default_BSW_Async_Task
      Rte_Al_TE2_Default_BSW_Async_Task_0_5ms
        OsAlarmAction
          OsAlarmSetEvent: OsAlarmSetEventRef=Rte_Ev_Cyclic2_Default_BSW_Async_Task_0_5ms, OsAlarmSetEventTaskRef=Default_BSW_Async_Task
    5 x OsEvent:
      Rte_Ev_Cyclic2_Default_BSW_Async_Task_0_10ms
      Rte_Ev_Cyclic2_Default_BSW_Async_Task_0_20ms
      Rte_Ev_Cyclic2_Default_BSW_Async_Task_0_5ms
      Rte_Ev_Run1_DCMGLUE_DcmSessionControlRunnable
      Rte_Ev_Run_DCMGLUE_DcmDtcControlRunnable
    Rte_Al_TE_DCMGLUE_CyclicTestRunnable (OsAlarm): OsAlarmCounterRef=SystemTimer, OsAlarmAccessingApplication=SystemApplication_OsCore_CORE0
      OsAlarmAction
        OsAlarmSetEvent: OsAlarmSetEventRef=Rte_Ev_Run_DCMGLUE_CyclicTestRunnable, OsAlarmSetEventTaskRef=Default_BSW_Async_Task
    Rte_Ev_Run_DCMGLUE_CyclicTestRunnable (OsEvent)
