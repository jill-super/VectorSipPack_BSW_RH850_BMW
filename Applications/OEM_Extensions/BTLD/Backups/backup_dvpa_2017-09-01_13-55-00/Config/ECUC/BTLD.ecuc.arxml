AUTOSAR XML (schema 4-3-0)
package /ActiveEcuC
  ecuc value collection ActiveEcuC: ecu-extract=SYSTEM
    ecuc-values:
      Rte
      Os
      Xcp
      FrSM
      FrIf
      ComM
      EcuC
      Fr
      Det
      PduR
      EcuM
      BswM
      BUtil
      Cpl
      CplShared
      Dlog
      Nrv
      Prog
      Srv
      Cal
      Fls
      MemIf
      Crc
      StdDiag
      Stm
      SysTime
      DlogShared
      Dcm
      Mcu
      Port
      Fee
      FrTp
      Dem
