AUTOSAR XML (schema 4-3-0)
package /ActiveEcuC
  module config Prog: implementation-config-variant=VARIANT-PRE-COMPILE
    CommonPublishedInformation: SwMajorVersion=3, SwMinorVersion=3, SwPatchVersion=1
    ProgGeneral:
      ProgReadActiveDiagSessionInDcmEnable = false
      ProgEraseAddressedEnable = true
      ProgNoncompressedEnable = true
      ProgNrvEnable = true
      ProgCryptoEnable = true
      ProgHttpEnable = false
      ProgNrvTempBufferSize = 16384
      ProgFlashPageSize = 256
      ProgFlashAddressAlign = 4
      ProgEraseResponsePendingTimeMax = 10000
      ProgTransferDataResponsePendingTimeMax = 10000
      ProgAuthCalConfigId = CalSignatureVerifyConfig_MD5
      ProgSigCalConfigId = CalSignatureVerifyConfig_MD5
      ProgCalRandomSeedConfigId = CalRandomSeedConfig
      ProgCalRandomGenerateConfigId = CalRandomGenerateConfig
