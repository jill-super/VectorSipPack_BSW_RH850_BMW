AUTOSAR XML (schema 4-3-0)
package /ActiveEcuC
  module config CplShared: implementation-config-variant=VARIANT-PRE-COMPILE
    CplKeys:
      CplKeyAsymLevel3Enabled = true
      CplKeyAsymLevel4Enabled = true
      CplKeyAsymLevel5Enabled = false
      CplKeyAsymSignatureEnabled = true
      CplKeyAsymNcdEnabled = true
      CplKeyAsymSwtLightEnabled = false
      CplKeySymSwtFullEnabled = false
      CplKeySymSwtShortEnabled = false
      CplKeySymFscsmTkEnabled = false
      CplKeyBarrett = CPL_KEY_BARRETT_ENABLED
    CplJmpTable:
      CplAESDecryptJmpTableEntryEnable = false
      CplAESEncryptJmpTableEntryEnable = false
      CplCbcDecWithBlockEncJmpTableEntryEnable = false
      CplCBCMacGenerateJmpTableEntryEnable = false
      CplCBCMacVerifyJmpTableEntryEnable = false
      CplCbcPkcs5DecryptJmpTableEntryEnable = false
      CplDESDecryptJmpTableEntryEnable = false
      CplDESEncryptJmpTableEntryEnable = false
      CplDifHellmanCalcSecretJmpTableEntryEnable = false
      CplHMacGenerateJmpTableEntryEnable = false
      CplHMacVerifyJmpTableEntryEnable = false
      CplMD5JmpTableEntryEnable = false
      CplPBKDF1JmpTableEntryEnable = false
      CplPKCS1VrfyJmpTableEntryEnable = false
      CplSHAJmpTableEntryEnable = true
      CplSigBMWVerifyJmpTableEntryEnable = true
      CplSSGJmpTableEntryEnable = false
      CplSymKeyExtractJmpTableEntryEnable = false
      CplGetAsymKeyJmpTableEntryEnable = true
      CplGetSymKeyJmpTableEntryEnable = false
