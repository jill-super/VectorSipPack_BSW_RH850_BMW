AUTOSAR XML (schema 4-3-0)
package /ActiveEcuC
  module config SysTime: implementation-config-variant=VARIANT-PRE-COMPILE
    SysTimeGeneral: SysTimeDevErrorDetect=false, SysTimeEnableServiceInterface=false, SysTimeMainTaskCycle=0.01, SysTimeInitialTimeout=5
    CommonPublishedInformation: SwMajorVersion=3, SwMinorVersion=3, SwPatchVersion=0
