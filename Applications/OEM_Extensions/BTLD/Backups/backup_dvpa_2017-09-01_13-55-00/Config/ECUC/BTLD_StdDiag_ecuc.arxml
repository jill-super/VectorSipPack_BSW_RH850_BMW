AUTOSAR XML (schema 4-3-0)
package /ActiveEcuC
  module config StdDiag: implementation-config-variant=VARIANT-PRE-COMPILE
    StdDiagGeneral:
      StdDiagDevErrorDetect = false
      StdDiagUserProgrammingPreconditionsCheck = false
      StdDiagProvideUDSServiceActiveDiagnosticSession = true
      StdDiagClearSecondaryErrorMemory = true
      StdDiagUserCalloutForHddUpdateSession = false
    CommonPublishedInformation: SwMajorVersion=3, SwMinorVersion=4, SwPatchVersion=3
    StdDiagUserDefinedMemory: StdDiagUserDefinedMemoryName=BMWSecondaryErrorMemory, StdDiagUserDefinedMemoryId=257
