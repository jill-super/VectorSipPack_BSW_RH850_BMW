AUTOSAR XML (schema 4-3-0)
package /MICROSAR
  bsw implementation PduR_Impl: programming-language=C, sw-version=9.00.02, used-code-generator=DaVinci Configurator, vendor-id=30, ar-release-version=4.01.02
package /MICROSAR/PduR_ib_bswmd/BswModuleDescriptions
  bsw module description PduR
    bsw internal behavior PduRBehavior
      exclusive area PDUR_EXCLUSIVE_AREA_0
      exclusive area PDUR_EXCLUSIVE_AREA_1
