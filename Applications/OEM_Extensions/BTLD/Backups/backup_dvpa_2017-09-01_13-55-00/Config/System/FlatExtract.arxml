AUTOSAR XML (schema 4-3-0)
package /COM/VECTOR/CFG/WORKFLOW/SYSDESC/SYNC
  system SYSTEM
    system mapping MAPPINGS
    root-software-compositions:
      root sw composition prototype COMPOSITIONTYPE: flat-map=FLATMAP, software-composition=COMPOSITIONTYPE
  composition sw component type COMPOSITIONTYPE  # UB:Derived from original system description
    7 x component:
      BswM: type=BswM
      ComM: type=ComM
      Det: type=Det
      EcuM: type=EcuM
      Os_OsCore_CORE0_swc: type=Os_OsCore_CORE0_swc
      Dcm: type=Dcm
      DCMGLUE: type=DCMGLUE
    connect DCMGLUE.SecurityAccess_UNLOCKED_LVL_09 -> Dcm.SecurityAccess_UNLOCKED_LVL_09
    connect Dcm.DcmControlDtcSetting -> DCMGLUE.DcmControlDtcSetting
    connect Dcm.DcmDiagnosticSessionControl -> DCMGLUE.DcmDiagnosticSessionControl
    connect Dcm.DcmEcuReset -> BswM.Notification_SwcModeNotification_DcmEcuReset
  end to end protection set E2EPROTECTIONSET
  port interface mapping set PORTINTERFACEMAPPINGSET
