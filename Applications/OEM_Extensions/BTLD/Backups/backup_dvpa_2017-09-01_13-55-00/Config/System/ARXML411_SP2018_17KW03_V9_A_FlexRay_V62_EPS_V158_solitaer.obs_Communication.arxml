[part 2 of 2: packages /BMW/SystemDescription/EcuInstances to /BMW/SystemDescription/ISignalIPduGroups]
AUTOSAR XML (schema 4-3-0)
package /BMW/SystemDescription/EcuInstances
  ecu instance EPS: associated-com-i-pdu-group=[EPS_IN_PduGroup, EPS_OUT_PduGroup, EPS_IN_PduGroup2, EPS_OUT_PduGroup2, EPS_IN_PduGroup3, EPS_IN_PduGroup4, EPS_IN_PduGroup5, EPS_IN_PduGroup6, EPS_IN_PduGroup7, EPS_IN_PduGroup8, EPS_IN_PduGroup9, EPS_OUT_PduGroup3, EPS_IN_PduGroup10], diagnostic-address=48, sleep-mode-supported=false, wake-up-over-bus-supported=false  # Electrical Power - Assist - Steering | Achsparalleles EPS (electrical power-assist steering): System steuert unmittelbar Lenkschenkel an | MCV 0.94.5
    flexray communication controller contr_EPS_A_FlexRay:  # component: Electrical Power - Assist - Steering, bus: A-FlexRay / component: , bus: A-FlexRay
      accepted-startup-range=212
      allow-halt-due-to-clock=true
      allow-passive-to-active=0
      cluster-drift-damping=2
      decoding-correction=48
      delay-compensation-a=1
      delay-compensation-b=1
      extern-offset-correction=0
      extern-rate-correction=0
      key-slot-id=0
      key-slot-only-enabled=false
      key-slot-used-for-start-up=false
      key-slot-used-for-sync=false
      latest-tx=269
      listen-timeout=400242
      macro-initial-offset-a=3
      macro-initial-offset-b=3
      maximum-dynamic-payload-length=60
      micro-initial-offset-a=6
      micro-initial-offset-b=6
      micro-per-cycle=200000
      microtick-duration=2.5E-8
      offset-correction-out=126
      rate-correction-out=121
      samples-per-microtick=2
      wake-up-pattern=33
    flexray communication connector con_EPS_A_FlexRay: comm-controller=contr_EPS_A_FlexRay, wake-up-channel=true
package /BMW/SystemDescription/Pdus
  pdu ANFRAGE: length=8, minimum-delay=0.5, transmission-mode-true-timing=event-controlled-timing=number-of-repetitions=0, unused-bit-pattern=255  # Anfrage / Inquiry | Diese PDU löst die bis einschließlich SP2015 gültige Version der gleichnamigen PDU ab. Ab SP2018 darf nur noch diese Version der PDU verwendet werden. Mit dem Anfrage-Dienst kann eine Nachricht, die als anfragbar definiert ist, angefragt werden.
    signal ANFRAGE_ID2: start 0, 8 bit, little-endian, init-value=SWITCH_CODE:1, base-type=uint8, transfer-property=PENDING, to EPS
    signal ID_FN_INQY: start 8, 16 bit, little-endian, base-type=uint16, compu-method=ID_FN_INQY, data-constr=ID_FN_INQY, invalid-value=65535, to EPS  # ID_Funktion_Anfrage / ID_function_inquiry | LogicalInterface:BMW.INFRASTRUCTURE.COMMUNICATION.InquiryService[external]@Infrastruktur; Dieses Signal löst die bis einschließlich SP2015 gültige Version des gleichnamigen Signales ab. Ab SP2018 darf nur noch diese Version des Signals verwendet werden. Damit wird die in der alten Signalversion existierende Ausnahme bezüglich der Byteorder aufgelöst. Die Darstellung der Signal-Inhalte auf dem Bus wird dadurch jedoch nicht verändert – um dies zu erreichen wurden High-Byte und Low-Byte der Kodierungen vertauscht. Achtung: Sollte es sich sender- oder empfängerseitig um ein reines SP2015-Gleichteil handeln, das demnach die Versendung oder den Empfang des Signals ID_Funktion_Anfrage unverändert zu SP2015 umsetzt, so ist die hier spezifizierte Version des Signals ungültig! Für diese Gleichteile ist die für SP2015 spezifizierte Version dieses Signals gültig. Dieses Signal enthält in der Regel den 11-Bit CAN-Identifier der angefragten Nachricht. Es kann allerdings Abweichungen von dieser Regel geben, z.B. - im Fall von Zuordnungen mehrerer anfragbarer Frames zu einer CAN-ID - im Fall busspezifischer unterschiedlicher CAN-IDs des angefragten Frames - im Fall von Anfragen auf Nicht-CAN Bussen (z.B. FlexRay) - im Fall von 29-Bit CAN-IDs der angefragten Frames Es sind nur die Codierungen erlaubt, zu denen anfragbare PDUs definiert sind. / This signal contains the identifier of the message inquired. Only the identifiers are allowed which are defined as addressable messages. N.B. As regards byte orderings, this signal constitutes an exception because the inquired identifier must be transmitted in Engineola format. In the definite case this means that Byte 1 contains the high byte and Byte 2 the low byte of the desired identifiers [Byte 1, Bit 0: 2^8, Byte 1, Bit 7: 2^15 (= MSEC.B) and Byte 2, Bit 0: 2^0 (= LSB), Byte 2, Bit 7: 2^7]
  pdu DBG_EPS_BS_MOD_58_BYTE: length=58, transmission-mode-true-timing=cyclic-timing=time-period={tolerance=absolute-tolerance=0.002, value=0.02}, unused-bit-pattern=255  # Debug EPS Modus Basis 58 Byte | Diese PDU enthält die 57-Byte langen Debug Information. Die Signale in dieser PDU können durch den Fachbereich eigenständig angepasst werden.
    signal DBG_EPS_BS_MOD_58_BYTE_CHOV_DBG_MOD_EPS: start 0, 8 bit, little-endian, init-value=SWITCH_CODE:1, base-type=uint8, transfer-property=PENDING
    signal DBG_EPS_MOD_BS_58_BYTE: start 8, 8 bit, little-endian, base-type=uint8, compu-method=DBG_8Bit, data-constr=DBG_8Bit  # Debug_EPS_Modus_Basis_58_Byte / debug_EPS_mode_base_58_byte | LogicalInterface:BMW.INFRASTRUCTURE.DIAGNOSIS.Debug[internal]@Infrastruktur; Dummy-Signal. Kann beliebig geändert werden.
  pdu DBG_EPS_MOD_EXT_120_BYTE: length=58, transmission-mode-true-timing=cyclic-timing=time-period={tolerance=absolute-tolerance=0.0005, value=0.005}, unused-bit-pattern=255  # Debug EPS Modus Erweitert 120 Byte | Diese PDU enthält die 119-Byte langen Debug Information. Bei Verwendung dieses Modes muss die Frame Länge vom Fachbereich auf 120-Bytes angepasst werden. Die Signale in dieser PDU können durch den Fachbereich eigenständig angepasst werden.
    signal DBG_EPS_MOD_EXT_120_BYTE_CHOV_DBG_MOD_EPS: start 0, 8 bit, little-endian, init-value=SWITCH_CODE:2, base-type=uint8, transfer-property=PENDING
    signal DBG_EPS_MOD_EXT_120_BYTE: start 8, 8 bit, little-endian, base-type=uint8, compu-method=DBG_8Bit, data-constr=DBG_8Bit  # Debug_EPS_Modus_Erweitert_120_Byte / debug_EPS_mode_extended_120_byte | LogicalInterface:BMW.INFRASTRUCTURE.DIAGNOSIS.Debug[internal]@Infrastruktur; Dummy-Signal. Kann beliebig geändert werden.
  pdu RQ_STG_EFAN:  # Anforderung Wärmemanagement / Request Stage Electric-Fan
    length=8
    transmission-mode-true-timing=cyclic-timing={time-period={tolerance=absolute-tolerance=0.1, value=1}, "Um sicherzustellen, dass das Ende der zyklischen Versendung erkannt wird, muss die Versendung der Stoppnachricht (Signal Anforderung_Steuerung_Elektrolüfter = 0) insgesamt 3-mal mit einem Wiederholzyklus von t=160 ms erfolgen (Details in der Spezifikation: Erweiterung der ereignisgesteuerten Auslösebedingungen). Zusätzlich erfolgt eine zyklische Versendung der Nachricht, wenn die Signale Temperatur_Komponente_Wärmemanagement und ID_Temperatur_Komponente_Wärmemanagement befüllt sind."}
    unused-bit-pattern=255
    signal RQ_STG_EFAN_ID2: start 0, 8 bit, little-endian, init-value=SWITCH_CODE:21, base-type=uint8, transfer-property=PENDING
    signal ID_FN_RQ_STG_EFAN: start 8, 8 bit, little-endian, base-type=uint8, compu-method=ID_FN_RQ_STG_EFAN, data-constr=ID_FN_RQ_STG_EFAN, invalid-value=255  # ID_Funktion_Anforderung_Stufe_Elektrolüfter / ID_function_request_stage_electric-fan | LogicalInterface:BMW.POWERTRAIN.ENGINE.COMBUSTION.HeatManagement[internal]@Fahren; Dieses Signal gibt den Anforderer der gewünschten Elektrolüfterstufe an.
    signal RQ_STG_EFAN: start 16, 4 bit, little-endian, base-type=uint8, compu-method=RQ_STG_EFAN, data-constr=RQ_STG_EFAN, invalid-value=15  # Anforderung_Stufe_Elektrolüfter / request_stage_electric-fan | LogicalInterface:BMW.POWERTRAIN.ENGINE.COMBUSTION.HeatManagement[internal]@Fahren; Die Stufen werden als Luftmassenstrom interpretiert. Die Stufe 14 entspricht der maximalen Luftmassenstromanforderung.
    signal ID_TEMP_CPO_HET_MNG: start 20, 4 bit, little-endian, base-type=uint8, compu-method=ID_TEMP_CPO_HET_MNG, data-constr=ID_TEMP_CPO_HET_MNG, invalid-value=15  # ID_Temperatur_Komponente_Wärme_Management / ID_temperature_component_heat_management | LogicalInterface:BMW.POWERTRAIN.ENGINE.COMBUSTION.HeatManagement[internal]@Fahren; Dieses Signal gibt die Komponente für das Temperatursignal für das Motorwärmemanagement an. Dieses Signal wird in 444, F15-F16, F25 und F25_ab_PU12-07 nicht ausgewertet.
    signal TEMP_CPO_HET_MNG: start 24, 8 bit, little-endian, base-type=uint8, compu-method=TEMP_CPO_HET_MNG, data-constr=TEMP_CPO_HET_MNG, invalid-value=255  # Temperatur_Komponente_Wärme_Management / temperature_component_heat_management | LogicalInterface:BMW.POWERTRAIN.ENGINE.COMBUSTION.HeatManagement[internal]@Fahren; Komponententemperatur für das Motorwärmemanagement Dieses Signal wird in 444, F15-F16, F25 und F25_ab_PU12-07 nicht ausgewertet.
  pdu SECU_CHAL: length=8, minimum-delay=0.05, transmission-mode-true-timing=event-controlled-timing=number-of-repetitions=0, unused-bit-pattern=255  # Sicher Challenge | $(AUTOSAR; SIGNALGROUP)
    signal SECU_CHAL_ID2: start 0, 8 bit, little-endian, init-value=SWITCH_CODE:248, base-type=uint8, transfer-property=PENDING
    signal SSV_IDENT_CHAL: start 8, 8 bit, little-endian, base-type=uint8, compu-method=SSV_IDENT, data-constr=SSV_IDENT, invalid-value=255  # SSV_Identifikation_Challenge / SSV_identification_challenge | LogicalInterface:BMW.INFRASTRUCTURE.COMMUNICATION.SecureChallengeResponse[internal]@Infrastruktur;
    signal SSS_IDENT_CHAL: start 16, 8 bit, little-endian, base-type=uint8, compu-method=SSS_IDENT, data-constr=SSS_IDENT, invalid-value=255  # SSS_Identifikation_Challenge / SSS_identification_challenge | LogicalInterface:BMW.INFRASTRUCTURE.COMMUNICATION.SecureChallengeResponse[internal]@Infrastruktur;
    signal SECU_CHAL: start 24, 40 bit, little-endian, base-type=uint64, compu-method=SECU_CHAL, data-constr=SECU_CHAL, invalid-value=1099511627775  # Sicher_Challenge / secure_challenge | LogicalInterface:BMW.INFRASTRUCTURE.COMMUNICATION.SecureChallengeResponse[internal]@Infrastruktur;
    mapping signalGrp_SECU_CHAL_grpMap: i-signal-group=signalGrp_SECU_CHAL
  pdu SECU_RESP: length=8, minimum-delay=0.05, transmission-mode-true-timing=event-controlled-timing=number-of-repetitions=0, unused-bit-pattern=255  # Sicher Response | $(AUTOSAR; SIGNALGROUP)
    signal SECU_RESP_ID2: start 0, 8 bit, little-endian, init-value=SWITCH_CODE:247, base-type=uint8, transfer-property=PENDING, to EPS
    signal SSV_IDENT_RESP: start 8, 8 bit, little-endian, base-type=uint8, compu-method=SSV_IDENT, data-constr=SSV_IDENT, invalid-value=255  # SSV_Identifikation_Response / SSV_identification_response | LogicalInterface:BMW.INFRASTRUCTURE.COMMUNICATION.SecureChallengeResponse[internal]@Infrastruktur;
    signal COU_BS_RESP: start 16, 24 bit, little-endian, base-type=uint32, compu-method=COU_BS_RESP, data-constr=COU_BS_RESP, invalid-value=16777215  # Zähler_Basis_Response / counter_base_response | LogicalInterface:BMW.INFRASTRUCTURE.COMMUNICATION.SecureChallengeResponse[internal]@Infrastruktur;
    signal STU_RESP: start 40, 24 bit, little-endian, base-type=uint32, compu-method=STU_RESP, data-constr=STU_RESP, invalid-value=16777215  # Signatur_Response / signature_response | LogicalInterface:BMW.INFRASTRUCTURE.COMMUNICATION.SecureChallengeResponse[internal]@Infrastruktur;
    mapping signalGrp_SECU_RESP_grpMap: i-signal-group=signalGrp_SECU_RESP
package /BMW/SystemDescription/ISignalGroups
  23 x i signal group:
    e2eGrp_ACLNY_MASSCNTR: i-signal=[CRC_ACLNY_COG, ALIV_ACLNY_COG, ACLNY_MASSCNTR_dummy_12_15, ACLNY_COG, ACLNY_COG_ERR_AMP, QU_ACLNY_COG], system-signal-group=e2eGrp_ACLNY_MASSCNTR
    e2eGrp_AVL_FORC_GRD: i-signal=[CRC_AVL_FORC_GRD, ALIV_AVL_FORC_GRD, AVL_FORC_GRD_dummy_12_15, AVL_FORC_GRD, QU_AVL_FORC_GRD, AVL_PWR_EL_EPS_COOD], system-signal-group=e2eGrp_AVL_FORC_GRD
    e2eGrp_AVL_PO_EPS: i-signal=[CRC_AVL_PO_EPS, ALIV_AVL_PO_EPS, QU_AVL_PO_EPS, AVL_PO_EPS, AVL_PO_IDX_EPS, OFFS_GRD_MID_EPS, IDX_TORQ_SEN, UN_PO_EPS], system-signal-group=e2eGrp_AVL_PO_EPS
    e2eGrp_AVL_RPM_WHL: i-signal=[CRC_AVL_RPM_WHL, ALIV_AVL_RPM_WHL, AVL_RPM_WHL_dummy_12_15, AVL_RPM_WHL_RLH, AVL_RPM_WHL_RRH, AVL_RPM_WHL_FLH, AVL_RPM_WHL_FRH, QU_AVL_RPM_WHL_RLH, QU_AVL_RPM_WHL_RRH, QU_AVL_RPM_WHL_FLH, QU_AVL_RPM_WHL_FRH], system-signal-group=e2eGrp_AVL_RPM_WHL
    e2eGrp_AVL_STMOM_DV_ACT: i-signal=[CRC_AVL_STMOM_DV_ACT, ALIV_AVL_STMOM_DV_ACT, AVL_STMOM_DV_ACT_dummy_12_15, AVL_STMOM_DV_ACT, QU_AVL_STMOM_DV_ACT], system-signal-group=e2eGrp_AVL_STMOM_DV_ACT
    e2eGrp_CON_VEH: i-signal=[CRC_CON_VEH, ALIV_CON_VEH, CTR_BS_PRTNT, CTR_FKTN_PRTNT, ST_CON_VEH, QU_ST_CON_VEH, CON_VEH_dummy_56_63], system-signal-group=e2eGrp_CON_VEH
    e2eGrp_DISP_CC_EPS: i-signal=[CRC_DISP_CC_EPS, ALIV_DISP_CC_EPS, CHL_DISP_CC_EPS, NO_CC_EPS, ST_CC_EPS, TRANF_CC_EPS, ST_IDC_CC_EPS], system-signal-group=e2eGrp_DISP_CC_EPS
    e2eGrp_DT_EST: i-signal=[CRC_DT_EST, ALIV_DT_EST, DT_EST_dummy_12_15, DT_EST_dummy_16_47, AVL_I_ACT_EST, ST_CULI_EST, QU_AVL_I_ACT_EST, DT_EST_dummy_64_95, DT_EST_dummy_96_127], system-signal-group=e2eGrp_DT_EST
    e2eGrp_ENERG_DGR_DRDY: i-signal=[MAX_I_SPEC_EPS, RQ_CULI_EST_SFY, ENERG_DGR_DRDY_dummy_12_15, MAX_I_SPEC_BAX_STE, MAX_I_LD_SPEC_ARS, MAX_I_RECUP_SPEC_ARS, ENERG_AVAI_ARS, QU_DGR_AISP_ENERG, ALIV_ENERG_DGR_DRDY, CRC_ENERG_DGR_DRDY], system-signal-group=e2eGrp_ENERG_DGR_DRDY
    e2eGrp_ENSU_SFY: i-signal=[CRC_ENSU_SFY, ALIV_ENSU_SFY, CHL_ENSU_SFY, QU_FN_ENSU_SFY, RQ_CULI, ENSU_SFY_dummy_28_31, ENSU_SFY_dummy_32_63], system-signal-group=e2eGrp_ENSU_SFY
    signalGrp_FAHRGESTELLNUMMER: i-signal=[NO_VECH_1, NO_VECH_2, NO_VECH_3, NO_VECH_4, NO_VECH_5, NO_VECH_6, NO_VECH_7], system-signal-group=signalGrp_FAHRGESTELLNUMMER
    e2eGrp_OFFS_QUAD_EPS: i-signal=[CRC_OFFS_QUAD_EPS, ALIV_OFFS_QUAD_EPS, ST_OFFS_QUAD_EPS, OFFS_QUAD_RTR_EPS, AVL_PO_IDX_ICM], system-signal-group=e2eGrp_OFFS_QUAD_EPS
    signalGrp_SECU_CHAL: i-signal=[SSV_IDENT_CHAL, SSS_IDENT_CHAL, SECU_CHAL], system-signal-group=signalGrp_SECU_CHAL
    signalGrp_SECU_FAHRGESTELLNUMMER: i-signal=STU_8_BYTE, system-signal-group=signalGrp_SECU_FAHRGESTELLNUMMER
    signalGrp_SECU_RESP: i-signal=[SSV_IDENT_RESP, COU_BS_RESP, STU_RESP], system-signal-group=signalGrp_SECU_RESP
    signalGrp_ST_DIAG_OBD_3_DRDY: i-signal=[ALIV_ST_DIAG_OBD_3_DRDY, ST_DIAG_OBD_3_DRDY_MAX_MUX, ST_DIAG_OBD_3_DRDY_IMME_MUX, DIAG_ST_OBD_3_DRDY_1, DIAG_ST_OBD_3_DRDY_2, DIAG_ST_OBD_3_DRDY_3, DIAG_ST_OBD_3_DRDY_4, DIAG_ST_OBD_3_DRDY_5, DIAG_ST_OBD_3_DRDY_6, DIAG_ST_OBD_3_DRDY_7, DIAG_ST_OBD_3_DRDY_8], system-signal-group=signalGrp_ST_DIAG_OBD_3_DRDY
    e2eGrp_ST_EST: i-signal=[CRC_ST_EST_FTAX, ALIV_ST_EST_FTAX, QU_FN_VIB_EPS, ST_EST_dummy_16_23, QU_SER_STMOM_DV_ACT, QU_FN_EST], system-signal-group=e2eGrp_ST_EST
    e2eGrp_SU_EPS: i-signal=[TOT_STR_EPS, UN_TOT_STR_EPS, SU_EPS_dummy_14_19, SU_EPS_dummy_20_51, ALIV_SU_EPS, CRC_SU_EPS], system-signal-group=e2eGrp_SU_EPS
    e2eGrp_TAR_ESTP_VIRT_FTAX: i-signal=[CRC_TAR_ESTP_VIRT_FTAX, ALIV_TAR_ESTP_VIRT_FTAX, TAR_ESTP_VIRT_FTAX_dummy_12_31, ACTVN_FN_ESTP_VIRT_FTAX, TAR_ESTP_VIRT_FTAX_dummy_36_63], system-signal-group=e2eGrp_TAR_ESTP_VIRT_FTAX
    e2eGrp_TAR_QTA_STRMOM_DV: i-signal=[CRC_TAR_QTA_STMOM_DV, ALIV_TAR_QTA_STMOM_DV, TAR_QTA_STRMOM_DV_dummy_12_15, TAR_QTA_STMOM_DV, QU_TAR_QTA_STMOM_DV, FACT_CTRR_STMOM_FTAX, FACT_DMPNG_STMOM_FTAX, FACT_ASS_STMOM_FTAX, QU_TAR_FACT_STMOM_FTAX, CTR_DEAC_EPS_FNS], system-signal-group=e2eGrp_TAR_QTA_STRMOM_DV
    e2eGrp_TAR_STMOM_DV_ACT: i-signal=[CRC_TAR_STMOM_DV_ACT, ALIV_TAR_STMOM_DV_ACT, TAR_STMOM_DV_ACT_dummy_12_15, TAR_STMOM_DV_ACT, QU_TAR_STMOM_DV_ACT, TAR_STMOM_DV_ACT_dummy_32_51, QU_TAR_DMPNG_ADDON_STMOM_FTAX, FACT_DMPNG_ADDON_STMOM_FTAX], system-signal-group=e2eGrp_TAR_STMOM_DV_ACT
    e2eGrp_VYAW_VEH: i-signal=[CRC_VYAW_VEH, ALIV_VYAW_VEH, VYAW_VEH_dummy_12_15, VYAW_VEH, VYAW_VEH_ERR_AMP, QU_VYAW_VEH], system-signal-group=e2eGrp_VYAW_VEH
    e2eGrp_V_VEH: i-signal=[CRC_V_VEH, ALIV_V_VEH, ST_V_VEH_NSS, V_VEH_COG, QU_V_VEH_COG, DVCO_VEH, V_VEH_dummy_39_39], system-signal-group=e2eGrp_V_VEH
package /BMW/SystemDescription/EndtoEndProtections
  end to end protection set EndToEndProtectionSet
    18 x end to end protection:
      e2e_ACLNY_MASSCNTR: end-to-end-profile={category=PROFILE_01, data-ids=31, data-id-mode=0, data-length=48, max-delta-counter-init=14, crc-offset=0, counter-offset=8}, end-to-end-protection-i-signal-i-pdu{data-offset=0, i-signal-group=e2eGrp_ACLNY_MASSCNTR, i-signal-i-pdu=ACLNY_MASSCNTR}
      e2e_AVL_FORC_GRD: end-to-end-profile={category=PROFILE_01, data-ids=190, data-id-mode=0, data-length=40, max-delta-counter-init=14, crc-offset=0, counter-offset=8}, end-to-end-protection-i-signal-i-pdu{data-offset=0, i-signal-group=e2eGrp_AVL_FORC_GRD, i-signal-i-pdu=AVL_FORC_GRD}
      e2e_AVL_PO_EPS: end-to-end-profile={category=PROFILE_01, data-ids=186, data-id-mode=0, data-length=64, max-delta-counter-init=14, crc-offset=0, counter-offset=8}, end-to-end-protection-i-signal-i-pdu{data-offset=0, i-signal-group=e2eGrp_AVL_PO_EPS, i-signal-i-pdu=AVL_PO_EPS}
      e2e_AVL_RPM_WHL: end-to-end-profile={category=PROFILE_01, data-ids=17, data-id-mode=0, data-length=96, max-delta-counter-init=14, crc-offset=0, counter-offset=8}, end-to-end-protection-i-signal-i-pdu{data-offset=0, i-signal-group=e2eGrp_AVL_RPM_WHL, i-signal-i-pdu=AVL_RPM_WHL}
      e2e_AVL_STMOM_DV_ACT: end-to-end-profile={category=PROFILE_01, data-ids=108, data-id-mode=0, data-length=32, max-delta-counter-init=14, crc-offset=0, counter-offset=8}, end-to-end-protection-i-signal-i-pdu{data-offset=0, i-signal-group=e2eGrp_AVL_STMOM_DV_ACT, i-signal-i-pdu=AVL_STMOM_DV_ACT}
      e2e_CON_VEH: end-to-end-profile={category=PROFILE_01, data-ids=197, data-id-mode=0, data-length=64, max-delta-counter-init=14, crc-offset=0, counter-offset=8}, end-to-end-protection-i-signal-i-pdu{data-offset=0, i-signal-group=e2eGrp_CON_VEH, i-signal-i-pdu=CON_VEH}
      e2e_DISP_CC_EPS: end-to-end-profile={category=PROFILE_01, data-ids=3148, data-id-mode=3, data-length=40, max-delta-counter-init=14, crc-offset=0, counter-offset=8, data-id-nibble-offset=12}, end-to-end-protection-i-signal-i-pdu{data-offset=0, i-signal-group=e2eGrp_DISP_CC_EPS, i-signal-i-pdu=DISP_CC_EPS}
      e2e_DT_EST: end-to-end-profile={category=PROFILE_01, data-ids=230, data-id-mode=0, data-length=128, max-delta-counter-init=14, crc-offset=0, counter-offset=8}, end-to-end-protection-i-signal-i-pdu{data-offset=0, i-signal-group=e2eGrp_DT_EST, i-signal-i-pdu=DT_EST}
      e2e_ENERG_DGR_DRDY: end-to-end-profile={category=PROFILE_01, data-ids=56, data-id-mode=0, data-length=64, max-delta-counter-init=14, crc-offset=56, counter-offset=52}, end-to-end-protection-i-signal-i-pdu{data-offset=0, i-signal-group=e2eGrp_ENERG_DGR_DRDY, i-signal-i-pdu=ENERG_DGR_DRDY}
      e2e_ENSU_SFY: end-to-end-profile={category=PROFILE_01, data-ids=628, data-id-mode=3, data-length=64, max-delta-counter-init=14, crc-offset=0, counter-offset=8, data-id-nibble-offset=12}, end-to-end-protection-i-signal-i-pdu{data-offset=0, i-signal-group=e2eGrp_ENSU_SFY, i-signal-i-pdu=ENSU_SFY}
      e2e_OFFS_QUAD_EPS: end-to-end-profile={category=PROFILE_01, data-ids=229, data-id-mode=0, data-length=40, max-delta-counter-init=14, crc-offset=0, counter-offset=8}, end-to-end-protection-i-signal-i-pdu{data-offset=0, i-signal-group=e2eGrp_OFFS_QUAD_EPS, i-signal-i-pdu=OFFS_QUAD_EPS}
      e2e_ST_EST: end-to-end-profile={category=PROFILE_01, data-ids=112, data-id-mode=0, data-length=40, max-delta-counter-init=14, crc-offset=0, counter-offset=8}, end-to-end-protection-i-signal-i-pdu{data-offset=0, i-signal-group=e2eGrp_ST_EST, i-signal-i-pdu=ST_EST}
      e2e_SU_EPS: end-to-end-profile={category=PROFILE_01, data-ids=131, data-id-mode=0, data-length=64, max-delta-counter-init=14, crc-offset=56, counter-offset=52}, end-to-end-protection-i-signal-i-pdu{data-offset=0, i-signal-group=e2eGrp_SU_EPS, i-signal-i-pdu=SU_EPS}
      e2e_TAR_ESTP_VIRT_FTAX: end-to-end-profile={category=PROFILE_01, data-ids=52, data-id-mode=0, data-length=64, max-delta-counter-init=14, crc-offset=0, counter-offset=8}, end-to-end-protection-i-signal-i-pdu{data-offset=0, i-signal-group=e2eGrp_TAR_ESTP_VIRT_FTAX, i-signal-i-pdu=TAR_ESTP_VIRT_FTAX}
      e2e_TAR_QTA_STRMOM_DV: end-to-end-profile={category=PROFILE_01, data-ids=109, data-id-mode=0, data-length=64, max-delta-counter-init=14, crc-offset=0, counter-offset=8}, end-to-end-protection-i-signal-i-pdu{data-offset=0, i-signal-group=e2eGrp_TAR_QTA_STRMOM_DV, i-signal-i-pdu=TAR_QTA_STRMOM_DV}
      e2e_TAR_STMOM_DV_ACT: end-to-end-profile={category=PROFILE_01, data-ids=179, data-id-mode=0, data-length=64, max-delta-counter-init=14, crc-offset=0, counter-offset=8}, end-to-end-protection-i-signal-i-pdu{data-offset=0, i-signal-group=e2eGrp_TAR_STMOM_DV_ACT, i-signal-i-pdu=TAR_STMOM_DV_ACT}
      e2e_VYAW_VEH: end-to-end-profile={category=PROFILE_01, data-ids=14, data-id-mode=0, data-length=48, max-delta-counter-init=14, crc-offset=0, counter-offset=8}, end-to-end-protection-i-signal-i-pdu{data-offset=0, i-signal-group=e2eGrp_VYAW_VEH, i-signal-i-pdu=VYAW_VEH}
      e2e_V_VEH: end-to-end-profile={category=PROFILE_01, data-ids=12, data-id-mode=0, data-length=40, max-delta-counter-init=14, crc-offset=0, counter-offset=8}, end-to-end-protection-i-signal-i-pdu{data-offset=0, i-signal-group=e2eGrp_V_VEH, i-signal-i-pdu=V_VEH}
package /BMW/SystemDescription/ISignalIPduGroups
  13 x i signal i pdu group:
    EPS_IN_PduGroup: communication-direction=IN, communication-mode=KOM_FAHRBEREITSCHAFT_BEENDEN_ON, KOM_FAHRBEREITSCHAFT_HERSTELLEN_ON, KOM_FAHREN_ON, KOM_PRUEFEN_ANALYSE_DIAGNOSE_ON, KOM_STANDFUNKTIONEN_KUNDE_NICHT_IM_FZG_ON, KOM_WOHNEN_ON, i-signal-i-pdus=[ACLNY_MASSCNTR, STEA_OFFS, ST_ENERG_GEN]
    EPS_IN_PduGroup10: communication-direction=IN, communication-mode=KOM_FAHRBEREITSCHAFT_BEENDEN_ON, KOM_FAHRBEREITSCHAFT_HERSTELLEN_ON, KOM_FAHREN_ON, KOM_PRUEFEN_ANALYSE_DIAGNOSE_ON, KOM_STANDFUNKTIONEN_KUNDE_NICHT_IM_FZG_ON, KOM_WOHNEN_ON, ENTERTAINMENTBETRIEB_ON, i-signal-i-pdus=ST_CENG
    EPS_IN_PduGroup2: communication-direction=IN, communication-mode=KOM_FAHRBEREITSCHAFT_BEENDEN_ON, KOM_FAHRBEREITSCHAFT_HERSTELLEN_ON, KOM_FAHREN_ON, KOM_PARKEN_BN_IO_ON, KOM_PARKEN_BN_NIO_ON, KOM_PRUEFEN_ANALYSE_DIAGNOSE_ON, KOM_STANDFUNKTIONEN_KUNDE_NICHT_IM_FZG_ON, KOM_WOHNEN_ON, ASSISTENZ_PARKEN_HIGH_ON, ENTERTAINMENTBETRIEB_ON, i-signal-i-pdus=ANFRAGE
    EPS_IN_PduGroup3: communication-direction=IN, communication-mode=KOM_FAHRBEREITSCHAFT_BEENDEN_ON, KOM_FAHRBEREITSCHAFT_HERSTELLEN_ON, KOM_FAHREN_ON, KOM_PARKEN_BN_IO_ON, KOM_PARKEN_BN_NIO_ON, KOM_PRUEFEN_ANALYSE_DIAGNOSE_ON, KOM_STANDFUNKTIONEN_KUNDE_NICHT_IM_FZG_ON, KOM_WOHNEN_ON
      i-signal-i-pdus:
        AVL_RPM_WHL
        FAHRGESTELLNUMMER
        OFFS_QUAD_EPS
        SECU_FAHRGESTELLNUMMER
        ST_STAB_DSC
        SU_CLE_DRDY_DXP
        TAR_ESTP_VIRT_FTAX
        TAR_QTA_STRMOM_DV
        TAR_STMOM_DV_ACT
        VYAW_VEH
        V_VEH
    EPS_IN_PduGroup4: communication-direction=IN, communication-mode=KOM_FAHRBEREITSCHAFT_BEENDEN_ON, KOM_FAHRBEREITSCHAFT_HERSTELLEN_ON, KOM_FAHREN_ON, KOM_PARKEN_BN_IO_ON, KOM_PARKEN_BN_NIO_ON, KOM_PRUEFEN_ANALYSE_DIAGNOSE_ON, KOM_STANDFUNKTIONEN_KUNDE_NICHT_IM_FZG_ON, KOM_WOHNEN_ON, ENTERTAINMENTBETRIEB_ON, i-signal-i-pdus=[A_TEMP, FZZSTD, KILOMETERSTAND, RELATIVZEIT, SECU_RESP]
    EPS_IN_PduGroup5: communication-direction=IN, communication-mode=KOM_FAHRBEREITSCHAFT_BEENDEN_ON, KOM_FAHRBEREITSCHAFT_HERSTELLEN_ON, KOM_FAHREN_ON, KOM_PARKEN_BN_IO_ON, KOM_PARKEN_BN_NIO_ON, KOM_PRUEFEN_ANALYSE_DIAGNOSE_ON, KOM_STANDFUNKTIONEN_KUNDE_NICHT_IM_FZG_ON, KOM_WOHNEN_ON, ASSISTENZ_PARKEN_HIGH_ON, ENTERTAINMENTBETRIEB_ON, LICHT_ON, i-signal-i-pdus=CON_VEH
    EPS_IN_PduGroup6: communication-direction=IN, communication-mode=KOM_FAHRBEREITSCHAFT_BEENDEN_ON, KOM_FAHRBEREITSCHAFT_HERSTELLEN_ON, KOM_FAHREN_ON, KOM_PRUEFEN_ANALYSE_DIAGNOSE_ON, i-signal-i-pdus=[CTR_DIAG_OBD_DRDY, CTR_VIB_STW_DISP_EXMI_SP2015, ENSU_SFY]
    EPS_IN_PduGroup7: communication-direction=IN, communication-mode=KOM_FAHRBEREITSCHAFT_BEENDEN_ON, KOM_FAHRBEREITSCHAFT_HERSTELLEN_ON, KOM_FAHREN_ON, KOM_PRUEFEN_ANALYSE_DIAGNOSE_ON, KOM_STANDFUNKTIONEN_KUNDE_NICHT_IM_FZG_ON, KOM_WOHNEN_ON, LADEN_ON, i-signal-i-pdus=DIAG_OBD_ENG
    EPS_IN_PduGroup8: communication-direction=IN, communication-mode=KOM_FAHRBEREITSCHAFT_BEENDEN_ON, KOM_FAHRBEREITSCHAFT_HERSTELLEN_ON, KOM_FAHREN_ON, KOM_PARKEN_BN_IO_ON, KOM_PRUEFEN_ANALYSE_DIAGNOSE_ON, KOM_STANDFUNKTIONEN_KUNDE_NICHT_IM_FZG_ON, KOM_WOHNEN_ON, i-signal-i-pdus=ENERG_DGR_DRDY
    EPS_IN_PduGroup9: communication-direction=IN, communication-mode=KOM_FAHRBEREITSCHAFT_BEENDEN_ON, KOM_FAHRBEREITSCHAFT_HERSTELLEN_ON, KOM_FAHREN_ON, KOM_PRUEFEN_ANALYSE_DIAGNOSE_ON, KOM_STANDFUNKTIONEN_KUNDE_NICHT_IM_FZG_ON, KOM_WOHNEN_ON, ASSISTENZ_PARKEN_HIGH_ON, ENTERTAINMENTBETRIEB_ON, i-signal-i-pdus=ERRM_BN_U
    EPS_OUT_PduGroup: communication-direction=OUT, communication-mode=KOM_FAHRBEREITSCHAFT_BEENDEN_ON, KOM_FAHRBEREITSCHAFT_HERSTELLEN_ON, KOM_FAHREN_ON, KOM_PARKEN_BN_IO_ON, KOM_PARKEN_BN_NIO_ON, KOM_PRUEFEN_ANALYSE_DIAGNOSE_ON, KOM_STANDFUNKTIONEN_KUNDE_NICHT_IM_FZG_ON, KOM_WOHNEN_ON, ASSISTENZ_PARKEN_HIGH_ON, ENTERTAINMENTBETRIEB_ON, i-signal-i-pdus=ANFRAGE
    EPS_OUT_PduGroup2: communication-direction=OUT, communication-mode=KOM_FAHRBEREITSCHAFT_BEENDEN_ON, KOM_FAHRBEREITSCHAFT_HERSTELLEN_ON, KOM_FAHREN_ON, KOM_PRUEFEN_ANALYSE_DIAGNOSE_ON
      i-signal-i-pdus:
        AVL_FORC_GRD
        AVL_PO_EPS
        AVL_STMOM_DV_ACT
        DBG_EPS_BS_MOD_58_BYTE
        DBG_EPS_MOD_EXT_120_BYTE
        DISP_CC_EPS
        DT_EST
        ENGTORQ_EPS
        RQ_STG_EFAN
        ST_DIAG_OBD_3_DRDY
        ST_EST
        SU_EPS
    EPS_OUT_PduGroup3: communication-direction=OUT, communication-mode=KOM_FAHRBEREITSCHAFT_BEENDEN_ON, KOM_FAHRBEREITSCHAFT_HERSTELLEN_ON, KOM_FAHREN_ON, KOM_PARKEN_BN_IO_ON, KOM_PARKEN_BN_NIO_ON, KOM_PRUEFEN_ANALYSE_DIAGNOSE_ON, KOM_STANDFUNKTIONEN_KUNDE_NICHT_IM_FZG_ON, KOM_WOHNEN_ON, i-signal-i-pdus=SECU_CHAL
