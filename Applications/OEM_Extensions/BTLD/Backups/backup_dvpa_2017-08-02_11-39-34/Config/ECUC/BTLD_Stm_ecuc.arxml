AUTOSAR XML (schema 4-3-0)
package /ActiveEcuC
  module config Stm: implementation-config-variant=VARIANT-PRE-COMPILE
    CommonPublishedInformation: SwMajorVersion=3, SwMinorVersion=1, SwPatchVersion=0
    StmGeneral:
      StmInitialCentralErrorLockTimeout = 6
      StmCentralErrorLockTimeout = 21
      StmEnergyStateTimeout = 21
      StmVehicleStateSP2015Timeout = 0.5
      StmComVariant = STM_COM_CYCLIC_DATAELEMENTS
    StmFeatureActivation: StmCentralErrorLockEnabled=true, StmEnergyStateEnabled=true, StmVehicleStateSP2015Enabled=false
