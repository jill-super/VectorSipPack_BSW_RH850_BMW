AUTOSAR XML (schema 4-3-0)
package /ActiveEcuC
  module config Dlog: implementation-config-variant=VARIANT-PRE-COMPILE
    Dlog_General: DlogDevErrorDetect=true, DlogUseCoding=false, DlogWatchdogTrigger=WdgIf_SetTriggerCondition(0,100)
    Dlog_Features:
      EnableMemSegTableRead = true
      EnableSvkRead = true
      EnableSvkWrite = true
      EnableSvkRamMirror = true
      EnableNvMemory = true
      NvmInterface = DLOG_NVM_INTERFACE_MEMIF
      MemIfDeviceId = 0
      EnableSweGet = true
      SweGetDirectBootAndAppl1Swe = false
      SweGetValidFlagBlankCheck = false
      SweGetPerformErrorCheck = false
      SweGetVerifyCrcChecksum = true
      EnableSweInit = false
      EnableProgCounter = true
      EnableProgCounterWrite = true
      EnableTimingParameters = true
      EnableEcu = true
      EnableEcuWriteFingerprint = true
      EnableEcuWriteVin = true
      EnableSgbdId = false
      ExceptionHandlerHandleSWEErrors = false
      EnableRte = false
      RteSvkArrayMaxSize = 100
      RteUserSvkArrayMaxSize = 100
    Dlog_User: RomAccessExceptionHandler=0
    CommonPublishedInformation: SwMajorVersion=3, SwMinorVersion=3, SwPatchVersion=5
