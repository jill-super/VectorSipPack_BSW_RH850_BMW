AUTOSAR XML (schema 4-3-0)
package /ActiveEcuC
  module config Mcu: implementation-config-variant=VARIANT-POST-BUILD, module-description=Mcu_Impl
    McuModuleConfiguration:
      McuClockSrcFailureNotification = DISABLED
      McuLviDetectionLevel = DETECTION_LEVEL_0
      McuLviResetMask = false
      McuNumberOfMcuModes = 1
      McuRamSectors = 1
      McuCvmOutMaskFbist = false
      McuCvmOutMaskDiag = false
      McuCvmOutputFilter = false
      McuCvmDiagLockBit = true
      McuCvmResetEnable = false
      McuEcmErrorSourcesCfg
        McuEcmErrorSource0:
          McuMiNotification = NULL_PTR
          McuNmiNotification = NULL_PTR
          McuEcmErrorMaskableInterrupt = false
          McuEcmErrorNonMaskableInterrupt = false
          McuEcmErrorInternalReset = false
          McuEcmErrorNMIDelayTimer = false
          McuEcmErrorMIDelayTimer = false
          McuEcmErrorOutputMask = true
        McuEcmErrorSource1:
          McuMiNotification = NULL_PTR
          McuNmiNotification = NULL_PTR
          McuEcmErrorMaskableInterrupt = false
          McuEcmErrorNonMaskableInterrupt = false
          McuEcmErrorInternalReset = false
          McuEcmErrorNMIDelayTimer = false
          McuEcmErrorMIDelayTimer = false
          McuEcmErrorOutputMask = true
        McuEcmErrorSource4:
          McuNmiNotification = NULL_PTR
          McuMiNotification = NULL_PTR
          McuEcmErrorMaskableInterrupt = false
          McuEcmErrorNonMaskableInterrupt = false
          McuEcmErrorInternalReset = false
          McuEcmErrorNMIDelayTimer = false
          McuEcmErrorMIDelayTimer = false
          McuEcmErrorOutputMask = true
        McuEcmErrorSource10:
          McuNmiNotification = NULL_PTR
          McuMiNotification = NULL_PTR
          McuEcmErrorMaskableInterrupt = false
          McuEcmErrorNonMaskableInterrupt = false
          McuEcmErrorInternalReset = false
          McuEcmErrorNMIDelayTimer = false
          McuEcmErrorMIDelayTimer = false
          McuEcmErrorOutputMask = true
        McuEcmErrorSource11:
          McuNmiNotification = NULL_PTR
          McuMiNotification = NULL_PTR
          McuEcmErrorMaskableInterrupt = false
          McuEcmErrorNonMaskableInterrupt = false
          McuEcmErrorInternalReset = false
          McuEcmErrorNMIDelayTimer = false
          McuEcmErrorMIDelayTimer = false
          McuEcmErrorOutputMask = true
        McuEcmErrorSource12:
          McuNmiNotification = NULL_PTR
          McuMiNotification = NULL_PTR
          McuEcmErrorMaskableInterrupt = false
          McuEcmErrorNonMaskableInterrupt = false
          McuEcmErrorInternalReset = false
          McuEcmErrorNMIDelayTimer = false
          McuEcmErrorMIDelayTimer = false
          McuEcmErrorOutputMask = true
        McuEcmErrorSource14:
          McuNmiNotification = NULL_PTR
          McuMiNotification = NULL_PTR
          McuEcmErrorMaskableInterrupt = false
          McuEcmErrorNonMaskableInterrupt = false
          McuEcmErrorInternalReset = false
          McuEcmErrorNMIDelayTimer = false
          McuEcmErrorMIDelayTimer = false
          McuEcmErrorOutputMask = true
        McuEcmErrorSource15:
          McuNmiNotification = NULL_PTR
          McuMiNotification = NULL_PTR
          McuEcmErrorMaskableInterrupt = false
          McuEcmErrorNonMaskableInterrupt = false
          McuEcmErrorInternalReset = false
          McuEcmErrorNMIDelayTimer = false
          McuEcmErrorMIDelayTimer = false
          McuEcmErrorOutputMask = true
        McuEcmErrorSource16:
          McuNmiNotification = NULL_PTR
          McuMiNotification = NULL_PTR
          McuEcmErrorMaskableInterrupt = false
          McuEcmErrorNonMaskableInterrupt = false
          McuEcmErrorInternalReset = false
          McuEcmErrorNMIDelayTimer = false
          McuEcmErrorMIDelayTimer = false
          McuEcmErrorOutputMask = true
        McuEcmErrorSource17:
          McuNmiNotification = NULL_PTR
          McuMiNotification = NULL_PTR
          McuEcmErrorMaskableInterrupt = false
          McuEcmErrorNonMaskableInterrupt = false
          McuEcmErrorInternalReset = false
          McuEcmErrorNMIDelayTimer = false
          McuEcmErrorMIDelayTimer = false
          McuEcmErrorOutputMask = true
        McuEcmErrorSource18:
          McuNmiNotification = NULL_PTR
          McuMiNotification = NULL_PTR
          McuEcmErrorMaskableInterrupt = false
          McuEcmErrorNonMaskableInterrupt = false
          McuEcmErrorInternalReset = false
          McuEcmErrorNMIDelayTimer = false
          McuEcmErrorMIDelayTimer = false
          McuEcmErrorOutputMask = true
        McuEcmErrorSource19:
          McuNmiNotification = NULL_PTR
          McuMiNotification = NULL_PTR
          McuEcmErrorMaskableInterrupt = false
          McuEcmErrorNonMaskableInterrupt = false
          McuEcmErrorInternalReset = false
          McuEcmErrorNMIDelayTimer = false
          McuEcmErrorMIDelayTimer = false
          McuEcmErrorOutputMask = true
        McuEcmErrorSource20:
          McuNmiNotification = NULL_PTR
          McuMiNotification = NULL_PTR
          McuEcmErrorMaskableInterrupt = false
          McuEcmErrorNonMaskableInterrupt = false
          McuEcmErrorInternalReset = false
          McuEcmErrorNMIDelayTimer = false
          McuEcmErrorMIDelayTimer = false
          McuEcmErrorOutputMask = true
        McuEcmErrorSource21:
          McuNmiNotification = NULL_PTR
          McuMiNotification = NULL_PTR
          McuEcmErrorMaskableInterrupt = false
          McuEcmErrorNonMaskableInterrupt = false
          McuEcmErrorInternalReset = false
          McuEcmErrorNMIDelayTimer = false
          McuEcmErrorMIDelayTimer = false
          McuEcmErrorOutputMask = true
        McuEcmErrorSource22:
          McuNmiNotification = NULL_PTR
          McuMiNotification = NULL_PTR
          McuEcmErrorMaskableInterrupt = false
          McuEcmErrorNonMaskableInterrupt = false
          McuEcmErrorInternalReset = false
          McuEcmErrorNMIDelayTimer = false
          McuEcmErrorMIDelayTimer = false
          McuEcmErrorOutputMask = true
        McuEcmErrorSource23:
          McuNmiNotification = NULL_PTR
          McuMiNotification = NULL_PTR
          McuEcmErrorMaskableInterrupt = false
          McuEcmErrorNonMaskableInterrupt = false
          McuEcmErrorInternalReset = false
          McuEcmErrorNMIDelayTimer = false
          McuEcmErrorMIDelayTimer = false
          McuEcmErrorOutputMask = true
        McuEcmErrorSource24:
          McuNmiNotification = NULL_PTR
          McuMiNotification = NULL_PTR
          McuEcmErrorMaskableInterrupt = false
          McuEcmErrorNonMaskableInterrupt = false
          McuEcmErrorInternalReset = false
          McuEcmErrorNMIDelayTimer = false
          McuEcmErrorMIDelayTimer = false
          McuEcmErrorOutputMask = true
        McuEcmErrorSource26:
          McuNmiNotification = NULL_PTR
          McuMiNotification = NULL_PTR
          McuEcmErrorMaskableInterrupt = false
          McuEcmErrorNonMaskableInterrupt = false
          McuEcmErrorInternalReset = false
          McuEcmErrorNMIDelayTimer = false
          McuEcmErrorMIDelayTimer = false
          McuEcmErrorOutputMask = true
        McuEcmErrorSource27:
          McuNmiNotification = NULL_PTR
          McuMiNotification = NULL_PTR
          McuEcmErrorMaskableInterrupt = false
          McuEcmErrorNonMaskableInterrupt = false
          McuEcmErrorInternalReset = false
          McuEcmErrorNMIDelayTimer = false
          McuEcmErrorMIDelayTimer = false
          McuEcmErrorOutputMask = true
        McuEcmErrorSource28:
          McuNmiNotification = NULL_PTR
          McuMiNotification = NULL_PTR
          McuEcmErrorMaskableInterrupt = false
          McuEcmErrorNonMaskableInterrupt = false
          McuEcmErrorInternalReset = false
          McuEcmErrorNMIDelayTimer = false
          McuEcmErrorMIDelayTimer = false
          McuEcmErrorOutputMask = true
        McuEcmErrorSource29:
          McuNmiNotification = NULL_PTR
          McuMiNotification = NULL_PTR
          McuEcmErrorMaskableInterrupt = false
          McuEcmErrorNonMaskableInterrupt = false
          McuEcmErrorInternalReset = false
          McuEcmErrorNMIDelayTimer = false
          McuEcmErrorMIDelayTimer = false
          McuEcmErrorOutputMask = true
        McuEcmErrorSource30:
          McuNmiNotification = NULL_PTR
          McuMiNotification = NULL_PTR
          McuEcmErrorMaskableInterrupt = false
          McuEcmErrorNonMaskableInterrupt = false
          McuEcmErrorInternalReset = false
          McuEcmErrorNMIDelayTimer = false
          McuEcmErrorMIDelayTimer = false
          McuEcmErrorOutputMask = true
        McuEcmErrorSource31:
          McuNmiNotification = NULL_PTR
          McuMiNotification = NULL_PTR
          McuEcmErrorMaskableInterrupt = false
          McuEcmErrorNonMaskableInterrupt = false
          McuEcmErrorInternalReset = false
          McuEcmErrorNMIDelayTimer = false
          McuEcmErrorMIDelayTimer = false
          McuEcmErrorOutputMask = true
        McuEcmErrorSource32:
          McuNmiNotification = NULL_PTR
          McuMiNotification = NULL_PTR
          McuEcmErrorMaskableInterrupt = false
          McuEcmErrorNonMaskableInterrupt = false
          McuEcmErrorInternalReset = false
          McuEcmErrorNMIDelayTimer = false
          McuEcmErrorMIDelayTimer = false
          McuEcmErrorOutputMask = true
        McuEcmErrorSource33:
          McuNmiNotification = NULL_PTR
          McuMiNotification = NULL_PTR
          McuEcmErrorMaskableInterrupt = false
          McuEcmErrorNonMaskableInterrupt = false
          McuEcmErrorInternalReset = false
          McuEcmErrorNMIDelayTimer = false
          McuEcmErrorMIDelayTimer = false
          McuEcmErrorOutputMask = true
        McuEcmErrorSource34:
          McuNmiNotification = NULL_PTR
          McuMiNotification = NULL_PTR
          McuEcmErrorMaskableInterrupt = false
          McuEcmErrorNonMaskableInterrupt = false
          McuEcmErrorInternalReset = false
          McuEcmErrorNMIDelayTimer = false
          McuEcmErrorMIDelayTimer = false
          McuEcmErrorOutputMask = true
        McuEcmErrorSource36:
          McuNmiNotification = NULL_PTR
          McuMiNotification = NULL_PTR
          McuEcmErrorMaskableInterrupt = false
          McuEcmErrorNonMaskableInterrupt = false
          McuEcmErrorInternalReset = false
          McuEcmErrorNMIDelayTimer = false
          McuEcmErrorMIDelayTimer = false
          McuEcmErrorOutputMask = true
        McuEcmErrorSource37:
          McuNmiNotification = NULL_PTR
          McuMiNotification = NULL_PTR
          McuEcmErrorMaskableInterrupt = false
          McuEcmErrorNonMaskableInterrupt = false
          McuEcmErrorInternalReset = false
          McuEcmErrorNMIDelayTimer = false
          McuEcmErrorMIDelayTimer = false
          McuEcmErrorOutputMask = true
        McuEcmErrorSource38:
          McuNmiNotification = NULL_PTR
          McuMiNotification = NULL_PTR
          McuEcmErrorMaskableInterrupt = false
          McuEcmErrorNonMaskableInterrupt = false
          McuEcmErrorInternalReset = false
          McuEcmErrorNMIDelayTimer = false
          McuEcmErrorMIDelayTimer = false
          McuEcmErrorOutputMask = true
        McuEcmErrorSource39:
          McuNmiNotification = NULL_PTR
          McuMiNotification = NULL_PTR
          McuEcmErrorMaskableInterrupt = false
          McuEcmErrorNonMaskableInterrupt = false
          McuEcmErrorInternalReset = false
          McuEcmErrorNMIDelayTimer = false
          McuEcmErrorMIDelayTimer = false
          McuEcmErrorOutputMask = true
        McuEcmErrorSource40:
          McuNmiNotification = NULL_PTR
          McuMiNotification = NULL_PTR
          McuEcmErrorMaskableInterrupt = false
          McuEcmErrorNonMaskableInterrupt = false
          McuEcmErrorInternalReset = false
          McuEcmErrorNMIDelayTimer = false
          McuEcmErrorMIDelayTimer = false
          McuEcmErrorOutputMask = true
        McuEcmErrorSource41:
          McuNmiNotification = NULL_PTR
          McuMiNotification = NULL_PTR
          McuEcmErrorMaskableInterrupt = false
          McuEcmErrorNonMaskableInterrupt = false
          McuEcmErrorInternalReset = false
          McuEcmErrorNMIDelayTimer = false
          McuEcmErrorMIDelayTimer = false
          McuEcmErrorOutputMask = true
        McuEcmErrorSource42:
          McuNmiNotification = NULL_PTR
          McuMiNotification = NULL_PTR
          McuEcmErrorMaskableInterrupt = false
          McuEcmErrorNonMaskableInterrupt = false
          McuEcmErrorInternalReset = false
          McuEcmErrorNMIDelayTimer = false
          McuEcmErrorMIDelayTimer = false
          McuEcmErrorOutputMask = true
        McuEcmErrorSource5:
          McuNmiNotification = NULL_PTR
          McuMiNotification = NULL_PTR
          McuEcmErrorMaskableInterrupt = false
          McuEcmErrorNonMaskableInterrupt = false
          McuEcmErrorInternalReset = false
          McuEcmErrorNMIDelayTimer = false
          McuEcmErrorMIDelayTimer = false
          McuEcmErrorOutputMask = true
        McuEcmErrorSource6:
          McuNmiNotification = NULL_PTR
          McuMiNotification = NULL_PTR
          McuEcmErrorMaskableInterrupt = false
          McuEcmErrorNonMaskableInterrupt = false
          McuEcmErrorInternalReset = false
          McuEcmErrorNMIDelayTimer = false
          McuEcmErrorMIDelayTimer = false
          McuEcmErrorOutputMask = true
        McuEcmErrorSource7:
          McuNmiNotification = NULL_PTR
          McuMiNotification = NULL_PTR
          McuEcmErrorMaskableInterrupt = false
          McuEcmErrorNonMaskableInterrupt = false
          McuEcmErrorInternalReset = false
          McuEcmErrorNMIDelayTimer = false
          McuEcmErrorMIDelayTimer = false
          McuEcmErrorOutputMask = true
        McuEcmErrorSource8:
          McuNmiNotification = NULL_PTR
          McuMiNotification = NULL_PTR
          McuEcmErrorMaskableInterrupt = false
          McuEcmErrorNonMaskableInterrupt = false
          McuEcmErrorInternalReset = false
          McuEcmErrorNMIDelayTimer = false
          McuEcmErrorMIDelayTimer = false
          McuEcmErrorOutputMask = true
        McuEcmErrorSource9:
          McuNmiNotification = NULL_PTR
          McuMiNotification = NULL_PTR
          McuEcmErrorMaskableInterrupt = false
          McuEcmErrorNonMaskableInterrupt = false
          McuEcmErrorInternalReset = false
          McuEcmErrorNMIDelayTimer = false
          McuEcmErrorMIDelayTimer = false
          McuEcmErrorOutputMask = true
        McuEcmErrorSource129: McuEcmErrorInternalReset=false, McuEcmErrorOutputMask=true
      McuClockSettingConfig: McuClockSettingId=0, McuMainOsciFrequency=16000000, McuCpuMainSysClk=160000000, McuUnitName=CLK_CPU
        McuExternalClkOutSetting:
          McuExternalClk0SourceSel = MCU_MAIN_OSCILLATOR
          McuExternalClk0DividerSel = 1
          McuExternalClock0 = 16000000
          McuExternalClk1SourceSel = MCU_MAIN_OSCILLATOR
          McuExternalClk1DividerSel = 1
          McuExternalClock1 = 16000000
        McuAdcClk: McuDivClockSel=CLK_LSB, McuUnitName=ADC, McuPeripheralClock=40000000
        McuClockReferencePoint: McuClockReferencePointFrequency=16000000
        McuHighspeedPeriClk: McuUnitName=CLK_HSB, McuPeripheralClock=80000000
        McuLowspeedPeriClk: McuUnitName=CLK_LSB, McuPeripheralClock=40000000
        McuWdtacounterClk: McuWdtCounterDivider=DIVBY_32_ID_1, McuUnitName=WDTCLKI, McuPeripheralClock=250000
      McuDemEventParameterRefs:
        MCU_E_CLOCK_FAILURE = AutoCreatedDemEvent_McuModuleConfiguration_MCU_E_CLOCK_FAILURE
        MCU_E_WRITE_TIMEOUT_FAILURE = AutoCreatedDemEvent_McuModuleConfiguration_MCU_E_WRITE_TIMEOUT_FAILURE
        MCU_E_RESETCONTROLLER_STARTUP_FAILURE = AutoCreatedDemEvent_McuModuleConfiguration_MCU_E_RESETCONTROLLER_STARTUP_FAILURE
      McuModeSettingConf: McuModeType=RUN_MODE, McuMode=0
      McuRamSectorSettingConf: McuRamDefaultValue=255, McuRamSectionBaseAddress=4273864704, McuRamSectionSize=256, McuRamTypeSel=LOCAL_RAM_4273864704_4273995775
    McuGeneralConfiguration:
      McuVersionCheckExternalModules = false
      McuDevErrorDetect = false
      McuGetRamStateApi = false
      McuInitClock = true
      McuNoPll = false
      McuPerformResetApi = true
      McuVersionInfoApi = false
      McuCriticalSectionProtection = true
      McuSwResetCallApi = false
      McuEcmDelayTimerOverflowValue = 65535
      McuEcmErrorOutputMode = NON_DYNAMIC_MODE
      McuEcmErrorOutTimer = false
      McuRamSectorSetting = false
      McuDeviceName = R7F701319
      McuClm0Operation = false
      McuClm0MonitoringClockAccuracy = 9
      McuClm0SamplingClockAccuracy = 9
      McuClm1Operation = false
      McuClm1MonitoringClockAccuracy = 9
      McuClm1SamplingClockAccuracy = 9
      McuClm2Operation = false
      McuClm2MonitoringClockAccuracy = 14
      McuClm2SamplingClockAccuracy = 14
      McuClm3Operation = false
      McuClm3MonitoringClockAccuracy = 14
      McuClm3SamplingClockAccuracy = 14
      McuCvmSelfDiagnosticTest = false
      McuClma{0..3}SelfDiagnosticTest = false
      McuEcmSelfDiagnosticTest = false
      McuWriteVerify = WV_DISABLE
      McuLoopCount = 5
      McuLockStepSelfDiagnosticTest = false
      McuStartUpSWResetTest = true
      McuStartUpECMResetTest = true
      McuInterruptConsistencyCheck = false
    McuPublishedInformation
      McuResetReasonConf: McuResetReason=0
      McuRstRsnConfPowOnClr: McuResetReason=0
      McuRstRsnConfPinRst: McuResetReason=1
      McuRstRsnConfSwRst: McuResetReason=2
      McuRstRsnConfWdta: McuResetReason=3
      McuRstRsnConfLockStepCompare: McuResetReason=4
      McuRstRsnConfClkMonUprLimErMosc: McuResetReason=5
      McuRstRsnConfClkMonLwrLimErMosc: McuResetReason=6
      McuRstRsnConfClkMonUprLimErWdt: McuResetReason=7
      McuRstRsnConfClkMonLwrLimErWdt: McuResetReason=8
      McuRstRsnConfClkMonUprLimErPclk: McuResetReason=9
      McuRstRsnConfClkMonLwrLimErPclk: McuResetReason=10
      McuRstRsnConfClkMonUprLimErPe1: McuResetReason=11
      McuRstRsnConfClkMonLwrLimErPe1: McuResetReason=12
      McuRstRsnConfLRamEcc2AddPrty: McuResetReason=13
      McuRstRsnConfInstCacheRamEcc2: McuResetReason=14
      McuRstRsnConfCodeFlsEcc2AddPrty: McuResetReason=15
      McuRstRsnConfDataFlsEcc2: McuResetReason=16
      McuRstRsnConfDtsRamEcc2: McuResetReason=17
      McuRstRsnConfCsihRamEcc2: McuResetReason=18
      McuRstRsnConfCanRamEcc2: McuResetReason=19
      McuRstRsnConfFrRamEcc2: McuResetReason=20
      McuRstRsnConfFlsProgMode: McuResetReason=21
      McuRstRsnConfTestMode: McuResetReason=22
      McuRstRsnConfSingChipModInact: McuResetReason=23
      McuRstRsnConfPeGuard: McuResetReason=24
      McuRstRsnConfPBusGuard: McuResetReason=25
      McuRstRsnConfSarAdcPrty: McuResetReason=26
      McuRstRsnConfBusDataPrty: McuResetReason=27
      McuRstRsnConfEcmCompare: McuResetReason=28
      McuRstRsnConfLvi: McuResetReason=29
      McuRstRsnConfTempSensor: McuResetReason=30
      McuRstRsnConfDmaTrans: McuResetReason=31
      McuRstRsnConfDmaViol: McuResetReason=32
      McuRstRsnConfLRamEcc1: McuResetReason=33
      McuRstRsnConfCodeFlsEcc1: McuResetReason=34
      McuRstRsnConfDataFlsEcc1: McuResetReason=35
      McuRstRsnConfDtsRamEcc1: McuResetReason=36
      McuRstRsnConfPeriRamEcc1: McuResetReason=37
      McuRstRsnConfBistCodeEcc1: McuResetReason=38
      McuRstRsnConfBistCodeEcc2: McuResetReason=39
      McuRstRsnConfFaci: McuResetReason=40
      McuRstRsnConfEcmDelayOverFlow: McuResetReason=41
      McuRstRsnConfCvmRst: McuResetReason=42
      McuRstRsnConfRstUndefined: McuResetReason=43
      McuRstRsnConfRstUnknown: McuResetReason=44
