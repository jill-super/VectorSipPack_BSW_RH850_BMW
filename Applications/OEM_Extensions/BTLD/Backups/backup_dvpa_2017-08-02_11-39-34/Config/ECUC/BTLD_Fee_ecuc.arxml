AUTOSAR XML (schema 4-3-0)
package /ActiveEcuC
  module config Fee: implementation-config-variant=VARIANT-PRE-COMPILE, module-description=Fee_Impl
    FeeGeneral:
      FeeSafeBswChecks = true
      FeeDevErrorDetect = true
      FeeIndex = 0
      FeeNvmJobEndNotification = NvM_JobEndNotification
      FeeNvmJobErrorNotification = NvM_JobErrorNotification
      FeePollingMode = true
      FeeSetModeSupported = true
      FeeVersionInfoApi = false
      FeeVirtualPageSize = 8
      FeeMainFunctionPeriod = 0.005
      FeeMainFunctionTriggering = FixedCycleTime
      FeeCorrectSingleBitFlips = false
    FeeNVM_BLOCK_BOOT_PROG_COUNTER (FeeBlockConfiguration):
      FeeBlockNumber = 4
      FeeBlockSize = 8
      FeeImmediateData = false
      FeeNumberOfWriteCycles = 10000
      FeeNumberOfDatasets = 1
      FeeNumberOfInstances = 1
      FeeVerifyWrittenData = false
      FeeBlockId = 0
      FeeDeviceIndex = FlsGeneral
      FeePartition = FeePartitionConfiguration_BTLD
    FeePublishedInformation: FeeBlockOverhead=2, FeeMaximumBlockingTime=1, FeePageOverhead=0
    FeePartitionConfiguration_BTLD (FeePartitionConfiguration):
      FeePartitionStartAddress = 0
      FeePartitionSize = 512
      FeePartitionAddressAlignment = 64
      FeePartitionWriteAlignment = 4
      FeePartitionReadAlignment = 1
      FeeFlsBlankCheckApi = true
      FeePartitionDevice = FlsConfigSet
    6 x FeeBlockConfiguration, all with FeeImmediateData=false, FeeNumberOfWriteCycles=10000, FeeNumberOfDatasets=1, FeeNumberOfInstances=1, FeeVerifyWrittenData=false, FeeDeviceIndex=FlsGeneral, FeePartition=FeePartitionConfiguration_BTLD:
      FeeNVM_BLOCK_BOOT_PROG_DATA: FeeBlockNumber=8, FeeBlockSize=48, FeeBlockId=1
      FeeNVM_BLOCK_BOOT_PROG_STATUS: FeeBlockNumber=12, FeeBlockSize=3, FeeBlockId=2
      FeeNVM_BLOCK_BOOT_SVK_HISTORY: FeeBlockNumber=16, FeeBlockSize=1, FeeBlockId=3
      FeeNVM_BLOCK_OMC_DATA: FeeBlockNumber=20, FeeBlockSize=2, FeeBlockId=4
      FeeNVM_BLOCK_DLOG_SVK_SYS_SUPP: FeeBlockNumber=24, FeeBlockSize=57, FeeBlockId=5
      FeeNVM_BLOCK_DLOG_SVK_PLANT: FeeBlockNumber=28, FeeBlockSize=57, FeeBlockId=6
