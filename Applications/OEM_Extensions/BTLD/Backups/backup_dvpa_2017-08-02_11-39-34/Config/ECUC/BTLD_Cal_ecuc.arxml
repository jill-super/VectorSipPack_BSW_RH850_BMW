AUTOSAR XML (schema 4-3-0)
package /ActiveEcuC
  module config Cal: implementation-config-variant=VARIANT-PRE-COMPILE, module-description=Cal_Impl
    CalGeneral: CalMaxAlignScalarType=32, CalVersionInfoApi=true, CalDisableNotConfiguredApis=true
    CalHash: CalHashMaxCtxBufByteSize=336
      CalHashConfig_MD5 (CalHashConfig): CalHashInitConfiguration=, CalHashPrimitiveName=, CalHashIncludeFile=
      CalHashConfig_SHA (CalHashConfig): CalHashInitConfiguration=, CalHashPrimitiveName=, CalHashIncludeFile=
    CalRandomGenerate
      CalRandomGenerateConfig: CalRandomGenerateInitConfiguration=, CalRandomGeneratePrimitiveName=, CalRandomGenerateIncludeFile=
    CalRandomSeed: CalRandomMaxCtxBufByteSize=24
      CalRandomSeedConfig: CalRandomSeedInitConfiguration=, CalRandomSeedPrimitiveName=, CalRandomSeedIncludeFile=
    CalSignatureVerify: CalSignatureVerifyMaxCtxBufByteSize=2048, CalSignatureVerifyMaxKeySize=2048
      CalSignatureVerifyConfig_MD5 (CalSignatureVerifyConfig): CalSignatureVerifyInitConfiguration=, CalSignatureVerifyPrimitiveName=, CalSignatureVerifyIncludeFile=
      CalSignatureVerifyConfig_SHA (CalSignatureVerifyConfig): CalSignatureVerifyInitConfiguration=, CalSignatureVerifyPrimitiveName=, CalSignatureVerifyIncludeFile=
