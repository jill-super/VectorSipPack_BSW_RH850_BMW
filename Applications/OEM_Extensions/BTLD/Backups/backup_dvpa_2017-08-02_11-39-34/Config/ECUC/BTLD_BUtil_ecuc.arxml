AUTOSAR XML (schema 4-3-0)
package /ActiveEcuC
  module config BUtil: implementation-config-variant=VARIANT-PRE-COMPILE
    General: FeatureSet=BUTIL_FS_FULL
    CommonPublishedInformation: SwMajorVersion=3, SwMinorVersion=1, SwPatchVersion=0
