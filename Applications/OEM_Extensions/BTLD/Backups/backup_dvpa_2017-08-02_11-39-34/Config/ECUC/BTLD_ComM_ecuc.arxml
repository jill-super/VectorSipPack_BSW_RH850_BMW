AUTOSAR XML (schema 4-3-0)
package /ActiveEcuC
  module config ComM: implementation-config-variant=VARIANT-PRE-COMPILE, module-description=ComM_Impl
    ComMGeneral:
      ComMPncIdCounting = COMM_PNC_ID_COUNT_FROM_NM_MESSAGE
      ComMPncSupport = false
      ComMDevErrorDetect = true
      ComMEcuGroupClassification = 3
      ComMModeLimitationEnabled = false
      ComMSynchronousWakeUp = true
      ComMTMinFullComModeDuration = 5
      ComMVersionInfoApi = false
      ComMWakeupInhibitionEnabled = false
      ComMSafeBswChecks = true
      ComMGeneration: ComMOutOfBoundsWriteSanitizer=false, ComMOutOfBoundsReadSanitizer=false
    ComMConfigSet: ComMPncEnabled=false
      A_FlexRay_5b5a9ac2 (ComMChannel):  # con_EPS_A_FlexRay
        ComMBusType = COMM_BUS_TYPE_FR
        ComMChannelId = 0
        ComMFullCommRequestNotificationEnabled = false
        ComMMainFunctionPeriod = 0.02
        ComMNoCom = false
        ComMNoWakeup = false
        ComMNetworkManagement: ComMNmVariant=NONE, ComMPncNmRequest=false
        A_FlexRay_5b5a9ac2 (ComMUserPerChannel): ComMUserChannel=USR_A_FlexRay_5b5a9ac2  # con_EPS_A_FlexRay
      USR_A_FlexRay_5b5a9ac2 (ComMUser): ComMUserIdentifier=0, ComMUserModeNotification=false  # con_EPS_A_FlexRay
