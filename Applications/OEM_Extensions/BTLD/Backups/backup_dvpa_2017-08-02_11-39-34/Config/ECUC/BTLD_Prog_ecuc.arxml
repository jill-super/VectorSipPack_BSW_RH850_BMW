AUTOSAR XML (schema 4-3-0)
package /ActiveEcuC
  module config Prog: implementation-config-variant=VARIANT-PRE-COMPILE
    CommonPublishedInformation: SwMajorVersion=3, SwMinorVersion=3, SwPatchVersion=1
    ProgGeneral:
      ProgReadActiveDiagSessionInDcmEnable = false
      ProgEraseAddressedEnable = true
      ProgNoncompressedEnable = true
      ProgNrvEnable = true
      ProgCryptoEnable = true
      ProgHttpEnable = false
      ProgNrvTempBufferSize = 1024
      ProgFlashPageSize = 32
      ProgFlashAddressAlign = 4
      ProgEraseResponsePendingTimeMax = 4000
      ProgTransferDataResponsePendingTimeMax = 4000
      ProgAuthCalConfigId = CalSignatureVerifyConfig_SHA
      ProgSigCalConfigId = CalSignatureVerifyConfig_SHA
      ProgCalRandomSeedConfigId = CalRandomSeedConfig
      ProgCalRandomGenerateConfigId = CalRandomGenerateConfig
