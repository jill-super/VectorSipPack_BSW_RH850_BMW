AUTOSAR XML (schema 4-3-0)
package /ActiveEcuC
  module config Nrv: implementation-config-variant=VARIANT-PRE-COMPILE
    CommonPublishedInformation: SwMajorVersion=3, SwMinorVersion=1, SwPatchVersion=0
    NrvGeneral: NrvReadFromDest=(uint8)destination[offset]
