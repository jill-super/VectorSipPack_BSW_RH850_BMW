AUTOSAR XML (schema 4-3-0)
package /ActiveEcuC
  module config Xcp: implementation-config-variant=VARIANT-PRE-COMPILE, module-description=Xcp_Impl
    XcpCmdConfig: XcpOpenCommandInterface=false
      XcpStandard:
        XcpBlockUpload = false
        XcpCommunicationModeInfo = false
        XcpGetIdGeneric = false
        XcpMemoryReadProtection = false
        XcpSeedKey = false
        XcpUserDefinedCommand = false
      XcpAsynchMessage: XcpEventCodes=false, XcpServiceRequestMessage=false
    XcpGeneral:
      XcpOnFlexRayEnabled = true
      XcpDevErrorDetect = true
      XcpMainFunctionPeriod = 0.005
      XcpMaxEventChannel = 255
      XcpPrescalerSupported = false
      XcpVersionInfoApi = false
      XcpBootloaderDownload = false
      XcpControl = false
      XcpMultiClientSupport = false
      XcpRuntimeMeasurementSupport = false
      XcpSafeBswChecks = true
      XcpSessionStatusAPI = false
      XcpTypeSafeCopy = false
      XcpDAQMemAccessByApplication = false
      XcpA2L: XcpTimeoutT1=2000, XcpTimeoutT2=10000, XcpTimeoutT3=2000, XcpTimeoutT4=2000, XcpTimeoutT5=2000, XcpTimeoutT6=2000, XcpTimeoutT7=0
    XcpConfig
      11 x XcpPdu:
        xcpdynamic254_6_23008def
          xcpdynamic254_6_23008def (XcpTxPdu): XcpTxPduId=0, XcpTxPduRef=pduTr_xcpdynamic254_6_A_FlexRay_pduPort_EPS_A_FlexRay_OUT_7d601c47_052bff33
        xcpdynamic254_3_23008def
          xcpdynamic254_3_23008def (XcpTxPdu): XcpTxPduId=0, XcpTxPduRef=pduTr_xcpdynamic254_3_A_FlexRay_pduPort_EPS_A_FlexRay_OUT_7d601c47_052bff33
        xcpdynamic254_8_23008def
          xcpdynamic254_8_23008def (XcpTxPdu): XcpTxPduId=0, XcpTxPduRef=pduTr_xcpdynamic254_8_A_FlexRay_pduPort_EPS_A_FlexRay_OUT_7d601c47_052bff33
        dummy16bstatic_23008def
          dummy16bstatic_23008def (XcpTxPdu): XcpTxPduId=0, XcpTxPduRef=pduTr_dummy16bstatic_A_FlexRay_pduPort_EPS_A_FlexRay_OUT_7d601c47_052bff33
        xcpdynamic254_7_23008def
          xcpdynamic254_7_23008def (XcpTxPdu): XcpTxPduId=0, XcpTxPduRef=pduTr_xcpdynamic254_7_A_FlexRay_pduPort_EPS_A_FlexRay_OUT_7d601c47_052bff33
        xcpdynamic254_1_23008def
          xcpdynamic254_1_23008def (XcpTxPdu): XcpTxPduId=0, XcpTxPduRef=pduTr_xcpdynamic254_1_A_FlexRay_pduPort_EPS_A_FlexRay_OUT_7d601c47_052bff33
        xcpdynamic254_4_23008def
          xcpdynamic254_4_23008def (XcpTxPdu): XcpTxPduId=0, XcpTxPduRef=pduTr_xcpdynamic254_4_A_FlexRay_pduPort_EPS_A_FlexRay_OUT_7d601c47_052bff33
        dummy32bslave_23008def
          dummy32bslave_23008def (XcpTxPdu): XcpTxPduId=0, XcpTxPduRef=pduTr_dummy32bslave_A_FlexRay_pduPort_EPS_A_FlexRay_OUT_7d601c47_052bff33
        xcpdynamic254_2_23008def
          xcpdynamic254_2_23008def (XcpTxPdu): XcpTxPduId=0, XcpTxPduRef=pduTr_xcpdynamic254_2_A_FlexRay_pduPort_EPS_A_FlexRay_OUT_7d601c47_052bff33
        xcpdynamic254_5_23008def
          xcpdynamic254_5_23008def (XcpTxPdu): XcpTxPduId=0, XcpTxPduRef=pduTr_xcpdynamic254_5_A_FlexRay_pduPort_EPS_A_FlexRay_OUT_7d601c47_052bff33
        dummy32bmaster_23008def
          dummy32bmaster_23008def (XcpRxPdu): XcpRxPduId=0, XcpRxPduRef=pduTr_dummy32bmaster_A_FlexRay_pduPort_EPS_A_FlexRay_IN_7d601c47_052bff33
      XcpTransportLayer
