AUTOSAR XML (schema 4-3-0)
package /ActiveEcuC
  module config Rte: implementation-config-variant=VARIANT-PRE-COMPILE, module-description=Rte_Impl
    3 x RteBswModuleInstance:
      EcuM: RteBswImplementationRef=EcuM_Impl, RteBswModuleConfigurationRef=EcuM
        ECUM_EXCLUSIVE_AREA_1 (RteBswExclusiveAreaImpl): RteExclusiveAreaImplMechanism=ALL_INTERRUPT_BLOCKING, RteBswExclusiveAreaRef=ECUM_EXCLUSIVE_AREA_1
        ECUM_EXCLUSIVE_AREA_2 (RteBswExclusiveAreaImpl): RteExclusiveAreaImplMechanism=ALL_INTERRUPT_BLOCKING, RteBswExclusiveAreaRef=ECUM_EXCLUSIVE_AREA_2
        EcuM_MainFunctionTimingEvent0 (RteBswEventToTaskMapping): RteBswImmediateRestart=false, RteBswEventRef=EcuM_MainFunctionTimingEvent0
        ECUM_EXCLUSIVE_AREA_0 (RteBswExclusiveAreaImpl): RteExclusiveAreaImplMechanism=ALL_INTERRUPT_BLOCKING, RteBswExclusiveAreaRef=ECUM_EXCLUSIVE_AREA_0
      Xcp: RteBswImplementationRef=Xcp_Impl, RteBswModuleConfigurationRef=Xcp
        4 x RteBswExclusiveAreaImpl, all with RteExclusiveAreaImplMechanism=ALL_INTERRUPT_BLOCKING:
          XCP_EXCLUSIVE_AREA_2: RteBswExclusiveAreaRef=XCP_EXCLUSIVE_AREA_2
          FRXCP_EXCLUSIVE_AREA_0: RteBswExclusiveAreaRef=FRXCP_EXCLUSIVE_AREA_0
          CANXCP_EXCLUSIVE_AREA_0: RteBswExclusiveAreaRef=CANXCP_EXCLUSIVE_AREA_0
          FRXCP_EXCLUSIVE_AREA_1: RteBswExclusiveAreaRef=FRXCP_EXCLUSIVE_AREA_1
        Xcp_MainFunctionTimingEvent0 (RteBswEventToTaskMapping): RteBswImmediateRestart=false, RteBswEventRef=Xcp_MainFunctionTimingEvent0
        4 x RteBswExclusiveAreaImpl, all with RteExclusiveAreaImplMechanism=ALL_INTERRUPT_BLOCKING:
          TCPIPXCP_EXCLUSIVE_AREA_0: RteBswExclusiveAreaRef=TCPIPXCP_EXCLUSIVE_AREA_0
          XCP_EXCLUSIVE_AREA_0: RteBswExclusiveAreaRef=XCP_EXCLUSIVE_AREA_0
          XCP_EXCLUSIVE_AREA_1: RteBswExclusiveAreaRef=XCP_EXCLUSIVE_AREA_1
          FRXCP_EXCLUSIVE_AREA_2: RteBswExclusiveAreaRef=FRXCP_EXCLUSIVE_AREA_2
      Rte: RteBswImplementationRef=Rte_Impl, RteBswModuleConfigurationRef=Rte
    RteBswGeneral: RteSchMVersionInfoApi=false, RteUseComShadowSignalApi=false
    5 x RteBswModuleInstance:
      BswM: RteBswImplementationRef=BswM_Impl, RteBswModuleConfigurationRef=BswM
        BSWM_EXCLUSIVE_AREA_0 (RteBswExclusiveAreaImpl): RteExclusiveAreaImplMechanism=ALL_INTERRUPT_BLOCKING, RteBswExclusiveAreaRef=BSWM_EXCLUSIVE_AREA_0
      PduR: RteBswImplementationRef=PduR_Impl, RteBswModuleConfigurationRef=PduR
        PDUR_EXCLUSIVE_AREA_1 (RteBswExclusiveAreaImpl): RteExclusiveAreaImplMechanism=ALL_INTERRUPT_BLOCKING, RteBswExclusiveAreaRef=PDUR_EXCLUSIVE_AREA_1
        PDUR_EXCLUSIVE_AREA_0 (RteBswExclusiveAreaImpl): RteExclusiveAreaImplMechanism=ALL_INTERRUPT_BLOCKING, RteBswExclusiveAreaRef=PDUR_EXCLUSIVE_AREA_0
      Det: RteBswImplementationRef=Det_Impl, RteBswModuleConfigurationRef=Det
        DET_EXCLUSIVE_AREA_0 (RteBswExclusiveAreaImpl): RteExclusiveAreaImplMechanism=ALL_INTERRUPT_BLOCKING, RteBswExclusiveAreaRef=DET_EXCLUSIVE_AREA_0
      Fr: RteBswImplementationRef=Fr_Impl, RteBswModuleConfigurationRef=Fr
        FR_EXCLUSIVE_AREA_0 (RteBswExclusiveAreaImpl): RteExclusiveAreaImplMechanism=ALL_INTERRUPT_BLOCKING, RteBswExclusiveAreaRef=FR_EXCLUSIVE_AREA_0
        FR_EXCLUSIVE_AREA_1 (RteBswExclusiveAreaImpl): RteExclusiveAreaImplMechanism=ALL_INTERRUPT_BLOCKING, RteBswExclusiveAreaRef=FR_EXCLUSIVE_AREA_1
      FrSM: RteBswImplementationRef=FrSM_Impl, RteBswModuleConfigurationRef=FrSM
        FRSM_EXCLUSIVE_AREA_2 (RteBswExclusiveAreaImpl): RteExclusiveAreaImplMechanism=ALL_INTERRUPT_BLOCKING, RteBswExclusiveAreaRef=FRSM_EXCLUSIVE_AREA_2
        FRSM_EXCLUSIVE_AREA_1 (RteBswExclusiveAreaImpl): RteExclusiveAreaImplMechanism=ALL_INTERRUPT_BLOCKING, RteBswExclusiveAreaRef=FRSM_EXCLUSIVE_AREA_1
        FrSM_MainFunction_0TimingEvent0 (RteBswEventToTaskMapping): RteBswImmediateRestart=false, RteBswEventRef=FrSM_MainFunction_0TimingEvent0
        FRSM_EXCLUSIVE_AREA_3 (RteBswExclusiveAreaImpl): RteExclusiveAreaImplMechanism=ALL_INTERRUPT_BLOCKING, RteBswExclusiveAreaRef=FRSM_EXCLUSIVE_AREA_3
        FRSM_EXCLUSIVE_AREA_0 (RteBswExclusiveAreaImpl): RteExclusiveAreaImplMechanism=ALL_INTERRUPT_BLOCKING, RteBswExclusiveAreaRef=FRSM_EXCLUSIVE_AREA_0
    RteInitializationBehavior: RteInitializationStrategy=RTE_INITIALIZATION_STRATEGY_AT_DATA_DECLARATION, RteSectionInitializationPolicy=INIT
    FrIf (RteBswModuleInstance): RteBswImplementationRef=FrIf_Impl, RteBswModuleConfigurationRef=FrIf
      3 x RteBswExclusiveAreaImpl, all with RteExclusiveAreaImplMechanism=ALL_INTERRUPT_BLOCKING:
        FRIF_EXCLUSIVE_AREA_{0..2}: RteBswExclusiveAreaRef=FRIF_EXCLUSIVE_AREA_{0..2}
      FrIf_MainFunction_0TimingEvent0 (RteBswEventToTaskMapping): RteBswImmediateRestart=false, RteBswEventRef=FrIf_MainFunction_0TimingEvent0
    RteGeneration:
      RteGenerationMode = COMPATIBILITY_MODE
      RteIocInteractionReturnValue = RTE_IOC
      RteValueRangeCheckEnabled = false
      RteCalibrationSupport = NONE
      RteCodeVendorId = 30
      RteDevErrorDetect = false
      RteDevErrorDetectUninit = false
      RteMeasurementSupport = false
      RteOptimizationMode = MEMORY
      RteVfbTraceEnabled = false
    ComM (RteBswModuleInstance): RteBswImplementationRef=ComM_Impl, RteBswModuleConfigurationRef=ComM
      ComM_MainFunction_0TimingEvent0 (RteBswEventToTaskMapping): RteBswImmediateRestart=false, RteBswEventRef=ComM_MainFunction_0TimingEvent0
      COMM_EXCLUSIVE_AREA_1 (RteBswExclusiveAreaImpl): RteExclusiveAreaImplMechanism=ALL_INTERRUPT_BLOCKING, RteBswExclusiveAreaRef=COMM_EXCLUSIVE_AREA_1
      COMM_EXCLUSIVE_AREA_0 (RteBswExclusiveAreaImpl): RteExclusiveAreaImplMechanism=ALL_INTERRUPT_BLOCKING, RteBswExclusiveAreaRef=COMM_EXCLUSIVE_AREA_0
    RteOsInteraction
    4 x RteSwComponentInstance:
      Det_EcuSwComposition: RteSoftwareComponentInstanceRef=Det
      ComM_EcuSwComposition: RteSoftwareComponentInstanceRef=ComM
        13 x RteEventToTaskMapping, all with RteImmediateRestart=false:
          Timer_ComM_MainFunction_0: RteEventRef=Timer_ComM_MainFunction_0
          OpEventGetInhibitionStatus_GetInhibitionStatus_CL_A_FlexRay_5b5a9ac2: RteEventRef=OpEventGetInhibitionStatus_GetInhibitionStatus_CL_A_FlexRay_5b5a9ac2
          OpEventGetInhibitionStatus_GetInhibitionStatus_CW_A_FlexRay_5b5a9ac2: RteEventRef=OpEventGetInhibitionStatus_GetInhibitionStatus_CW_A_FlexRay_5b5a9ac2
          OpEventLimitECUToNoComMode_LimitECUToNoComMode_modeLimitation: RteEventRef=OpEventLimitECUToNoComMode_LimitECUToNoComMode_modeLimitation
          OpEventReadInhibitCounter_ReadInhibitCounter_modeLimitation: RteEventRef=OpEventReadInhibitCounter_ReadInhibitCounter_modeLimitation
          OpEventResetInhibitCounter_ResetInhibitCounter_modeLimitation: RteEventRef=OpEventResetInhibitCounter_ResetInhibitCounter_modeLimitation
          OpEventSetECUGroupClassification_SetECUGroupClassification_modeLimitation: RteEventRef=OpEventSetECUGroupClassification_SetECUGroupClassification_modeLimitation
          OpEventLimitChannelToNoComMode_LimitChannelToNoComMode_CL_A_FlexRay_5b5a9ac2: RteEventRef=OpEventLimitChannelToNoComMode_LimitChannelToNoComMode_CL_A_FlexRay_5b5a9ac2
          OpEventPreventWakeUp_PreventWakeUp_CW_A_FlexRay_5b5a9ac2: RteEventRef=OpEventPreventWakeUp_PreventWakeUp_CW_A_FlexRay_5b5a9ac2
          OpEventRequestComMode_RequestComMode_UR_USR_A_FlexRay_5b5a9ac2: RteEventRef=OpEventRequestComMode_RequestComMode_UR_USR_A_FlexRay_5b5a9ac2
          OpEventGetCurrentComMode_GetCurrentComMode_UR_USR_A_FlexRay_5b5a9ac2: RteEventRef=OpEventGetCurrentComMode_GetCurrentComMode_UR_USR_A_FlexRay_5b5a9ac2
          OpEventGetMaxComMode_GetMaxComMode_UR_USR_A_FlexRay_5b5a9ac2: RteEventRef=OpEventGetMaxComMode_GetMaxComMode_UR_USR_A_FlexRay_5b5a9ac2
          OpEventGetRequestedComMode_GetRequestedComMode_UR_USR_A_FlexRay_5b5a9ac2: RteEventRef=OpEventGetRequestedComMode_GetRequestedComMode_UR_USR_A_FlexRay_5b5a9ac2
      BswM_EcuSwComposition: RteSoftwareComponentInstanceRef=BswM
      EcuM_EcuSwComposition: RteSoftwareComponentInstanceRef=EcuM
        8 x RteEventToTaskMapping, all with RteImmediateRestart=false:
          Timer_EcuM_MainFunction: RteEventRef=Timer_EcuM_MainFunction
          OpEventSelectShutdownTarget_SelectShutdownTarget_EcuM_ShutdownTarget: RteEventRef=OpEventSelectShutdownTarget_SelectShutdownTarget_EcuM_ShutdownTarget
          OpEventGetShutdownTarget_GetShutdownTarget_EcuM_ShutdownTarget: RteEventRef=OpEventGetShutdownTarget_GetShutdownTarget_EcuM_ShutdownTarget
          OpEventGetLastShutdownTarget_GetLastShutdownTarget_EcuM_ShutdownTarget: RteEventRef=OpEventGetLastShutdownTarget_GetLastShutdownTarget_EcuM_ShutdownTarget
          OpEventSelectShutdownCause_SelectShutdownCause_EcuM_ShutdownTarget: RteEventRef=OpEventSelectShutdownCause_SelectShutdownCause_EcuM_ShutdownTarget
          OpEventGetShutdownCause_GetShutdownCause_EcuM_ShutdownTarget: RteEventRef=OpEventGetShutdownCause_GetShutdownCause_EcuM_ShutdownTarget
          OpEventSelectBootTarget_SelectBootTarget_EcuM_BootTarget: RteEventRef=OpEventSelectBootTarget_SelectBootTarget_EcuM_BootTarget
          OpEventGetBootTarget_GetBootTarget_EcuM_BootTarget: RteEventRef=OpEventGetBootTarget_GetBootTarget_EcuM_BootTarget
    Fls (RteBswModuleInstance): RteBswImplementationRef=Fls_Impl, RteBswModuleConfigurationRef=Fls
      3 x RteBswExclusiveAreaImpl, all with RteExclusiveAreaImplMechanism=ALL_INTERRUPT_BLOCKING:
        FLS_DRIVERSTATE_DATA_PROTECTION: RteBswExclusiveAreaRef=FLS_DRIVERSTATE_DATA_PROTECTION
        FLS_REGISTER_PROTECTION: RteBswExclusiveAreaRef=FLS_REGISTER_PROTECTION
        FLS_CODE_FLASH_DISABLED: RteBswExclusiveAreaRef=FLS_CODE_FLASH_DISABLED
      Fls_MainFunctionTimingEvent0 (RteBswEventToTaskMapping): RteBswImmediateRestart=false, RteBswEventRef=Fls_MainFunctionTimingEvent0
    Dcm (RteBswModuleInstance): RteBswImplementationRef=Dcm_Impl, RteBswModuleConfigurationRef=Dcm
      Dcm_MainFunctionTimingEvent0 (RteBswEventToTaskMapping): RteBswImmediateRestart=false, RteBswEventRef=Dcm_MainFunctionTimingEvent0
      DCM_EXCLUSIVE_AREA_0 (RteBswExclusiveAreaImpl): RteExclusiveAreaImplMechanism=ALL_INTERRUPT_BLOCKING, RteBswExclusiveAreaRef=DCM_EXCLUSIVE_AREA_0
    Os_OsCore_CORE0_swc_EcuSwComposition (RteSwComponentInstance): RteSoftwareComponentInstanceRef=Os_OsCore_CORE0_swc
      4 x RteEventToTaskMapping, all with RteImmediateRestart=false:
        OpEventGetCounterValue_GetCounterValue_OsService_SystemTimer: RteEventRef=OpEventGetCounterValue_GetCounterValue_OsService_SystemTimer
        OpEventGetElapsedValue_GetElapsedValue_OsService_SystemTimer: RteEventRef=OpEventGetElapsedValue_GetElapsedValue_OsService_SystemTimer
        OpEventGetCounterValue_GetCounterValue_OsService_TpCounter_OsCore_CORE0: RteEventRef=OpEventGetCounterValue_GetCounterValue_OsService_TpCounter_OsCore_CORE0
        OpEventGetElapsedValue_GetElapsedValue_OsService_TpCounter_OsCore_CORE0: RteEventRef=OpEventGetElapsedValue_GetElapsedValue_OsService_TpCounter_OsCore_CORE0
    4 x RteBswModuleInstance:
      Mcu: RteBswImplementationRef=Mcu_Impl, RteBswModuleConfigurationRef=Mcu
        MCU_REG_DATA_PROTECTION (RteBswExclusiveAreaImpl): RteExclusiveAreaImplMechanism=ALL_INTERRUPT_BLOCKING, RteBswExclusiveAreaRef=MCU_REG_DATA_PROTECTION
        MCU_REGISTER_PROTECTION (RteBswExclusiveAreaImpl): RteExclusiveAreaImplMechanism=ALL_INTERRUPT_BLOCKING, RteBswExclusiveAreaRef=MCU_REGISTER_PROTECTION
      Port: RteBswImplementationRef=Port_Impl, RteBswModuleConfigurationRef=Port
        7 x RteBswExclusiveAreaImpl, all with RteExclusiveAreaImplMechanism=ALL_INTERRUPT_BLOCKING:
          PORT_SET_PIN_DIR_PROTECTION: RteBswExclusiveAreaRef=PORT_SET_PIN_DIR_PROTECTION
          PORT_SET_PIN_MODE_PROTECTION: RteBswExclusiveAreaRef=PORT_SET_PIN_MODE_PROTECTION
          PORT_SET_TO_DIO_ALT_PROTECTION: RteBswExclusiveAreaRef=PORT_SET_TO_DIO_ALT_PROTECTION
          PORT_INIT_CONFIG_PROTECTION: RteBswExclusiveAreaRef=PORT_INIT_CONFIG_PROTECTION
          PORT_REFRESHPORT_INTERNAL_PROTECTION: RteBswExclusiveAreaRef=PORT_REFRESHPORT_INTERNAL_PROTECTION
          PORT_SET_PIN_DEFAULT_MODE_PROTECTION: RteBswExclusiveAreaRef=PORT_SET_PIN_DEFAULT_MODE_PROTECTION
          PORT_SET_PIN_DEFAULT_DIR_PROTECTION: RteBswExclusiveAreaRef=PORT_SET_PIN_DEFAULT_DIR_PROTECTION
      Fee: RteBswImplementationRef=Fee_Impl, RteBswModuleConfigurationRef=Fee
        Fee_30_SmallSector_MainFunctionTimingEvent0 (RteBswEventToTaskMapping): RteBswImmediateRestart=false, RteBswEventRef=Fee_30_SmallSector_MainFunctionTimingEvent0
      Dem: RteBswImplementationRef=Dem_Impl, RteBswModuleConfigurationRef=Dem
        Dem_MainFunctionTimingEvent0 (RteBswEventToTaskMapping): RteBswImmediateRestart=false, RteBswEventRef=Dem_MainFunctionTimingEvent0
        3 x RteBswExclusiveAreaImpl, all with RteExclusiveAreaImplMechanism=ALL_INTERRUPT_BLOCKING:
          DEM_EXCLUSIVE_AREA_{0..2}: RteBswExclusiveAreaRef=DEM_EXCLUSIVE_AREA_{0..2}
    Dem_EcuSwComposition (RteSwComponentInstance): RteSoftwareComponentInstanceRef=Dem
      147 x RteEventToTaskMapping, all with RteImmediateRestart=false:
        Timer_Dem_MainFunction: RteEventRef=Timer_Dem_MainFunction
        OpEventClearDTC_ClearDTC_Cdd: RteEventRef=OpEventClearDTC_ClearDTC_Cdd
        OpEventPostRunRequested_GetPostRunRequested_DemServices: RteEventRef=OpEventPostRunRequested_GetPostRunRequested_DemServices
        OpEventGetDTCStatusAvailabilityMask_GetDTCStatusAvailabilityMask_DemServices: RteEventRef=OpEventGetDTCStatusAvailabilityMask_GetDTCStatusAvailabilityMask_DemServices
        OpEventGetEventMemoryOverflow_GetEventMemoryOverflow_OverflowIndPrimaryMemory: RteEventRef=OpEventGetEventMemoryOverflow_GetEventMemoryOverflow_OverflowIndPrimaryMemory
        OpEventGetNumberOfEventMemoryEntries_GetNumberOfEventMemoryEntries_OverflowIndPrimaryMemory: RteEventRef=OpEventGetNumberOfEventMemoryEntries_GetNumberOfEventMemoryEntries_OverflowIndPrimaryMemory
        OpEventGetEventStatus_GetEventStatus_GeneralEventInfo: RteEventRef=OpEventGetEventStatus_GetEventStatus_GeneralEventInfo
        OpEventGetEventStatus_GetEventStatus_EvtInfo_AutoCreatedDemEvent_FlsConfigSet_FLS_E_COMPARE_FAILED: RteEventRef=OpEventGetEventStatus_GetEventStatus_EvtInfo_AutoCreatedDemEvent_FlsConfigSet_FLS_E_COMPARE_FAILED
        OpEventGetEventStatus_GetEventStatus_EvtInfo_AutoCreatedDemEvent_FlsConfigSet_FLS_E_UNEXPECTED_FLASH_ID: RteEventRef=OpEventGetEventStatus_GetEventStatus_EvtInfo_AutoCreatedDemEvent_FlsConfigSet_FLS_E_UNEXPECTED_FLASH_ID
        OpEventGetEventStatus_GetEventStatus_EvtInfo_AutoCreatedDemEvent_FlsConfigSet_FLS_E_WRITE_FAILED: RteEventRef=OpEventGetEventStatus_GetEventStatus_EvtInfo_AutoCreatedDemEvent_FlsConfigSet_FLS_E_WRITE_FAILED
        OpEventGetEventStatus_GetEventStatus_EvtInfo_AutoCreatedDemEvent_FlsConfigSet_FLS_E_READ_FAILED: RteEventRef=OpEventGetEventStatus_GetEventStatus_EvtInfo_AutoCreatedDemEvent_FlsConfigSet_FLS_E_READ_FAILED
        OpEventGetEventStatus_GetEventStatus_EvtInfo_AutoCreatedDemEvent_FlsConfigSet_FLS_E_ERASE_FAILED: RteEventRef=OpEventGetEventStatus_GetEventStatus_EvtInfo_AutoCreatedDemEvent_FlsConfigSet_FLS_E_ERASE_FAILED
        OpEventGetEventStatus_GetEventStatus_EvtInfo_AutoCreatedDemEvent_FlsConfigSet_FLS_E_HW_FAILURE: RteEventRef=OpEventGetEventStatus_GetEventStatus_EvtInfo_AutoCreatedDemEvent_FlsConfigSet_FLS_E_HW_FAILURE
        OpEventGetEventStatus_GetEventStatus_EvtInfo_AutoCreatedDemEvent_FlsConfigSet_FLS_E_INT_INCONSISTENT: RteEventRef=OpEventGetEventStatus_GetEventStatus_EvtInfo_AutoCreatedDemEvent_FlsConfigSet_FLS_E_INT_INCONSISTENT
        OpEventGetEventStatus_GetEventStatus_EvtInfo_AutoCreatedDemEvent_FlsConfigSet_FLS_E_READ_FAILED_DED: RteEventRef=OpEventGetEventStatus_GetEventStatus_EvtInfo_AutoCreatedDemEvent_FlsConfigSet_FLS_E_READ_FAILED_DED
        OpEventGetEventStatus_GetEventStatus_EvtInfo_AutoCreatedDemEvent_FlsConfigSet_FLS_E_REG_WRITE_VERIFY: RteEventRef=OpEventGetEventStatus_GetEventStatus_EvtInfo_AutoCreatedDemEvent_FlsConfigSet_FLS_E_REG_WRITE_VERIFY
        OpEventGetEventFailed_GetEventFailed_GeneralEventInfo: RteEventRef=OpEventGetEventFailed_GetEventFailed_GeneralEventInfo
        OpEventGetEventFailed_GetEventFailed_EvtInfo_AutoCreatedDemEvent_FlsConfigSet_FLS_E_COMPARE_FAILED: RteEventRef=OpEventGetEventFailed_GetEventFailed_EvtInfo_AutoCreatedDemEvent_FlsConfigSet_FLS_E_COMPARE_FAILED
        OpEventGetEventFailed_GetEventFailed_EvtInfo_AutoCreatedDemEvent_FlsConfigSet_FLS_E_UNEXPECTED_FLASH_ID: RteEventRef=OpEventGetEventFailed_GetEventFailed_EvtInfo_AutoCreatedDemEvent_FlsConfigSet_FLS_E_UNEXPECTED_FLASH_ID
        OpEventGetEventFailed_GetEventFailed_EvtInfo_AutoCreatedDemEvent_FlsConfigSet_FLS_E_WRITE_FAILED: RteEventRef=OpEventGetEventFailed_GetEventFailed_EvtInfo_AutoCreatedDemEvent_FlsConfigSet_FLS_E_WRITE_FAILED
        OpEventGetEventFailed_GetEventFailed_EvtInfo_AutoCreatedDemEvent_FlsConfigSet_FLS_E_READ_FAILED: RteEventRef=OpEventGetEventFailed_GetEventFailed_EvtInfo_AutoCreatedDemEvent_FlsConfigSet_FLS_E_READ_FAILED
        OpEventGetEventFailed_GetEventFailed_EvtInfo_AutoCreatedDemEvent_FlsConfigSet_FLS_E_ERASE_FAILED: RteEventRef=OpEventGetEventFailed_GetEventFailed_EvtInfo_AutoCreatedDemEvent_FlsConfigSet_FLS_E_ERASE_FAILED
        OpEventGetEventFailed_GetEventFailed_EvtInfo_AutoCreatedDemEvent_FlsConfigSet_FLS_E_HW_FAILURE: RteEventRef=OpEventGetEventFailed_GetEventFailed_EvtInfo_AutoCreatedDemEvent_FlsConfigSet_FLS_E_HW_FAILURE
        OpEventGetEventFailed_GetEventFailed_EvtInfo_AutoCreatedDemEvent_FlsConfigSet_FLS_E_INT_INCONSISTENT: RteEventRef=OpEventGetEventFailed_GetEventFailed_EvtInfo_AutoCreatedDemEvent_FlsConfigSet_FLS_E_INT_INCONSISTENT
        OpEventGetEventFailed_GetEventFailed_EvtInfo_AutoCreatedDemEvent_FlsConfigSet_FLS_E_READ_FAILED_DED: RteEventRef=OpEventGetEventFailed_GetEventFailed_EvtInfo_AutoCreatedDemEvent_FlsConfigSet_FLS_E_READ_FAILED_DED
        OpEventGetEventFailed_GetEventFailed_EvtInfo_AutoCreatedDemEvent_FlsConfigSet_FLS_E_REG_WRITE_VERIFY: RteEventRef=OpEventGetEventFailed_GetEventFailed_EvtInfo_AutoCreatedDemEvent_FlsConfigSet_FLS_E_REG_WRITE_VERIFY
        OpEventGetEventTested_GetEventTested_GeneralEventInfo: RteEventRef=OpEventGetEventTested_GetEventTested_GeneralEventInfo
        OpEventGetEventTested_GetEventTested_EvtInfo_AutoCreatedDemEvent_FlsConfigSet_FLS_E_COMPARE_FAILED: RteEventRef=OpEventGetEventTested_GetEventTested_EvtInfo_AutoCreatedDemEvent_FlsConfigSet_FLS_E_COMPARE_FAILED
        OpEventGetEventTested_GetEventTested_EvtInfo_AutoCreatedDemEvent_FlsConfigSet_FLS_E_UNEXPECTED_FLASH_ID: RteEventRef=OpEventGetEventTested_GetEventTested_EvtInfo_AutoCreatedDemEvent_FlsConfigSet_FLS_E_UNEXPECTED_FLASH_ID
        OpEventGetEventTested_GetEventTested_EvtInfo_AutoCreatedDemEvent_FlsConfigSet_FLS_E_WRITE_FAILED: RteEventRef=OpEventGetEventTested_GetEventTested_EvtInfo_AutoCreatedDemEvent_FlsConfigSet_FLS_E_WRITE_FAILED
        OpEventGetEventTested_GetEventTested_EvtInfo_AutoCreatedDemEvent_FlsConfigSet_FLS_E_READ_FAILED: RteEventRef=OpEventGetEventTested_GetEventTested_EvtInfo_AutoCreatedDemEvent_FlsConfigSet_FLS_E_READ_FAILED
        OpEventGetEventTested_GetEventTested_EvtInfo_AutoCreatedDemEvent_FlsConfigSet_FLS_E_ERASE_FAILED: RteEventRef=OpEventGetEventTested_GetEventTested_EvtInfo_AutoCreatedDemEvent_FlsConfigSet_FLS_E_ERASE_FAILED
        OpEventGetEventTested_GetEventTested_EvtInfo_AutoCreatedDemEvent_FlsConfigSet_FLS_E_HW_FAILURE: RteEventRef=OpEventGetEventTested_GetEventTested_EvtInfo_AutoCreatedDemEvent_FlsConfigSet_FLS_E_HW_FAILURE
        OpEventGetEventTested_GetEventTested_EvtInfo_AutoCreatedDemEvent_FlsConfigSet_FLS_E_INT_INCONSISTENT: RteEventRef=OpEventGetEventTested_GetEventTested_EvtInfo_AutoCreatedDemEvent_FlsConfigSet_FLS_E_INT_INCONSISTENT
        OpEventGetEventTested_GetEventTested_EvtInfo_AutoCreatedDemEvent_FlsConfigSet_FLS_E_READ_FAILED_DED: RteEventRef=OpEventGetEventTested_GetEventTested_EvtInfo_AutoCreatedDemEvent_FlsConfigSet_FLS_E_READ_FAILED_DED
        OpEventGetEventTested_GetEventTested_EvtInfo_AutoCreatedDemEvent_FlsConfigSet_FLS_E_REG_WRITE_VERIFY: RteEventRef=OpEventGetEventTested_GetEventTested_EvtInfo_AutoCreatedDemEvent_FlsConfigSet_FLS_E_REG_WRITE_VERIFY
        OpEventGetDTCOfEvent_GetDTCOfEvent_GeneralEventInfo: RteEventRef=OpEventGetDTCOfEvent_GetDTCOfEvent_GeneralEventInfo
        OpEventGetDTCOfEvent_GetDTCOfEvent_EvtInfo_AutoCreatedDemEvent_FlsConfigSet_FLS_E_COMPARE_FAILED: RteEventRef=OpEventGetDTCOfEvent_GetDTCOfEvent_EvtInfo_AutoCreatedDemEvent_FlsConfigSet_FLS_E_COMPARE_FAILED
        OpEventGetDTCOfEvent_GetDTCOfEvent_EvtInfo_AutoCreatedDemEvent_FlsConfigSet_FLS_E_UNEXPECTED_FLASH_ID: RteEventRef=OpEventGetDTCOfEvent_GetDTCOfEvent_EvtInfo_AutoCreatedDemEvent_FlsConfigSet_FLS_E_UNEXPECTED_FLASH_ID
        OpEventGetDTCOfEvent_GetDTCOfEvent_EvtInfo_AutoCreatedDemEvent_FlsConfigSet_FLS_E_WRITE_FAILED: RteEventRef=OpEventGetDTCOfEvent_GetDTCOfEvent_EvtInfo_AutoCreatedDemEvent_FlsConfigSet_FLS_E_WRITE_FAILED
        OpEventGetDTCOfEvent_GetDTCOfEvent_EvtInfo_AutoCreatedDemEvent_FlsConfigSet_FLS_E_READ_FAILED: RteEventRef=OpEventGetDTCOfEvent_GetDTCOfEvent_EvtInfo_AutoCreatedDemEvent_FlsConfigSet_FLS_E_READ_FAILED
        OpEventGetDTCOfEvent_GetDTCOfEvent_EvtInfo_AutoCreatedDemEvent_FlsConfigSet_FLS_E_ERASE_FAILED: RteEventRef=OpEventGetDTCOfEvent_GetDTCOfEvent_EvtInfo_AutoCreatedDemEvent_FlsConfigSet_FLS_E_ERASE_FAILED
        OpEventGetDTCOfEvent_GetDTCOfEvent_EvtInfo_AutoCreatedDemEvent_FlsConfigSet_FLS_E_HW_FAILURE: RteEventRef=OpEventGetDTCOfEvent_GetDTCOfEvent_EvtInfo_AutoCreatedDemEvent_FlsConfigSet_FLS_E_HW_FAILURE
        OpEventGetDTCOfEvent_GetDTCOfEvent_EvtInfo_AutoCreatedDemEvent_FlsConfigSet_FLS_E_INT_INCONSISTENT: RteEventRef=OpEventGetDTCOfEvent_GetDTCOfEvent_EvtInfo_AutoCreatedDemEvent_FlsConfigSet_FLS_E_INT_INCONSISTENT
        OpEventGetDTCOfEvent_GetDTCOfEvent_EvtInfo_AutoCreatedDemEvent_FlsConfigSet_FLS_E_READ_FAILED_DED: RteEventRef=OpEventGetDTCOfEvent_GetDTCOfEvent_EvtInfo_AutoCreatedDemEvent_FlsConfigSet_FLS_E_READ_FAILED_DED
        OpEventGetDTCOfEvent_GetDTCOfEvent_EvtInfo_AutoCreatedDemEvent_FlsConfigSet_FLS_E_REG_WRITE_VERIFY: RteEventRef=OpEventGetDTCOfEvent_GetDTCOfEvent_EvtInfo_AutoCreatedDemEvent_FlsConfigSet_FLS_E_REG_WRITE_VERIFY
        OpEventGetFaultDetectionCounter_GetFaultDetectionCounter_GeneralEventInfo: RteEventRef=OpEventGetFaultDetectionCounter_GetFaultDetectionCounter_GeneralEventInfo
        OpEventGetFaultDetectionCounter_GetFaultDetectionCounter_EvtInfo_AutoCreatedDemEvent_FlsConfigSet_FLS_E_COMPARE_FAILED: RteEventRef=OpEventGetFaultDetectionCounter_GetFaultDetectionCounter_EvtInfo_AutoCreatedDemEvent_FlsConfigSet_FLS_E_COMPARE_FAILED
        OpEventGetFaultDetectionCounter_GetFaultDetectionCounter_EvtInfo_AutoCreatedDemEvent_FlsConfigSet_FLS_E_UNEXPECTED_FLASH_ID: RteEventRef=OpEventGetFaultDetectionCounter_GetFaultDetectionCounter_EvtInfo_AutoCreatedDemEvent_FlsConfigSet_FLS_E_UNEXPECTED_FLASH_ID
        OpEventGetFaultDetectionCounter_GetFaultDetectionCounter_EvtInfo_AutoCreatedDemEvent_FlsConfigSet_FLS_E_WRITE_FAILED: RteEventRef=OpEventGetFaultDetectionCounter_GetFaultDetectionCounter_EvtInfo_AutoCreatedDemEvent_FlsConfigSet_FLS_E_WRITE_FAILED
        OpEventGetFaultDetectionCounter_GetFaultDetectionCounter_EvtInfo_AutoCreatedDemEvent_FlsConfigSet_FLS_E_READ_FAILED: RteEventRef=OpEventGetFaultDetectionCounter_GetFaultDetectionCounter_EvtInfo_AutoCreatedDemEvent_FlsConfigSet_FLS_E_READ_FAILED
        OpEventGetFaultDetectionCounter_GetFaultDetectionCounter_EvtInfo_AutoCreatedDemEvent_FlsConfigSet_FLS_E_ERASE_FAILED: RteEventRef=OpEventGetFaultDetectionCounter_GetFaultDetectionCounter_EvtInfo_AutoCreatedDemEvent_FlsConfigSet_FLS_E_ERASE_FAILED
        OpEventGetFaultDetectionCounter_GetFaultDetectionCounter_EvtInfo_AutoCreatedDemEvent_FlsConfigSet_FLS_E_HW_FAILURE: RteEventRef=OpEventGetFaultDetectionCounter_GetFaultDetectionCounter_EvtInfo_AutoCreatedDemEvent_FlsConfigSet_FLS_E_HW_FAILURE
        OpEventGetFaultDetectionCounter_GetFaultDetectionCounter_EvtInfo_AutoCreatedDemEvent_FlsConfigSet_FLS_E_INT_INCONSISTENT: RteEventRef=OpEventGetFaultDetectionCounter_GetFaultDetectionCounter_EvtInfo_AutoCreatedDemEvent_FlsConfigSet_FLS_E_INT_INCONSISTENT
        OpEventGetFaultDetectionCounter_GetFaultDetectionCounter_EvtInfo_AutoCreatedDemEvent_FlsConfigSet_FLS_E_READ_FAILED_DED: RteEventRef=OpEventGetFaultDetectionCounter_GetFaultDetectionCounter_EvtInfo_AutoCreatedDemEvent_FlsConfigSet_FLS_E_READ_FAILED_DED
        OpEventGetFaultDetectionCounter_GetFaultDetectionCounter_EvtInfo_AutoCreatedDemEvent_FlsConfigSet_FLS_E_REG_WRITE_VERIFY: RteEventRef=OpEventGetFaultDetectionCounter_GetFaultDetectionCounter_EvtInfo_AutoCreatedDemEvent_FlsConfigSet_FLS_E_REG_WRITE_VERIFY
        OpEventGetEventFreezeFrameData_GetEventFreezeFrameData_GeneralEventInfo: RteEventRef=OpEventGetEventFreezeFrameData_GetEventFreezeFrameData_GeneralEventInfo
        OpEventGetEventFreezeFrameData_GetEventFreezeFrameData_EvtInfo_AutoCreatedDemEvent_FlsConfigSet_FLS_E_COMPARE_FAILED: RteEventRef=OpEventGetEventFreezeFrameData_GetEventFreezeFrameData_EvtInfo_AutoCreatedDemEvent_FlsConfigSet_FLS_E_COMPARE_FAILED
        OpEventGetEventFreezeFrameData_GetEventFreezeFrameData_EvtInfo_AutoCreatedDemEvent_FlsConfigSet_FLS_E_UNEXPECTED_FLASH_ID: RteEventRef=OpEventGetEventFreezeFrameData_GetEventFreezeFrameData_EvtInfo_AutoCreatedDemEvent_FlsConfigSet_FLS_E_UNEXPECTED_FLASH_ID
        OpEventGetEventFreezeFrameData_GetEventFreezeFrameData_EvtInfo_AutoCreatedDemEvent_FlsConfigSet_FLS_E_WRITE_FAILED: RteEventRef=OpEventGetEventFreezeFrameData_GetEventFreezeFrameData_EvtInfo_AutoCreatedDemEvent_FlsConfigSet_FLS_E_WRITE_FAILED
        OpEventGetEventFreezeFrameData_GetEventFreezeFrameData_EvtInfo_AutoCreatedDemEvent_FlsConfigSet_FLS_E_READ_FAILED: RteEventRef=OpEventGetEventFreezeFrameData_GetEventFreezeFrameData_EvtInfo_AutoCreatedDemEvent_FlsConfigSet_FLS_E_READ_FAILED
        OpEventGetEventFreezeFrameData_GetEventFreezeFrameData_EvtInfo_AutoCreatedDemEvent_FlsConfigSet_FLS_E_ERASE_FAILED: RteEventRef=OpEventGetEventFreezeFrameData_GetEventFreezeFrameData_EvtInfo_AutoCreatedDemEvent_FlsConfigSet_FLS_E_ERASE_FAILED
        OpEventGetEventFreezeFrameData_GetEventFreezeFrameData_EvtInfo_AutoCreatedDemEvent_FlsConfigSet_FLS_E_HW_FAILURE: RteEventRef=OpEventGetEventFreezeFrameData_GetEventFreezeFrameData_EvtInfo_AutoCreatedDemEvent_FlsConfigSet_FLS_E_HW_FAILURE
        OpEventGetEventFreezeFrameData_GetEventFreezeFrameData_EvtInfo_AutoCreatedDemEvent_FlsConfigSet_FLS_E_INT_INCONSISTENT: RteEventRef=OpEventGetEventFreezeFrameData_GetEventFreezeFrameData_EvtInfo_AutoCreatedDemEvent_FlsConfigSet_FLS_E_INT_INCONSISTENT
        OpEventGetEventFreezeFrameData_GetEventFreezeFrameData_EvtInfo_AutoCreatedDemEvent_FlsConfigSet_FLS_E_READ_FAILED_DED: RteEventRef=OpEventGetEventFreezeFrameData_GetEventFreezeFrameData_EvtInfo_AutoCreatedDemEvent_FlsConfigSet_FLS_E_READ_FAILED_DED
        OpEventGetEventFreezeFrameData_GetEventFreezeFrameData_EvtInfo_AutoCreatedDemEvent_FlsConfigSet_FLS_E_REG_WRITE_VERIFY: RteEventRef=OpEventGetEventFreezeFrameData_GetEventFreezeFrameData_EvtInfo_AutoCreatedDemEvent_FlsConfigSet_FLS_E_REG_WRITE_VERIFY
        OpEventGetEventExtendedDataRecord_GetEventExtendedDataRecord_GeneralEventInfo: RteEventRef=OpEventGetEventExtendedDataRecord_GetEventExtendedDataRecord_GeneralEventInfo
        OpEventGetEventExtendedDataRecord_GetEventExtendedDataRecord_EvtInfo_AutoCreatedDemEvent_FlsConfigSet_FLS_E_COMPARE_FAILED: RteEventRef=OpEventGetEventExtendedDataRecord_GetEventExtendedDataRecord_EvtInfo_AutoCreatedDemEvent_FlsConfigSet_FLS_E_COMPARE_FAILED
        OpEventGetEventExtendedDataRecord_GetEventExtendedDataRecord_EvtInfo_AutoCreatedDemEvent_FlsConfigSet_FLS_E_UNEXPECTED_FLASH_ID: RteEventRef=OpEventGetEventExtendedDataRecord_GetEventExtendedDataRecord_EvtInfo_AutoCreatedDemEvent_FlsConfigSet_FLS_E_UNEXPECTED_FLASH_ID
        OpEventGetEventExtendedDataRecord_GetEventExtendedDataRecord_EvtInfo_AutoCreatedDemEvent_FlsConfigSet_FLS_E_WRITE_FAILED: RteEventRef=OpEventGetEventExtendedDataRecord_GetEventExtendedDataRecord_EvtInfo_AutoCreatedDemEvent_FlsConfigSet_FLS_E_WRITE_FAILED
        OpEventGetEventExtendedDataRecord_GetEventExtendedDataRecord_EvtInfo_AutoCreatedDemEvent_FlsConfigSet_FLS_E_READ_FAILED: RteEventRef=OpEventGetEventExtendedDataRecord_GetEventExtendedDataRecord_EvtInfo_AutoCreatedDemEvent_FlsConfigSet_FLS_E_READ_FAILED
        OpEventGetEventExtendedDataRecord_GetEventExtendedDataRecord_EvtInfo_AutoCreatedDemEvent_FlsConfigSet_FLS_E_ERASE_FAILED: RteEventRef=OpEventGetEventExtendedDataRecord_GetEventExtendedDataRecord_EvtInfo_AutoCreatedDemEvent_FlsConfigSet_FLS_E_ERASE_FAILED
        OpEventGetEventExtendedDataRecord_GetEventExtendedDataRecord_EvtInfo_AutoCreatedDemEvent_FlsConfigSet_FLS_E_HW_FAILURE: RteEventRef=OpEventGetEventExtendedDataRecord_GetEventExtendedDataRecord_EvtInfo_AutoCreatedDemEvent_FlsConfigSet_FLS_E_HW_FAILURE
        OpEventGetEventExtendedDataRecord_GetEventExtendedDataRecord_EvtInfo_AutoCreatedDemEvent_FlsConfigSet_FLS_E_INT_INCONSISTENT: RteEventRef=OpEventGetEventExtendedDataRecord_GetEventExtendedDataRecord_EvtInfo_AutoCreatedDemEvent_FlsConfigSet_FLS_E_INT_INCONSISTENT
        OpEventGetEventExtendedDataRecord_GetEventExtendedDataRecord_EvtInfo_AutoCreatedDemEvent_FlsConfigSet_FLS_E_READ_FAILED_DED: RteEventRef=OpEventGetEventExtendedDataRecord_GetEventExtendedDataRecord_EvtInfo_AutoCreatedDemEvent_FlsConfigSet_FLS_E_READ_FAILED_DED
        OpEventGetEventExtendedDataRecord_GetEventExtendedDataRecord_EvtInfo_AutoCreatedDemEvent_FlsConfigSet_FLS_E_REG_WRITE_VERIFY: RteEventRef=OpEventGetEventExtendedDataRecord_GetEventExtendedDataRecord_EvtInfo_AutoCreatedDemEvent_FlsConfigSet_FLS_E_REG_WRITE_VERIFY
        OpEventGetEventEnableCondition_GetEventEnableCondition_GeneralEventInfo: RteEventRef=OpEventGetEventEnableCondition_GetEventEnableCondition_GeneralEventInfo
        OpEventGetEventEnableCondition_GetEventEnableCondition_EvtInfo_AutoCreatedDemEvent_FlsConfigSet_FLS_E_COMPARE_FAILED: RteEventRef=OpEventGetEventEnableCondition_GetEventEnableCondition_EvtInfo_AutoCreatedDemEvent_FlsConfigSet_FLS_E_COMPARE_FAILED
        OpEventGetEventEnableCondition_GetEventEnableCondition_EvtInfo_AutoCreatedDemEvent_FlsConfigSet_FLS_E_UNEXPECTED_FLASH_ID: RteEventRef=OpEventGetEventEnableCondition_GetEventEnableCondition_EvtInfo_AutoCreatedDemEvent_FlsConfigSet_FLS_E_UNEXPECTED_FLASH_ID
        OpEventGetEventEnableCondition_GetEventEnableCondition_EvtInfo_AutoCreatedDemEvent_FlsConfigSet_FLS_E_WRITE_FAILED: RteEventRef=OpEventGetEventEnableCondition_GetEventEnableCondition_EvtInfo_AutoCreatedDemEvent_FlsConfigSet_FLS_E_WRITE_FAILED
        OpEventGetEventEnableCondition_GetEventEnableCondition_EvtInfo_AutoCreatedDemEvent_FlsConfigSet_FLS_E_READ_FAILED: RteEventRef=OpEventGetEventEnableCondition_GetEventEnableCondition_EvtInfo_AutoCreatedDemEvent_FlsConfigSet_FLS_E_READ_FAILED
        OpEventGetEventEnableCondition_GetEventEnableCondition_EvtInfo_AutoCreatedDemEvent_FlsConfigSet_FLS_E_ERASE_FAILED: RteEventRef=OpEventGetEventEnableCondition_GetEventEnableCondition_EvtInfo_AutoCreatedDemEvent_FlsConfigSet_FLS_E_ERASE_FAILED
        OpEventGetEventEnableCondition_GetEventEnableCondition_EvtInfo_AutoCreatedDemEvent_FlsConfigSet_FLS_E_HW_FAILURE: RteEventRef=OpEventGetEventEnableCondition_GetEventEnableCondition_EvtInfo_AutoCreatedDemEvent_FlsConfigSet_FLS_E_HW_FAILURE
        OpEventGetEventEnableCondition_GetEventEnableCondition_EvtInfo_AutoCreatedDemEvent_FlsConfigSet_FLS_E_INT_INCONSISTENT: RteEventRef=OpEventGetEventEnableCondition_GetEventEnableCondition_EvtInfo_AutoCreatedDemEvent_FlsConfigSet_FLS_E_INT_INCONSISTENT
        OpEventGetEventEnableCondition_GetEventEnableCondition_EvtInfo_AutoCreatedDemEvent_FlsConfigSet_FLS_E_READ_FAILED_DED: RteEventRef=OpEventGetEventEnableCondition_GetEventEnableCondition_EvtInfo_AutoCreatedDemEvent_FlsConfigSet_FLS_E_READ_FAILED_DED
        OpEventGetEventEnableCondition_GetEventEnableCondition_EvtInfo_AutoCreatedDemEvent_FlsConfigSet_FLS_E_REG_WRITE_VERIFY: RteEventRef=OpEventGetEventEnableCondition_GetEventEnableCondition_EvtInfo_AutoCreatedDemEvent_FlsConfigSet_FLS_E_REG_WRITE_VERIFY
        OpEventGetDebouncingOfEvent_GetDebouncingOfEvent_GeneralEventInfo: RteEventRef=OpEventGetDebouncingOfEvent_GetDebouncingOfEvent_GeneralEventInfo
        OpEventGetDebouncingOfEvent_GetDebouncingOfEvent_EvtInfo_AutoCreatedDemEvent_FlsConfigSet_FLS_E_COMPARE_FAILED: RteEventRef=OpEventGetDebouncingOfEvent_GetDebouncingOfEvent_EvtInfo_AutoCreatedDemEvent_FlsConfigSet_FLS_E_COMPARE_FAILED
        OpEventGetDebouncingOfEvent_GetDebouncingOfEvent_EvtInfo_AutoCreatedDemEvent_FlsConfigSet_FLS_E_UNEXPECTED_FLASH_ID: RteEventRef=OpEventGetDebouncingOfEvent_GetDebouncingOfEvent_EvtInfo_AutoCreatedDemEvent_FlsConfigSet_FLS_E_UNEXPECTED_FLASH_ID
        OpEventGetDebouncingOfEvent_GetDebouncingOfEvent_EvtInfo_AutoCreatedDemEvent_FlsConfigSet_FLS_E_WRITE_FAILED: RteEventRef=OpEventGetDebouncingOfEvent_GetDebouncingOfEvent_EvtInfo_AutoCreatedDemEvent_FlsConfigSet_FLS_E_WRITE_FAILED
        OpEventGetDebouncingOfEvent_GetDebouncingOfEvent_EvtInfo_AutoCreatedDemEvent_FlsConfigSet_FLS_E_READ_FAILED: RteEventRef=OpEventGetDebouncingOfEvent_GetDebouncingOfEvent_EvtInfo_AutoCreatedDemEvent_FlsConfigSet_FLS_E_READ_FAILED
        OpEventGetDebouncingOfEvent_GetDebouncingOfEvent_EvtInfo_AutoCreatedDemEvent_FlsConfigSet_FLS_E_ERASE_FAILED: RteEventRef=OpEventGetDebouncingOfEvent_GetDebouncingOfEvent_EvtInfo_AutoCreatedDemEvent_FlsConfigSet_FLS_E_ERASE_FAILED
        OpEventGetDebouncingOfEvent_GetDebouncingOfEvent_EvtInfo_AutoCreatedDemEvent_FlsConfigSet_FLS_E_HW_FAILURE: RteEventRef=OpEventGetDebouncingOfEvent_GetDebouncingOfEvent_EvtInfo_AutoCreatedDemEvent_FlsConfigSet_FLS_E_HW_FAILURE
        OpEventGetDebouncingOfEvent_GetDebouncingOfEvent_EvtInfo_AutoCreatedDemEvent_FlsConfigSet_FLS_E_INT_INCONSISTENT: RteEventRef=OpEventGetDebouncingOfEvent_GetDebouncingOfEvent_EvtInfo_AutoCreatedDemEvent_FlsConfigSet_FLS_E_INT_INCONSISTENT
        OpEventGetDebouncingOfEvent_GetDebouncingOfEvent_EvtInfo_AutoCreatedDemEvent_FlsConfigSet_FLS_E_READ_FAILED_DED: RteEventRef=OpEventGetDebouncingOfEvent_GetDebouncingOfEvent_EvtInfo_AutoCreatedDemEvent_FlsConfigSet_FLS_E_READ_FAILED_DED
        OpEventGetDebouncingOfEvent_GetDebouncingOfEvent_EvtInfo_AutoCreatedDemEvent_FlsConfigSet_FLS_E_REG_WRITE_VERIFY: RteEventRef=OpEventGetDebouncingOfEvent_GetDebouncingOfEvent_EvtInfo_AutoCreatedDemEvent_FlsConfigSet_FLS_E_REG_WRITE_VERIFY
        OpEventDcmClearDTC_DcmClearDTC_Dcm: RteEventRef=OpEventDcmClearDTC_DcmClearDTC_Dcm
        OpEventDcmGetNextFilteredDTCAndFDC_DcmGetNextFilteredDTCAndFDC_Dcm: RteEventRef=OpEventDcmGetNextFilteredDTCAndFDC_DcmGetNextFilteredDTCAndFDC_Dcm
        OpEventDcmEnableDTCSetting_DcmEnableDTCSetting_Dcm: RteEventRef=OpEventDcmEnableDTCSetting_DcmEnableDTCSetting_Dcm
        OpEventDcmGetFreezeFrameDataByDTC_DcmGetFreezeFrameDataByDTC_Dcm: RteEventRef=OpEventDcmGetFreezeFrameDataByDTC_DcmGetFreezeFrameDataByDTC_Dcm
        OpEventDcmGetExtendedDataRecordByDTC_DcmGetExtendedDataRecordByDTC_Dcm: RteEventRef=OpEventDcmGetExtendedDataRecordByDTC_DcmGetExtendedDataRecordByDTC_Dcm
        OpEventSetOperationCycleState_SetOperationCycleState_OpCycle_DemOperationCycle: RteEventRef=OpEventSetOperationCycleState_SetOperationCycleState_OpCycle_DemOperationCycle
        OpEventGetDebouncingOfEvent_GetDebouncingOfEvent_EvtInfo_AutoCreatedDemEvent_McuModuleConfiguration_MCU_E_CLOCK_FAILURE: RteEventRef=OpEventGetDebouncingOfEvent_GetDebouncingOfEvent_EvtInfo_AutoCreatedDemEvent_McuModuleConfiguration_MCU_E_CLOCK_FAILURE
        OpEventGetFaultDetectionCounter_GetFaultDetectionCounter_EvtInfo_AutoCreatedDemEvent_McuModuleConfiguration_MCU_E_RESET_91721255: RteEventRef=OpEventGetFaultDetectionCounter_GetFaultDetectionCounter_EvtInfo_AutoCreatedDemEvent_McuModuleConfiguration_MCU_E_RESET_91721255
        OpEventGetFaultDetectionCounter_GetFaultDetectionCounter_EvtInfo_AutoCreatedDemEvent_FlsConfigSet_FLS_E_ECC_FAILED: RteEventRef=OpEventGetFaultDetectionCounter_GetFaultDetectionCounter_EvtInfo_AutoCreatedDemEvent_FlsConfigSet_FLS_E_ECC_FAILED
        OpEventGetEventFailed_GetEventFailed_EvtInfo_AutoCreatedDemEvent_McuModuleConfiguration_MCU_E_RESETCONTROLLER_STARTUP_FAILURE: RteEventRef=OpEventGetEventFailed_GetEventFailed_EvtInfo_AutoCreatedDemEvent_McuModuleConfiguration_MCU_E_RESETCONTROLLER_STARTUP_FAILURE
        OpEventGetDebouncingOfEvent_GetDebouncingOfEvent_EvtInfo_AutoCreatedDemEvent_FlsConfigSet_FLS_E_ECC_FAILED: RteEventRef=OpEventGetDebouncingOfEvent_GetDebouncingOfEvent_EvtInfo_AutoCreatedDemEvent_FlsConfigSet_FLS_E_ECC_FAILED
        OpEventGetEventEnableCondition_GetEventEnableCondition_EvtInfo_AutoCreatedDemEvent_PortModuleConfiguration_PORT_E_WRITE_e42b0531: RteEventRef=OpEventGetEventEnableCondition_GetEventEnableCondition_EvtInfo_AutoCreatedDemEvent_PortModuleConfiguration_PORT_E_WRITE_e42b0531
        OpEventGetEventFreezeFrameData_GetEventFreezeFrameData_EvtInfo_AutoCreatedDemEvent_McuModuleConfiguration_MCU_E_WRITE_T_c289301c: RteEventRef=OpEventGetEventFreezeFrameData_GetEventFreezeFrameData_EvtInfo_AutoCreatedDemEvent_McuModuleConfiguration_MCU_E_WRITE_T_c289301c
        OpEventGetFaultDetectionCounter_GetFaultDetectionCounter_EvtInfo_AutoCreatedDemEvent_McuModuleConfiguration_MCU_E_WRITE_10a4598a: RteEventRef=OpEventGetFaultDetectionCounter_GetFaultDetectionCounter_EvtInfo_AutoCreatedDemEvent_McuModuleConfiguration_MCU_E_WRITE_10a4598a
        OpEventGetEventStatus_GetEventStatus_EvtInfo_AutoCreatedDemEvent_McuModuleConfiguration_MCU_E_RESETCONTROLLER_STARTUP_FAILURE: RteEventRef=OpEventGetEventStatus_GetEventStatus_EvtInfo_AutoCreatedDemEvent_McuModuleConfiguration_MCU_E_RESETCONTROLLER_STARTUP_FAILURE
        OpEventGetEventFreezeFrameData_GetEventFreezeFrameData_EvtInfo_AutoCreatedDemEvent_McuModuleConfiguration_MCU_E_CLOCK_FAILURE: RteEventRef=OpEventGetEventFreezeFrameData_GetEventFreezeFrameData_EvtInfo_AutoCreatedDemEvent_McuModuleConfiguration_MCU_E_CLOCK_FAILURE
        OpEventGetDebouncingOfEvent_GetDebouncingOfEvent_EvtInfo_AutoCreatedDemEvent_McuModuleConfiguration_MCU_E_WRITE_TIMEOUT_FAILURE: RteEventRef=OpEventGetDebouncingOfEvent_GetDebouncingOfEvent_EvtInfo_AutoCreatedDemEvent_McuModuleConfiguration_MCU_E_WRITE_TIMEOUT_FAILURE
        OpEventGetEventEnableCondition_GetEventEnableCondition_EvtInfo_AutoCreatedDemEvent_McuModuleConfiguration_MCU_E_WRITE_T_a2e88142: RteEventRef=OpEventGetEventEnableCondition_GetEventEnableCondition_EvtInfo_AutoCreatedDemEvent_McuModuleConfiguration_MCU_E_WRITE_T_a2e88142
        OpEventGetEventFreezeFrameData_GetEventFreezeFrameData_EvtInfo_AutoCreatedDemEvent_PortModuleConfiguration_PORT_E_WRITE_7c759690: RteEventRef=OpEventGetEventFreezeFrameData_GetEventFreezeFrameData_EvtInfo_AutoCreatedDemEvent_PortModuleConfiguration_PORT_E_WRITE_7c759690
        OpEventGetEventFailed_GetEventFailed_EvtInfo_AutoCreatedDemEvent_McuModuleConfiguration_MCU_E_CLOCK_FAILURE: RteEventRef=OpEventGetEventFailed_GetEventFailed_EvtInfo_AutoCreatedDemEvent_McuModuleConfiguration_MCU_E_CLOCK_FAILURE
        OpEventGetDebouncingOfEvent_GetDebouncingOfEvent_EvtInfo_AutoCreatedDemEvent_McuModuleConfiguration_MCU_E_RESETCONTROLL_9837ac5d: RteEventRef=OpEventGetDebouncingOfEvent_GetDebouncingOfEvent_EvtInfo_AutoCreatedDemEvent_McuModuleConfiguration_MCU_E_RESETCONTROLL_9837ac5d
        OpEventGetEventTested_GetEventTested_EvtInfo_AutoCreatedDemEvent_McuModuleConfiguration_MCU_E_WRITE_TIMEOUT_FAILURE: RteEventRef=OpEventGetEventTested_GetEventTested_EvtInfo_AutoCreatedDemEvent_McuModuleConfiguration_MCU_E_WRITE_TIMEOUT_FAILURE
        OpEventGetEventStatus_GetEventStatus_EvtInfo_AutoCreatedDemEvent_PortModuleConfiguration_PORT_E_WRITE_TIMEOUT_FAILURE: RteEventRef=OpEventGetEventStatus_GetEventStatus_EvtInfo_AutoCreatedDemEvent_PortModuleConfiguration_PORT_E_WRITE_TIMEOUT_FAILURE
        OpEventGetEventTested_GetEventTested_EvtInfo_AutoCreatedDemEvent_McuModuleConfiguration_MCU_E_CLOCK_FAILURE: RteEventRef=OpEventGetEventTested_GetEventTested_EvtInfo_AutoCreatedDemEvent_McuModuleConfiguration_MCU_E_CLOCK_FAILURE
        OpEventGetDTCOfEvent_GetDTCOfEvent_EvtInfo_AutoCreatedDemEvent_FlsConfigSet_FLS_E_ECC_FAILED: RteEventRef=OpEventGetDTCOfEvent_GetDTCOfEvent_EvtInfo_AutoCreatedDemEvent_FlsConfigSet_FLS_E_ECC_FAILED
        OpEventGetEventExtendedDataRecord_GetEventExtendedDataRecord_EvtInfo_AutoCreatedDemEvent_FlsConfigSet_FLS_E_ECC_FAILED: RteEventRef=OpEventGetEventExtendedDataRecord_GetEventExtendedDataRecord_EvtInfo_AutoCreatedDemEvent_FlsConfigSet_FLS_E_ECC_FAILED
        OpEventGetEventFailed_GetEventFailed_EvtInfo_AutoCreatedDemEvent_McuModuleConfiguration_MCU_E_WRITE_TIMEOUT_FAILURE: RteEventRef=OpEventGetEventFailed_GetEventFailed_EvtInfo_AutoCreatedDemEvent_McuModuleConfiguration_MCU_E_WRITE_TIMEOUT_FAILURE
        OpEventGetEventTested_GetEventTested_EvtInfo_AutoCreatedDemEvent_FlsConfigSet_FLS_E_ECC_FAILED: RteEventRef=OpEventGetEventTested_GetEventTested_EvtInfo_AutoCreatedDemEvent_FlsConfigSet_FLS_E_ECC_FAILED
        OpEventGetEventTested_GetEventTested_EvtInfo_AutoCreatedDemEvent_McuModuleConfiguration_MCU_E_RESETCONTROLLER_STARTUP_FAILURE: RteEventRef=OpEventGetEventTested_GetEventTested_EvtInfo_AutoCreatedDemEvent_McuModuleConfiguration_MCU_E_RESETCONTROLLER_STARTUP_FAILURE
        OpEventGetEventExtendedDataRecord_GetEventExtendedDataRecord_EvtInfo_AutoCreatedDemEvent_McuModuleConfiguration_MCU_E_C_9cd3cb4c: RteEventRef=OpEventGetEventExtendedDataRecord_GetEventExtendedDataRecord_EvtInfo_AutoCreatedDemEvent_McuModuleConfiguration_MCU_E_C_9cd3cb4c
        OpEventGetDTCOfEvent_GetDTCOfEvent_EvtInfo_AutoCreatedDemEvent_McuModuleConfiguration_MCU_E_CLOCK_FAILURE: RteEventRef=OpEventGetDTCOfEvent_GetDTCOfEvent_EvtInfo_AutoCreatedDemEvent_McuModuleConfiguration_MCU_E_CLOCK_FAILURE
        OpEventGetEventTested_GetEventTested_EvtInfo_AutoCreatedDemEvent_PortModuleConfiguration_PORT_E_WRITE_TIMEOUT_FAILURE: RteEventRef=OpEventGetEventTested_GetEventTested_EvtInfo_AutoCreatedDemEvent_PortModuleConfiguration_PORT_E_WRITE_TIMEOUT_FAILURE
        OpEventGetEventExtendedDataRecord_GetEventExtendedDataRecord_EvtInfo_AutoCreatedDemEvent_PortModuleConfiguration_PORT_E_4f2c3204: RteEventRef=OpEventGetEventExtendedDataRecord_GetEventExtendedDataRecord_EvtInfo_AutoCreatedDemEvent_PortModuleConfiguration_PORT_E_4f2c3204
        OpEventGetDTCOfEvent_GetDTCOfEvent_EvtInfo_AutoCreatedDemEvent_PortModuleConfiguration_PORT_E_WRITE_TIMEOUT_FAILURE: RteEventRef=OpEventGetDTCOfEvent_GetDTCOfEvent_EvtInfo_AutoCreatedDemEvent_PortModuleConfiguration_PORT_E_WRITE_TIMEOUT_FAILURE
        OpEventGetEventFreezeFrameData_GetEventFreezeFrameData_EvtInfo_AutoCreatedDemEvent_FlsConfigSet_FLS_E_ECC_FAILED: RteEventRef=OpEventGetEventFreezeFrameData_GetEventFreezeFrameData_EvtInfo_AutoCreatedDemEvent_FlsConfigSet_FLS_E_ECC_FAILED
        OpEventGetFaultDetectionCounter_GetFaultDetectionCounter_EvtInfo_AutoCreatedDemEvent_PortModuleConfiguration_PORT_E_WRI_6f00b0dd: RteEventRef=OpEventGetFaultDetectionCounter_GetFaultDetectionCounter_EvtInfo_AutoCreatedDemEvent_PortModuleConfiguration_PORT_E_WRI_6f00b0dd
        OpEventGetEventStatus_GetEventStatus_EvtInfo_AutoCreatedDemEvent_FlsConfigSet_FLS_E_ECC_FAILED: RteEventRef=OpEventGetEventStatus_GetEventStatus_EvtInfo_AutoCreatedDemEvent_FlsConfigSet_FLS_E_ECC_FAILED
        OpEventGetEventFailed_GetEventFailed_EvtInfo_AutoCreatedDemEvent_PortModuleConfiguration_PORT_E_WRITE_TIMEOUT_FAILURE: RteEventRef=OpEventGetEventFailed_GetEventFailed_EvtInfo_AutoCreatedDemEvent_PortModuleConfiguration_PORT_E_WRITE_TIMEOUT_FAILURE
        OpEventGetEventExtendedDataRecord_GetEventExtendedDataRecord_EvtInfo_AutoCreatedDemEvent_McuModuleConfiguration_MCU_E_R_26066ef0: RteEventRef=OpEventGetEventExtendedDataRecord_GetEventExtendedDataRecord_EvtInfo_AutoCreatedDemEvent_McuModuleConfiguration_MCU_E_R_26066ef0
        OpEventGetEventEnableCondition_GetEventEnableCondition_EvtInfo_AutoCreatedDemEvent_FlsConfigSet_FLS_E_ECC_FAILED: RteEventRef=OpEventGetEventEnableCondition_GetEventEnableCondition_EvtInfo_AutoCreatedDemEvent_FlsConfigSet_FLS_E_ECC_FAILED
        OpEventGetDebouncingOfEvent_GetDebouncingOfEvent_EvtInfo_AutoCreatedDemEvent_PortModuleConfiguration_PORT_E_WRITE_TIMEO_977c25cc: RteEventRef=OpEventGetDebouncingOfEvent_GetDebouncingOfEvent_EvtInfo_AutoCreatedDemEvent_PortModuleConfiguration_PORT_E_WRITE_TIMEO_977c25cc
        OpEventGetEventStatus_GetEventStatus_EvtInfo_AutoCreatedDemEvent_McuModuleConfiguration_MCU_E_CLOCK_FAILURE: RteEventRef=OpEventGetEventStatus_GetEventStatus_EvtInfo_AutoCreatedDemEvent_McuModuleConfiguration_MCU_E_CLOCK_FAILURE
        OpEventGetFaultDetectionCounter_GetFaultDetectionCounter_EvtInfo_AutoCreatedDemEvent_McuModuleConfiguration_MCU_E_CLOCK_FAILURE: RteEventRef=OpEventGetFaultDetectionCounter_GetFaultDetectionCounter_EvtInfo_AutoCreatedDemEvent_McuModuleConfiguration_MCU_E_CLOCK_FAILURE
        OpEventGetEventStatus_GetEventStatus_EvtInfo_AutoCreatedDemEvent_McuModuleConfiguration_MCU_E_WRITE_TIMEOUT_FAILURE: RteEventRef=OpEventGetEventStatus_GetEventStatus_EvtInfo_AutoCreatedDemEvent_McuModuleConfiguration_MCU_E_WRITE_TIMEOUT_FAILURE
        OpEventGetDTCOfEvent_GetDTCOfEvent_EvtInfo_AutoCreatedDemEvent_McuModuleConfiguration_MCU_E_WRITE_TIMEOUT_FAILURE: RteEventRef=OpEventGetDTCOfEvent_GetDTCOfEvent_EvtInfo_AutoCreatedDemEvent_McuModuleConfiguration_MCU_E_WRITE_TIMEOUT_FAILURE
        OpEventGetEventExtendedDataRecord_GetEventExtendedDataRecord_EvtInfo_AutoCreatedDemEvent_McuModuleConfiguration_MCU_E_W_7e2746e2: RteEventRef=OpEventGetEventExtendedDataRecord_GetEventExtendedDataRecord_EvtInfo_AutoCreatedDemEvent_McuModuleConfiguration_MCU_E_W_7e2746e2
        OpEventGetEventEnableCondition_GetEventEnableCondition_EvtInfo_AutoCreatedDemEvent_McuModuleConfiguration_MCU_E_CLOCK_FAILURE: RteEventRef=OpEventGetEventEnableCondition_GetEventEnableCondition_EvtInfo_AutoCreatedDemEvent_McuModuleConfiguration_MCU_E_CLOCK_FAILURE
        OpEventGetEventFailed_GetEventFailed_EvtInfo_AutoCreatedDemEvent_FlsConfigSet_FLS_E_ECC_FAILED: RteEventRef=OpEventGetEventFailed_GetEventFailed_EvtInfo_AutoCreatedDemEvent_FlsConfigSet_FLS_E_ECC_FAILED
        OpEventGetDTCOfEvent_GetDTCOfEvent_EvtInfo_AutoCreatedDemEvent_McuModuleConfiguration_MCU_E_RESETCONTROLLER_STARTUP_FAILURE: RteEventRef=OpEventGetDTCOfEvent_GetDTCOfEvent_EvtInfo_AutoCreatedDemEvent_McuModuleConfiguration_MCU_E_RESETCONTROLLER_STARTUP_FAILURE
        OpEventGetEventEnableCondition_GetEventEnableCondition_EvtInfo_AutoCreatedDemEvent_McuModuleConfiguration_MCU_E_RESETCO_9c1d360a: RteEventRef=OpEventGetEventEnableCondition_GetEventEnableCondition_EvtInfo_AutoCreatedDemEvent_McuModuleConfiguration_MCU_E_RESETCO_9c1d360a
        OpEventGetEventFreezeFrameData_GetEventFreezeFrameData_EvtInfo_AutoCreatedDemEvent_McuModuleConfiguration_MCU_E_RESETCO_f328b8ef: RteEventRef=OpEventGetEventFreezeFrameData_GetEventFreezeFrameData_EvtInfo_AutoCreatedDemEvent_McuModuleConfiguration_MCU_E_RESETCO_f328b8ef
