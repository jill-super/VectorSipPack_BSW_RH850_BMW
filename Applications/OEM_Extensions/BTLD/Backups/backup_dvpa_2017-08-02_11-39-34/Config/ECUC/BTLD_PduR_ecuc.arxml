AUTOSAR XML (schema 4-3-0)
package /ActiveEcuC
  module config PduR: implementation-config-variant=VARIANT-PRE-COMPILE, module-description=PduR_Impl
    FrIf (PduRBswModules):
      PduRCancelReceive = false
      PduRCancelTransmit = false
      PduRChangeParameterRequestApi = false
      PduRCommunicationInterface = true
      PduRLowerModule = true
      PduRTransportProtocol = false
      PduRTriggertransmit = true
      PduRTxConfirmation = true
      PduRUpperModule = false
      PduRUseTag = false
      PduRBswModuleRef = FrIf
    PduRGeneral: PduRDevErrorDetect=true, PduRVersionInfoApi=false, PduRMetaDataSupport=false, PduRPduCallback=false, PduRSwitching=false, PduRSafeBswChecks=true
      PduRGeneration:
        PduROutOfBoundsWriteProtectionStrategy = NONE
        PduROutOfBoundsWriteSanitizer = false
        PduROutOfBoundsReadSanitizer = false
        PduRNumericalDataTypeMinimizationStrategy = WITH_CAST
        PduRReduceConstantData2Define = false
        PduRBoolDataInArrayOfStructStrategy = BITMASKING
        PduRDeduplicateIndirectedData = true
        PduRDataDeduplicationStrategy = WITH_CAST
        PduRReduceBoolDataByNegationThreshold = 2
        PduRReduceBoolDataByNumericalComparisonThreshold = 2
        PduRReduceBoolDataByNumericalRelationThreshold = 2
        PduRReduceBoolDataByNumericalOperandStrategy = WITH_ANY_VALUE
        PduRReduceNumericalDataByOffsetThreshold = 2
        PduRReduceNumericalDataByArraySubtractionThreshold = 2
        PduRReduceDataByStreaming = false
        PduRShortSymbols = false
        PduRInterfacesForDeactivatedData = false
        PduRReferringKeysInComments = false
    PduRRoutingTables: PduRConfigurationId=0
      PduRRoutingTable
        45 x PduRRoutingPath:
          Fr_pduTr_FR_DBG_EPS_A_FlexRay_7d601c47: PduRRoutingPathCommunicationType=COMMUNICATION_INTERFACE  # FR_DBG_EPS
            DST_Fr_pduTr_FR_DBG_EPS_A_FlexRay_7d601c47 (PduRDestPdu):
              PduRDestPduHandleId = 10
              PduRDestPduDirection = TRANSMIT
              PduRDestPduRoutingType = API_FORWARDING
              PduRTransmissionConfirmation = false
              PduRDestPduDataProvision = PDUR_TRIGGERTRANSMIT
              PduRDestPduRef = pduTr_FR_DBG_EPS_A_FlexRay_pduPort_EPS_A_FlexRay_OUT_7d601c47_052bff33
              PduRDestPduPduRBswModulesRef = FrIf
            SRC_Fr_pduTr_FR_DBG_EPS_A_FlexRay_7d601c47 (PduRSrcPdu): PduRSourcePduHandleId=9, PduRSrcPduDirection=TRANSMIT, PduRSrcPduRef=pduTr_FR_DBG_EPS_A_FlexRay_pduPort_EPS_A_FlexRay_OUT_7d601c47_052bff33
          Fr_pduTr_SECU_RESP_A_FlexRay_7d601c47: PduRRoutingPathCommunicationType=UNDEFINED  # SECU_RESP
            DST_Fr_pduTr_SECU_RESP_A_FlexRay_7d601c47 (PduRDestPdu):
              PduRDestPduHandleId = 18
              PduRDestPduDirection = UNDEFINED
              PduRDestPduRoutingType = UNDEFINED
              PduRTransmissionConfirmation = false
              PduRDestPduRef = pduTr_SECU_RESP_A_FlexRay_pduPort_EPS_A_FlexRay_IN_7d601c47_052bff33
            SRC_Fr_pduTr_SECU_RESP_A_FlexRay_7d601c47 (PduRSrcPdu): PduRSourcePduHandleId=17, PduRSrcPduDirection=UNDEFINED, PduRSrcPduRef=pduTr_SECU_RESP_A_FlexRay_pduPort_EPS_A_FlexRay_IN_7d601c47_052bff33
          SVC_434514f6_In: PduRRoutingPathCommunicationType=COMMUNICATION_INTERFACE
            DST_SVC_434514f6_In (PduRDestPdu):
              PduRDestPduHandleId = 1
              PduRDestPduDirection = RECEIVE
              PduRDestPduRoutingType = API_FORWARDING
              PduRTransmissionConfirmation = false
              PduRDestPduRef = SVC_434514f6_In
            SRC_SVC_434514f6_In (PduRSrcPdu): PduRSourcePduHandleId=28, PduRSrcPduDirection=RECEIVE, PduRSrcPduRef=SVC_434514f6_In, PduRSrcPduPduRBswModulesRef=FrIf
          Fr_pduTr_FAHRGESTELLNUMMER_A_FlexRay_7d601c47: PduRRoutingPathCommunicationType=COMMUNICATION_INTERFACE  # FAHRGESTELLNUMMER
            DST_Fr_pduTr_FAHRGESTELLNUMMER_A_FlexRay_7d601c47 (PduRDestPdu):
              PduRDestPduHandleId = 12
              PduRDestPduDirection = RECEIVE
              PduRDestPduRoutingType = API_FORWARDING
              PduRTransmissionConfirmation = false
              PduRDestPduRef = pduTr_FAHRGESTELLNUMMER_A_FlexRay_pduPort_EPS_A_FlexRay_IN_7d601c47_052bff33
            SRC_Fr_pduTr_FAHRGESTELLNUMMER_A_FlexRay_7d601c47 (PduRSrcPdu):
              PduRSourcePduHandleId = 11
              PduRSrcPduDirection = RECEIVE
              PduRSrcPduRef = pduTr_FAHRGESTELLNUMMER_A_FlexRay_pduPort_EPS_A_FlexRay_IN_7d601c47_052bff33
              PduRSrcPduPduRBswModulesRef = FrIf
          Fr_pduTr_AVL_RPM_WHL_A_FlexRay_7d601c47: PduRRoutingPathCommunicationType=COMMUNICATION_INTERFACE  # AVL_RPM_WHL
            SRC_Fr_pduTr_AVL_RPM_WHL_A_FlexRay_7d601c47 (PduRSrcPdu):
              PduRSourcePduHandleId = 2
              PduRSrcPduDirection = RECEIVE
              PduRSrcPduRef = pduTr_AVL_RPM_WHL_A_FlexRay_pduPort_EPS_A_FlexRay_IN_7d601c47_052bff33
              PduRSrcPduPduRBswModulesRef = FrIf
            DST_Fr_pduTr_AVL_RPM_WHL_A_FlexRay_7d601c47 (PduRDestPdu):
              PduRDestPduHandleId = 3
              PduRDestPduDirection = RECEIVE
              PduRDestPduRoutingType = API_FORWARDING
              PduRTransmissionConfirmation = false
              PduRDestPduRef = pduTr_AVL_RPM_WHL_A_FlexRay_pduPort_EPS_A_FlexRay_IN_7d601c47_052bff33
          Fr_pduTr_SECU_FAHRGESTELLNUMMER_A_FlexRay_7d601c47: PduRRoutingPathCommunicationType=COMMUNICATION_INTERFACE  # SECU_FAHRGESTELLNUMMER
            DST_Fr_pduTr_SECU_FAHRGESTELLNUMMER_A_FlexRay_7d601c47 (PduRDestPdu):
              PduRDestPduHandleId = 17
              PduRDestPduDirection = RECEIVE
              PduRDestPduRoutingType = API_FORWARDING
              PduRTransmissionConfirmation = false
              PduRDestPduRef = pduTr_SECU_FAHRGESTELLNUMMER_A_FlexRay_pduPort_EPS_A_FlexRay_IN_7d601c47_052bff33
            SRC_Fr_pduTr_SECU_FAHRGESTELLNUMMER_A_FlexRay_7d601c47 (PduRSrcPdu):
              PduRSourcePduHandleId = 16
              PduRSrcPduDirection = RECEIVE
              PduRSrcPduRef = pduTr_SECU_FAHRGESTELLNUMMER_A_FlexRay_pduPort_EPS_A_FlexRay_IN_7d601c47_052bff33
              PduRSrcPduPduRBswModulesRef = FrIf
          Fr_pduTr_ACLNY_MASSCNTR_A_FlexRay_7d601c47: PduRRoutingPathCommunicationType=COMMUNICATION_INTERFACE  # ACLNY_MASSCNTR
            DST_Fr_pduTr_ACLNY_MASSCNTR_A_FlexRay_7d601c47 (PduRDestPdu):
              PduRDestPduHandleId = 2
              PduRDestPduDirection = RECEIVE
              PduRDestPduRoutingType = API_FORWARDING
              PduRTransmissionConfirmation = false
              PduRDestPduRef = pduTr_ACLNY_MASSCNTR_A_FlexRay_pduPort_EPS_A_FlexRay_IN_7d601c47_052bff33
            SRC_Fr_pduTr_ACLNY_MASSCNTR_A_FlexRay_7d601c47 (PduRSrcPdu):
              PduRSourcePduHandleId = 1
              PduRSrcPduDirection = RECEIVE
              PduRSrcPduRef = pduTr_ACLNY_MASSCNTR_A_FlexRay_pduPort_EPS_A_FlexRay_IN_7d601c47_052bff33
              PduRSrcPduPduRBswModulesRef = FrIf
          Fr_pduTr_DT_EST_A_FlexRay_7d601c47: PduRRoutingPathCommunicationType=COMMUNICATION_INTERFACE  # DT_EST
            DST_Fr_pduTr_DT_EST_A_FlexRay_7d601c47 (PduRDestPdu):
              PduRDestPduHandleId = 8
              PduRDestPduDirection = TRANSMIT
              PduRDestPduRoutingType = API_FORWARDING
              PduRDestPduDataProvision = PDUR_TRIGGERTRANSMIT
              PduRTransmissionConfirmation = false
              PduRDestPduRef = pduTr_DT_EST_A_FlexRay_pduPort_EPS_A_FlexRay_OUT_7d601c47_052bff33
              PduRDestPduPduRBswModulesRef = FrIf
            SRC_Fr_pduTr_DT_EST_A_FlexRay_7d601c47 (PduRSrcPdu): PduRSourcePduHandleId=7, PduRSrcPduDirection=TRANSMIT, PduRSrcPduRef=pduTr_DT_EST_A_FlexRay_pduPort_EPS_A_FlexRay_OUT_7d601c47_052bff33
          Fr_pduTr_DISP_CC_EPS_A_FlexRay_7d601c47: PduRRoutingPathCommunicationType=COMMUNICATION_INTERFACE  # DISP_CC_EPS
            DST_Fr_pduTr_DISP_CC_EPS_A_FlexRay_7d601c47 (PduRDestPdu):
              PduRDestPduHandleId = 7
              PduRDestPduDirection = TRANSMIT
              PduRDestPduRoutingType = API_FORWARDING
              PduRDestPduDataProvision = PDUR_TRIGGERTRANSMIT
              PduRTransmissionConfirmation = true
              PduRDestPduRef = pduTr_DISP_CC_EPS_A_FlexRay_pduPort_EPS_A_FlexRay_OUT_7d601c47_052bff33
              PduRDestPduPduRBswModulesRef = FrIf
            SRC_Fr_pduTr_DISP_CC_EPS_A_FlexRay_7d601c47 (PduRSrcPdu): PduRSourcePduHandleId=6, PduRSrcPduDirection=TRANSMIT, PduRSrcPduRef=pduTr_DISP_CC_EPS_A_FlexRay_pduPort_EPS_A_FlexRay_OUT_7d601c47_052bff33
          Fr_pduTr_RQ_STG_EFAN_A_FlexRay_7d601c47: PduRRoutingPathCommunicationType=UNDEFINED  # RQ_STG_EFAN
            SRC_Fr_pduTr_RQ_STG_EFAN_A_FlexRay_7d601c47 (PduRSrcPdu): PduRSourcePduHandleId=10, PduRSrcPduDirection=UNDEFINED, PduRSrcPduRef=pduTr_RQ_STG_EFAN_A_FlexRay_pduPort_EPS_A_FlexRay_OUT_7d601c47_052bff33
            DST_Fr_pduTr_RQ_STG_EFAN_A_FlexRay_7d601c47 (PduRDestPdu):
              PduRDestPduHandleId = 11
              PduRDestPduDirection = UNDEFINED
              PduRDestPduRoutingType = UNDEFINED
              PduRTransmissionConfirmation = false
              PduRDestPduRef = pduTr_RQ_STG_EFAN_A_FlexRay_pduPort_EPS_A_FlexRay_OUT_7d601c47_052bff33
          Fr_pduTr_ST_DIAG_OBD_3_DRDY_A_FlexRay_7d601c47: PduRRoutingPathCommunicationType=COMMUNICATION_INTERFACE  # ST_DIAG_OBD_3_DRDY
            DST_Fr_pduTr_ST_DIAG_OBD_3_DRDY_A_FlexRay_7d601c47 (PduRDestPdu):
              PduRDestPduHandleId = 13
              PduRDestPduDirection = TRANSMIT
              PduRDestPduRoutingType = API_FORWARDING
              PduRDestPduDataProvision = PDUR_TRIGGERTRANSMIT
              PduRTransmissionConfirmation = true
              PduRDestPduRef = pduTr_ST_DIAG_OBD_3_DRDY_A_FlexRay_pduPort_EPS_A_FlexRay_OUT_7d601c47_052bff33
              PduRDestPduPduRBswModulesRef = FrIf
            SRC_Fr_pduTr_ST_DIAG_OBD_3_DRDY_A_FlexRay_7d601c47 (PduRSrcPdu):
              PduRSourcePduHandleId = 12
              PduRSrcPduDirection = TRANSMIT
              PduRSrcPduRef = pduTr_ST_DIAG_OBD_3_DRDY_A_FlexRay_pduPort_EPS_A_FlexRay_OUT_7d601c47_052bff33
          Fr_pduTr_A_TEMP_A_FlexRay_7d601c47: PduRRoutingPathCommunicationType=COMMUNICATION_INTERFACE  # A_TEMP
            DST_Fr_pduTr_A_TEMP_A_FlexRay_7d601c47 (PduRDestPdu):
              PduRDestPduHandleId = 4
              PduRDestPduDirection = RECEIVE
              PduRDestPduRoutingType = API_FORWARDING
              PduRTransmissionConfirmation = false
              PduRDestPduRef = pduTr_A_TEMP_A_FlexRay_pduPort_EPS_A_FlexRay_IN_7d601c47_052bff33
            SRC_Fr_pduTr_A_TEMP_A_FlexRay_7d601c47 (PduRSrcPdu):
              PduRSourcePduHandleId = 3
              PduRSrcPduDirection = RECEIVE
              PduRSrcPduRef = pduTr_A_TEMP_A_FlexRay_pduPort_EPS_A_FlexRay_IN_7d601c47_052bff33
              PduRSrcPduPduRBswModulesRef = FrIf
          ANFRAGE_434514f6_Out: PduRRoutingPathCommunicationType=UNDEFINED
            DST_ANFRAGE_434514f6_Out (PduRDestPdu):
              PduRDestPduHandleId = 0
              PduRDestPduDirection = UNDEFINED
              PduRDestPduRoutingType = UNDEFINED
              PduRTransmissionConfirmation = true
              PduRDestPduRef = ANFRAGE_434514f6_Out
            SRC_ANFRAGE_434514f6_Out (PduRSrcPdu): PduRSourcePduHandleId=0, PduRSrcPduDirection=UNDEFINED, PduRSrcPduRef=ANFRAGE_434514f6_Out
          Fr_pduTr_TAR_QTA_STRMOM_DV_A_FlexRay_7d601c47: PduRRoutingPathCommunicationType=COMMUNICATION_INTERFACE  # TAR_QTA_STRMOM_DV
            SRC_Fr_pduTr_TAR_QTA_STRMOM_DV_A_FlexRay_7d601c47 (PduRSrcPdu):
              PduRSourcePduHandleId = 24
              PduRSrcPduDirection = RECEIVE
              PduRSrcPduRef = pduTr_TAR_QTA_STRMOM_DV_A_FlexRay_pduPort_EPS_A_FlexRay_IN_7d601c47_052bff33
              PduRSrcPduPduRBswModulesRef = FrIf
            DST_Fr_pduTr_TAR_QTA_STRMOM_DV_A_FlexRay_7d601c47 (PduRDestPdu):
              PduRDestPduHandleId = 25
              PduRDestPduDirection = RECEIVE
              PduRDestPduRoutingType = API_FORWARDING
              PduRTransmissionConfirmation = false
              PduRDestPduRef = pduTr_TAR_QTA_STRMOM_DV_A_FlexRay_pduPort_EPS_A_FlexRay_IN_7d601c47_052bff33
          Fr_pduTr_KILOMETERSTAND_A_FlexRay_7d601c47: PduRRoutingPathCommunicationType=COMMUNICATION_INTERFACE  # KILOMETERSTAND
            DST_Fr_pduTr_KILOMETERSTAND_A_FlexRay_7d601c47 (PduRDestPdu):
              PduRDestPduHandleId = 14
              PduRDestPduDirection = RECEIVE
              PduRDestPduRoutingType = API_FORWARDING
              PduRTransmissionConfirmation = false
              PduRDestPduRef = pduTr_KILOMETERSTAND_A_FlexRay_pduPort_EPS_A_FlexRay_IN_7d601c47_052bff33
            SRC_Fr_pduTr_KILOMETERSTAND_A_FlexRay_7d601c47 (PduRSrcPdu):
              PduRSourcePduHandleId = 13
              PduRSrcPduDirection = RECEIVE
              PduRSrcPduRef = pduTr_KILOMETERSTAND_A_FlexRay_pduPort_EPS_A_FlexRay_IN_7d601c47_052bff33
              PduRSrcPduPduRBswModulesRef = FrIf
          Fr_pduTr_VYAW_VEH_A_FlexRay_7d601c47: PduRRoutingPathCommunicationType=COMMUNICATION_INTERFACE  # VYAW_VEH
            DST_Fr_pduTr_VYAW_VEH_A_FlexRay_7d601c47 (PduRDestPdu):
              PduRDestPduHandleId = 27
              PduRDestPduDirection = RECEIVE
              PduRDestPduRoutingType = API_FORWARDING
              PduRTransmissionConfirmation = false
              PduRDestPduRef = pduTr_VYAW_VEH_A_FlexRay_pduPort_EPS_A_FlexRay_IN_7d601c47_052bff33
            SRC_Fr_pduTr_VYAW_VEH_A_FlexRay_7d601c47 (PduRSrcPdu):
              PduRSourcePduHandleId = 26
              PduRSrcPduDirection = RECEIVE
              PduRSrcPduRef = pduTr_VYAW_VEH_A_FlexRay_pduPort_EPS_A_FlexRay_IN_7d601c47_052bff33
              PduRSrcPduPduRBswModulesRef = FrIf
          Fr_pduTr_ST_STAB_DSC_A_FlexRay_7d601c47: PduRRoutingPathCommunicationType=COMMUNICATION_INTERFACE  # ST_STAB_DSC
            DST_Fr_pduTr_ST_STAB_DSC_A_FlexRay_7d601c47 (PduRDestPdu):
              PduRDestPduHandleId = 22
              PduRDestPduDirection = RECEIVE
              PduRDestPduRoutingType = API_FORWARDING
              PduRTransmissionConfirmation = false
              PduRDestPduRef = pduTr_ST_STAB_DSC_A_FlexRay_pduPort_EPS_A_FlexRay_IN_7d601c47_052bff33
            SRC_Fr_pduTr_ST_STAB_DSC_A_FlexRay_7d601c47 (PduRSrcPdu):
              PduRSourcePduHandleId = 21
              PduRSrcPduDirection = RECEIVE
              PduRSrcPduRef = pduTr_ST_STAB_DSC_A_FlexRay_pduPort_EPS_A_FlexRay_IN_7d601c47_052bff33
              PduRSrcPduPduRBswModulesRef = FrIf
          Fr_pduTr_DIAG_OBD_ENG_A_FlexRay_7d601c47: PduRRoutingPathCommunicationType=COMMUNICATION_INTERFACE  # DIAG_OBD_ENG
            DST_Fr_pduTr_DIAG_OBD_ENG_A_FlexRay_7d601c47 (PduRDestPdu):
              PduRDestPduHandleId = 8
              PduRDestPduDirection = RECEIVE
              PduRDestPduRoutingType = API_FORWARDING
              PduRTransmissionConfirmation = false
              PduRDestPduRef = pduTr_DIAG_OBD_ENG_A_FlexRay_pduPort_EPS_A_FlexRay_IN_7d601c47_052bff33
            SRC_Fr_pduTr_DIAG_OBD_ENG_A_FlexRay_7d601c47 (PduRSrcPdu):
              PduRSourcePduHandleId = 7
              PduRSrcPduDirection = RECEIVE
              PduRSrcPduRef = pduTr_DIAG_OBD_ENG_A_FlexRay_pduPort_EPS_A_FlexRay_IN_7d601c47_052bff33
              PduRSrcPduPduRBswModulesRef = FrIf
          Fr_pduTr_TAR_STMOM_DV_ACT_A_FlexRay_7d601c47: PduRRoutingPathCommunicationType=COMMUNICATION_INTERFACE  # TAR_STMOM_DV_ACT
            SRC_Fr_pduTr_TAR_STMOM_DV_ACT_A_FlexRay_7d601c47 (PduRSrcPdu):
              PduRSourcePduHandleId = 25
              PduRSrcPduDirection = RECEIVE
              PduRSrcPduRef = pduTr_TAR_STMOM_DV_ACT_A_FlexRay_pduPort_EPS_A_FlexRay_IN_7d601c47_052bff33
              PduRSrcPduPduRBswModulesRef = FrIf
            DST_Fr_pduTr_TAR_STMOM_DV_ACT_A_FlexRay_7d601c47 (PduRDestPdu):
              PduRDestPduHandleId = 26
              PduRDestPduDirection = RECEIVE
              PduRDestPduRoutingType = API_FORWARDING
              PduRTransmissionConfirmation = false
              PduRDestPduRef = pduTr_TAR_STMOM_DV_ACT_A_FlexRay_pduPort_EPS_A_FlexRay_IN_7d601c47_052bff33
          Fr_pduTr_ENGTORQ_EPS_A_FlexRay_7d601c47: PduRRoutingPathCommunicationType=COMMUNICATION_INTERFACE  # ENGTORQ_EPS
            SRC_Fr_pduTr_ENGTORQ_EPS_A_FlexRay_7d601c47 (PduRSrcPdu): PduRSourcePduHandleId=8, PduRSrcPduDirection=TRANSMIT, PduRSrcPduRef=pduTr_ENGTORQ_EPS_A_FlexRay_pduPort_EPS_A_FlexRay_OUT_7d601c47_052bff33
            DST_Fr_pduTr_ENGTORQ_EPS_A_FlexRay_7d601c47 (PduRDestPdu):
              PduRDestPduHandleId = 9
              PduRDestPduDirection = TRANSMIT
              PduRDestPduRoutingType = API_FORWARDING
              PduRDestPduDataProvision = PDUR_TRIGGERTRANSMIT
              PduRTransmissionConfirmation = false
              PduRDestPduRef = pduTr_ENGTORQ_EPS_A_FlexRay_pduPort_EPS_A_FlexRay_OUT_7d601c47_052bff33
              PduRDestPduPduRBswModulesRef = FrIf
          Fr_pduTr_ST_ENERG_GEN_A_FlexRay_7d601c47: PduRRoutingPathCommunicationType=COMMUNICATION_INTERFACE  # ST_ENERG_GEN
            DST_Fr_pduTr_ST_ENERG_GEN_A_FlexRay_7d601c47 (PduRDestPdu):
              PduRDestPduHandleId = 21
              PduRDestPduDirection = RECEIVE
              PduRDestPduRoutingType = API_FORWARDING
              PduRTransmissionConfirmation = false
              PduRDestPduRef = pduTr_ST_ENERG_GEN_A_FlexRay_pduPort_EPS_A_FlexRay_IN_7d601c47_052bff33
            SRC_Fr_pduTr_ST_ENERG_GEN_A_FlexRay_7d601c47 (PduRSrcPdu):
              PduRSourcePduHandleId = 20
              PduRSrcPduDirection = RECEIVE
              PduRSrcPduRef = pduTr_ST_ENERG_GEN_A_FlexRay_pduPort_EPS_A_FlexRay_IN_7d601c47_052bff33
              PduRSrcPduPduRBswModulesRef = FrIf
          Fr_pduTr_AVL_PO_EPS_A_FlexRay_7d601c47: PduRRoutingPathCommunicationType=COMMUNICATION_INTERFACE  # AVL_PO_EPS
            DST_Fr_pduTr_AVL_PO_EPS_A_FlexRay_7d601c47 (PduRDestPdu):
              PduRDestPduHandleId = 3
              PduRDestPduDirection = TRANSMIT
              PduRDestPduRoutingType = API_FORWARDING
              PduRDestPduDataProvision = PDUR_TRIGGERTRANSMIT
              PduRTransmissionConfirmation = false
              PduRDestPduRef = pduTr_AVL_PO_EPS_A_FlexRay_pduPort_EPS_A_FlexRay_OUT_7d601c47_052bff33
              PduRDestPduPduRBswModulesRef = FrIf
            SRC_Fr_pduTr_AVL_PO_EPS_A_FlexRay_7d601c47 (PduRSrcPdu): PduRSourcePduHandleId=2, PduRSrcPduDirection=TRANSMIT, PduRSrcPduRef=pduTr_AVL_PO_EPS_A_FlexRay_pduPort_EPS_A_FlexRay_OUT_7d601c47_052bff33
          Fr_pduTr_AVL_STMOM_DV_ACT_A_FlexRay_7d601c47: PduRRoutingPathCommunicationType=COMMUNICATION_INTERFACE  # AVL_STMOM_DV_ACT
            SRC_Fr_pduTr_AVL_STMOM_DV_ACT_A_FlexRay_7d601c47 (PduRSrcPdu):
              PduRSourcePduHandleId = 3
              PduRSrcPduDirection = TRANSMIT
              PduRSrcPduRef = pduTr_AVL_STMOM_DV_ACT_A_FlexRay_pduPort_EPS_A_FlexRay_OUT_7d601c47_052bff33
            DST_Fr_pduTr_AVL_STMOM_DV_ACT_A_FlexRay_7d601c47 (PduRDestPdu):
              PduRDestPduHandleId = 4
              PduRDestPduDirection = TRANSMIT
              PduRDestPduRoutingType = API_FORWARDING
              PduRDestPduDataProvision = PDUR_TRIGGERTRANSMIT
              PduRTransmissionConfirmation = false
              PduRDestPduRef = pduTr_AVL_STMOM_DV_ACT_A_FlexRay_pduPort_EPS_A_FlexRay_OUT_7d601c47_052bff33
              PduRDestPduPduRBswModulesRef = FrIf
          Fr_pduTr_SU_CLE_DRDY_DXP_A_FlexRay_7d601c47: PduRRoutingPathCommunicationType=COMMUNICATION_INTERFACE  # SU_CLE_DRDY_DXP
            DST_Fr_pduTr_SU_CLE_DRDY_DXP_A_FlexRay_7d601c47 (PduRDestPdu):
              PduRDestPduHandleId = 23
              PduRDestPduDirection = RECEIVE
              PduRDestPduRoutingType = API_FORWARDING
              PduRTransmissionConfirmation = false
              PduRDestPduRef = pduTr_SU_CLE_DRDY_DXP_A_FlexRay_pduPort_EPS_A_FlexRay_IN_7d601c47_052bff33
            SRC_Fr_pduTr_SU_CLE_DRDY_DXP_A_FlexRay_7d601c47 (PduRSrcPdu):
              PduRSourcePduHandleId = 22
              PduRSrcPduDirection = RECEIVE
              PduRSrcPduRef = pduTr_SU_CLE_DRDY_DXP_A_FlexRay_pduPort_EPS_A_FlexRay_IN_7d601c47_052bff33
              PduRSrcPduPduRBswModulesRef = FrIf
          Fr_pduTr_ENSU_SFY_A_FlexRay_7d601c47: PduRRoutingPathCommunicationType=COMMUNICATION_INTERFACE  # ENSU_SFY
            DST_Fr_pduTr_ENSU_SFY_A_FlexRay_7d601c47 (PduRDestPdu):
              PduRDestPduHandleId = 10
              PduRDestPduDirection = RECEIVE
              PduRDestPduRoutingType = API_FORWARDING
              PduRTransmissionConfirmation = false
              PduRDestPduRef = pduTr_ENSU_SFY_A_FlexRay_pduPort_EPS_A_FlexRay_IN_7d601c47_052bff33
            SRC_Fr_pduTr_ENSU_SFY_A_FlexRay_7d601c47 (PduRSrcPdu):
              PduRSourcePduHandleId = 9
              PduRSrcPduDirection = RECEIVE
              PduRSrcPduRef = pduTr_ENSU_SFY_A_FlexRay_pduPort_EPS_A_FlexRay_IN_7d601c47_052bff33
              PduRSrcPduPduRBswModulesRef = FrIf
          Fr_pduTr_SECU_CHAL_A_FlexRay_7d601c47: PduRRoutingPathCommunicationType=UNDEFINED  # SECU_CHAL
            DST_Fr_pduTr_SECU_CHAL_A_FlexRay_7d601c47 (PduRDestPdu):
              PduRDestPduHandleId = 12
              PduRDestPduDirection = UNDEFINED
              PduRDestPduRoutingType = UNDEFINED
              PduRTransmissionConfirmation = true
              PduRDestPduRef = pduTr_SECU_CHAL_A_FlexRay_pduPort_EPS_A_FlexRay_OUT_7d601c47_052bff33
            SRC_Fr_pduTr_SECU_CHAL_A_FlexRay_7d601c47 (PduRSrcPdu): PduRSourcePduHandleId=11, PduRSrcPduDirection=UNDEFINED, PduRSrcPduRef=pduTr_SECU_CHAL_A_FlexRay_pduPort_EPS_A_FlexRay_OUT_7d601c47_052bff33
          Fr_pduTr_ST_CENG_A_FlexRay_7d601c47: PduRRoutingPathCommunicationType=COMMUNICATION_INTERFACE  # ST_CENG
            DST_Fr_pduTr_ST_CENG_A_FlexRay_7d601c47 (PduRDestPdu):
              PduRDestPduHandleId = 20
              PduRDestPduDirection = RECEIVE
              PduRDestPduRoutingType = API_FORWARDING
              PduRTransmissionConfirmation = false
              PduRDestPduRef = pduTr_ST_CENG_A_FlexRay_pduPort_EPS_A_FlexRay_IN_7d601c47_052bff33
            SRC_Fr_pduTr_ST_CENG_A_FlexRay_7d601c47 (PduRSrcPdu):
              PduRSourcePduHandleId = 19
              PduRSrcPduDirection = RECEIVE
              PduRSrcPduRef = pduTr_ST_CENG_A_FlexRay_pduPort_EPS_A_FlexRay_IN_7d601c47_052bff33
              PduRSrcPduPduRBswModulesRef = FrIf
          Fr_pduTr_OFFS_QUAD_EPS_A_FlexRay_7d601c47: PduRRoutingPathCommunicationType=COMMUNICATION_INTERFACE  # OFFS_QUAD_EPS
            SRC_Fr_pduTr_OFFS_QUAD_EPS_A_FlexRay_7d601c47 (PduRSrcPdu):
              PduRSourcePduHandleId = 14
              PduRSrcPduDirection = RECEIVE
              PduRSrcPduRef = pduTr_OFFS_QUAD_EPS_A_FlexRay_pduPort_EPS_A_FlexRay_IN_7d601c47_052bff33
              PduRSrcPduPduRBswModulesRef = FrIf
            DST_Fr_pduTr_OFFS_QUAD_EPS_A_FlexRay_7d601c47 (PduRDestPdu):
              PduRDestPduHandleId = 15
              PduRDestPduDirection = RECEIVE
              PduRDestPduRoutingType = API_FORWARDING
              PduRTransmissionConfirmation = false
              PduRDestPduRef = pduTr_OFFS_QUAD_EPS_A_FlexRay_pduPort_EPS_A_FlexRay_IN_7d601c47_052bff33
          Fr_pduTr_ST_EST_A_FlexRay_7d601c47: PduRRoutingPathCommunicationType=COMMUNICATION_INTERFACE  # ST_EST
            SRC_Fr_pduTr_ST_EST_A_FlexRay_7d601c47 (PduRSrcPdu): PduRSourcePduHandleId=13, PduRSrcPduDirection=TRANSMIT, PduRSrcPduRef=pduTr_ST_EST_A_FlexRay_pduPort_EPS_A_FlexRay_OUT_7d601c47_052bff33
            DST_Fr_pduTr_ST_EST_A_FlexRay_7d601c47 (PduRDestPdu):
              PduRDestPduHandleId = 14
              PduRDestPduDirection = TRANSMIT
              PduRDestPduRoutingType = API_FORWARDING
              PduRDestPduDataProvision = PDUR_TRIGGERTRANSMIT
              PduRTransmissionConfirmation = true
              PduRDestPduRef = pduTr_ST_EST_A_FlexRay_pduPort_EPS_A_FlexRay_OUT_7d601c47_052bff33
              PduRDestPduPduRBswModulesRef = FrIf
          Fr_pduTr_V_VEH_A_FlexRay_7d601c47: PduRRoutingPathCommunicationType=COMMUNICATION_INTERFACE  # V_VEH
            SRC_Fr_pduTr_V_VEH_A_FlexRay_7d601c47 (PduRSrcPdu):
              PduRSourcePduHandleId = 27
              PduRSrcPduDirection = RECEIVE
              PduRSrcPduRef = pduTr_V_VEH_A_FlexRay_pduPort_EPS_A_FlexRay_IN_7d601c47_052bff33
              PduRSrcPduPduRBswModulesRef = FrIf
            DST_Fr_pduTr_V_VEH_A_FlexRay_7d601c47 (PduRDestPdu):
              PduRDestPduHandleId = 28
              PduRDestPduDirection = RECEIVE
              PduRDestPduRoutingType = API_FORWARDING
              PduRTransmissionConfirmation = false
              PduRDestPduRef = pduTr_V_VEH_A_FlexRay_pduPort_EPS_A_FlexRay_IN_7d601c47_052bff33
          Fr_pduTr_AVL_FORC_GRD_A_FlexRay_7d601c47: PduRRoutingPathCommunicationType=COMMUNICATION_INTERFACE  # AVL_FORC_GRD
            SRC_Fr_pduTr_AVL_FORC_GRD_A_FlexRay_7d601c47 (PduRSrcPdu): PduRSourcePduHandleId=1, PduRSrcPduDirection=TRANSMIT, PduRSrcPduRef=pduTr_AVL_FORC_GRD_A_FlexRay_pduPort_EPS_A_FlexRay_OUT_7d601c47_052bff33
            DST_Fr_pduTr_AVL_FORC_GRD_A_FlexRay_7d601c47 (PduRDestPdu):
              PduRDestPduHandleId = 2
              PduRDestPduDirection = TRANSMIT
              PduRDestPduRoutingType = API_FORWARDING
              PduRDestPduDataProvision = PDUR_TRIGGERTRANSMIT
              PduRTransmissionConfirmation = false
              PduRDestPduRef = pduTr_AVL_FORC_GRD_A_FlexRay_pduPort_EPS_A_FlexRay_OUT_7d601c47_052bff33
              PduRDestPduPduRBswModulesRef = FrIf
          Fr_pduTr_DBG_EPS_BS_MOD_58_BYTE_A_FlexRay_7d601c47: PduRRoutingPathCommunicationType=UNDEFINED  # DBG_EPS_BS_MOD_58_BYTE
            DST_Fr_pduTr_DBG_EPS_BS_MOD_58_BYTE_A_FlexRay_7d601c47 (PduRDestPdu):
              PduRDestPduHandleId = 5
              PduRDestPduDirection = UNDEFINED
              PduRDestPduRoutingType = UNDEFINED
              PduRTransmissionConfirmation = false
              PduRDestPduRef = pduTr_DBG_EPS_BS_MOD_58_BYTE_A_FlexRay_pduPort_EPS_A_FlexRay_OUT_7d601c47_052bff33
            SRC_Fr_pduTr_DBG_EPS_BS_MOD_58_BYTE_A_FlexRay_7d601c47 (PduRSrcPdu):
              PduRSourcePduHandleId = 4
              PduRSrcPduDirection = UNDEFINED
              PduRSrcPduRef = pduTr_DBG_EPS_BS_MOD_58_BYTE_A_FlexRay_pduPort_EPS_A_FlexRay_OUT_7d601c47_052bff33
          Fr_pduTr_CTR_DIAG_OBD_DRDY_A_FlexRay_7d601c47: PduRRoutingPathCommunicationType=COMMUNICATION_INTERFACE  # CTR_DIAG_OBD_DRDY
            DST_Fr_pduTr_CTR_DIAG_OBD_DRDY_A_FlexRay_7d601c47 (PduRDestPdu):
              PduRDestPduHandleId = 6
              PduRDestPduDirection = RECEIVE
              PduRDestPduRoutingType = API_FORWARDING
              PduRTransmissionConfirmation = false
              PduRDestPduRef = pduTr_CTR_DIAG_OBD_DRDY_A_FlexRay_pduPort_EPS_A_FlexRay_IN_7d601c47_052bff33
            SRC_Fr_pduTr_CTR_DIAG_OBD_DRDY_A_FlexRay_7d601c47 (PduRSrcPdu):
              PduRSourcePduHandleId = 5
              PduRSrcPduDirection = RECEIVE
              PduRSrcPduRef = pduTr_CTR_DIAG_OBD_DRDY_A_FlexRay_pduPort_EPS_A_FlexRay_IN_7d601c47_052bff33
              PduRSrcPduPduRBswModulesRef = FrIf
          Fr_pduTr_SU_EPS_A_FlexRay_7d601c47: PduRRoutingPathCommunicationType=COMMUNICATION_INTERFACE  # SU_EPS
            SRC_Fr_pduTr_SU_EPS_A_FlexRay_7d601c47 (PduRSrcPdu): PduRSourcePduHandleId=14, PduRSrcPduDirection=TRANSMIT, PduRSrcPduRef=pduTr_SU_EPS_A_FlexRay_pduPort_EPS_A_FlexRay_OUT_7d601c47_052bff33
            DST_Fr_pduTr_SU_EPS_A_FlexRay_7d601c47 (PduRDestPdu):
              PduRDestPduHandleId = 15
              PduRDestPduDirection = TRANSMIT
              PduRDestPduRoutingType = API_FORWARDING
              PduRDestPduDataProvision = PDUR_TRIGGERTRANSMIT
              PduRTransmissionConfirmation = true
              PduRDestPduRef = pduTr_SU_EPS_A_FlexRay_pduPort_EPS_A_FlexRay_OUT_7d601c47_052bff33
              PduRDestPduPduRBswModulesRef = FrIf
          Fr_pduTr_RELATIVZEIT_A_FlexRay_7d601c47: PduRRoutingPathCommunicationType=COMMUNICATION_INTERFACE  # RELATIVZEIT
            SRC_Fr_pduTr_RELATIVZEIT_A_FlexRay_7d601c47 (PduRSrcPdu):
              PduRSourcePduHandleId = 15
              PduRSrcPduDirection = RECEIVE
              PduRSrcPduRef = pduTr_RELATIVZEIT_A_FlexRay_pduPort_EPS_A_FlexRay_IN_7d601c47_052bff33
              PduRSrcPduPduRBswModulesRef = FrIf
            DST_Fr_pduTr_RELATIVZEIT_A_FlexRay_7d601c47 (PduRDestPdu):
              PduRDestPduHandleId = 16
              PduRDestPduDirection = RECEIVE
              PduRDestPduRoutingType = API_FORWARDING
              PduRTransmissionConfirmation = false
              PduRDestPduRef = pduTr_RELATIVZEIT_A_FlexRay_pduPort_EPS_A_FlexRay_IN_7d601c47_052bff33
          Fr_pduTr_DBG_EPS_MOD_EXT_120_BYTE_A_FlexRay_7d601c47: PduRRoutingPathCommunicationType=UNDEFINED  # DBG_EPS_MOD_EXT_120_BYTE
            SRC_Fr_pduTr_DBG_EPS_MOD_EXT_120_BYTE_A_FlexRay_7d601c47 (PduRSrcPdu):
              PduRSourcePduHandleId = 5
              PduRSrcPduDirection = UNDEFINED
              PduRSrcPduRef = pduTr_DBG_EPS_MOD_EXT_120_BYTE_A_FlexRay_pduPort_EPS_A_FlexRay_OUT_7d601c47_052bff33
            DST_Fr_pduTr_DBG_EPS_MOD_EXT_120_BYTE_A_FlexRay_7d601c47 (PduRDestPdu):
              PduRDestPduHandleId = 6
              PduRDestPduDirection = UNDEFINED
              PduRDestPduRoutingType = UNDEFINED
              PduRTransmissionConfirmation = false
              PduRDestPduRef = pduTr_DBG_EPS_MOD_EXT_120_BYTE_A_FlexRay_pduPort_EPS_A_FlexRay_OUT_7d601c47_052bff33
          Fr_pduTr_FZZSTD_A_FlexRay_7d601c47: PduRRoutingPathCommunicationType=COMMUNICATION_INTERFACE  # FZZSTD
            SRC_Fr_pduTr_FZZSTD_A_FlexRay_7d601c47 (PduRSrcPdu):
              PduRSourcePduHandleId = 12
              PduRSrcPduDirection = RECEIVE
              PduRSrcPduRef = pduTr_FZZSTD_A_FlexRay_pduPort_EPS_A_FlexRay_IN_7d601c47_052bff33
              PduRSrcPduPduRBswModulesRef = FrIf
            DST_Fr_pduTr_FZZSTD_A_FlexRay_7d601c47 (PduRDestPdu):
              PduRDestPduHandleId = 13
              PduRDestPduDirection = RECEIVE
              PduRDestPduRoutingType = API_FORWARDING
              PduRTransmissionConfirmation = false
              PduRDestPduRef = pduTr_FZZSTD_A_FlexRay_pduPort_EPS_A_FlexRay_IN_7d601c47_052bff33
          Fr_pduTr_ENERG_DGR_DRDY_A_FlexRay_7d601c47: PduRRoutingPathCommunicationType=COMMUNICATION_INTERFACE  # ENERG_DGR_DRDY
            SRC_Fr_pduTr_ENERG_DGR_DRDY_A_FlexRay_7d601c47 (PduRSrcPdu):
              PduRSourcePduHandleId = 8
              PduRSrcPduDirection = RECEIVE
              PduRSrcPduRef = pduTr_ENERG_DGR_DRDY_A_FlexRay_pduPort_EPS_A_FlexRay_IN_7d601c47_052bff33
              PduRSrcPduPduRBswModulesRef = FrIf
            DST_Fr_pduTr_ENERG_DGR_DRDY_A_FlexRay_7d601c47 (PduRDestPdu):
              PduRDestPduHandleId = 9
              PduRDestPduDirection = RECEIVE
              PduRDestPduRoutingType = API_FORWARDING
              PduRTransmissionConfirmation = false
              PduRDestPduRef = pduTr_ENERG_DGR_DRDY_A_FlexRay_pduPort_EPS_A_FlexRay_IN_7d601c47_052bff33
          Fr_pduTr_STEA_OFFS_A_FlexRay_7d601c47: PduRRoutingPathCommunicationType=COMMUNICATION_INTERFACE  # STEA_OFFS
            SRC_Fr_pduTr_STEA_OFFS_A_FlexRay_7d601c47 (PduRSrcPdu):
              PduRSourcePduHandleId = 18
              PduRSrcPduDirection = RECEIVE
              PduRSrcPduRef = pduTr_STEA_OFFS_A_FlexRay_pduPort_EPS_A_FlexRay_IN_7d601c47_052bff33
              PduRSrcPduPduRBswModulesRef = FrIf
            DST_Fr_pduTr_STEA_OFFS_A_FlexRay_7d601c47 (PduRDestPdu):
              PduRDestPduHandleId = 19
              PduRDestPduDirection = RECEIVE
              PduRDestPduRoutingType = API_FORWARDING
              PduRTransmissionConfirmation = false
              PduRDestPduRef = pduTr_STEA_OFFS_A_FlexRay_pduPort_EPS_A_FlexRay_IN_7d601c47_052bff33
          Fr_pduTr_TAR_ESTP_VIRT_FTAX_A_FlexRay_7d601c47: PduRRoutingPathCommunicationType=COMMUNICATION_INTERFACE  # TAR_ESTP_VIRT_FTAX
            DST_Fr_pduTr_TAR_ESTP_VIRT_FTAX_A_FlexRay_7d601c47 (PduRDestPdu):
              PduRDestPduHandleId = 24
              PduRDestPduDirection = RECEIVE
              PduRDestPduRoutingType = API_FORWARDING
              PduRTransmissionConfirmation = false
              PduRDestPduRef = pduTr_TAR_ESTP_VIRT_FTAX_A_FlexRay_pduPort_EPS_A_FlexRay_IN_7d601c47_052bff33
            SRC_Fr_pduTr_TAR_ESTP_VIRT_FTAX_A_FlexRay_7d601c47 (PduRSrcPdu):
              PduRSourcePduHandleId = 23
              PduRSrcPduDirection = RECEIVE
              PduRSrcPduRef = pduTr_TAR_ESTP_VIRT_FTAX_A_FlexRay_pduPort_EPS_A_FlexRay_IN_7d601c47_052bff33
              PduRSrcPduPduRBswModulesRef = FrIf
          Fr_pduTr_CTR_VIB_STW_DISP_EXMI_SP2015_A_FlexRay_7d601c47: PduRRoutingPathCommunicationType=COMMUNICATION_INTERFACE  # CTR_VIB_STW_DISP_EXMI_SP2015
            DST_Fr_pduTr_CTR_VIB_STW_DISP_EXMI_SP2015_A_FlexRay_7d601c47 (PduRDestPdu):
              PduRDestPduHandleId = 7
              PduRDestPduDirection = RECEIVE
              PduRDestPduRoutingType = API_FORWARDING
              PduRTransmissionConfirmation = false
              PduRDestPduRef = pduTr_CTR_VIB_STW_DISP_EXMI_SP2015_A_FlexRay_pduPort_EPS_A_FlexRay_IN_7d601c47_052bff33
            SRC_Fr_pduTr_CTR_VIB_STW_DISP_EXMI_SP2015_A_FlexRay_7d601c47 (PduRSrcPdu):
              PduRSourcePduHandleId = 6
              PduRSrcPduDirection = RECEIVE
              PduRSrcPduRef = pduTr_CTR_VIB_STW_DISP_EXMI_SP2015_A_FlexRay_pduPort_EPS_A_FlexRay_IN_7d601c47_052bff33
              PduRSrcPduPduRBswModulesRef = FrIf
          Fr_pduTr_CON_VEH_A_FlexRay_7d601c47: PduRRoutingPathCommunicationType=COMMUNICATION_INTERFACE  # CON_VEH
            SRC_Fr_pduTr_CON_VEH_A_FlexRay_7d601c47 (PduRSrcPdu):
              PduRSourcePduHandleId = 4
              PduRSrcPduDirection = RECEIVE
              PduRSrcPduRef = pduTr_CON_VEH_A_FlexRay_pduPort_EPS_A_FlexRay_IN_7d601c47_052bff33
              PduRSrcPduPduRBswModulesRef = FrIf
            DST_Fr_pduTr_CON_VEH_A_FlexRay_7d601c47 (PduRDestPdu):
              PduRDestPduHandleId = 5
              PduRDestPduDirection = RECEIVE
              PduRDestPduRoutingType = API_FORWARDING
              PduRTransmissionConfirmation = false
              PduRDestPduRef = pduTr_CON_VEH_A_FlexRay_pduPort_EPS_A_FlexRay_IN_7d601c47_052bff33
          ANFRAGE_434514f6_In: PduRRoutingPathCommunicationType=UNDEFINED
            DST_ANFRAGE_434514f6_In (PduRDestPdu):
              PduRDestPduHandleId = 0
              PduRDestPduDirection = UNDEFINED
              PduRDestPduRoutingType = UNDEFINED
              PduRTransmissionConfirmation = false
              PduRDestPduRef = ANFRAGE_434514f6_In
            SRC_ANFRAGE_434514f6_In (PduRSrcPdu): PduRSourcePduHandleId=0, PduRSrcPduDirection=UNDEFINED, PduRSrcPduRef=ANFRAGE_434514f6_In
          SVC_434514f6_Out: PduRRoutingPathCommunicationType=COMMUNICATION_INTERFACE
            SRC_SVC_434514f6_Out (PduRSrcPdu): PduRSourcePduHandleId=15, PduRSrcPduDirection=TRANSMIT, PduRSrcPduRef=SVC_434514f6_Out
            DST_SVC_434514f6_Out (PduRDestPdu):
              PduRDestPduHandleId = 1
              PduRDestPduDirection = TRANSMIT
              PduRDestPduRoutingType = API_FORWARDING
              PduRTransmissionConfirmation = true
              PduRDestPduDataProvision = PDUR_TRIGGERTRANSMIT
              PduRDestPduRef = SVC_434514f6_Out
              PduRDestPduPduRBswModulesRef = FrIf
          Fr_pduTr_ERRM_BN_U_A_FlexRay_7d601c47: PduRRoutingPathCommunicationType=COMMUNICATION_INTERFACE  # ERRM_BN_U
            SRC_Fr_pduTr_ERRM_BN_U_A_FlexRay_7d601c47 (PduRSrcPdu):
              PduRSourcePduHandleId = 10
              PduRSrcPduDirection = RECEIVE
              PduRSrcPduRef = pduTr_ERRM_BN_U_A_FlexRay_pduPort_EPS_A_FlexRay_IN_7d601c47_052bff33
              PduRSrcPduPduRBswModulesRef = FrIf
            DST_Fr_pduTr_ERRM_BN_U_A_FlexRay_7d601c47 (PduRDestPdu):
              PduRDestPduHandleId = 11
              PduRDestPduDirection = RECEIVE
              PduRDestPduRoutingType = API_FORWARDING
              PduRTransmissionConfirmation = false
              PduRDestPduRef = pduTr_ERRM_BN_U_A_FlexRay_pduPort_EPS_A_FlexRay_IN_7d601c47_052bff33
    Dcm (PduRBswModules):
      PduRCancelReceive = false
      PduRCancelTransmit = false
      PduRChangeParameterRequestApi = false
      PduRCommunicationInterface = false
      PduRLowerModule = false
      PduRTransportProtocol = true
      PduRTriggertransmit = false
      PduRTxConfirmation = false
      PduRUpperModule = true
      PduRUseTag = true
      PduRBswModuleRef = Dcm
