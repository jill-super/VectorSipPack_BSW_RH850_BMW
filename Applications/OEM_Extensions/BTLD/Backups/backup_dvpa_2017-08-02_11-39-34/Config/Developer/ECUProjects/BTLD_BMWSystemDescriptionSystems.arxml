AUTOSAR XML (schema 4-3-0)
package /BMW/SystemDescription/Systems
  system Systems_SOLITAER_A_FlexRay_EPS: category=SYSTEM_EXTRACT
    system mapping Systems_SOLITAER_A_FlexRay_EPS_MPPNG
    root-software-compositions:
      root sw composition prototype ECU_Composition: software-composition=ECU_Composition
package /ECUCompositionTypes
  composition sw component type ECU_Composition
package /EndToEndProtections
  end to end protection set EndToEndConnections
