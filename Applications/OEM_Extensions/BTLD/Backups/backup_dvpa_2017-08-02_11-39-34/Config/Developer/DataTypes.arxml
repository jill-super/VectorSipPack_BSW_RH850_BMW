AUTOSAR XML (schema 4-3-0)
package /BMW/SystemDescription/BaseTypes
  base type ascii8: category=FIXED_LENGTH, base-type-size=8, base-type-encoding=ISO-8859-1
package /BMW/SystemDescription/CompuMethods
  compu method ACLNY_COG: phys=raw*0.002-65 for raw >0..<255; unit m/s²
  compu method ACLNY_COG_ERR_AMP: phys=raw*0.005 for raw >0..<255; unit m/s²
  compu method ACTVN_FN_ESTP_VIRT_FTAX: 0=Funktion virtueller Endanschlag deaktivieren (ACTVN_FN_ESTP_VIRT_FTAX_Funktion_virtueller_Endanschlag_deaktivieren) (Funktion virtueller Endanschlag deaktivieren durch Fahrzeugführung), 1=Funktion virtueller Endanschlag aktivieren (ACTVN_FN_ESTP_VIRT_FTAX_Funktion_virtueller_Endanschlag_aktivieren) (Funktion virtueller Endanschlag aktivieren durch Fahrzeugführung), 13=Funktionsschnittstelle_ist_nicht_verfuegbar (ACTVN_FN_ESTP_VIRT_FTAX_Funktionsschnittstelle_ist_nicht_verfuegbar) (Sendefunktion in Betrieb, Werte nicht verfügbar), 14=Funktion_meldet_Fehler (ACTVN_FN_ESTP_VIRT_FTAX_Funktion_meldet_Fehler) (Sendefunktion in Betrieb, meldet Fehler), 15=Signal_unbefuellt (ACTVN_FN_ESTP_VIRT_FTAX_Signal_unbefuellt) (Sendefunktion nicht in Betrieb)
  compu method ALIV_4_BIT_UInt: phys=raw for raw >0..<255
  compu method ALIV_4_BIT_Unsigned_Integer: phys=raw for raw >0..<255
  compu method ALIV_COU_4: 0..14=Zählerstand 0..E (After counter reading 14, the counter restarts at 0 again in cycles), 15=Signal ungültig (ALIV_COU_4_Signal_ungueltig)
  compu method ALIV_COU_V: 0..14=Zählerstand 0..E (After counter reading 14, the counter restarts at 0 again in cycles), 15=Signal ungültig (ALIV_COU_V_Signal_ungueltig)
  compu method AVL_FORC_GRD: phys=raw*0.0084-17 for raw >0..<255; unit kN
  compu method AVL_PINA_EPS: phys=raw*0.0439453125-1439.956055 for raw >0..<255
  compu method AVL_PINA_IDX_ICM: phys=raw*0.0439453125-1439.956055 for raw >0..<255
  compu method AVL_PWR_EL: phys=raw*0.1-12 for raw >0..<255; unit kW
  compu method AVL_RPM_WHL: phys=raw/64-511.984375 for raw >0..<255; unit rad/s
  compu method AVL_STEA_PNI_OFFS: phys=raw*0.021994-45 for raw 0..4092, 4093=Funktionsschnittstelle_ist_nicht_verfuegbar (AVL_STEA_PNI_OFFS_Funktionsschnittstelle_ist_nicht_verfuegbar) (Signal Tag - Schnittstelle ist nicht verfügbar), 4094=Funktion_meldet_Fehler (AVL_STEA_PNI_OFFS_Funktion_meldet_Fehler) (Signal Tag - Funktion meldet Fehler), 4095=Signal_unbefuellt (AVL_STEA_PNI_OFFS_Signal_unbefuellt) (Signal Tag - Signal ist unbefüllt)
  compu method CHL_4_UInt: phys=raw for raw >0..<255
  compu method COU_BS_RESP: phys=raw for raw >0..<255
  compu method CRC_V_VEH: phys=raw for raw >0..<255
  compu method CRC8: phys=raw for raw >0..<255
  compu method CTR_BS_PRTNT: 0=Keine Kommunikation (CTR_BS_PRTNT_Keine_Kommunikation), 1=Kom_Parken_BN_niO (CTR_BS_PRTNT_Kom_Parken_BN_niO), 2=Kom_Parken_BN_iO (CTR_BS_PRTNT_Kom_Parken_BN_iO), 3=Kom_Standfunktionen_Kunde_nicht_im_FZG (CTR_BS_PRTNT_Kom_Standfunktionen_Kunde_nicht_im_FZG), 4=reserviert (CTR_BS_PRTNT_reserviert), 5=Kom_Wohnen (CTR_BS_PRTNT_Kom_Wohnen), 6=reserviert (CTR_BS_PRTNT_reserviert_2), 7=Kom_Pruefen_Analyse_Diagnose (CTR_BS_PRTNT_Kom_Pruefen_Analyse_Diagnose), 8=Kom_Fahrbereitschaft_herstellen (CTR_BS_PRTNT_Kom_Fahrbereitschaft_herstellen), 9=reserviert (CTR_BS_PRTNT_reserviert_3), 10=Kom_Fahren (CTR_BS_PRTNT_Kom_Fahren), 11=reserviert (CTR_BS_PRTNT_reserviert_4), 12=Kom_Fahrbereitschaft_beenden (CTR_BS_PRTNT_Kom_Fahrbereitschaft_beenden), 13=reserviert (CTR_BS_PRTNT_reserviert_5) (Hinweis: Reserviert für funktionale Kennung Signal-Tag.), 14=reserviert (CTR_BS_PRTNT_reserviert_6) (Hinweis: Reserviert für funktionale Kennung Signal-Tag.), 15=Signal_unbefuellt (CTR_BS_PRTNT_Signal_unbefuellt)
  compu method CTR_DEAC_EPS_FNS: mask 15: 0=Keine_Deaktivierung_EPS_Funktionen (CTR_DEAC_EPS_FNS_Keine_Deaktivierung_EPS_Funktionen) (Es besteht keine Anforderung zur Deaktivierung von Funktionen auf der EPS.), mask 9: 1=Deaktivierung_EPS_Funktionen_ Funktionsgruppe_1 (CTR_DEAC_EPS_FNS_Deaktivierung_EPS_Funktionen_Funktionsgruppe_1) (Anforderung zur Deaktivierung einer spezifizierten Funktionsgruppe 1 auf der EPS. Die detaillierte Spezifikation der Funktionsgruppe 1 erfolgt im Entwicklungsprozess mit den Lieferanten.), mask 10: 2=Deaktivierung_EPS_Funktionen_ Funktionsgruppe_2 (CTR_DEAC_EPS_FNS_Deaktivierung_EPS_Funktionen_Funktionsgruppe_2) (Anforderung zur Deaktivierung einer spezifizierten Funktionsgruppe 2 auf der EPS. Die detaillierte Spezifikation der Funktionsgruppe 2 erfolgt im Entwicklungsprozess mit den Lieferanten.), mask 15: 13=Funktionsschnittstelle_ist_nicht_verfuegbar (CTR_DEAC_EPS_FNS_Funktionsschnittstelle_ist_nicht_verfuegbar) (Sendefunktion in Betrieb, Werte nicht verfügbar), mask 15: 14=Funktion_meldet_Fehler (CTR_DEAC_EPS_FNS_Funktion_meldet_Fehler) (Sendefunktion in Betrieb, meldet Fehler), mask 15: 15=Signal_unbefuellt (CTR_DEAC_EPS_FNS_Signal_unbefuellt) (Wird nicht aktiv gesetzt)
  compu method CTR_ERRM_BN_U: mask 33: 0=Keine Unterspannung Normalbetrieb (CTR_ERRM_BN_U_Keine_Unterspannung_Normalbetrieb) (Unterspannungsschwelle für Normalbetrieb nicht erreicht.), mask 33: 1=Unterspannung Normalbetrieb (CTR_ERRM_BN_U_Unterspannung_Normalbetrieb) (Unterspannungsschwelle für Normalbetrieb unterschritten.), mask 34: 0=Keine Unterspannung MSA-Start (CTR_ERRM_BN_U_Keine_Unterspannung_MSA_Start) (Unterspannungsschwelle für MSA-Start Festigkeit nicht erreicht.), mask 34: 2=Unterspannung MSA-Start (CTR_ERRM_BN_U_Unterspannung_MSA_Start) (Unterspannungsschwelle für MSA-Start Festigkeit unterschritten.), mask 36: 0=Keine Überspannung (CTR_ERRM_BN_U_Keine_Ueberspannung) (Überspannungsschwelle nicht erreicht.), mask 36: 4=Überspannung (CTR_ERRM_BN_U_Ueberspannung) (Überspannungsschwelle überschritten.), mask 63: 61=Funktionsschnittstelle_ist_nicht_verfuegbar (CTR_ERRM_BN_U_Funktionsschnittstelle_ist_nicht_verfuegbar) (Sendefunktion in Betrieb, Werte nicht verfügbar), mask 63: 62=Funktion_meldet_Fehler (CTR_ERRM_BN_U_Funktion_meldet_Fehler) (Sendefunktion in Betrieb, meldet Fehler), mask 63: 63=Signal_unbefuellt (CTR_ERRM_BN_U_Signal_unbefuellt) (Sendefunktion nicht in Betrieb)
  compu method CTR_WARN_DIR_VIB_EPS: 0=Keine_Richtung (CTR_WARN_DIR_VIB_EPS_Keine_Richtung) (Ungerichteter Impuls Diese Codierung wird auch versendet, wenn keine haptische Warnung erfolgt.), 1=Richtung_links (CTR_WARN_DIR_VIB_EPS_Richtung_links) (Impuls Richtung links), 2=Richtung_rechts (CTR_WARN_DIR_VIB_EPS_Richtung_rechts) (Impuls Richtung rechts), 3=Signal_unbefuellt (CTR_WARN_DIR_VIB_EPS_Signal_unbefuellt) (Sendefunktion nicht in Betrieb)
  compu method CTR_WARN_ILVL_VIB_EPS: 0=Intensitaetsstufe_0 (CTR_WARN_ILVL_VIB_EPS_Intensitaetsstufe_0) (Diese Codierung wird auch verwendet, wenn keine haptische Warnung erfolgt.), 1=Intensitaetsstufe_1 (CTR_WARN_ILVL_VIB_EPS_Intensitaetsstufe_1), 2=Intensitaetsstufe_2 (CTR_WARN_ILVL_VIB_EPS_Intensitaetsstufe_2), 3=Intensitaetsstufe_3 (CTR_WARN_ILVL_VIB_EPS_Intensitaetsstufe_3), 4=Intensitaetsstufe_4 (CTR_WARN_ILVL_VIB_EPS_Intensitaetsstufe_4), 5=Intensitaetsstufe_5 (CTR_WARN_ILVL_VIB_EPS_Intensitaetsstufe_5), 6=Intensitaetsstufe_6 (CTR_WARN_ILVL_VIB_EPS_Intensitaetsstufe_6), 7=Intensitaetsstufe_7 (CTR_WARN_ILVL_VIB_EPS_Intensitaetsstufe_7), 8=Intensitaetsstufe_8 (CTR_WARN_ILVL_VIB_EPS_Intensitaetsstufe_8), 9=Intensitaetsstufe_9 (CTR_WARN_ILVL_VIB_EPS_Intensitaetsstufe_9), 10=Intensitaetsstufe_10 (CTR_WARN_ILVL_VIB_EPS_Intensitaetsstufe_10), 11=Intensitaetsstufe_11 (CTR_WARN_ILVL_VIB_EPS_Intensitaetsstufe_11), 12=Intensitaetsstufe_12 (CTR_WARN_ILVL_VIB_EPS_Intensitaetsstufe_12), 13=Reserviert (CTR_WARN_ILVL_VIB_EPS_Reserviert) (Hinweis: Reserviert für funktionale Kennung Signal-Tag.), 14=Reserviert (CTR_WARN_ILVL_VIB_EPS_Reserviert_2) (Hinweis: Reserviert für funktionale Kennung Signal-Tag.), 15=Signal_unbefuellt (CTR_WARN_ILVL_VIB_EPS_Signal_unbefuellt) (Sendefunktion nicht in Betrieb)
  compu method CTR_WARN_PTRN_VIB_EPS: 0=Keine_haptische_Warnung (CTR_WARN_PTRN_VIB_EPS_Keine_haptische_Warnung), 1=Muster_1 (CTR_WARN_PTRN_VIB_EPS_Muster_1), 2=Muster_2 (CTR_WARN_PTRN_VIB_EPS_Muster_2), 3=Muster_3 (CTR_WARN_PTRN_VIB_EPS_Muster_3), 4=Muster_4 (CTR_WARN_PTRN_VIB_EPS_Muster_4), 5=Muster_5 (CTR_WARN_PTRN_VIB_EPS_Muster_5), 6=Muster_6 (CTR_WARN_PTRN_VIB_EPS_Muster_6), 7=Muster_7 (CTR_WARN_PTRN_VIB_EPS_Muster_7), 8=Muster_8 (CTR_WARN_PTRN_VIB_EPS_Muster_8), 9=Muster_9 (CTR_WARN_PTRN_VIB_EPS_Muster_9), 10=Muster_10 (CTR_WARN_PTRN_VIB_EPS_Muster_10), 13=Funktionsschnittstelle_ist_nicht_verfuegbar (CTR_WARN_PTRN_VIB_EPS_Funktionsschnittstelle_ist_nicht_verfuegbar) (Sendefunktion in Betrieb, Werte nicht verfügbar), 14=Funktion_meldet_Fehler (CTR_WARN_PTRN_VIB_EPS_Funktion_meldet_Fehler) (Sendefunktion in Betrieb, meldet Fehler), 15=Signal_unbefuellt (CTR_WARN_PTRN_VIB_EPS_Signal_unbefuellt) (Sendefunktion nicht in Betrieb)
  compu method DBG_8Bit: phys=raw for raw >0..<255
  compu method DIAG_ST_OBD: identical
  compu method DVCO_VEH: 0=Fahrzeug steht (DVCO_VEH_Fahrzeug_steht) (See above), 1=Fahrzeug fährt vorwärts (DVCO_VEH_Fahrzeug_faehrt_vorwaerts) (FL and FR forwards), 2=Fahrzeug fährt rückwärts (DVCO_VEH_Fahrzeug_faehrt_rueckwaerts) (FL and FR backwards), 3=Fahrzeug fährt (DVCO_VEH_Fahrzeug_faehrt) (Direction recognition not possible, e.g. air gap too large), 4=Fahrzeug steht, Hinterachse auf Rollenprüfstand erkannt (DVCO_VEH_Fahrzeug_steht_Hinterachse_auf_Rollenpruefstand_erkannt) (Fahrzeug auf Hinterachs-Ein-Achs- Rollenprüfstand erkannt. Signalverhalten von Geschwindigkeit_Fahrzeug_Schwerpunkt siehe Signalbeschreibung DVCO_VEH), 5=Fahrzeug steht, Zwei-Achs-Rollenbetrieb gesetzt (DVCO_VEH_Fahrzeug_steht_Zwei_Achs_Rollenbetrieb_gesetzt) (Codierung wird beim CAS4 im F25 erst ab I400 richtig interpretiert. Signal Geschwindigkeit_Fahrzeug_Schwerpunkt entspricht der Rollengeschwindigkeit, Details siehe Signalbeschreibung), 6=Fahrzeug steht, Vorderachse auf Rollenprüfstand erkannt (DVCO_VEH_Fahrzeug_steht_Vorderachse_auf_Rollenpruefstand_erkannt) (Fahrzeug auf Vorderachs-Ein-Achs-Rollenprüfstand erkannt. (Bit kann erst ab SP2013 gesetzt werden) Signalverhalten von Geschwindigkeit_Fahrzeug_Schwerpunkt siehe Signalbeschreibung DVCO_VEH), 7=Signal ungültig (DVCO_VEH_Signal_ungueltig) (Wird beim Aufstarten gesetzt, solange kein gültiger Zustand ermittelt werden kann und beim Auftreten eines Kommunikationsfehlers.)
  compu method ENERG_AVAI_ARS: phys=raw for raw 0..100, 253=Funktionsschnittstelle_ist_nicht_verfuegbar (ENERG_AVAI_ARS_Funktionsschnittstelle_ist_nicht_verfuegbar) (Sendefunktion in Betrieb, Werte nicht verfügbar), 254=Funktion_meldet_Fehler (ENERG_AVAI_ARS_Funktion_meldet_Fehler) (Nutzsignal kann nicht berechnet werden), 255=Signal_unbefuellt (ENERG_AVAI_ARS_Signal_unbefuellt) (Sendefunktion nicht in Betrieb); unit %
  compu method FACT_ASS_STMOM_FTAX: phys=raw/256+1 for raw >0..<255
  compu method FACT_CTRR_STMOM_FTAX: phys=raw/256+0.0078125 for raw >0..<255
  compu method FACT_DMPNG_ADDON_STMOM_FTAX: phys=raw/64 for raw 0..128, 253=Reserviert (FACT_DMPNG_ADDON_STMOM_FTAX_Reserviert) (Hinweis: Reserviert für funktionale Kennung Signal-Tag.), 254=Reserviert (FACT_DMPNG_ADDON_STMOM_FTAX_Reserviert_2) (Hinweis: Reserviert für funktionale Kennung Signal-Tag.), 255=Signal_unbefuellt (FACT_DMPNG_ADDON_STMOM_FTAX_Signal_unbefuellt) (Sendefunktion nicht in Betrieb)
  compu method FACT_MO_STE_SO_DXP: phys=raw*0.02 for raw 0..250, 253=Funktionsschnittstelle_ist_nicht_verfuegbar (FACT_MO_STE_SO_DXP_Funktionsschnittstelle_ist_nicht_verfuegbar) (Sendefunktion in Betrieb, Werte nicht verfügbar), 254=Funktion_meldet_Fehler (FACT_MO_STE_SO_DXP_Funktion_meldet_Fehler) (Sendefunktion in Betrieb, meldet Fehler), 255=Signal_unbefuellt (FACT_MO_STE_SO_DXP_Signal_unbefuellt) (Sendefunktion nicht in Betrieb)
  compu method FKTN_PRTNT: mask 2147483649: 0=Konfiguration aus (FKTN_PRTNT_Konfiguration_aus), mask 2147483649: 1=Konfiguration ein (FKTN_PRTNT_Konfiguration_ein), mask 2147483650: 0=Ethernet Infrastruktur aus (FKTN_PRTNT_Ethernet_Infrastruktur_aus), mask 2147483650: 2=Ethernet Infrastruktur ein (FKTN_PRTNT_Ethernet_Infrastruktur_ein), mask 2147483652: 0=Datenkommunikation_aus (FKTN_PRTNT_Datenkommunikation_aus) (Gilt ab SP2018), mask 2147483652: 4=Datenkommunikation_ein (FKTN_PRTNT_Datenkommunikation_ein) (Gilt ab SP2018), mask 2147483904: 0=Klimabetrieb aus (FKTN_PRTNT_Klimabetrieb_aus), mask 2147483904: 256=Klimabetrieb ein (FKTN_PRTNT_Klimabetrieb_ein), mask 2147484160: 0=Entertainmentbetrieb aus (FKTN_PRTNT_Entertainmentbetrieb_aus), mask 2147484160: 512=Entertainmentbetrieb ein (FKTN_PRTNT_Entertainmentbetrieb_ein), mask 2147484672: 0=Externe_Kommunikation aus (FKTN_PRTNT_Externe_Kommunikation_aus), mask 2147484672: 1024=Externe_Kommunikation ein (FKTN_PRTNT_Externe_Kommunikation_ein), mask 2147485696: 0=Entertainmentbetrieb_Fond_aus (FKTN_PRTNT_Entertainmentbetrieb_Fond_aus) (Gilt ab SP2018), mask 2147485696: 2048=Entertainmentbetrieb_Fond_ein (FKTN_PRTNT_Entertainmentbetrieb_Fond_ein) (Gilt ab SP2018), mask 2147487744: 0=Assistenz_Parken_high aus (FKTN_PRTNT_Assistenz_Parken_high_aus), mask 2147487744: 4096=Assistenz_Parken_high ein (FKTN_PRTNT_Assistenz_Parken_high_ein), mask 2147516416: 0=Laden aus (FKTN_PRTNT_Laden_aus), mask 2147516416: 32768=Laden ein (FKTN_PRTNT_Laden_ein), mask 2147549184: 0=Fahrzeug Infrastruktur aus (FKTN_PRTNT_Fahrzeug_Infrastruktur_aus), mask 2147549184: 65536=Fahrzeug Infrastruktur ein (FKTN_PRTNT_Fahrzeug_Infrastruktur_ein), mask 2148007936: 0=Licht_aus (FKTN_PRTNT_Licht_aus) (Gilt ab SP2018), mask 2148007936: 524288=Licht_ein (FKTN_PRTNT_Licht_ein) (Gilt ab SP2018), mask 2148532224: 0=TN_48V_aus (FKTN_PRTNT_TN_48V_aus), mask 2148532224: 1048576=TN_48V_ein (FKTN_PRTNT_TN_48V_ein), mask 4294967295: 4294967295=Signal_unbefuellt (FKTN_PRTNT_Signal_unbefuellt)
  compu method I_SPEC_ARS: phys=raw for raw 0..252, 253=Funktionsschnittstelle_ist_nicht_verfuegbar (I_SPEC_ARS_Funktionsschnittstelle_ist_nicht_verfuegbar) (Sendefunktion in Betrieb, Werte nicht verfügbar), 254=Funktion_meldet_Fehler (I_SPEC_ARS_Funktion_meldet_Fehler) (Nutzsignal kann nicht berechnet werden), 255=Signal_unbefuellt (I_SPEC_ARS_Signal_unbefuellt) (Sendefunktion nicht in Betrieb); unit A
  compu method ID_FN_INQY: 41216=Bedienung Tasten Entertainment (ID_FN_INQY_Bedienung_Tasten_Entertainment), 62976=Steuerung Außenspiegel (ID_FN_INQY_Steuerung_Aussenspiegel), 57857=Sicher Fahrgestellnummer (ID_FN_INQY_Sicher_Fahrgestellnummer), 9730=Regensensor-Wischergeschwindigkeit (ID_FN_INQY_Regensensor_Wischergeschwindigkeit), 14850=Status Funkschlüssel (ID_FN_INQY_Status_Funkschluessel), 26370=Bedienung Tastgeber Bedienelement Front (ID_FN_INQY_Bedienung_Tastgeber_Bedienelement_Front), 32258=Status Verdeck Cabrio (ID_FN_INQY_Status_Verdeck_Cabrio) (Wird ab BN2020 nur noch von HMI verwendet), 36866=Status Schlüssel Suche (ID_FN_INQY_Status_Schluessel_Suche), 58882=Status Klima Luftverteilung FA (ID_FN_INQY_Status_Klima_Luftverteilung_FA), 59906=Status Klima Luftverteilung BF (ID_FN_INQY_Status_Klima_Luftverteilung_BF), 60418=Status Klima SH/ZH Zusatzwasserpumpe (ID_FN_INQY_Status_Klima_SH_ZH_Zusatzwasserpumpe), 60930=Status Klima Zusatzprogramme (ID_FN_INQY_Status_Klima_Zusatzprogramme) (Wird ab BN2020 nur noch von HMI verwendet), 61442=Status Klima Standfunktionen (ID_FN_INQY_Status_Klima_Standfunktionen), 63234=Einheiten BN2020 (ID_FN_INQY_Einheiten_BN2020), 63490=Uhrzeit/Datum (ID_FN_INQY_Uhrzeit_Datum), 3843=Status Service Call TeleX (ID_FN_INQY_Status_Service_Call_TeleX), 4867=Status Service Call Teleservice (ID_FN_INQY_Status_Service_Call_Teleservice), 12803=Verbrauch Information Daten (ID_FN_INQY_Verbrauch_Information_Daten), 13827=Anzeige Checkcontrol-Meldung (Rolle) (ID_FN_INQY_Anzeige_Checkcontrol_Meldung_Rolle_), 14851=Status Monitor Front (ID_FN_INQY_Status_Monitor_Front) ((E60, RR01)), 16643=Status Kartendaten (ID_FN_INQY_Status_Kartendaten), 23555=Status Bordcomputer BN2020 (ID_FN_INQY_Status_Bordcomputer_BN2020) ((E60)), 24579=Daten Bordcomputer (Fahrtbeginn) (ID_FN_INQY_Daten_Bordcomputer_Fahrtbeginn_) ((E60)), 32771=Fahrgestellnummer (ID_FN_INQY_Fahrgestellnummer), 33027=Elektronischer Motorölmessstab (ID_FN_INQY_Elektronischer_Motoroelmessstab), 34819=Fahrzeugtyp (ID_FN_INQY_Fahrzeugtyp), 38147=Codierung Powermanagement (ID_FN_INQY_Codierung_Powermanagement), 40451=Bedienung_Uhrzeit_Datum (ID_FN_INQY_Bedienung_Uhrzeit_Datum), 43523=Bedienung_Uhrzeit_Datum_UTC (ID_FN_INQY_Bedienung_Uhrzeit_Datum_UTC), 43779=Bedienung_Datum_Winterzeit_Sommerzeit (ID_FN_INQY_Bedienung_Datum_Winterzeit_Sommerzeit), 46595=Position Fensterheber FAT (ID_FN_INQY_Position_Fensterheber_FAT) (ATTENTION:The CAN identifier of the message cannot be given here, even if the message comes from the SI bus with E60. The E60 door electronics DRD on the SI bus must react to this coding and send out the position of window regulator DRD message on request.), 46851=Position Fensterheber FATH (ID_FN_INQY_Position_Fensterheber_FATH), 47107=Position Fensterheber BFT (ID_FN_INQY_Position_Fensterheber_BFT) (ATTENTION:The CAN identifier of the message is given here, even if the message comes from the SI bus with E60. The E60 door electronics PSD on the SI bus must react to this coding and send out the position of electric windows PSD message on request.), 47363=Position Fensterheber BFTH (ID_FN_INQY_Position_Fensterheber_BFTH), 47619=Position SHD (ID_FN_INQY_Position_SHD), 48131=Position Fensterheber Sicherheitsfahrzeug (ID_FN_INQY_Position_Fensterheber_Sicherheitsfahrzeug), 48899=Position Fensterheber Heckscheibe (ID_FN_INQY_Position_Fensterheber_Heckscheibe), 49155=Konfiguration FAS (ID_FN_INQY_Konfiguration_FAS), 49411=Konfiguration BFS (ID_FN_INQY_Konfiguration_BFS), 49667=Konfiguration FASH (ID_FN_INQY_Konfiguration_FASH), 49923=Konfiguration BFSH (ID_FN_INQY_Konfiguration_BFSH), 53251=Status Spurverlassenswarnsystem CKM (ID_FN_INQY_Status_Spurverlassenswarnsystem_CKM), 54531=Status Zentralverriegelung CKM (ID_FN_INQY_Status_Zentralverriegelung_CKM), 55043=Status DWA CKM (ID_FN_INQY_Status_DWA_CKM), 56067=Status Memorypositionen CKM (ID_FN_INQY_Status_Memorypositionen_CKM), 56579=Status Licht CKM (ID_FN_INQY_Status_Licht_CKM), 57603=Status ALC CKM (ID_FN_INQY_Status_ALC_CKM), 58115=Status Heckklappe CKM (ID_FN_INQY_Status_Heckklappe_CKM), 60163=Grenzwerte Schwenk Links (ID_FN_INQY_Grenzwerte_Schwenk_Links), 60419=Grenzwerte Schwenk Rechts (ID_FN_INQY_Grenzwerte_Schwenk_Rechts), 61699=Status Licht Erweitert CKM (ID_FN_INQY_Status_Licht_Erweitert_CKM), 9731=Wirkungsgrad Information Data (ID_FN_INQY_Wirkungsgrad_Information_Data), 10243=Relativzeit BN2020 (ID_FN_INQY_Relativzeit_BN2020), 3588=GPS_Datum_CAN (ID_FN_INQY_GPS_Datum_CAN), 3844=GPS_Uhrzeit_CAN (ID_FN_INQY_GPS_Uhrzeit_CAN), 6660=Status Konfiguration Kombi 4 (ID_FN_INQY_Status_Konfiguration_Kombi_4), 9220=Status Konfiguration Kombi (ID_FN_INQY_Status_Konfiguration_Kombi), 9988=Konfiguration DSC (ID_FN_INQY_Konfiguration_DSC), 11780=Status M-Drive 2 (ID_FN_INQY_Status_M_Drive_2), 13316=Konfiguration EPS (ID_FN_INQY_Konfiguration_EPS), 13572=Messung Motoröl (ID_FN_INQY_Messung_Motoroel), 16132=Identifikationsnummer Sensorcluster (ID_FN_INQY_Identifikationsnummer_Sensorcluster), 16642=Status_Hindernis_Tuer (ID_FN_INQY_Status_Hindernis_Tuer), 65535=Signal_unbefuellt (ID_FN_INQY_Signal_unbefuellt), 65533=Reserviert_nicht_verfuegbar (ID_FN_INQY_Reserviert_nicht_verfuegbar) (Hinweis: Reserviert für funktionale Kennung Signal-Tag "Funktionsschnittstelle_ist_nicht_verfuegbar"), 65534=Reserviert_Fehler (ID_FN_INQY_Reserviert_Fehler) (Hinweis: Reserviert für funktionale Kennung Signal-Tag "Funktion_meldet_Fehler")
  compu method ID_FN_RQ_STG_EFAN: 1=AFS-Anforderung (ID_FN_RQ_STG_EFAN_AFS_Anforderung) (Diese Nachricht darf vom AFS ausschließlich zum Bauteilschutz im Notfall versandt werden! Anforderung wird vom E6x/PL2/PL4 AFS nicht mehr versendet.), 2=EPS-Anforderung (ID_FN_RQ_STG_EFAN_EPS_Anforderung) (Diese Nachricht darf vom EPS ausschließlich zum Bauteilschutz im Notfall versandt werden!), 3=DSC-Anforderung (ID_FN_RQ_STG_EFAN_DSC_Anforderung) (Diese Nachricht darf vom DSC ausschließlich zum Bauteilschutz im Notfall versandt werden!), 4=Servotronic-Anforderung (ID_FN_RQ_STG_EFAN_Servotronic_Anforderung) (Diese Kodierung wird _nicht_ in den Baureihen L1 bis L5 verwendet. Diese Nachricht darf ausschließlich zum Bauteilschutz im Notfall versandt werden!), 255=Signal ungültig (ID_FN_RQ_STG_EFAN_Signal_ungueltig)
  compu method ID_TEMP_CPO_HET_MNG: 1=EPS-Motortemperatur (ID_TEMP_CPO_HET_MNG_EPS_Motortemperatur), 13=Reserviert (ID_TEMP_CPO_HET_MNG_Reserviert) (Hinweis: Reserviert für funktionale Kennung Signal-Tag.), 14=Reserviert (ID_TEMP_CPO_HET_MNG_Reserviert_2) (Hinweis: Reserviert für funktionale Kennung Signal-Tag.), 15=Signal_unbefuellt (ID_TEMP_CPO_HET_MNG_Signal_unbefuellt) (Sendefunktion nicht in Betrieb)
  compu method IDX_TORQ_SEN: 0=Initialisierung (IDX_TORQ_SEN_Initialisierung), 1=Keine Index Flanke (IDX_TORQ_SEN_Keine_Index_Flanke) (FUSI: Verwendung im Funktionsrahmen zu prüfen.), 2=Index Flanke (IDX_TORQ_SEN_Index_Flanke) (Gilt für steigende und fallende Flanken FUSI: Verwendung im Funktionsrahmen zu prüfen.), 3=Signal ungültig (IDX_TORQ_SEN_Signal_ungueltig)
  compu method MILE_KM: phys=raw for raw >0..<255; unit km
  compu method MIN_I_SPEC_ARS: phys=raw-252 for raw 0..252, 253=Funktionsschnittstelle_ist_nicht_verfuegbar (MIN_I_SPEC_ARS_Funktionsschnittstelle_ist_nicht_verfuegbar) (Sendefunktion in Betrieb, Werte nicht verfügbar), 254=Funktion_meldet_Fehler (MIN_I_SPEC_ARS_Funktion_meldet_Fehler) (Nutzsignal kann nicht berechnet werden), 255=Signal_unbefuellt (MIN_I_SPEC_ARS_Signal_unbefuellt) (Sendefunktion nicht in Betrieb); unit A
  compu method NO_CC_EPS: phys=raw for raw >0..<255
  compu method NO_VECH_{1..7}: identical
  compu method OFFS_GRD_MID_EPS: phys=raw*0.0439453125-89.95605469 for raw >0..<255
  compu method OFFS_QUAD_PINA_EPS: phys=raw-127 for raw >0..<255
  compu method QU_ACLNY_COG: 8=Initialisierung (QU_ACLNY_COG_Initialisierung) (Tritt während der Initialisierungsphase auf bis Ist-Wert verfügbar (Vorbefüllung). Nutzsignal wird permanent mit Nutzwert 0 befüllt.), 1=Signalwert ist gültig und abgesichert und plausibilisiert (QU_ACLNY_COG_Signalwert_ist_gueltig_und_abgesichert_und_plausibilisiert) (Nutzsignal verfügbar, bereitgestellt aus zwei Sensoren (nur bei redundanter Sensorik) elektrische und Modellüberwachung i.O.), 9=Signalwert ist gültig und abgesichert, Zustand/Status temporär (QU_ACLNY_COG_Signalwert_ist_gueltig_und_abgesichert_Zustand_Status_temporaer) (Nutzsignal verfügbar; elektrische und Modellüberwachung i.O. Es liegt eine Signaltoleranz aufgrund nicht abgeschlossenen Offsetabgleichs an. FuSi : Bei sicherheitsrelevanten Funktionen ist die Fehleramplitude auszuwerten), 2=Signalwert ist gültig (QU_ACLNY_COG_Signalwert_ist_gueltig) (Nutzsignal verfügbar, bereitgestellt aus einem Sensor (Nur bei einfacher Sensorik) elektrische und Modellüberwachung i.O.), 10=Signalwert ist gültig, Zustand/Status temporär (QU_ACLNY_COG_Signalwert_ist_gueltig_Zustand_Status_temporaer) (Nutzsignal verfügbar, bereitgestellt aus einem Sensor elektrische und Modellüberwachung i.O. Es liegt eine Signaltoleranz aufgrund nicht abgeschlossenen Offsetabgleichs an. FuSi : Bei sicherheitsrelevanten Funktionen ist die Fehleramplitude auszuwerten), 3=Signalqualität bzw. Überwachung eingeschränkt (QU_ACLNY_COG_Signalqualitaet_bzw_Ueberwachung_eingeschraenkt) (keine Modellüberwachung, da Eingangsgrößen für Überwachung fehlen (zum Bsp. Gierrate), elektrische Überwachung i.O. Nutzsignal wird aus Sensorwert gebildet. FuSi: keine Verwendung für sicherheitsrelevante Funktionen), 11=Signalqualität bzw. Überwachung eingeschränkt, Zustand/Status temporär (QU_ACLNY_COG_Signalqualitaet_bzw_Ueberwachung_eingeschraenkt_Zustand_Status_temporaer) (keine Modellüberwachung, da Eingangsgrößen für Überwachung fehlen (zum Bsp. Gierrate), elektrische Überwachung i.O. Es liegt eine Signaltoleranz aufgrund nicht abgeschlossenen Offsetabgleichs an. Nutzsignal wird aus Sensorwert gebildet. FuSi: keine Verwendung für sicherheitsrelevante Funktionen), 4=Reserved (QU_ACLNY_COG_Reserved), 12=Ersatzwert ist im Nutzsignal gesetzt, Zustand/Status temporär (QU_ACLNY_COG_Ersatzwert_ist_im_Nutzsignal_gesetzt_Zustand_Status_temporaer) (elektrische Überwachung oder Modellüberwachung zeigt Fehler an, deshalb wird Ersatzwert aus Modell versendet FuSi: keine Verwendung für sicherheitsrelevante Funktionen), 6=Signalwert ist ungültig (QU_ACLNY_COG_Signalwert_ist_ungueltig) (Das zugehörige Nutzsignal wird permanent mit der Ungültigkeitskennung befüllt. elektrische Überwachung oder Modellüberwachung zeigt Fehler an, kein Ersatzwert verfügbar. Diese Codierung wird ab SP2015 nicht mehr bedient.), 14=Signalwert ist ungültig, Zustand/Status temporär (QU_ACLNY_COG_Signalwert_ist_ungueltig_Zustand_Status_temporaer) (Das zugehörige Nutzsignal wird permanent mit der Ungültigkeitskennung befüllt. elektrische Überwachung oder Modellüberwachung zeigt Fehler an, kein Ersatzwert verfügbar), 7=Reserved (QU_ACLNY_COG_Reserved_2), 15=Signal ungültig (QU_ACLNY_COG_Signal_ungueltig) (Kann nur vom Gateway gesetzt werden)
  compu method QU_AVL_FORC_GRD: 8=Initialisierung (QU_AVL_FORC_GRD_Initialisierung) (At the startup of the TSU driver. Nutzsignal wird permanent mit 0,0016 befüllt.), 2=Signalwert ist gültig (QU_AVL_FORC_GRD_Signalwert_ist_gueltig) (The signal is valid since every input signal is valid FUSI: Do not use for safety critical functions), 14=Signalwert ist ungültig, Zustand/Status temporär (QU_AVL_FORC_GRD_Signalwert_ist_ungueltig_Zustand_Status_temporaer) (The signal is invalid since one of the input signals is invalid. Das zugehörige Nutzsignal wird permanent mit der Ungültigkeitskennung befüllt.), 15=Signal ungültig (QU_AVL_FORC_GRD_Signal_ungueltig) (Kann Funktional nicht gesetzt werden)
  compu method QU_AVL_PINA_EPS: 8=Initialisierung (QU_AVL_PINA_EPS_Initialisierung) (Nach jedem Reset und Aufstarten des EPS-Steuergeräts. Nutzsignal wird permanent mit Nutzwert 0 befüllt.), 1=Signalwert ist gültig und abgesichert und plausibilisiert (QU_AVL_PINA_EPS_Signalwert_ist_gueltig_und_abgesichert_und_plausibilisiert) (Position ist aufgesetzt und offsetkompensiert. Sensorwert gültig und elektrische Überwachung i.O. und EPS intern plausibilisiert), 2=Signalwert ist gültig (QU_AVL_PINA_EPS_Signalwert_ist_gueltig) (Position ist aufgesetzt und offsetkompensiert Sensorwert gültig und elektrische Überwachung i.O.), 4=Ersatzwert ist im Nutzsignal gesetzt (QU_AVL_PINA_EPS_Ersatzwert_ist_im_Nutzsignal_gesetzt) (Signalwert rein aus dem Sensor, d.h. die Position ist aufintegriert (Relativ) Sensorwert gültig und elektrische Überwachung i.O. FUSI: keine Verwendung für sicherheitsrelevante Funktionen.), 9=Signalwert ist gültig, Zustand/Status temporär (mittlere Signalqualität) (QU_AVL_PINA_EPS_Signalwert_ist_gueltig_Zustand_Status_temporaer_mittlere_Signalqualitaet_) (Wird erst ab SP2015 unterstützt: Position ist aufgesetzt. Die minimale Signaltoleranz ist allerdings noch nicht erreicht. Sensorwert gültig und elektrische Überwachung i.O.), 10=Signalwert ist gültig, Zustand/Status temporär (geringe Signalqualität) (QU_AVL_PINA_EPS_Signalwert_ist_gueltig_Zustand_Status_temporaer_geringe_Signalqualitaet_) (Position ist aufgesetzt, es liegt aber noch eine Signaltoleranz bis etwa 30° Lenkradwinkel vor. Sensorwert gültig und elektrische Überwachung i.O. Wird erst ab SP2013 (außer F15-F16, 444) unterstützt.), 12=Abgleichwert ist im Nutzsignal gesetzt, Zustand/Status temporär (QU_AVL_PINA_EPS_Abgleichwert_ist_im_Nutzsignal_gesetzt_Zustand_Status_temporaer) (Nicht vertrauenswürdige aufgesetzte und offsetkompensierte Position, die in diesem Zustand korrigiert wird (durch Aufsetzalgorithmus im ICM). Dieser Zustand bleibt mindestens 50ms bestehen. FUSI: keine Verwendung für sicherheitsrelevante Funktionen.), 14=Signalwert ist ungültig, Zustand/Status temporär (QU_AVL_PINA_EPS_Signalwert_ist_ungueltig_Zustand_Status_temporaer) (Das zugehörige Nutzsignal wird permanent mit der Ungültigkeitskennung befüllt. Wird gesetzt bei internen EPS Fehler (Sensor Fehler, Interner Kommunikationsfehler,...) Dieser Zustand bleibt mindestens 20ms bestehen.), 15=Signal ungültig (QU_AVL_PINA_EPS_Signal_ungueltig)
  compu method QU_AVL_RPM_WHL: 8=Initialisierung (QU_AVL_RPM_WHL_Initialisierung) (Wird gelegt solange aufgrund des Aufstartvorgangs (und der dazu gehörenden Sensorprüfung) für den zugehörigen Raddrehzahlsensor kein Wert ermittelt werden kann. Nutzsignal wird permanent mit der Ungültigkeitskennung befüllt.), 1=Signalwert ist gültig und abgesichert und plausibilisiert (QU_AVL_RPM_WHL_Signalwert_ist_gueltig_und_abgesichert_und_plausibilisiert) (Ist der zugehörige Raddrehzahlsensor i.O. geprüft, so wird der Qualifier auf diesem Zustand gesetzt.), 9=Reserved (QU_AVL_RPM_WHL_Reserved), 2=Reserved (QU_AVL_RPM_WHL_Reserved_2), 10=Reserved (QU_AVL_RPM_WHL_Reserved_3), 3=Reserved (QU_AVL_RPM_WHL_Reserved_4), 11=Signalqualität bzw. Überwachung eingeschränkt, Zustand/Status temporär (QU_AVL_RPM_WHL_Signalqualitaet_bzw_Ueberwachung_eingeschraenkt_Zustand_Status_temporaer) (Implementierungsinfo des DSC-8 Bosch-Systems: Wird gelegt, wenn bei gesetzter Rollenerkennung des ICM-Q/L die Anfahrüberwachung des DSC zuschlägt.), 4=Ersatzwert ist im Nutzsignal gesetzt (QU_AVL_RPM_WHL_Ersatzwert_ist_im_Nutzsignal_gesetzt) (Wird gelegt, solange keine gültige Drehrichtung erkannt wurde. (z.B. Stillstand) Kann nur bei Sensoren mit Drehrichtungserkennung gesetzt werden.), 12=Ersatzwert ist im Nutzsignal gesetzt Zustand / Status Temporär (QU_AVL_RPM_WHL_Ersatzwert_ist_im_Nutzsignal_gesetzt_Zustand_Status_Temporaer) (Nutzsignal liefert das aktuelle Rohsignal mit eingeschränkter Qualität (es kann zu Abweichungen kommen). Der Übergang zum "Signalwert ist gültig" (0001) erfolgt über eine Einschwingphase (ca. 300ms) Kann auftreten während bzw. nach Unterspannung am Raddrehzahlsensor (DSC) In der PL6 wird dieser Code nicht verwendet.), 6=Wert_nicht_verfuegbar_Fehler_elektrisch (QU_AVL_RPM_WHL_Wert_nicht_verfuegbar_Fehler_elektrisch) (Im Fehlerfall wird abhängig von der Ursache entweder 0110 (Schwerpunkt: elektrische Fehler mit Reparaturbedarf) oder 1110 (Schwerpunkt: Plausibilitätsfehler ohne Reparaturbedarf) gesendet. Die Umsetzung ist produktlinienspezifisch unterschiedlich. Nutzsignal wird permanent mit der Ungültigkeitskennung befüllt.), 14=Wert_nicht_verfuegbar_Plausibilitaetsfehler (QU_AVL_RPM_WHL_Wert_nicht_verfuegbar_Plausibilitaetsfehler) (Im Fehlerfall wird abhängig von der Ursache entweder 0110 (Schwerpunkt: elektrische Fehler mit Reparaturbedarf) oder 1110 (Schwerpunkt: Plausibilitätsfehler ohne Reparaturbedarf) gesendet. Die Umsetzung ist produktlinienspezifisch unterschiedlich. Nutzsignal wird permanent mit der Ungültigkeitskennung befüllt.), 7=Reserved (QU_AVL_RPM_WHL_Reserved_5), 15=Signal ungültig (QU_AVL_RPM_WHL_Signal_ungueltig) (Kann nur vom Gateway gesetzt werden)
  compu method QU_AVL_STMOM_DV_ACT: 8=Initialisierung (QU_AVL_STMOM_DV_ACT_Initialisierung) (Tritt während der Initialisierungsphase auf (Vorbefüllung). Nutzsignal wird permanent mit Nutzwert 0 befüllt.), 1=Signalwert ist gültig und abgesichert und plausibilisiert (QU_AVL_STMOM_DV_ACT_Signalwert_ist_gueltig_und_abgesichert_und_plausibilisiert) (The TSU works properly and the two torque signals are close enough to be plausible), 14=Signalwert ist ungültig, Zustand/Status temporär (QU_AVL_STMOM_DV_ACT_Signalwert_ist_ungueltig_Zustand_Status_temporaer) (Das zugehörige Nutzsignal wird permanent mit der Ungültigkeitskennung befüllt. The communication with the TSU or the TSU itself is wrong or because of some other reason the TSU signals are not good Wird in der L6 nicht verwendet), 6=Signalwert ist ungültig (QU_AVL_STMOM_DV_ACT_Signalwert_ist_ungueltig) (Wird in der L6 verwendet für die Ungültigkeitskennung des Signalwert Das zugehörige Nutzsignal wird permanent mit der Ungültigkeitskennung befüllt.), 15=Signal ungültig (QU_AVL_STMOM_DV_ACT_Signal_ungueltig) (Wird funktional nicht versendet)
  compu method QU_DGR_AISP_ENERG: 0=Degradationsstufe 0 (QU_DGR_AISP_ENERG_Degradationsstufe_0) (Keine Anlaufverzögerung oder Anlaufunterbrechung des Kompressors Incl. Default- und Aufstartwert), 1=Degradationsstufe 1 (QU_DGR_AISP_ENERG_Degradationsstufe_1) (Geringe Anlaufverzögerung (Geringe Aufweitung der Anregelschwellen, keine Anlaufsperre oder -unterbrechung)), 2=Degradationsstufe 2 (QU_DGR_AISP_ENERG_Degradationsstufe_2) (Mittlere Anlaufverzögerung (Mittlere Aufweitung der Anregelschwellen, keine Anlaufsperre oder -unterbrechung)), 3=Degradationsstufe 3 (QU_DGR_AISP_ENERG_Degradationsstufe_3) (Maximale Anlaufverzögerung (Maximale Aufweitung der Anregelschwellen, keine Anlaufsperre oder -unterbrechung)), 4=Degradationsstufe 4 (QU_DGR_AISP_ENERG_Degradationsstufe_4) (Anlaufsperre für definierte Zeitspanne oder Anlaufunterbrechung), 15=Signal ungültig (QU_DGR_AISP_ENERG_Signal_ungueltig)
  compu method QU_FN_ENSU_SFY: mask 240: 144=Sichere_Energieversorgung_aktiv (QU_FN_ENSU_SFY_Sichere_Energieversorgung_aktiv) (Zustand der sicheren Energieversorgung: Die sichere Energieversorgung ist aktiv, es liegt kein Fehler oder Vorwarnung vor.), mask 240: 176=Sichere_Energieversorgung_aktiv_Vorwarnung (QU_FN_ENSU_SFY_Sichere_Energieversorgung_aktiv_Vorwarnung) (Zustand der sicheren Energieversorgung: Die sichere Energieversorgung ist aktiv, es liegt eine Vorwarnung vor. Der Zustand kann wieder in _aktiv zurückwechseln oder in _nicht_verfügbar_Fehler wechseln.), mask 15: 0=Sichere_Energieversorgung_Klasse_0 (QU_FN_ENSU_SFY_Sichere_Energieversorgung_Klasse_0) (Zusätzlich zum Zustand die Klasse der sicheren Energieversorgung: Es ist keine spezielle Ausprägung der sicheren Energieversorgung angefordert und umgesetzt. Die Klassen sind weder pauschal disjunkt noch pauschal überschneidend oder pauschal inkludierend.), mask 15: 1=Sichere_Energieversorgung_Klasse_1 (QU_FN_ENSU_SFY_Sichere_Energieversorgung_Klasse_1) (Zusätzlich zum Zustand die Klasse der sicheren Energieversorgung: Es ist eine spezielle Ausprägung der sicheren Energieversorgung angefordert und umgesetzt. Die Klassen sind weder pauschal disjunkt noch pauschal überschneidend oder pauschal inkludierend.), mask 15: 2=Sichere_Energieversorgung_Klasse_2 (QU_FN_ENSU_SFY_Sichere_Energieversorgung_Klasse_2) (Zusätzlich zum Zustand die Klasse der sicheren Energieversorgung: Es ist eine spezielle Ausprägung der sicheren Energieversorgung angefordert und umgesetzt. Die Klassen sind weder pauschal disjunkt noch pauschal überschneidend oder pauschal inkludierend.), mask 15: 3=Sichere_Energieversorgung_Klasse_3 (QU_FN_ENSU_SFY_Sichere_Energieversorgung_Klasse_3) (Zusätzlich zum Zustand die Klasse der sicheren Energieversorgung: Es ist eine spezielle Ausprägung der sicheren Energieversorgung angefordert und umgesetzt. Die Klassen sind weder pauschal disjunkt noch pauschal überschneidend oder pauschal inkludierend.), mask 15: 4=Sichere_Energieversorgung_Klasse_4 (QU_FN_ENSU_SFY_Sichere_Energieversorgung_Klasse_4) (Zusätzlich zum Zustand die Klasse der sicheren Energieversorgung: Es ist eine spezielle Ausprägung der sicheren Energieversorgung angefordert und umgesetzt. Die Klassen sind weder pauschal disjunkt noch pauschal überschneidend oder pauschal inkludierend.), mask 15: 5=Sichere_Energieversorgung_Klasse_5 (QU_FN_ENSU_SFY_Sichere_Energieversorgung_Klasse_5) (Zusätzlich zum Zustand die Klasse der sicheren Energieversorgung: Es ist eine spezielle Ausprägung der sicheren Energieversorgung angefordert und umgesetzt. Die Klassen sind weder pauschal disjunkt noch pauschal überschneidend oder pauschal inkludierend.), mask 240: 96=Sichere_Energieversorgung_nicht_verfuegbar_Fehler (QU_FN_ENSU_SFY_Sichere_Energieversorgung_nicht_verfuegbar_Fehler) (Zustand der sicheren Energieversorgung: Die sichere Energieversorgung ist nicht verfügbar, weil ein Fehler vorliegt.), mask 255: 254=Funktion_meldet_Fehler (QU_FN_ENSU_SFY_Funktion_meldet_Fehler) (Sendefunktion in Betrieb, meldet Fehler), mask 255: 255=Signal_unbefuellt (QU_FN_ENSU_SFY_Signal_unbefuellt) (Sendefunktion nicht in Betrieb)
  compu method QU_FN_EST: 128=Initialisierung (QU_FN_EST_Initialisierung) (EPS Initialisierungszustand), 160=Funktion verfügbar - Aktiv, 12V EPS (QU_FN_EST_Funktion_verfuegbar_Aktiv_12V_EPS) (12V EPS / EPS im Normalzustand), 164=Funktion verfügbar - Aktiv, 12V EAS (QU_FN_EST_Funktion_verfuegbar_Aktiv_12V_EAS) (12V EAS / EPS im Normalzustand.), 168=Funktion verfügbar - Aktiv, 24V EAS (QU_FN_EST_Funktion_verfuegbar_Aktiv_24V_EAS) (24V EAS / EPS im Normalzustand), 162=Funktion verfügbar - Aktiv, Notfallfunktion Umwelteinflüsse - Aktiv (QU_FN_EST_Funktion_verfuegbar_Aktiv_Notfallfunktion_Umwelteinfluesse_Aktiv) (Diese Codierung wird ab SP2015 verwendet: Notfallfunktion zur Reduzierung Liegenbleiber aufgrund von Umwelteinflüssen aktiv), 49=Funktion in Rückfallebene (QU_FN_EST_Funktion_in_Rueckfallebene) (24V EAS / Kl.30 Abfall von 24V -> 12V Ritzelwinkelschnittstelle soll nicht zur Verfügung stehen => Service nicht verfügbar, Fahrdynamikschnittstelle verfügbar Heilung im aktuellen Zündungszyklus nicht möglich), 51=Funktion in Rückfallebene, Notfallfunktion Umwelteinflüsse- Aktiv (QU_FN_EST_Funktion_in_Rueckfallebene_Notfallfunktion_Umwelteinfluesse_Aktiv) (Diese Codierung wird ab SP2015 verwendet: 24V EAS / Kl.30 Abfall von 24V -> 12V Zusätzlich ist die Notfallfunktion zur Reduzierung Liegenbleiber aufgrund von Umwelteinflüssen aktiv. Ritzelwinkelschnittstelle soll nicht zur Verfügung stehen => Service nicht verfügbar, Fahrdynamikschnittstelle verfügbar Heilung im aktuellen Zündungszyklus nicht möglich), 176=Funktion temporär in Rückfallebene (QU_FN_EST_Funktion_temporaer_in_Rueckfallebene) (Unterstützungslevel < Schwellwert (z.B. 70%) Heilung im aktuellen Zündungszyklus möglich), 178=Funktion temporär in Rückfallebene, Notfallfunktion Umwelteinflüsse- Aktiv (QU_FN_EST_Funktion_temporaer_in_Rueckfallebene_Notfallfunktion_Umwelteinfluesse_Aktiv) (Diese Codierung wird ab SP2015 verwendet: Unterstützungslevel < Schwellwert (z.B. 70%) Zusätzlich ist die Notfallfunktion zur Reduzierung Liegenbleiber aufgrund von Umwelteinflüssen aktiv. Heilung im aktuellen Zündungszyklus möglich), 96=Funktion nicht verfügbar - Fehler (QU_FN_EST_Funktion_nicht_verfuegbar_Fehler) (EPS Zustand = Fehler Heilung im aktuellen Zündungszyklus nicht möglich), 224=Funktion nicht verfügbar - ausgeschaltet (QU_FN_EST_Funktion_nicht_verfuegbar_ausgeschaltet) (Wird gesetzt zum Beispiel kurzfristig nach dem Zustand "Initialisierung", im KL.15N Nachlauf, im Werkmodus,...), 255=Signal ungültig (QU_FN_EST_Signal_ungueltig) (Wird Funktional nicht versendet.)
  compu method QU_FN_FDR: mask 3848: 512=Funktion verfügbar und bereit, nicht aktiv, Schlupfschwellen normal (QU_FN_FDR_Funktion_verfuegbar_und_bereit_nicht_aktiv_Schlupfschwellen_normal), mask 3848: 520=Funktion verfügbar und bereit, nicht aktiv, Schlupfschwellen aufgeweitet (QU_FN_FDR_Funktion_verfuegbar_und_bereit_nicht_aktiv_Schlupfschwellen_aufgeweitet), mask 3856: 2576=Funktion verfügbar und aktiv, FDR Regeleingriff VL (QU_FN_FDR_Funktion_verfuegbar_und_aktiv_FDR_Regeleingriff_VL), mask 3872: 2592=Funktion verfügbar und aktiv, FDR Regeleingriff VR (QU_FN_FDR_Funktion_verfuegbar_und_aktiv_FDR_Regeleingriff_VR), mask 3904: 2624=Funktion verfügbar und aktiv, FDR Regeleingriff HL (QU_FN_FDR_Funktion_verfuegbar_und_aktiv_FDR_Regeleingriff_HL), mask 3968: 2688=Funktion verfügbar und aktiv, FDR Regeleingriff HR (QU_FN_FDR_Funktion_verfuegbar_und_aktiv_FDR_Regeleingriff_HR), mask 3848: 2560=Funktion verfügbar und aktiv, Schlupfschwellen normal (QU_FN_FDR_Funktion_verfuegbar_und_aktiv_Schlupfschwellen_normal), mask 3848: 2568=Funktion verfügbar und aktiv, Schlupfschwellen aufgeweitet (QU_FN_FDR_Funktion_verfuegbar_und_aktiv_Schlupfschwellen_aufgeweitet), mask 3840: 1536=Funktion nicht verfügbar: Fehler (QU_FN_FDR_Funktion_nicht_verfuegbar_Fehler), mask 3840: 3584=Funktion nicht verfügbar: Ausgeschaltet (QU_FN_FDR_Funktion_nicht_verfuegbar_Ausgeschaltet) (Diese Codierung wird versendet wenn mind. eine dieser Bedingungen erfüllt ist: Initialisierungsphase des SG (Vorbefüllung), Zündung=aus, Motorstart, INITAusblendung aktiv, Funktion über DTC-Taster deaktiviert), mask 3840: 2048=reserviert (QU_FN_FDR_reserviert), mask 3840: 512=reserviert (QU_FN_FDR_reserviert_2), mask 3848: 768=reserviert (QU_FN_FDR_reserviert_3), mask 3848: 776=reserviert (QU_FN_FDR_reserviert_4), mask 4095: 4095=Signal ungültig (QU_FN_FDR_Signal_ungueltig) (Nutzung nur vom Gateway, nicht seitens Sender-SG)
  compu method QU_FN_VIB_EPS: 1=Funktion_verfuegbar_nicht_aktiv (QU_FN_VIB_EPS_Funktion_verfuegbar_nicht_aktiv) (Funktion EPS-Lenkradvibration ist verfügbar, Vibration ist aber nicht aktiv.), 9=Funktion_verfuegbar_aktiv (QU_FN_VIB_EPS_Funktion_verfuegbar_aktiv) (Funktion EPS-Lenkradvibration ist verfügbar und Vibration ist aktiv), 14=Funktion_nicht_verfuegbar (QU_FN_VIB_EPS_Funktion_nicht_verfuegbar) (Funktion EPS-Lenkradvibration ist temporär nicht verfügbar Dieser Zustand stellt sich dann ein, wenn die Funktion aufgrund eines EPS-internen Fehlers oder einer Degradation vorübergehend nicht zur Verfügung gestellt werden kann.), 6=Fehler (QU_FN_VIB_EPS_Fehler) (Funktion EPS-Lenkradvibration ist dauerhaft nicht verfügbar Dieser Zustand stellt sich dann ein, wenn die Funktion aufgrund eines EPS-internen Fehlers oder einer Degradation in dem aktuellen Klemme15-Zyklus nicht mehr zur Verfügung gestellt werden kann.), 15=Signal_unbefuellt (QU_FN_VIB_EPS_Signal_unbefuellt) (Sendefunktion nicht in Betrieb)
  compu method QU_SER_STMOM_STMOM_DV_ACT: 128=Schnittstelle wird initialisiert (QU_SER_STMOM_STMOM_DV_ACT_Schnittstelle_wird_initialisiert) (Wird beim Hochfahren des Steuergerätes gesetzt (Vorbefüllung).), 32=Schnittstelle verfügbar / funktionsbereit ohne Zusatzdämpfung (QU_SER_STMOM_STMOM_DV_ACT_Schnittstelle_verfuegbar_funktionsbereit_ohne_Zusatzdaempfung) (Schnittsstelle verfügbar/funktionsbereit.), 34=Schnittstelle verfügbar / funktionsbereit mit Zusatzdämpfung (QU_SER_STMOM_STMOM_DV_ACT_Schnittstelle_verfuegbar_funktionsbereit_mit_Zusatzdaempfung) (Wird bei EPS mit Dämpfungfunktion versendet.), 33=Schnittstelle aktiv - Zusatzdämpfung nicht verfügbar (QU_SER_STMOM_STMOM_DV_ACT_Schnittstelle_aktiv_Zusatzdaempfung_nicht_verfuegbar) (Schnittstelle aktiv (ohne Zusatzdämpfung)), 35=Schnittstelle aktiv - Zusatzdämpfung verfügbar (QU_SER_STMOM_STMOM_DV_ACT_Schnittstelle_aktiv_Zusatzdaempfung_verfuegbar) (Wird bei EPS mit Dämpfungfunktion versendet.), 96=Service nicht verfügbar - Fehler (QU_SER_STMOM_STMOM_DV_ACT_Service_nicht_verfuegbar_Fehler) (EPS Zustand = Fehler.), 224=Service nicht verfügbar - Standby - PMA (QU_SER_STMOM_STMOM_DV_ACT_Service_nicht_verfuegbar_Standby_PMA) (PMA aktiv deshalb Fahrdynamik Schnittstelle inaktiv.), 225=Service nicht verfügbar - Standby - EPS Status (QU_SER_STMOM_STMOM_DV_ACT_Service_nicht_verfuegbar_Standby_EPS_Status) (Wird verwendet für alle andere EPS Zustände als: -Verfügbar -Fehler Fahrdynamik Schnittstelle inaktiv.), 255=Signal ungültig (QU_SER_STMOM_STMOM_DV_ACT_Signal_ungueltig) (Wird Funktional nicht versendet.)
  compu method QU_ST_CON_VEH: 2=Signalwert gültig (QU_ST_CON_VEH_Signalwert_gueltig), 3=Signalwert eingeschränkt gültig (QU_ST_CON_VEH_Signalwert_eingeschraenkt_gueltig), 6=Reserviert für die nicht umgesetzte Kennung "Fehler" (QU_ST_CON_VEH_Reserviert_fuer_die_nicht_umgesetzte_Kennung_Fehler_) (Codierung wird nicht befüllt), 14=Wert_nicht_verfuegbar (QU_ST_CON_VEH_Wert_nicht_verfuegbar) (Siehe Signalbeschreibung), 15=Signal unbefüllt (QU_ST_CON_VEH_Signal_unbefuellt)
  compu method QU_SUM_AVL_I_DRDY_SFY: 1=Wert_gueltig_abgesichert (QU_SUM_AVL_I_DRDY_SFY_Wert_gueltig_abgesichert) (Stromwert gueltig und abgesichert), 3=Wert_gueltig_eingeschraenkt (QU_SUM_AVL_I_DRDY_SFY_Wert_gueltig_eingeschraenkt) (Stromwert nicht abgesichert), 6=Wert_nicht_verfuegbar_Fehler (QU_SUM_AVL_I_DRDY_SFY_Wert_nicht_verfuegbar_Fehler) (Sendefunktion in Betrieb, Werte nicht verfügbar), 14=Wert_nicht_verfuegbar (QU_SUM_AVL_I_DRDY_SFY_Wert_nicht_verfuegbar) (Sendefunktion in Betrieb, meldet Fehler), 15=Signal_unbefuellt (QU_SUM_AVL_I_DRDY_SFY_Signal_unbefuellt) (Sendefunktion nicht in Betrieb)
  compu method QU_TAR_DMPNG_ADDON_STMOM_FTAX: 1=Sollwert Zusatzdämpfung nicht umsetzen (QU_TAR_DMPNG_ADDON_STMOM_FTAX_Sollwert_Zusatzdaempfung_nicht_umsetzen), 2=Sollwert Zusatzdämpfung umsetzen (QU_TAR_DMPNG_ADDON_STMOM_FTAX_Sollwert_Zusatzdaempfung_umsetzen), 15=Signal unbefüllt (QU_TAR_DMPNG_ADDON_STMOM_FTAX_Signal_unbefuellt) (Wird nicht aktiv gesetzt)
  compu method QU_TAR_FACT_STMOM_FTAX: 2=Sollwerte umsetzen (QU_TAR_FACT_STMOM_FTAX_Sollwerte_umsetzen) (Es wird ein Lenkmoment angefordert.), 7=Sollwerte nicht vorhanden (QU_TAR_FACT_STMOM_FTAX_Sollwerte_nicht_vorhanden) (Wird immer gesetzt wenn keine EPS verbaut ist.), 14=Standby: Sollwerte nicht umsetzen (QU_TAR_FACT_STMOM_FTAX_Standby_Sollwerte_nicht_umsetzen) (Es wird kein Moment angefordert. Wird auch im Fehlerfall gesetzt.), 15=Signal ungültig (QU_TAR_FACT_STMOM_FTAX_Signal_ungueltig) (Wird nicht aktiv gesetzt)
  compu method QU_TAR_QTA_STMOM_DV: 2=Sollwerte umsetzen (QU_TAR_QTA_STMOM_DV_Sollwerte_umsetzen) (Es wird ein Lenkmoment angefordert.), 7=Sollwerte nicht vorhanden (QU_TAR_QTA_STMOM_DV_Sollwerte_nicht_vorhanden) (Wird gesendet, wenn die Funktion auscodiert ist. Wird immer gesetzt wenn keine EPS verbaut ist.), 14=Sollwerte nicht umsetzen - Standby (QU_TAR_QTA_STMOM_DV_Sollwerte_nicht_umsetzen_Standby) (Es wird kein Moment angefordert.), 15=Signal ungültig (QU_TAR_QTA_STMOM_DV_Signal_ungueltig) (Wird nicht aktiv gesetzt)
  compu method QU_TAR_STMOM_DV_ACT: 2=Sollwerte umsetzen (QU_TAR_STMOM_DV_ACT_Sollwerte_umsetzen) (Es wird ein Lenkmoment angefordert.), 7=Sollwerte nicht vorhanden (QU_TAR_STMOM_DV_ACT_Sollwerte_nicht_vorhanden) (Wird immer gesetzt wenn keine EPS verbaut ist), 14=Standby: Sollwerte nicht umsetzen (QU_TAR_STMOM_DV_ACT_Standby_Sollwerte_nicht_umsetzen) (Es wird kein Moment angefordert. Wird auch im Fehlerfall gesetzt.), 15=Signal ungültig (QU_TAR_STMOM_DV_ACT_Signal_ungueltig) (Wird nicht aktiv gesetzt)
  compu method QU_V_VEH_COG: 8=Initialisierung (QU_V_VEH_COG_Initialisierung) (Tritt während der Initialisierungsphase auf bis Ist-Wert verfügbar (Vorbefüllung). Nutzsignal wird permanent mit Nutzwert 0 befüllt.), 1=Signalwert ist gültig und abgesichert und plausibilisiert (QU_V_VEH_COG_Signalwert_ist_gueltig_und_abgesichert_und_plausibilisiert), 9=Reserved (QU_V_VEH_COG_Reserved), 2=Reserved (QU_V_VEH_COG_Reserved_2), 10=Signalwert ist gültig, Zustand/Status temporär (QU_V_VEH_COG_Signalwert_ist_gueltig_Zustand_Status_temporaer) (FUSI: Eine für die Berechnung der Geschwindigkeit notwendige Größe fehlt (z.B. Längsbeschleunigung, Raddrehzahl,...). Signalqualität bei instabiler Fahrt eingeschränkt. (Für sicherheitsrelevante Funktionen Anwendbarkeit des Signals prüfen.)), 3=Reserved (QU_V_VEH_COG_Reserved_3), 11=Signalqualität bzw. Überwachung eingeschränkt, Zustand/Status temporär (QU_V_VEH_COG_Signalqualitaet_bzw_Ueberwachung_eingeschraenkt_Zustand_Status_temporaer) (FUSI: Mehr als eine für die Berechnung der Geschwindigkeit notwendige Größe fehlt (z.B. Längsbeschleunigung, Raddrehzahl,...). Signalqualität bei instabiler Fahrt eingeschränkt. (Für sicherheitsrelevante Funktionen Anwendbarkeit des Signals prüfen.)), 4=Reserved (QU_V_VEH_COG_Reserved_4), 12=Reserved (QU_V_VEH_COG_Reserved_5), 6=Reserved (QU_V_VEH_COG_Reserved_6), 14=Signalwert ist ungültig, Zustand/Status temporär (QU_V_VEH_COG_Signalwert_ist_ungueltig_Zustand_Status_temporaer) (Keine Raddrehzahlen verfügbar, Berechnung der Geschwindigkeit nicht möglich. Das zugehörige Nutzsignal wird permanent mit der Ungültigkeitskennung befüllt.), 7=Reserved (QU_V_VEH_COG_Reserved_7), 15=Signal ungültig (QU_V_VEH_COG_Signal_ungueltig) (Kann nur vom Gateway gesetzt werden)
  compu method QU_VYAW_VEH: 8=Initialisierung (QU_VYAW_VEH_Initialisierung) (Tritt während der Initialisierungsphase auf bis Ist-Wert verfügbar (Vorbefüllung). Nutzsignal wird permanent mit Nutzwert 0 befüllt.), 1=Signalwert ist gültig und abgesichert und plausibilisiert (QU_VYAW_VEH_Signalwert_ist_gueltig_und_abgesichert_und_plausibilisiert) (Nutzsignal verfügbar, bereitgestellt aus zwei Sensoren (nur bei redundanter Sensorik) elektrische und Modellüberwachung i.O.), 9=Signalwert ist gültig und abgesichert, Zustand/Status temporär (QU_VYAW_VEH_Signalwert_ist_gueltig_und_abgesichert_Zustand_Status_temporaer) (Nutzsignal verfügbar, bereitgestellt aus zwei Sensoren (nur bei redundanter Sensorik) elektrische und Modellüberwachung i.O. Es liegt eine Signaltoleranz aufgrund nicht abgeschlossenen Offsetabgleichs an. FuSi : Bei sicherheitsrelevanten Funktionen ist die Fehleramplitude auszuwerten), 2=Signalwert ist gültig (QU_VYAW_VEH_Signalwert_ist_gueltig) (Nutzsignal verfügbar, bereitgestellt aus einem Sensor elektrische und Modellüberwachung i.O.), 10=Signalwert ist gültig, Zustand/Status temporär (QU_VYAW_VEH_Signalwert_ist_gueltig_Zustand_Status_temporaer) (Nutzsignal verfügbar, bereitgestellt aus einem Sensor elektrische und Modellüberwachung i.O. Es liegt eine Signaltoleranz aufgrund nicht abgeschlossenen Offsetabgleichs an. FuSi : Bei sicherheitsrelevanten Funktionen ist die Fehleramplitude auszuwerten.), 3=Signalqualität bzw. Überwachung eingeschränkt (QU_VYAW_VEH_Signalqualitaet_bzw_Ueberwachung_eingeschraenkt) (keine Modellüberwachung, da Eingangsgrößen für Überwachung fehlen (zum Bsp. Querbeschleunigung, Lenkwinkel, ...), elektrische Überwachung i.O Nutzsignal wird aus Sensorwert gebildet. FuSi: keine Verwendung für sicherheitsrelevante Funktionen), 11=Signalqualität bzw. Überwachung eingeschränkt, Zustand/Status temporär (QU_VYAW_VEH_Signalqualitaet_bzw_Ueberwachung_eingeschraenkt_Zustand_Status_temporaer) (keine Modellüberwachung, da Eingangsgrößen für Überwachung fehlen (zum Bsp. Querbeschleunigung, Lenkwinkel, ...), elektrische Überwachung i.O Es liegt eine Signaltoleranz aufgrund nicht abgeschlossenen Offsetabgleichs an. Nutzsignal wird aus Sensorwert gebildet. FuSi : Bei sicherheitsrelevanten Funktionen ist die Fehleramplitude auszuwerten), 4=Reserved (QU_VYAW_VEH_Reserved), 12=Ersatzwert: Abgleichwert ist im Nutzsignal gesetzt, Zustand/Status temporär (QU_VYAW_VEH_Ersatzwert_Abgleichwert_ist_im_Nutzsignal_gesetzt_Zustand_Status_temporaer) (elektrische Überwachung oder Modellüberwachung zeigt Fehler an, deshalb wird Ersatzwert aus Modell (Lenkwinkel) versendet FuSi: keine Verwendung für sicherheitsrelevante Funktionen), 6=Signalwert ist ungültig (QU_VYAW_VEH_Signalwert_ist_ungueltig) (elektrische Überwachung oder Modellüberwachung zeigt Fehler an, kein Ersatzwert verfügbar (Steuergerät interner Fehler). Das zugehörige Nutzsignal wird permanent mit der Ungültigkeitskennung befüllt. Diese Codierung wird ab SP2015 nicht mehr bedient.), 14=Signalwert ist ungültig, Zustand/Status temporär (QU_VYAW_VEH_Signalwert_ist_ungueltig_Zustand_Status_temporaer) (elektrische Überwachung oder Modellüberwachung zeigt Fehler an, kein Ersatzwert verfügbar (Eingangssignale Fehler). Das zugehörige Nutzsignal wird permanent mit der Ungültigkeitskennung befüllt.), 7=Reserved (QU_VYAW_VEH_Reserved_2), 15=Signal ungültig (QU_VYAW_VEH_Signal_ungueltig) (Kann nur vom Gateway gesetzt werden)
  compu method RQ_CULI: 0=Keine_Strombegrenzung (RQ_CULI_Keine_Strombegrenzung) (Keine Strombegrenzung angefordert.), 10=Maximale_Strombegrenzung (RQ_CULI_Maximale_Strombegrenzung) (Sicherheits-Strombegrenzung angefordert.), 13=Reserviert_nicht_verfuegbar (RQ_CULI_Reserviert_nicht_verfuegbar) (Hinweis: Reserviert für funktionale Kennung Signal-Tag.), 14=Reserviert_Fehler (RQ_CULI_Reserviert_Fehler) (Hinweis: Reserviert für funktionale Kennung Signal-Tag.), 15=Signal_unbefuellt (RQ_CULI_Signal_unbefuellt) (Sendefunktion nicht in Betrieb)
  compu method RQ_CULI_EST_SFY: 0=Keine_Strombegrenzung (RQ_CULI_EST_SFY_Keine_Strombegrenzung) (Keine Strombegrenzung angefordert.), 1=Komfort_Strombegrenzung (RQ_CULI_EST_SFY_Komfort_Strombegrenzung) (Strombegrenzung über ELMa angefordert.), 10=Maximale_Strombegrenzung (RQ_CULI_EST_SFY_Maximale_Strombegrenzung) (Sicherheits-Strombegrenzung angefordert.), 13=Reserviert_nicht_verfuegbar (RQ_CULI_EST_SFY_Reserviert_nicht_verfuegbar) (Hinweis: Reserviert für funktionale Kennung Signal-Tag.), 14=Reserviert_Fehler (RQ_CULI_EST_SFY_Reserviert_Fehler) (Hinweis: Reserviert für funktionale Kennung Signal-Tag.), 15=Signal_unbefuellt (RQ_CULI_EST_SFY_Signal_unbefuellt) (Sendefunktion nicht in Betrieb)
  compu method RQ_RST_OBD_DIAG: 0=Keine Anforderung Reset OBD_Diagnose (RQ_RST_OBD_DIAG_Keine_Anforderung_Reset_OBD_Diagnose), 2=Anforderung Reset OBD_Diagnose (RQ_RST_OBD_DIAG_Anforderung_Reset_OBD_Diagnose), 3=Signal ungültig (RQ_RST_OBD_DIAG_Signal_ungueltig)
  compu method RQ_STG_EFAN: 0=AUS (RQ_STG_EFAN_AUS), 1..14=Stufe, 15=Signal ungültig (RQ_STG_EFAN_Signal_ungueltig)
  compu method SECU_CHAL: phys=raw for raw >0..<255
  compu method SSS_IDENT: 0=ZGW VIN (SSS_IDENT_ZGW_VIN), 255=Signal ungültig (SSS_IDENT_Signal_ungueltig)
  compu method SSV_IDENT: 0=REF_BAC4CAN_VIN (SSV_IDENT_REF_BAC4CAN_VIN), 1=DME1 VIN (SSV_IDENT_DME1_VIN), 2=DME2 VIN (SSV_IDENT_DME2_VIN), 3=RSE VIN (SSV_IDENT_RSE_VIN) (Vorhalt), 4=KAFAS, VIN (SSV_IDENT_KAFAS_VIN) (Vorhalt), 5=DSC_Modul VIN (SSV_IDENT_DSC_Modul_VIN) (Vorhalt), 6=VDP VIN (SSV_IDENT_VDP_VIN) (Vorhalt), 7=SAS VIN (SSV_IDENT_SAS_VIN) (Vorhalt), 8=NiVi VIN (SSV_IDENT_NiVi_VIN) (Vorhalt), 9=HU_VIN (SSV_IDENT_HU_VIN) (Alle HUs), 10=EPS_VIN (SSV_IDENT_EPS_VIN) (Vorhalt), 11=REF_BAC4_FR_VIN (SSV_IDENT_REF_BAC4_FR_VIN), 19=MRR_VIN (SSV_IDENT_MRR_VIN), 20=ATM2_VIN (SSV_IDENT_ATM2_VIN), 21=Kombi_VIN (SSV_IDENT_Kombi_VIN), 255=Signal ungültig (SSV_IDENT_Signal_ungueltig)
  compu method ST_ANO_MSA_ENG_STOP: 0=Kein Ankündigung (ST_ANO_MSA_ENG_STOP_Kein_Ankuendigung) (kein MSA-Motorstopp angekündigt oder aktiv), 1=Ankündigung MSA-Motorstopp (ST_ANO_MSA_ENG_STOP_Ankuendigung_MSA_Motorstopp) (MSA-Motorstopp angekündigt oder aktiv in Durchführung), 3=Signal ungültig (ST_ANO_MSA_ENG_STOP_Signal_ungueltig)
  compu method ST_CC_EPS: 0=Rücksetzen (ST_CC_EPS_Ruecksetzen) (Betreffende CC-message wird gelöscht), 1=Setzen (ST_CC_EPS_Setzen) (CC-message display), 3=Signal ungültig (ST_CC_EPS_Signal_ungueltig)
  compu method ST_CENG_DRV: 0=Motor steht (ST_CENG_DRV_Motor_steht) (Motorstillstand anhand interner Bedingungen erkannt (z.B. Kurbelwellendrehzahl < Schwelle für bestimmte Zeit)), 1=Motor startet (ST_CENG_DRV_Motor_startet) (Startroutinen aktiv, Motor in Vorsteuerung), 2=Motor läuft (ST_CENG_DRV_Motor_laeuft) (Motor im geregelten Betrieb, Motorlauf ohne Startsystemeingriff gewährleistet), 3=Motor im Auslauf (ST_CENG_DRV_Motor_im_Auslauf) (Anforderung zum Motorabstellen (z.B. über MSA-Anforderung, Anforderung Fahrbereitschaft beenden, etc.)), 13=Funktionsschnittstelle_ist_nicht_verfuegbar (ST_CENG_DRV_Funktionsschnittstelle_ist_nicht_verfuegbar) (DME in der Initialisierung (z.B. nach Reset)), 14=Reserviert (ST_CENG_DRV_Reserviert) (Hinweis: Reserviert für funktionale Kennung Signal-Tag.), 15=Signal_unbefuellt (ST_CENG_DRV_Signal_unbefuellt) (Sendefunktion nicht in Betrieb)
  compu method ST_CON_VEH: 0=reserviert (ST_CON_VEH_reserviert), 1=Parken_BN_niO (ST_CON_VEH_Parken_BN_niO), 2=Parken_BN_iO (ST_CON_VEH_Parken_BN_iO), 3=Standfunktionen_Kunde_nicht_im_FZG (ST_CON_VEH_Standfunktionen_Kunde_nicht_im_FZG), 5=Wohnen (ST_CON_VEH_Wohnen), 7=Pruefen_Analyse_Diagnose (ST_CON_VEH_Pruefen_Analyse_Diagnose), 8=Fahrbereitschaft_herstellen (ST_CON_VEH_Fahrbereitschaft_herstellen), 10=Fahren (ST_CON_VEH_Fahren), 12=Fahrbereitschaft_beenden (ST_CON_VEH_Fahrbereitschaft_beenden), 13=reserviert (ST_CON_VEH_reserviert_2) (Hinweis: Reserviert für funktionale Kennung Signal-Tag.), 14=reserviert (ST_CON_VEH_reserviert_3) (Hinweis: Reserviert für funktionale Kennung Signal-Tag.), 15=Signal_unbefuellt (ST_CON_VEH_Signal_unbefuellt)
  compu method ST_CULI_EST: 0=Keine_Strombegrenzung (ST_CULI_EST_Keine_Strombegrenzung) (Keine Strombegrenzung aktiv.), 1=Komfort_Strombegrenzung (ST_CULI_EST_Komfort_Strombegrenzung) (Strombegrenzung über ELMa aktiv.), 10=Maximale_Strombegrenzung (ST_CULI_EST_Maximale_Strombegrenzung) (Sicherheits-Strombegrenzung aktiv), 13=Reserviert_nicht_verfuegbar (ST_CULI_EST_Reserviert_nicht_verfuegbar) (Hinweis: Reserviert für funktionale Kennung Signal-Tag.), 14=Reserviert_Fehler (ST_CULI_EST_Reserviert_Fehler) (Hinweis: Reserviert für funktionale Kennung Signal-Tag.), 15=Signal_unbefuellt (ST_CULI_EST_Signal_unbefuellt) (Sendefunktion nicht in Betrieb)
  compu method ST_DCSW: 0=Trennelement auf 24V (ST_DCSW_Trennelement_auf_24V) (Kein Fehler - Trennelement ist auf Position 24V. (bei 150W und 750W PCU)), 1=Trennelement wird auf 12V umgeschaltet werden (ST_DCSW_Trennelement_wird_auf_12V_umgeschaltet_werden) (Trennelement wird von Position 24V auf Position 12V umgeschaltet werden (bei 150W und 750W PCU)), 2=Trennelement auf 12V (ST_DCSW_Trennelement_auf_12V) (Trennelement ist auf Position 12V. (bei 150W und 750W PCU)), 3=Signal ungültig (ST_DCSW_Signal_ungueltig)
  compu method ST_DIAG_OBD_MUX_IMME: phys=raw for raw 4..60, 1=Cal-ID (software calibration identification) (ST_DIAG_OBD_MUX_IMME_Cal_ID_software_calibration_identification_), 2=CVN (software calibration verification number) (ST_DIAG_OBD_MUX_IMME_CVN_software_calibration_verification_number_), 63=Ungültig (ST_DIAG_OBD_MUX_IMME_Ungueltig) (Wird funktional nicht bedient.)
  compu method ST_DIAG_OBD_MUX_MAX: phys=raw for raw >0..<255
  compu method ST_ENERG_FZM: 0=ENSTATE_GOOD (ST_ENERG_FZM_ENSTATE_GOOD), 1=ENSTATE_OK (ST_ENERG_FZM_ENSTATE_OK), 2=ENSTATE_SHORTAGE (ST_ENERG_FZM_ENSTATE_SHORTAGE), 3=ENSTATE_SEVERE_SHORTAGE (ST_ENERG_FZM_ENSTATE_SEVERE_SHORTAGE), 15=Signal ungültig (ST_ENERG_FZM_Signal_ungueltig)
  compu method ST_ENERG_SUPY: mask 255: 0=Kein Spannungseinbruch (ST_ENERG_SUPY_Kein_Spannungseinbruch), mask 129: 1=Startspannungseinbruch auf Versorgungszweig 1 (ST_ENERG_SUPY_Startspannungseinbruch_auf_Versorgungszweig_1) (Auf Versorgungszweig 1 ist bei MSA2.3 der Starter. Bei MSA2.5 kann beim Kaltstart Versorgungszweig 1 und Versorgungszweig 2 über ein Relais verbunden werden.), mask 130: 2=Startspannungseinbruch auf Versorgungszweig 2 (ST_ENERG_SUPY_Startspannungseinbruch_auf_Versorgungszweig_2) (Auf Versorgungszweig 2 ist bei MSA2.5 der Starter. Bei den Hybriden ist die Zustarteinrichtung ebenfalls auf Versorgungszweig 2.), mask 132: 4=Spannungsversorgung 48 Volt (ST_ENERG_SUPY_Spannungsversorgung_48_Volt), mask 255: 253=Reserviert (ST_ENERG_SUPY_Reserviert) (Hinweis: Reserviert für funktionale Kennung Signal-Tag), mask 255: 254=Reserviert (ST_ENERG_SUPY_Reserviert_2) (Hinweis: Reserviert für funktionale Kennung Signal-Tag), mask 255: 255=Signal_unbefuellt (ST_ENERG_SUPY_Signal_unbefuellt) (Sendefunktion nicht in Betrieb)
  compu method ST_IDC_CC_EPS: 0=Kein Blinken (ST_IDC_CC_EPS_Kein_Blinken), 1=Langsames Blinken (ST_IDC_CC_EPS_Langsames_Blinken) (Langsamer Takt = 1 Hz), 2=Schnelles Blinken (ST_IDC_CC_EPS_Schnelles_Blinken) (Schneller Takt = 3 Hz), 3=Signal ungültig (ST_IDC_CC_EPS_Signal_ungueltig)
  compu method ST_ILK_ERRM_FZM: 0=Fehlerspeicherfreigabe (ST_ILK_ERRM_FZM_Fehlerspeicherfreigabe) (Eintrag von Fehlern uneingeschränkt), 1=Fehlerspeichersperre (ST_ILK_ERRM_FZM_Fehlerspeichersperre) (Bereich Netzwerkfehler ist zu sperren), 2=Reserve (ST_ILK_ERRM_FZM_Reserve) (reserviert für zukünftige Erweiterungen), 3=Signal ungültig (ST_ILK_ERRM_FZM_Signal_ungueltig)
  compu method ST_LDREL_GEN: 0=Keine Entlastungsfkt. Aktiv / Rücknahme (ST_LDREL_GEN_Keine_Entlastungsfkt_Aktiv_Ruecknahme), 1=iGR-High (ST_LDREL_GEN_iGR_High), 2=SULEV-Fkt (ST_LDREL_GEN_SULEV_Fkt), 3=Entlastung nach Motorstart (ST_LDREL_GEN_Entlastung_nach_Motorstart), 4=Rennstart mit oder ohne AGM Batterie (ST_LDREL_GEN_Rennstart_mit_oder_ohne_AGM_Batterie), 5=ELMOTENTL Hitze (ST_LDREL_GEN_ELMOTENTL_Hitze), 6=ELMOTENTL Kälte (ST_LDREL_GEN_ELMOTENTL_Kaelte), 7=Entlastung Anfahrschwäche wie P66,P85 (ST_LDREL_GEN_Entlastung_Anfahrschwaeche_wie_P66_P85), 8=Übertemperatur Generator (ST_LDREL_GEN_Uebertemperatur_Generator), 9=Entlastung aus Sicherheitsgründen (ST_LDREL_GEN_Entlastung_aus_Sicherheitsgruenden), 10=Entlastung Begrenzung Lagerkräfte (ST_LDREL_GEN_Entlastung_Begrenzung_Lagerkraefte), 11=Entlastung aus Komfortgründen (ST_LDREL_GEN_Entlastung_aus_Komfortgruenden), 12=Entlastung aus funktionalen Gründen (ST_LDREL_GEN_Entlastung_aus_funktionalen_Gruenden), 15=Signal ungültig (ST_LDREL_GEN_Signal_ungueltig)
  compu method ST_MOT_DRV: 0=Kein E-Maschine verfügbar (ST_MOT_DRV_Kein_E_Maschine_verfuegbar) (Keine Traktions-E-Maschine verfügbar, oder Traktions-E-Maschine(n) nicht bereit, oder elektrische Fahrbereitschaft nicht zulässig.), 1=E-Maschine ist elektrisch fahrbereit oder bereits aktiv (ST_MOT_DRV_E_Maschine_ist_elektrisch_fahrbereit_oder_bereits_aktiv) (Hochvoltsystem ist aktiv, Traktions-E-Maschine(n) bereit und elektrische Fahrbereitschaft zulässig.), 3=Signal ungültig (ST_MOT_DRV_Signal_ungueltig)
  compu method ST_OBD_CYC: mask 9: 0=Warm-Up-Zyklus nicht aktiv (ST_OBD_CYC_Warm_Up_Zyklus_nicht_aktiv), mask 9: 1=Warm-Up-Zyklus aktiv (ST_OBD_CYC_Warm_Up_Zyklus_aktiv), mask 10: 0=Driving-Zyklus nicht aktiv (ST_OBD_CYC_Driving_Zyklus_nicht_aktiv), mask 10: 2=Driving-Zyklus aktiv (ST_OBD_CYC_Driving_Zyklus_aktiv), mask 44: 0=RBM-Zyklus nicht aktiv (ST_OBD_CYC_RBM_Zyklus_nicht_aktiv), mask 44: 4=RBM-Zyklus aktiv (ST_OBD_CYC_RBM_Zyklus_aktiv), mask 44: 32=RBM-Zyklus nicht erfüllbar (ST_OBD_CYC_RBM_Zyklus_nicht_erfuellbar), mask 24: 0=Kein PFC-Zyklus (ST_OBD_CYC_Kein_PFC_Zyklus), mask 24: 16=PFC-Zyklus erfüllt (ST_OBD_CYC_PFC_Zyklus_erfuellt), mask 63: 63=Signal ungültig (ST_OBD_CYC_Signal_ungueltig)
  compu method ST_OFFS_QUAD_PINA_EPS: 0=Algorithmus (Funktion) im Sleep-Modus (ST_OFFS_QUAD_PINA_EPS_Algorithmus_Funktion_im_Sleep_Modus) (Die Funktion ist bereit aber zur Zeit nicht aktiv), 1=Offset wird ermittelt (ST_OFFS_QUAD_PINA_EPS_Offset_wird_ermittelt), 2=Offset übernehmen, Aufsetzen über Index (ST_OFFS_QUAD_PINA_EPS_Offset_uebernehmen_Aufsetzen_ueber_Index) (Kann nur gesendet werden wenn Qualifier_Ist_Position_EPS = Ersatzwert oder ab SP2013 (außer F15-F16, 444) "Signalwert ist gültig, Zustand/Status temporär"), 3=Offset übernehmen, Aufsetzen über Modelvergleich (ST_OFFS_QUAD_PINA_EPS_Offset_uebernehmen_Aufsetzen_ueber_Modelvergleich) (Kann nur gesendet werden wenn Qualifier_Ist_Position_EPS = Ersatzwert oder ab SP2013 (außer F15-F16, 444) "Signalwert ist gültig, Zustand/Status temporär"), 4=Offset übernehmen, Aufsetzen über Anschlag-Anschlag (ST_OFFS_QUAD_PINA_EPS_Offset_uebernehmen_Aufsetzen_ueber_Anschlag_Anschlag) (Kann nur gesendet werden wenn Qualifier_Ist_Position_EPS = Ersatzwert oder ab SP2013 (außer F15-F16, 444) "Signalwert ist gültig, Zustand/Status temporär"), 5=Offset übernehmen, Aufsetzen über Summenlenkwinkel (im AFS-Fall) (ST_OFFS_QUAD_PINA_EPS_Offset_uebernehmen_Aufsetzen_ueber_Summenlenkwinkel_im_AFS_Fall_) (Kann nur gesendet werden wenn Qualifier_Ist_Position_EPS = Ersatzwert oder ab SP2013 (außer F15-F16, 444) "Signalwert ist gültig, Zustand/Status temporär" Wird zurzeit nicht verwendet.), 6=Offset in Prüfung (ST_OFFS_QUAD_PINA_EPS_Offset_in_Pruefung) (Wird gesetzt nach Offset übernehmen (nicht nach Groboffset!) bzw. sofern die EPS sich selbst aufsetzen konnte und nach Offset korrigieren, während der Bestätigungsphase.), 7=Offset korrigieren (ST_OFFS_QUAD_PINA_EPS_Offset_korrigieren) (Kann nur gesendet werden wenn Qualifier_Ist_Position_EPS = "Gültig" oder "Gültig und Abgesichert"), 8=Initialisierung (ST_OFFS_QUAD_PINA_EPS_Initialisierung) (wird im aller ersten Rechenzyklus gesetzt (10ms)), 9=Restoffset wird ermittelt (ST_OFFS_QUAD_PINA_EPS_Restoffset_wird_ermittelt) (Wird gesetzt, nachdem im Zustand "Offset wird ermittelt" erstmals nur ein Groboffset bestimmt und an die EPS gesendet werden konnte. Wird erst ab SP2013 (außer F15-F16, 444) unterstützt.), 11=Offset übernehmen, Groboffset über Modell (ST_OFFS_QUAD_PINA_EPS_Offset_uebernehmen_Groboffset_ueber_Modell) (Kann nur gesendet werden wenn Qualifier_Ist_Position_EPS = Ersatzwert Wird erst ab SP2013 (außer F15-F16, 444) unterstützt.), 15=Signal ungültig (ST_OFFS_QUAD_PINA_EPS_Signal_ungueltig) (Kann Funktional nicht gesetzt werden)
  compu method ST_UDP: 0=Kein Spannungseinbruch (ST_UDP_Kein_Spannungseinbruch) (kein Spannungseinbruch angekündigt oder aktiv), 1=Startspannungseinbruch bis maximal Spannungsschwelle 1 (ST_UDP_Startspannungseinbruch_bis_maximal_Spannungsschwelle_1) (Spannungseinbruch bis Schwelle 1 aktiv (z.B. Ankündigung vor Einbruch, bei Ansteuerung Startsystem, Nachlauf nach Abwurf Startsystem bis Normalisierung des BN-Niveaus) Siehe GS95024-2-1 (Kap. 4.11.2.2) Warmstart), 2=Startspannungseinbruch bis maximal Spannungsschwelle 2 (ST_UDP_Startspannungseinbruch_bis_maximal_Spannungsschwelle_2) (Spannungseinbruch bis Schwelle 2 aktiv (z.B. Ankündigung vor Einbruch, bei Ansteuerung Startsystem, Nachlauf nach Abwurf Startsystem bis Normalisierung des BN-Niveaus) Siehe GS95024-2-1 (Kap. 4.11.2.1) Kaltstart), 13=Funktionsschnittstelle_ist_nicht_verfuegbar (ST_UDP_Funktionsschnittstelle_ist_nicht_verfuegbar) (DME in der Initialisierung (z.B. nach Reset)), 14=Reserviert (ST_UDP_Reserviert) (Hinweis: Reserviert für funktionale Kennung Signal-Tag.), 15=Signal_unbefuellt (ST_UDP_Signal_unbefuellt) (Sendefunktion nicht in Betrieb)
  compu method ST_V_VEH_NSS: 12=Fahrzeug im stillstandsnahen Bereich (ST_V_VEH_NSS_Fahrzeug_im_stillstandsnahen_Bereich) (Dieser Zustand wird eingenommen wenn sowohl die Fahrzeuggeschwindigkeit (V_VEH_COG) als auch die 4 Einzelradgeschwindigkeit 10 kmh unterschreiten.), 13=Fahrzeug nicht im stillstandsnahen Bereich (ST_V_VEH_NSS_Fahrzeug_nicht_im_stillstandsnahen_Bereich) (Dieser Zustand wird eingenommen wenn das Fahrzeug sich nicht sicher im stillstandsnahen Bereich befindet. Mindestens eine der 5 Geschwindigkeiten, Fahrzeuggeschwindigkeit (V_VEH_COG) oder Einzelradgeschwindigkeiten, überschreitet die Schwelle von 10 kmh. Das heißt das Fahrzeug kann eine beliebige Geschwindigkeit aufweisen, auch unter 10 kmh. Es bedeutet nicht zwangsläufig dass das Fahrzeug schneller als 10kmh fährt.), 15=Signal ungültig (ST_V_VEH_NSS_Signal_ungueltig) (Dieser Zustand wird beim Aufstarten des Steuergeräts gesetzt bis ein gültiger Wert bereit gestellt werden kann. Während des laufenden Betriebs kann dieser Zustand eingenommen werden, wenn die Raddrehzahlen nicht zur Verfügung stehen.)
  compu method STMOM_QTA_DV: phys=raw*0.005-10 for raw >0..<255; unit Nm
  compu method STU_8_BYTE: phys=raw for raw >0..<255
  compu method STU_RESP: phys=raw for raw >0..<255
  compu method SU_CLU_STMOM_SFE_DXP: 1=Ultrahart (SU_CLU_STMOM_SFE_DXP_Ultrahart), 2=Sportlich ausgewogen (SU_CLU_STMOM_SFE_DXP_Sportlich_ausgewogen), 3=Ausgewogen (SU_CLU_STMOM_SFE_DXP_Ausgewogen), 4=Weich (SU_CLU_STMOM_SFE_DXP_Weich), 13=Funktionsschnittstelle_ist_nicht_verfuegbar (SU_CLU_STMOM_SFE_DXP_Funktionsschnittstelle_ist_nicht_verfuegbar) (Sendefunktion in Betrieb, Werte nicht verfügbar), 14=Funktion_meldet_Fehler (SU_CLU_STMOM_SFE_DXP_Funktion_meldet_Fehler) (Sendefunktion in Betrieb, meldet Fehler), 15=Signal_unbefuellt (SU_CLU_STMOM_SFE_DXP_Signal_unbefuellt) (Sendefunktion nicht in Betrieb)
  compu method TAR_STMOM_DV_ACT: phys=raw*0.006-12 for raw >0..<255; unit Nm
  compu method TEMP_CPO_HET_MNG: phys=raw-48 for raw 0..252, 253=Reserviert (TEMP_CPO_HET_MNG_Reserviert) (Hinweis: Reserviert für funktionale Kennung Signal-Tag.), 254=Reserviert (TEMP_CPO_HET_MNG_Reserviert_2) (Hinweis: Reserviert für funktionale Kennung Signal-Tag.), 255=Signal_unbefuellt (TEMP_CPO_HET_MNG_Signal_unbefuellt) (Sendefunktion nicht in Betrieb); unit °C
  compu method TOT_STR_EPS: phys=raw*0.012213 for raw >0..<255
  compu method TRANF_CC_EPS: phys=raw for raw >0..<255; unit s
  compu method TRGG_ENGTORQ_EPS: phys=raw*0.01-10 for raw 0..2000, 4093=Funktionsschnittstelle_ist_nicht_verfuegbar (TRGG_ENGTORQ_EPS_Funktionsschnittstelle_ist_nicht_verfuegbar) (Sendefunktion in Betrieb, Werte nicht verfügbar), 4094=Funktion_meldet_Fehler (TRGG_ENGTORQ_EPS_Funktion_meldet_Fehler) (Sendefunktion in Betrieb, meldet Fehler), 4095=Signal_unbefuellt (TRGG_ENGTORQ_EPS_Signal_unbefuellt) (Sendefunktion nicht in Betrieb); unit Nm
  compu method UI_32_noIniVal_noDflVal_4294967295_1_0_noEnc_hasRng: phys=raw for raw >0..<255; unit s
  compu method UI_8_noIniVal_noDflVal_255_0_50s_MI_40_noEnc_hasRng: phys=raw*0.5-40 for raw >0..<255; unit °C
  compu method UN_PO_EPS: 0=Ritzelschnittstelle (UN_PO_EPS_Ritzelschnittstelle) (Die Position wird in Grad übertragen.), 1=Zahnstangenhubschnittstelle (UN_PO_EPS_Zahnstangenhubschnittstelle) (Die Position wird in Millimeter übertragen (Einheit=0.2mm).), 3=Signal ungültig (UN_PO_EPS_Signal_ungueltig)
  compu method UN_TOT_STR_EPS: 0=Ritzelschnittstelle (UN_TOT_STR_EPS_Ritzelschnittstelle) (Die Position wird in Grad übertragen), 1=Zahnstangenhubschnittstelle (UN_TOT_STR_EPS_Zahnstangenhubschnittstelle) (Die Position wird in Millimeter übertragen (Einheit: 0.2mm)), 3=Signal ungültig (UN_TOT_STR_EPS_Signal_ungueltig)
  compu method V_VEH_COG: phys=raw/64 for raw >0..<255; unit km/h
  compu method VYAW_VEH: phys=raw*0.005-163.84 for raw >0..<255; unit °/s
  compu method VYAW_VEH_ERR_AMP: phys=raw*0.0125 for raw >0..<255; unit °/s
package /BMW/SystemDescription/DataConstrs
  range ACLNY_COG: phys -65..65, raw 0..65535
  range ACLNY_COG_ERR_AMP: phys 0..20, raw 0..4095
  range ACTVN_FN_ESTP_VIRT_FTAX: raw 0..15
  range ALIV_4_BIT_UInt: phys 0..14, raw 0..15
  range ALIV_4_BIT_Unsigned_Integer: phys 0..14, raw 0..15
  range ALIV_COU_4: raw 0..15
  range ALIV_COU_V: raw 0..15
  range AVL_FORC_GRD: phys -17..17, raw 0..4095
  range AVL_PINA_EPS: phys -1439.9560546875..1439.9560546875, raw 0..65535
  range AVL_PINA_IDX_ICM: phys -1439.9560546875..1439.9560546875, raw 0..65535
  range AVL_PWR_EL: phys -12..12, raw 0..255
  range AVL_RPM_WHL: phys -400..400, raw 0..65535
  range AVL_STEA_PNI_OFFS: phys -45..45, raw 0..4095
  range CHL_4_UInt: phys 0..14, raw 0..15
  range COU_BS_RESP: phys 0..16777214, raw 0..16777215
  range CRC_V_VEH: phys 0..255, raw 0..255
  range CRC8: phys 0..255, raw 0..255
  range CTR_BS_PRTNT: raw 0..15
  range CTR_DEAC_EPS_FNS: raw 0..15
  range CTR_ERRM_BN_U: raw 0..63
  range CTR_WARN_DIR_VIB_EPS: raw 0..3
  range CTR_WARN_ILVL_VIB_EPS: raw 0..15
  range CTR_WARN_PTRN_VIB_EPS: raw 0..15
  range DBG_8Bit: raw 0..255
  range DIAG_ST_OBD: raw 0..63
  range DVCO_VEH: raw 0..7
  range ENERG_AVAI_ARS: phys 0..100, raw 0..255
  range FACT_ASS_STMOM_FTAX: phys 1..1.9921875, raw 0..255
  range FACT_CTRR_STMOM_FTAX: phys 0.0078125..1, raw 0..255
  range FACT_DMPNG_ADDON_STMOM_FTAX: phys 0..2, raw 0..255
  range FACT_MO_STE_SO_DXP: phys 0..5, raw 0..255
  range FKTN_PRTNT: raw 0..4294967295
  range I_SPEC_ARS: phys 0..252, raw 0..255
  range ID_FN_INQY: raw 0..65535
  range ID_FN_RQ_STG_EFAN: raw 0..255
  range ID_TEMP_CPO_HET_MNG: raw 0..15
  range IDX_TORQ_SEN: raw 0..3
  range MILE_KM: phys 0..16777214, raw 0..16777215
  range MIN_I_SPEC_ARS: phys -252..0, raw 0..255
  range NO_CC_EPS: phys 0..65534, raw 0..65535
  range NO_VECH_{1..7}: raw 0..255
  range OFFS_GRD_MID_EPS: phys -89.9560546875..89.9560546875, raw 0..4095
  range OFFS_QUAD_PINA_EPS: phys -127..127, raw 0..255
  range QU_ACLNY_COG: raw 0..15
  range QU_AVL_FORC_GRD: raw 0..15
  range QU_AVL_PINA_EPS: raw 0..15
  range QU_AVL_RPM_WHL: raw 0..15
  range QU_AVL_STMOM_DV_ACT: raw 0..15
  range QU_DGR_AISP_ENERG: raw 0..15
  range QU_FN_ENSU_SFY: raw 0..255
  range QU_FN_EST: raw 0..255
  range QU_FN_FDR: raw 0..4095
  range QU_FN_VIB_EPS: raw 0..15
  range QU_SER_STMOM_STMOM_DV_ACT: raw 0..255
  range QU_ST_CON_VEH: raw 0..15
  range QU_SUM_AVL_I_DRDY_SFY: raw 0..15
  range QU_TAR_DMPNG_ADDON_STMOM_FTAX: raw 0..15
  range QU_TAR_FACT_STMOM_FTAX: raw 0..15
  range QU_TAR_QTA_STMOM_DV: raw 0..15
  range QU_TAR_STMOM_DV_ACT: raw 0..15
  range QU_V_VEH_COG: raw 0..15
  range QU_VYAW_VEH: raw 0..15
  range RQ_CULI: raw 0..15
  range RQ_CULI_EST_SFY: raw 0..15
  range RQ_RST_OBD_DIAG: raw 0..3
  range RQ_STG_EFAN: raw 0..15
  range SECU_CHAL: raw 0..1099511627775
  range SSS_IDENT: raw 0..255
  range SSV_IDENT: raw 0..255
  range ST_ANO_MSA_ENG_STOP: raw 0..3
  range ST_CC_EPS: raw 0..3
  range ST_CENG_DRV: raw 0..15
  range ST_CON_VEH: raw 0..15
  range ST_CULI_EST: raw 0..15
  range ST_DCSW: raw 0..3
  range ST_DIAG_OBD_MUX_IMME: phys 4..60, raw 0..63
  range ST_DIAG_OBD_MUX_MAX: phys 4..60, raw 0..63
  range ST_ENERG_FZM: raw 0..15
  range ST_ENERG_SUPY: raw 0..255
  range ST_IDC_CC_EPS: raw 0..3
  range ST_ILK_ERRM_FZM: raw 0..3
  range ST_LDREL_GEN: raw 0..15
  range ST_MOT_DRV: raw 0..3
  range ST_OBD_CYC: raw 0..63
  range ST_OFFS_QUAD_PINA_EPS: raw 0..15
  range ST_UDP: raw 0..15
  range ST_V_VEH_NSS: raw 0..15
  range STMOM_QTA_DV: phys -10..10, raw 0..4095
  range STU_8_BYTE: raw 0..18446744073709551615
  range STU_RESP: raw 0..16777215
  range SU_CLU_STMOM_SFE_DXP: raw 0..15
  range TAR_STMOM_DV_ACT: phys -12..12, raw 0..4095
  range TEMP_CPO_HET_MNG: phys -48..204, raw 0..255
  range TOT_STR_EPS: phys 0..50, raw 0..4095
  range TRANF_CC_EPS: phys 0..14, raw 0..15
  range TRGG_ENGTORQ_EPS: phys -10..10, raw 0..4095
  range UI_32_noIniVal_noDflVal_4294967295_1_0_noEnc_hasRng: phys 0..4294967294, raw 0..4294967295
  range UI_8_noIniVal_noDflVal_255_0_50s_MI_40_noEnc_hasRng: phys -40..85, raw 0..255
  range UN_PO_EPS: raw 0..3
  range UN_TOT_STR_EPS: raw 0..3
  range V_VEH_COG: phys 0..350, raw 0..65535
  range VYAW_VEH: phys -163.84..163.83, raw 0..65535
  range VYAW_VEH_ERR_AMP: phys 0..50, raw 0..4095
package /BMW/SystemDescription/Units
  15 x unit, all with factor-si-to-unit=1, offset-si-to-unit=0:
    ampere: display-name=A
    degree_celsius: display-name=°C
    degree_per_second: display-name=°/s
    kilometer: display-name=km
    kilometer_per_hour: display-name=km/h
    kilonewton: display-name=kN
    kilowatt: display-name=kW
    liter: display-name=l
    meter_per_second_squared: display-name=m/s²
    millisecond: display-name=ms
    newton_meter: display-name=Nm
    no_unit
    percent: display-name=%
    radian_per_second: display-name=rad/s
    second: display-name=s
package /Predefined_DEV/ImplementationDataTypes
  impl type Dem_UdsStatusByteType: compu {mask 1: 1=DEM_UDS_STATUS_TF, mask 2: 2=DEM_UDS_STATUS_TFTOC, mask 4: 4=DEM_UDS_STATUS_PDTC, mask 8: 8=DEM_UDS_STATUS_CDTC, mask 16: 16=DEM_UDS_STATUS_TNCSLC, mask 32: 32=DEM_UDS_STATUS_TFSLC, mask 64: 64=DEM_UDS_STATUS_TNCTOC, mask 128: 128=DEM_UDS_STATUS_WIR}, range raw 0..255, implementation-data-type=uint8
  impl type NvM_RequestResultType: compu {0=NVM_REQ_OK, 1=NVM_REQ_NOT_OK, 2=NVM_REQ_PENDING, 3=NVM_REQ_INTEGRITY_FAILED, 4=NVM_REQ_BLOCK_SKIPPED, 5=NVM_REQ_NV_INVALIDATED, 6=NVM_REQ_CANCELED, 7=NVM_REQ_REDUNDANCY_FAILED, 8=NVM_REQ_RESTORED_FROM_ROM}, implementation-data-type=uint8
  impl type NvM_ServiceIdType: compu {6=NVM_READ_BLOCK, 7=NVM_WRITE_BLOCK, 8=NVM_RESTORE_BLOCK_DEFAULTS, 9=NVM_ERASE_BLOCK, 11=NVM_INVALIDATE_NV_BLOCK, 12=NVM_READ_ALL}, implementation-data-type=uint8
