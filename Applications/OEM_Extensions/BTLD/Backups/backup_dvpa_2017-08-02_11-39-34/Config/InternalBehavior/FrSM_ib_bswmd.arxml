AUTOSAR XML (schema 4-3-0)
package /MICROSAR/FrSM_ib_bswmd/BswModuleDescriptions
  bsw module description FrSM: provided-entrys=FrSM_MainFunction_0
    bsw internal behavior FrSMBehavior
      4 x exclusive area:
        FRSM_EXCLUSIVE_AREA_{0..3}
      bsw schedulable entity FrSM_MainFunction_0: implemented-entry=FrSM_MainFunction_0
      bsw timing event FrSM_MainFunction_0TimingEvent0: starts-on-event=FrSM_MainFunction_0, period=0.005
  bsw module entry FrSM_MainFunction_0: call-type=SCHEDULED, execution-context=TASK
