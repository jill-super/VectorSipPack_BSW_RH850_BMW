AUTOSAR XML (schema 4-3-0)
package /MICROSAR/PduR_ib_bswmd/BswModuleDescriptions
  bsw module description PduR
    bsw internal behavior PduRBehavior
      exclusive area PDUR_EXCLUSIVE_AREA_0
      exclusive area PDUR_EXCLUSIVE_AREA_1
