AUTOSAR XML (schema 4-3-0)
package /MICROSAR/Fr_V85xEray_ib_bsmwd/BswModuleDescriptions
  bsw module description Fr
    bsw internal behavior Fr_V85xErayBehavior
      exclusive area FR_EXCLUSIVE_AREA_0
      exclusive area FR_EXCLUSIVE_AREA_1
