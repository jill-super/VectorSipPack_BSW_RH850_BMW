AUTOSAR XML (schema 4-3-0)
# \copyright BMW AG 2016 - 2017
package /BMW/Platform/IntegrationSample/DataTypeMappingSets
  data type mapping set IntegrationSampleModemappingSimpleTimerMode: mode-request-type-map{implementation-data-type=IntegrationSample_SimpleTimerStateType, mode-group=IntegrationSample_SimpleTimerState}
package /BMW/Platform/IntegrationSample/ImplementationDataTypes
  impl type IntegrationSample_SimpleTimerStateType: compu {0=IntegrationSample_Timer_FIRE, 1=IntegrationSample_Timer_IDLE, 2=IntegrationSample_Timer_RUNNING}, implementation-data-type=uint8
package /BMW/Platform/IntegrationSample/ModeDeclarationGroups
  mode declaration group IntegrationSample_SimpleTimerState: category=EXPLICIT_ORDER, initial-mode=IntegrationSample_Timer_IDLE, on-transition-value=3
    mode IntegrationSample_Timer_IDLE: value=0
    mode IntegrationSample_Timer_RUNNING: value=1
    mode IntegrationSample_Timer_FIRE: value=2
package /BMW/Platform/IntegrationSample/PortInterfaces
  mode switch interface ISimpleTimer
    mode group SimpleTimerMode: sw-calibration-access=READ-ONLY, type=IntegrationSample_SimpleTimerState
