AUTOSAR XML (schema 4-3-0)
package /ActiveEcuC
  module config Nrv: implementation-config-variant=VARIANT-PRE-COMPILE
    CommonPublishedInformation: SwMajorVersion=5, SwMinorVersion=0, SwPatchVersion=3
    NrvGeneral: NrvReadFromDest=(uint8)destination[offset]
