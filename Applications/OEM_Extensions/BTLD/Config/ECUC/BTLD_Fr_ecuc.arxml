AUTOSAR XML (schema 4-3-0)
package /ActiveEcuC
  module config Fr: implementation-config-variant=VARIANT-PRE-COMPILE, module-description=Fr_Impl
    FrMultipleConfiguration
      contr_EPS_A_FlexRay (FrController):
        FrPAllowHaltDueToClock = true
        FrPAllowPassiveToActive = 0
        FrPChannels = FR_CHANNEL_A
        FrPClusterDriftDamping = 2
        FrPDecodingCorrection = 48
        FrPDelayCompensationA = 1
        FrPDelayCompensationB = 1
        FrPKeySlotId = 0
        FrPKeySlotOnlyEnabled = false
        FrPKeySlotUsedForStartup = true
        FrPKeySlotUsedForSync = true
        FrPLatestTx = 269
        FrPMacroInitialOffsetA = 3
        FrPMacroInitialOffsetB = 3
        FrPMicroInitialOffsetA = 6
        FrPMicroInitialOffsetB = 6
        FrPMicroPerCycle = 200000
        FrPOffsetCorrectionOut = 126
        FrPOffsetCorrectionStart = 3632
        FrPPayloadLengthDynMax = 60
        FrPRateCorrectionOut = 121
        FrPSamplesPerMicrotick = N2SAMPLES
        FrPWakeupChannel = FR_CHANNEL_A
        FrPWakeupPattern = 33
        FrPdAcceptedStartupRange = 212
        FrPdListenTimeout = 400242
        FrPdMicrotick = T25NS
        FrCtrlIdx = 0
        FrPExternalSync = false
        FrPFallBackInternal = false
        FrPNmVectorEarlyUpdate = false
        FrPSecondKeySlotId = 0
        FrPTwoKeySlotMode = false
        FrStrobePointPosition = SAMPLE_5
        FrStatusIRQLine = LINE_0
        FrErrorIRQLine = LINE_1
        FrAbsoluteTimer: FrAbsTimerIdx=0
        FrControllerDemEventParameterRefs: FrDemCtrlTestResultRef=AutoCreatedDemEvent_contr_EPS_A_FlexRay_FrDemCtrlTestResultRef
    FrGeneral:
      FrAbsoluteTimerDisable = false
      FrRuntimeMeasurementSupport = false
      FrBufferReconfig = false
      FrCtrlTestCount = 1
      FrCycleStartInterrupt = true
      FrDevErrorDetect = true
      FrEnableMsgIdFiltering = false
      FrFIFOSupport = false
      FrHardwareCancellationEnable = false
      FrIndex = 0
      FrNumCtrlSupported = 1
      FrRxStringentCheck = false
      FrRxStringentLengthCheck = false
      FrSingleChannelAPI = false
      FrTimeoutDurationFactor = 0
      FrTimer0Interrupt = true
      FrTypeOfInterruptFunction = Category2
      FrUseAsmFunctionOptimization = false
      FrVersionInfoApi = false
      FrSafeBswChecks = true
