AUTOSAR XML (schema 4-3-0)
package /ActiveEcuC
  module config FrSM: implementation-config-variant=VARIANT-PRE-COMPILE, module-description=FrSM_Impl
    FrSMGeneral: FrSMDevErrorDetect=true, FrSMVersionInfoApi=false
      FrSMGeneration: FrSMOutOfBoundsWriteSanitizer=false, FrSMOutOfBoundsReadSanitizer=false
    FrSMConfig
      A_FlexRay_5b5a9ac2 (FrSMCluster):
        FrSMCheckWakeupReason = false
        FrSMDelayStartupWithoutWakeup = false
        FrSMDurationT1 = 0.005
        FrSMDurationT2 = 0.05
        FrSMDurationT3 = 0.5
        FrSMIsColdstartEcu = true
        FrSMIsWakeupEcu = true
        FrSMMainFunctionCycleTime = 0.005
        FrSMNumWakeupPatterns = 1
        FrSMStartupRepetitionsUnlimited = false
        FrSMStartupRepetitionsWithWakeupUnlimited = false
        FrSMStartupRepetitionsWithWakeup = 0
        FrSMStartupRepetitions = 0
        FrSMComMNetworkHandleRef = A_FlexRay_5b5a9ac2
        FrSMFrIfClusterRef = A_FlexRay
        FrSMClusterDemEventParameterRefs:
          FRSM_E_CLUSTER_STARTUP = AutoCreatedDemEvent_A_FlexRay_5b5a9ac2_FRSM_E_CLUSTER_STARTUP
          FRSM_E_CLUSTER_SYNC_LOSS = AutoCreatedDemEvent_A_FlexRay_5b5a9ac2_FRSM_E_CLUSTER_SYNC_LOSS
