AUTOSAR XML (schema 4-3-0)
package /ActiveEcuC
  module config Dem: implementation-config-variant=VARIANT-PRE-COMPILE, module-description=Dem_Impl
    DemGeneral:
      DemAgingCycleCounterProcessing = DEM_PROCESS_AGINGCTR_INTERN
      DemGeneralInterfaceSupport = false
      DemClearDTCLimitation = DEM_ALL_SUPPORTED_DTCS
      DemDataElementDefaultEndianness = LITTLE_ENDIAN
      DemAgingRequieresTestedCycle = false
      DemMaxNumberEventEntryMirror = 0
      DemPTOSupport = false
      DemTriggerMonitorInitBeforeClearOk = true
      DemExtendedDataCapture = DEM_TRIGGER_EVENT_MEMORY_STORAGE
      DemFreezeFrameCapture = DEM_TRIGGER_EVENT_MEMORY_STORAGE
      DemOperationCycleProcessing = DEM_PROCESS_OPCYC_STATE
      DemMaxNumberTimeSeriesSnapshots = 0
      DemEventMemoryEntryStorageTrigger = DEM_STORAGE_ON_TEST_FAILED
      DemResetConfirmedBitOnOverflow = true
      DemPendingDtcProcessing = DEM_PROCESS_PDTC_STOREDONLY
      DemWarningIndicatorRequestedProcessing = DEM_PROCESS_WIR_STOREDONLY
      DemExtendedDataVisibility = DEM_VISIBILITY_STOREDONLY
      DemEventDisplacementFallbackStrategy = DEM_FALLBACK_DISCARD_NEW_EVENT
      DemAgingRetainEnvironmentalData = false
      DemClearDTCBehavior = DEM_CLRRESP_NONVOLATILE_FINISH
      DemAvailabilitySupport = DEM_NO_AVAILABILITY
      DemAvailabilityStorage = false
      DemBswErrorBufferSize = 0
      DemDebounceCounterBasedSupport = true
      DemDebounceTimeBasedSupport = false
      DemDevErrorDetect = true
      DemDtcStatusAvailabilityMask = 255
      DemEnableConditionSupport = false
      DemEventCombinationSupport = DEM_EVCOMB_DISABLED
      DemEventDisplacementStrategy = DEM_DISPLACEMENT_LEGACY_403
      DemMaxNumberEventEntryOBDFreezeFrame = 0
      DemMaxNumberEventEntryPermanent = 0
      DemMaxNumberEventEntryPrimary = 8
      DemMaxNumberEventEntrySecondary = 0
      DemMaxNumberPrestoredFF = 0
      DemOBDSupport = DEM_OBD_NO_OBD_SUPPORT
      DemOccurrenceCounterProcessing = DEM_PROCESS_OCCCTR_TF
      DemOperationCycleStatusStorage = false
      DemStatusBitHandlingTestFailedSinceLastClear = DEM_STATUS_BIT_NORMAL
      DemStatusBitStorageTestFailed = true
      DemStorageConditionSupport = false
      DemSuppressionSupport = DEM_NO_SUPPRESSION
      DemTaskTime = 0.01
      DemTriggerDcmReports = false
      DemTriggerDltReports = false
      DemTriggerFiMReports = false
      DemTriggerMonitorInitForEnableConditions = false
      DemTypeOfDTCSupported = DEM_DTC_TRANSLATION_ISO14229_1
      DemTypeOfFreezeFrameRecordNumeration = DEM_FF_RECNUM_CALCULATED
      DemVersionInfoApi = false
      DemBswApiVersion = DEM_BSW_API_4_XX_XX
      DemBswApiVersionNvM = DEM_BSW_API_4_XX_XX
      DemBswApiVersionFiM = DEM_BSW_API_4_XX_XX
      DemAgingAfterHealing = DEM_AGING_WHILE_HEALING
      DemAgingBehavior = DEM_AGING_TYPE_1
      DemAgingCounterBehavior = DEM_AGING_COUNT_ALWAYS
      DemAgingCounterReporting = DEM_AGING_NORMAL_REPORTING
      DemCompiledPostbuildCrc = 4260228531
      DemCompiledPostbuildCrcMode = DEM_POSTBUILD_CRC_AUTOMATIC
      DemGeneralDiagnosticInfoSupport = true
      DemJ1939Support = false
      DemNvSynchronizeSupport = false
      DemResetDebounceBehavior = DEM_RESET_DEBOUNCE_ON_DISABLE_ENABLE_CONDITIONS
      DemResetTestFailedOnOperationCycleStart = false
      DemRetryStorageSupport = false
      DemSafeBswChecks = false
      DemUseMemcopyMacros = false
      DemUseRte = true
      DemUserControlledWirBehavior = DEM_DISABLED_DURING_CONTROLDTCSETTING
      DemUserDefinedCompareAndSwap = false
      DemUseNvm = false
      DemUserConfigFile = 
      DemEventMemorySet
      DemOperationCycle: DemOperationCycleAutomaticEnd=false, DemOperationCycleAutostart=false, DemOperationCycleType=DEM_OPCYC_OTHER
      DemPostbuild: DemEventAvailableDefaultSupport=true, DemMaxSizeFreezeFrame=0, DemMaxNumberDtr=0
      DemClient_BTLD (DemClient): DemClientId=0
    DemConfigSet
      30 x DemEventParameter, all with DemEventTimeSeries=DEM_TIMESERIES_SNAPSHOT_NONE, DemEventAvailable=true, DemEventAvailableInVariant=true, DemEventLatchTestFailed=false:
        DemEventParameter: DemEventId=1, DemEventKind=DEM_EVENT_KIND_SWC
          DemEventClass:
            DemAgingAllowed = false
            DemConsiderPtoStatus = false
            DemEventDestination = DEM_DTC_ORIGIN_PRIMARY_MEMORY
            DemEventPriority = 2
            DemFFPrestorageSupported = false
            DemOperationCycleRef = DemOperationCycle
            DemDebounceAlgorithmClass
              DemDebounceCounterBased:
                DemDebounceBehavior = DEM_DEBOUNCE_FREEZE
                DemDebounceCounterDecrementStepSize = 1
                DemDebounceCounterFailedThreshold = 127
                DemDebounceCounterIncrementStepSize = 1
                DemDebounceCounterJumpDown = true
                DemDebounceCounterJumpDownValue = 0
                DemDebounceCounterJumpUp = true
                DemDebounceCounterJumpUpValue = 0
                DemDebounceCounterPassedThreshold = -128
                DemDebounceCounterStorage = false
                DemDebounceContinuous = false
        AutoCreatedDemEvent_EcuMConfiguration_ECUM_E_ALL_RUN_REQUESTS_KILLED: DemEventId=20, DemEventKind=DEM_EVENT_KIND_BSW
          DemEventClass:
            DemAgingAllowed = false
            DemConsiderPtoStatus = false
            DemEventDestination = DEM_DTC_ORIGIN_PRIMARY_MEMORY
            DemEventPriority = 2
            DemFFPrestorageSupported = false
            DemOperationCycleRef = DemOperationCycle
            DemDebounceAlgorithmClass
              DemDebounceCounterBased:
                DemDebounceBehavior = DEM_DEBOUNCE_FREEZE
                DemDebounceCounterDecrementStepSize = 1
                DemDebounceCounterFailedThreshold = 127
                DemDebounceCounterIncrementStepSize = 1
                DemDebounceCounterJumpDown = true
                DemDebounceCounterJumpDownValue = 0
                DemDebounceCounterJumpUp = true
                DemDebounceCounterJumpUpValue = 0
                DemDebounceCounterPassedThreshold = -128
                DemDebounceCounterStorage = false
                DemDebounceContinuous = false
        AutoCreatedDemEvent_EcuMConfiguration_ECUM_E_CONFIGURATION_DATA_INCONSISTENT: DemEventId=21, DemEventKind=DEM_EVENT_KIND_BSW
          DemEventClass:
            DemAgingAllowed = false
            DemConsiderPtoStatus = false
            DemEventDestination = DEM_DTC_ORIGIN_PRIMARY_MEMORY
            DemEventPriority = 2
            DemFFPrestorageSupported = false
            DemOperationCycleRef = DemOperationCycle
            DemDebounceAlgorithmClass
              DemDebounceCounterBased:
                DemDebounceBehavior = DEM_DEBOUNCE_FREEZE
                DemDebounceCounterDecrementStepSize = 1
                DemDebounceCounterFailedThreshold = 127
                DemDebounceCounterIncrementStepSize = 1
                DemDebounceCounterJumpDown = true
                DemDebounceCounterJumpDownValue = 0
                DemDebounceCounterJumpUp = true
                DemDebounceCounterJumpUpValue = 0
                DemDebounceCounterPassedThreshold = -128
                DemDebounceCounterStorage = false
                DemDebounceContinuous = false
        AutoCreatedDemEvent_EcuMConfiguration_ECUM_E_RAM_CHECK_FAILED: DemEventId=23, DemEventKind=DEM_EVENT_KIND_BSW
          DemEventClass:
            DemAgingAllowed = false
            DemConsiderPtoStatus = false
            DemEventDestination = DEM_DTC_ORIGIN_PRIMARY_MEMORY
            DemEventPriority = 2
            DemFFPrestorageSupported = false
            DemOperationCycleRef = DemOperationCycle
            DemDebounceAlgorithmClass
              DemDebounceCounterBased:
                DemDebounceBehavior = DEM_DEBOUNCE_FREEZE
                DemDebounceCounterDecrementStepSize = 1
                DemDebounceCounterFailedThreshold = 127
                DemDebounceCounterIncrementStepSize = 1
                DemDebounceCounterJumpDown = true
                DemDebounceCounterJumpDownValue = 0
                DemDebounceCounterJumpUp = true
                DemDebounceCounterJumpUpValue = 0
                DemDebounceCounterPassedThreshold = -128
                DemDebounceCounterStorage = false
                DemDebounceContinuous = false
        AutoCreatedDemEvent_EcuMConfiguration_ECUM_E_IMPROPER_CALLER: DemEventId=22, DemEventKind=DEM_EVENT_KIND_BSW
          DemEventClass:
            DemAgingAllowed = false
            DemConsiderPtoStatus = false
            DemEventDestination = DEM_DTC_ORIGIN_PRIMARY_MEMORY
            DemEventPriority = 2
            DemFFPrestorageSupported = false
            DemOperationCycleRef = DemOperationCycle
            DemDebounceAlgorithmClass
              DemDebounceCounterBased:
                DemDebounceBehavior = DEM_DEBOUNCE_FREEZE
                DemDebounceCounterDecrementStepSize = 1
                DemDebounceCounterFailedThreshold = 127
                DemDebounceCounterIncrementStepSize = 1
                DemDebounceCounterJumpDown = true
                DemDebounceCounterJumpDownValue = 0
                DemDebounceCounterJumpUp = true
                DemDebounceCounterJumpUpValue = 0
                DemDebounceCounterPassedThreshold = -128
                DemDebounceCounterStorage = false
                DemDebounceContinuous = false
        AutoCreatedDemEvent_FlsConfigSet_FLS_E_COMPARE_FAILED: DemEventId=24, DemEventKind=DEM_EVENT_KIND_BSW
          DemEventClass:
            DemAgingAllowed = false
            DemConsiderPtoStatus = false
            DemEventDestination = DEM_DTC_ORIGIN_PRIMARY_MEMORY
            DemEventPriority = 2
            DemFFPrestorageSupported = false
            DemOperationCycleRef = DemOperationCycle
            DemDebounceAlgorithmClass
              DemDebounceCounterBased:
                DemDebounceBehavior = DEM_DEBOUNCE_FREEZE
                DemDebounceCounterDecrementStepSize = 1
                DemDebounceCounterFailedThreshold = 127
                DemDebounceCounterIncrementStepSize = 1
                DemDebounceCounterJumpDown = true
                DemDebounceCounterJumpDownValue = 0
                DemDebounceCounterJumpUp = true
                DemDebounceCounterJumpUpValue = 0
                DemDebounceCounterPassedThreshold = -128
                DemDebounceCounterStorage = false
                DemDebounceContinuous = false
        AutoCreatedDemEvent_FlsConfigSet_FLS_E_ERASE_FAILED: DemEventId=25, DemEventKind=DEM_EVENT_KIND_BSW
          DemEventClass:
            DemAgingAllowed = false
            DemConsiderPtoStatus = false
            DemEventDestination = DEM_DTC_ORIGIN_PRIMARY_MEMORY
            DemEventPriority = 2
            DemFFPrestorageSupported = false
            DemOperationCycleRef = DemOperationCycle
            DemDebounceAlgorithmClass
              DemDebounceCounterBased:
                DemDebounceBehavior = DEM_DEBOUNCE_FREEZE
                DemDebounceCounterDecrementStepSize = 1
                DemDebounceCounterFailedThreshold = 127
                DemDebounceCounterIncrementStepSize = 1
                DemDebounceCounterJumpDown = true
                DemDebounceCounterJumpDownValue = 0
                DemDebounceCounterJumpUp = true
                DemDebounceCounterJumpUpValue = 0
                DemDebounceCounterPassedThreshold = -128
                DemDebounceCounterStorage = false
                DemDebounceContinuous = false
        AutoCreatedDemEvent_FlsConfigSet_FLS_E_READ_FAILED: DemEventId=26, DemEventKind=DEM_EVENT_KIND_BSW
          DemEventClass:
            DemAgingAllowed = false
            DemConsiderPtoStatus = false
            DemEventDestination = DEM_DTC_ORIGIN_PRIMARY_MEMORY
            DemEventPriority = 2
            DemFFPrestorageSupported = false
            DemOperationCycleRef = DemOperationCycle
            DemDebounceAlgorithmClass
              DemDebounceCounterBased:
                DemDebounceBehavior = DEM_DEBOUNCE_FREEZE
                DemDebounceCounterDecrementStepSize = 1
                DemDebounceCounterFailedThreshold = 127
                DemDebounceCounterIncrementStepSize = 1
                DemDebounceCounterJumpDown = true
                DemDebounceCounterJumpDownValue = 0
                DemDebounceCounterJumpUp = true
                DemDebounceCounterJumpUpValue = 0
                DemDebounceCounterPassedThreshold = -128
                DemDebounceCounterStorage = false
                DemDebounceContinuous = false
        AutoCreatedDemEvent_FlsConfigSet_FLS_E_UNEXPECTED_FLASH_ID: DemEventId=27, DemEventKind=DEM_EVENT_KIND_BSW
          DemEventClass:
            DemAgingAllowed = false
            DemConsiderPtoStatus = false
            DemEventDestination = DEM_DTC_ORIGIN_PRIMARY_MEMORY
            DemEventPriority = 2
            DemFFPrestorageSupported = false
            DemOperationCycleRef = DemOperationCycle
            DemDebounceAlgorithmClass
              DemDebounceCounterBased:
                DemDebounceBehavior = DEM_DEBOUNCE_FREEZE
                DemDebounceCounterDecrementStepSize = 1
                DemDebounceCounterFailedThreshold = 127
                DemDebounceCounterIncrementStepSize = 1
                DemDebounceCounterJumpDown = true
                DemDebounceCounterJumpDownValue = 0
                DemDebounceCounterJumpUp = true
                DemDebounceCounterJumpUpValue = 0
                DemDebounceCounterPassedThreshold = -128
                DemDebounceCounterStorage = false
                DemDebounceContinuous = false
        AutoCreatedDemEvent_FlsConfigSet_FLS_E_WRITE_FAILED: DemEventId=28, DemEventKind=DEM_EVENT_KIND_BSW
          DemEventClass:
            DemAgingAllowed = false
            DemConsiderPtoStatus = false
            DemEventDestination = DEM_DTC_ORIGIN_PRIMARY_MEMORY
            DemEventPriority = 2
            DemFFPrestorageSupported = false
            DemOperationCycleRef = DemOperationCycle
            DemDebounceAlgorithmClass
              DemDebounceCounterBased:
                DemDebounceBehavior = DEM_DEBOUNCE_FREEZE
                DemDebounceCounterDecrementStepSize = 1
                DemDebounceCounterFailedThreshold = 127
                DemDebounceCounterIncrementStepSize = 1
                DemDebounceCounterJumpDown = true
                DemDebounceCounterJumpDownValue = 0
                DemDebounceCounterJumpUp = true
                DemDebounceCounterJumpUpValue = 0
                DemDebounceCounterPassedThreshold = -128
                DemDebounceCounterStorage = false
                DemDebounceContinuous = false
        AutoCreatedDemEvent_contr_EPS_A_FlexRay_FrDemCtrlTestResultRef: DemEventId=30, DemEventKind=DEM_EVENT_KIND_BSW
          DemEventClass:
            DemAgingAllowed = false
            DemConsiderPtoStatus = false
            DemEventDestination = DEM_DTC_ORIGIN_PRIMARY_MEMORY
            DemEventPriority = 2
            DemFFPrestorageSupported = false
            DemOperationCycleRef = DemOperationCycle
            DemDebounceAlgorithmClass
              DemDebounceCounterBased:
                DemDebounceBehavior = DEM_DEBOUNCE_FREEZE
                DemDebounceCounterDecrementStepSize = 1
                DemDebounceCounterFailedThreshold = 127
                DemDebounceCounterIncrementStepSize = 1
                DemDebounceCounterJumpDown = true
                DemDebounceCounterJumpDownValue = 0
                DemDebounceCounterJumpUp = true
                DemDebounceCounterJumpUpValue = 0
                DemDebounceCounterPassedThreshold = -128
                DemDebounceCounterStorage = false
                DemDebounceContinuous = false
        AutoCreatedDemEvent_A_FlexRay_FRIF_E_ACS_CH_A: DemEventId=14, DemEventKind=DEM_EVENT_KIND_BSW
          DemEventClass:
            DemAgingAllowed = false
            DemConsiderPtoStatus = false
            DemEventDestination = DEM_DTC_ORIGIN_PRIMARY_MEMORY
            DemEventPriority = 2
            DemFFPrestorageSupported = false
            DemOperationCycleRef = DemOperationCycle
            DemDebounceAlgorithmClass
              DemDebounceCounterBased:
                DemDebounceBehavior = DEM_DEBOUNCE_FREEZE
                DemDebounceCounterDecrementStepSize = 1
                DemDebounceCounterFailedThreshold = 127
                DemDebounceCounterIncrementStepSize = 1
                DemDebounceCounterJumpDown = true
                DemDebounceCounterJumpDownValue = 0
                DemDebounceCounterJumpUp = true
                DemDebounceCounterJumpUpValue = 0
                DemDebounceCounterPassedThreshold = -128
                DemDebounceCounterStorage = false
                DemDebounceContinuous = false
        AutoCreatedDemEvent_A_FlexRay_FRIF_E_ACS_CH_B: DemEventId=15, DemEventKind=DEM_EVENT_KIND_BSW
          DemEventClass:
            DemAgingAllowed = false
            DemConsiderPtoStatus = false
            DemEventDestination = DEM_DTC_ORIGIN_PRIMARY_MEMORY
            DemEventPriority = 2
            DemFFPrestorageSupported = false
            DemOperationCycleRef = DemOperationCycle
            DemDebounceAlgorithmClass
              DemDebounceCounterBased:
                DemDebounceBehavior = DEM_DEBOUNCE_FREEZE
                DemDebounceCounterDecrementStepSize = 1
                DemDebounceCounterFailedThreshold = 127
                DemDebounceCounterIncrementStepSize = 1
                DemDebounceCounterJumpDown = true
                DemDebounceCounterJumpDownValue = 0
                DemDebounceCounterJumpUp = true
                DemDebounceCounterJumpUpValue = 0
                DemDebounceCounterPassedThreshold = -128
                DemDebounceCounterStorage = false
                DemDebounceContinuous = false
        AutoCreatedDemEvent_A_FlexRay_FRIF_E_NIT_CH_A: DemEventId=16, DemEventKind=DEM_EVENT_KIND_BSW
          DemEventClass:
            DemAgingAllowed = false
            DemConsiderPtoStatus = false
            DemEventDestination = DEM_DTC_ORIGIN_PRIMARY_MEMORY
            DemEventPriority = 2
            DemFFPrestorageSupported = false
            DemOperationCycleRef = DemOperationCycle
            DemDebounceAlgorithmClass
              DemDebounceCounterBased:
                DemDebounceBehavior = DEM_DEBOUNCE_FREEZE
                DemDebounceCounterDecrementStepSize = 1
                DemDebounceCounterFailedThreshold = 127
                DemDebounceCounterIncrementStepSize = 1
                DemDebounceCounterJumpDown = true
                DemDebounceCounterJumpDownValue = 0
                DemDebounceCounterJumpUp = true
                DemDebounceCounterJumpUpValue = 0
                DemDebounceCounterPassedThreshold = -128
                DemDebounceCounterStorage = false
                DemDebounceContinuous = false
        AutoCreatedDemEvent_A_FlexRay_FRIF_E_NIT_CH_B: DemEventId=17, DemEventKind=DEM_EVENT_KIND_BSW
          DemEventClass:
            DemAgingAllowed = false
            DemConsiderPtoStatus = false
            DemEventDestination = DEM_DTC_ORIGIN_PRIMARY_MEMORY
            DemEventPriority = 2
            DemFFPrestorageSupported = false
            DemOperationCycleRef = DemOperationCycle
            DemDebounceAlgorithmClass
              DemDebounceCounterBased:
                DemDebounceBehavior = DEM_DEBOUNCE_FREEZE
                DemDebounceCounterDecrementStepSize = 1
                DemDebounceCounterFailedThreshold = 127
                DemDebounceCounterIncrementStepSize = 1
                DemDebounceCounterJumpDown = true
                DemDebounceCounterJumpDownValue = 0
                DemDebounceCounterJumpUp = true
                DemDebounceCounterJumpUpValue = 0
                DemDebounceCounterPassedThreshold = -128
                DemDebounceCounterStorage = false
                DemDebounceContinuous = false
        AutoCreatedDemEvent_A_FlexRay_FRIF_E_SW_CH_A: DemEventId=18, DemEventKind=DEM_EVENT_KIND_BSW
          DemEventClass:
            DemAgingAllowed = false
            DemConsiderPtoStatus = false
            DemEventDestination = DEM_DTC_ORIGIN_PRIMARY_MEMORY
            DemEventPriority = 2
            DemFFPrestorageSupported = false
            DemOperationCycleRef = DemOperationCycle
            DemDebounceAlgorithmClass
              DemDebounceCounterBased:
                DemDebounceBehavior = DEM_DEBOUNCE_FREEZE
                DemDebounceCounterDecrementStepSize = 1
                DemDebounceCounterFailedThreshold = 127
                DemDebounceCounterIncrementStepSize = 1
                DemDebounceCounterJumpDown = true
                DemDebounceCounterJumpDownValue = 0
                DemDebounceCounterJumpUp = true
                DemDebounceCounterJumpUpValue = 0
                DemDebounceCounterPassedThreshold = -128
                DemDebounceCounterStorage = false
                DemDebounceContinuous = false
        AutoCreatedDemEvent_A_FlexRay_FRIF_E_SW_CH_B: DemEventId=19, DemEventKind=DEM_EVENT_KIND_BSW
          DemEventClass:
            DemAgingAllowed = false
            DemConsiderPtoStatus = false
            DemEventDestination = DEM_DTC_ORIGIN_PRIMARY_MEMORY
            DemEventPriority = 2
            DemFFPrestorageSupported = false
            DemOperationCycleRef = DemOperationCycle
            DemDebounceAlgorithmClass
              DemDebounceCounterBased:
                DemDebounceBehavior = DEM_DEBOUNCE_FREEZE
                DemDebounceCounterDecrementStepSize = 1
                DemDebounceCounterFailedThreshold = 127
                DemDebounceCounterIncrementStepSize = 1
                DemDebounceCounterJumpDown = true
                DemDebounceCounterJumpDownValue = 0
                DemDebounceCounterJumpUp = true
                DemDebounceCounterJumpUpValue = 0
                DemDebounceCounterPassedThreshold = -128
                DemDebounceCounterStorage = false
                DemDebounceContinuous = false
        AutoCreatedDemEvent_A_FlexRay_5b5a9ac2_FRSM_E_CLUSTER_STARTUP: DemEventId=12, DemEventKind=DEM_EVENT_KIND_BSW
          DemEventClass:
            DemAgingAllowed = false
            DemConsiderPtoStatus = false
            DemEventDestination = DEM_DTC_ORIGIN_PRIMARY_MEMORY
            DemEventPriority = 2
            DemFFPrestorageSupported = false
            DemOperationCycleRef = DemOperationCycle
            DemDebounceAlgorithmClass
              DemDebounceCounterBased:
                DemDebounceBehavior = DEM_DEBOUNCE_FREEZE
                DemDebounceCounterDecrementStepSize = 1
                DemDebounceCounterFailedThreshold = 127
                DemDebounceCounterIncrementStepSize = 1
                DemDebounceCounterJumpDown = true
                DemDebounceCounterJumpDownValue = 0
                DemDebounceCounterJumpUp = true
                DemDebounceCounterJumpUpValue = 0
                DemDebounceCounterPassedThreshold = -128
                DemDebounceCounterStorage = false
                DemDebounceContinuous = false
        AutoCreatedDemEvent_A_FlexRay_5b5a9ac2_FRSM_E_CLUSTER_SYNC_LOSS: DemEventId=13, DemEventKind=DEM_EVENT_KIND_BSW
          DemEventClass:
            DemAgingAllowed = false
            DemConsiderPtoStatus = false
            DemEventDestination = DEM_DTC_ORIGIN_PRIMARY_MEMORY
            DemEventPriority = 2
            DemFFPrestorageSupported = false
            DemOperationCycleRef = DemOperationCycle
            DemDebounceAlgorithmClass
              DemDebounceCounterBased:
                DemDebounceBehavior = DEM_DEBOUNCE_FREEZE
                DemDebounceCounterDecrementStepSize = 1
                DemDebounceCounterFailedThreshold = 127
                DemDebounceCounterIncrementStepSize = 1
                DemDebounceCounterJumpDown = true
                DemDebounceCounterJumpDownValue = 0
                DemDebounceCounterJumpUp = true
                DemDebounceCounterJumpUpValue = 0
                DemDebounceCounterPassedThreshold = -128
                DemDebounceCounterStorage = false
                DemDebounceContinuous = false
        AutoCreatedDemEvent_McuModuleConfiguration_MCU_E_CLOCK_FAILURE: DemEventId=29, DemEventKind=DEM_EVENT_KIND_BSW
          DemEventClass:
            DemAgingAllowed = false
            DemConsiderPtoStatus = false
            DemEventDestination = DEM_DTC_ORIGIN_PRIMARY_MEMORY
            DemEventPriority = 2
            DemFFPrestorageSupported = false
            DemOperationCycleRef = DemOperationCycle
            DemDebounceAlgorithmClass
              DemDebounceCounterBased:
                DemDebounceBehavior = DEM_DEBOUNCE_FREEZE
                DemDebounceCounterDecrementStepSize = 1
                DemDebounceCounterFailedThreshold = 127
                DemDebounceCounterIncrementStepSize = 1
                DemDebounceCounterJumpDown = true
                DemDebounceCounterJumpDownValue = 0
                DemDebounceCounterJumpUp = true
                DemDebounceCounterJumpUpValue = 0
                DemDebounceCounterPassedThreshold = -128
                DemDebounceCounterStorage = false
                DemDebounceContinuous = false
        DemEventParameter_002: DemEventId=2, DemEventKind=DEM_EVENT_KIND_SWC
          DemEventClass:
            DemAgingAllowed = false
            DemConsiderPtoStatus = false
            DemEventDestination = DEM_DTC_ORIGIN_PRIMARY_MEMORY
            DemEventPriority = 2
            DemFFPrestorageSupported = false
            DemOperationCycleRef = DemOperationCycle
            DemDebounceAlgorithmClass
              DemDebounceCounterBased:
                DemDebounceBehavior = DEM_DEBOUNCE_FREEZE
                DemDebounceCounterDecrementStepSize = 1
                DemDebounceCounterFailedThreshold = 127
                DemDebounceCounterIncrementStepSize = 1
                DemDebounceCounterJumpDown = true
                DemDebounceCounterJumpDownValue = 0
                DemDebounceCounterJumpUp = true
                DemDebounceCounterJumpUpValue = 0
                DemDebounceCounterPassedThreshold = -128
                DemDebounceCounterStorage = false
                DemDebounceContinuous = false
        DemEventParameter_003: DemEventId=3, DemEventKind=DEM_EVENT_KIND_SWC
          DemEventClass:
            DemAgingAllowed = false
            DemConsiderPtoStatus = false
            DemEventDestination = DEM_DTC_ORIGIN_PRIMARY_MEMORY
            DemEventPriority = 2
            DemFFPrestorageSupported = false
            DemOperationCycleRef = DemOperationCycle
            DemDebounceAlgorithmClass
              DemDebounceCounterBased:
                DemDebounceBehavior = DEM_DEBOUNCE_FREEZE
                DemDebounceCounterDecrementStepSize = 1
                DemDebounceCounterFailedThreshold = 127
                DemDebounceCounterIncrementStepSize = 1
                DemDebounceCounterJumpDown = true
                DemDebounceCounterJumpDownValue = 0
                DemDebounceCounterJumpUp = true
                DemDebounceCounterJumpUpValue = 0
                DemDebounceCounterPassedThreshold = -128
                DemDebounceCounterStorage = false
                DemDebounceContinuous = false
        DemEventParameter_004: DemEventId=4, DemEventKind=DEM_EVENT_KIND_SWC
          DemEventClass:
            DemAgingAllowed = false
            DemConsiderPtoStatus = false
            DemEventDestination = DEM_DTC_ORIGIN_PRIMARY_MEMORY
            DemEventPriority = 2
            DemFFPrestorageSupported = false
            DemOperationCycleRef = DemOperationCycle
            DemDebounceAlgorithmClass
              DemDebounceCounterBased:
                DemDebounceBehavior = DEM_DEBOUNCE_FREEZE
                DemDebounceCounterDecrementStepSize = 1
                DemDebounceCounterFailedThreshold = 127
                DemDebounceCounterIncrementStepSize = 1
                DemDebounceCounterJumpDown = true
                DemDebounceCounterJumpDownValue = 0
                DemDebounceCounterJumpUp = true
                DemDebounceCounterJumpUpValue = 0
                DemDebounceCounterPassedThreshold = -128
                DemDebounceCounterStorage = false
                DemDebounceContinuous = false
        DemEventParameter_005: DemEventId=5, DemEventKind=DEM_EVENT_KIND_SWC
          DemEventClass:
            DemAgingAllowed = false
            DemConsiderPtoStatus = false
            DemEventDestination = DEM_DTC_ORIGIN_PRIMARY_MEMORY
            DemEventPriority = 2
            DemFFPrestorageSupported = false
            DemOperationCycleRef = DemOperationCycle
            DemDebounceAlgorithmClass
              DemDebounceCounterBased:
                DemDebounceBehavior = DEM_DEBOUNCE_FREEZE
                DemDebounceCounterDecrementStepSize = 1
                DemDebounceCounterFailedThreshold = 127
                DemDebounceCounterIncrementStepSize = 1
                DemDebounceCounterJumpDown = true
                DemDebounceCounterJumpDownValue = 0
                DemDebounceCounterJumpUp = true
                DemDebounceCounterJumpUpValue = 0
                DemDebounceCounterPassedThreshold = -128
                DemDebounceCounterStorage = false
                DemDebounceContinuous = false
        DemEventParameter_006: DemEventId=6, DemEventKind=DEM_EVENT_KIND_SWC
          DemEventClass:
            DemAgingAllowed = false
            DemConsiderPtoStatus = false
            DemEventDestination = DEM_DTC_ORIGIN_PRIMARY_MEMORY
            DemEventPriority = 2
            DemFFPrestorageSupported = false
            DemOperationCycleRef = DemOperationCycle
            DemDebounceAlgorithmClass
              DemDebounceCounterBased:
                DemDebounceBehavior = DEM_DEBOUNCE_FREEZE
                DemDebounceCounterDecrementStepSize = 1
                DemDebounceCounterFailedThreshold = 127
                DemDebounceCounterIncrementStepSize = 1
                DemDebounceCounterJumpDown = true
                DemDebounceCounterJumpDownValue = 0
                DemDebounceCounterJumpUp = true
                DemDebounceCounterJumpUpValue = 0
                DemDebounceCounterPassedThreshold = -128
                DemDebounceCounterStorage = false
                DemDebounceContinuous = false
        DemEventParameter_007: DemEventId=7, DemEventKind=DEM_EVENT_KIND_SWC
          DemEventClass:
            DemAgingAllowed = false
            DemConsiderPtoStatus = false
            DemEventDestination = DEM_DTC_ORIGIN_PRIMARY_MEMORY
            DemEventPriority = 2
            DemFFPrestorageSupported = false
            DemOperationCycleRef = DemOperationCycle
            DemDebounceAlgorithmClass
              DemDebounceCounterBased:
                DemDebounceBehavior = DEM_DEBOUNCE_FREEZE
                DemDebounceCounterDecrementStepSize = 1
                DemDebounceCounterFailedThreshold = 127
                DemDebounceCounterIncrementStepSize = 1
                DemDebounceCounterJumpDown = true
                DemDebounceCounterJumpDownValue = 0
                DemDebounceCounterJumpUp = true
                DemDebounceCounterJumpUpValue = 0
                DemDebounceCounterPassedThreshold = -128
                DemDebounceCounterStorage = false
                DemDebounceContinuous = false
        DemEventParameter_008: DemEventId=8, DemEventKind=DEM_EVENT_KIND_SWC
          DemEventClass:
            DemAgingAllowed = false
            DemConsiderPtoStatus = false
            DemEventDestination = DEM_DTC_ORIGIN_PRIMARY_MEMORY
            DemEventPriority = 2
            DemFFPrestorageSupported = false
            DemOperationCycleRef = DemOperationCycle
            DemDebounceAlgorithmClass
              DemDebounceCounterBased:
                DemDebounceBehavior = DEM_DEBOUNCE_FREEZE
                DemDebounceCounterDecrementStepSize = 1
                DemDebounceCounterFailedThreshold = 127
                DemDebounceCounterIncrementStepSize = 1
                DemDebounceCounterJumpDown = true
                DemDebounceCounterJumpDownValue = 0
                DemDebounceCounterJumpUp = true
                DemDebounceCounterJumpUpValue = 0
                DemDebounceCounterPassedThreshold = -128
                DemDebounceCounterStorage = false
                DemDebounceContinuous = false
        DemEventParameter_009: DemEventId=9, DemEventKind=DEM_EVENT_KIND_SWC
          DemEventClass:
            DemAgingAllowed = false
            DemConsiderPtoStatus = false
            DemEventDestination = DEM_DTC_ORIGIN_PRIMARY_MEMORY
            DemEventPriority = 2
            DemFFPrestorageSupported = false
            DemOperationCycleRef = DemOperationCycle
            DemDebounceAlgorithmClass
              DemDebounceCounterBased:
                DemDebounceBehavior = DEM_DEBOUNCE_FREEZE
                DemDebounceCounterDecrementStepSize = 1
                DemDebounceCounterFailedThreshold = 127
                DemDebounceCounterIncrementStepSize = 1
                DemDebounceCounterJumpDown = true
                DemDebounceCounterJumpDownValue = 0
                DemDebounceCounterJumpUp = true
                DemDebounceCounterJumpUpValue = 0
                DemDebounceCounterPassedThreshold = -128
                DemDebounceCounterStorage = false
                DemDebounceContinuous = false
        DemEventParameter_010: DemEventId=10, DemEventKind=DEM_EVENT_KIND_SWC
          DemEventClass:
            DemAgingAllowed = false
            DemConsiderPtoStatus = false
            DemEventDestination = DEM_DTC_ORIGIN_PRIMARY_MEMORY
            DemEventPriority = 2
            DemFFPrestorageSupported = false
            DemOperationCycleRef = DemOperationCycle
            DemDebounceAlgorithmClass
              DemDebounceCounterBased:
                DemDebounceBehavior = DEM_DEBOUNCE_FREEZE
                DemDebounceCounterDecrementStepSize = 1
                DemDebounceCounterFailedThreshold = 127
                DemDebounceCounterIncrementStepSize = 1
                DemDebounceCounterJumpDown = true
                DemDebounceCounterJumpDownValue = 0
                DemDebounceCounterJumpUp = true
                DemDebounceCounterJumpUpValue = 0
                DemDebounceCounterPassedThreshold = -128
                DemDebounceCounterStorage = false
                DemDebounceContinuous = false
        DemEventParameter_011: DemEventId=11, DemEventKind=DEM_EVENT_KIND_SWC
          DemEventClass:
            DemAgingAllowed = false
            DemConsiderPtoStatus = false
            DemEventDestination = DEM_DTC_ORIGIN_PRIMARY_MEMORY
            DemEventPriority = 2
            DemFFPrestorageSupported = false
            DemOperationCycleRef = DemOperationCycle
            DemDebounceAlgorithmClass
              DemDebounceCounterBased:
                DemDebounceBehavior = DEM_DEBOUNCE_FREEZE
                DemDebounceCounterDecrementStepSize = 1
                DemDebounceCounterFailedThreshold = 127
                DemDebounceCounterIncrementStepSize = 1
                DemDebounceCounterJumpDown = true
                DemDebounceCounterJumpDownValue = 0
                DemDebounceCounterJumpUp = true
                DemDebounceCounterJumpUpValue = 0
                DemDebounceCounterPassedThreshold = -128
                DemDebounceCounterStorage = false
                DemDebounceContinuous = false
