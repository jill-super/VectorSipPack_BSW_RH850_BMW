AUTOSAR XML (schema 4-3-0)
package /ActiveEcuC
  module config Dlog: implementation-config-variant=VARIANT-PRE-COMPILE
    Features: EnableEcu=true, EnableSvkCurrent=true, EnableSvkHistory=false
    General: DevErrorDetect=true, MaxNumberOfSweGroups=8
    CommonPublishedInformation: SwMajorVersion=5, SwMinorVersion=1, SwPatchVersion=1
