AUTOSAR XML (schema 4-3-0)
package /ActiveEcuC
  module config Cal: implementation-config-variant=VARIANT-PRE-COMPILE, module-description=Cal_Impl
    CalGeneral: CalMaxAlignScalarType=32, CalVersionInfoApi=true, CalDisableNotConfiguredApis=true
    CalHash: CalHashMaxCtxBufByteSize=336
      CalHashConfig_MD5 (CalHashConfig): CalHashInitConfiguration=CplMD5Config, CalHashPrimitiveName=Cpl_MD5, CalHashIncludeFile=Cpl_MD5.h
      CalHashConfig_SHA (CalHashConfig): CalHashInitConfiguration=CplSHAConfig, CalHashPrimitiveName=Cpl_SHA, CalHashIncludeFile=Cpl_SHA.h
    CalRandomGenerate
      CalRandomGenerateConfig: CalRandomGenerateInitConfiguration=CplSSGConfig_RandomGenerate, CalRandomGeneratePrimitiveName=Cpl_SSG, CalRandomGenerateIncludeFile=Cpl_SSG.h
    CalRandomSeed: CalRandomMaxCtxBufByteSize=24
      CalRandomSeedConfig: CalRandomSeedInitConfiguration=CplSSGConfig_RandomSeed, CalRandomSeedPrimitiveName=Cpl_SSG, CalRandomSeedIncludeFile=Cpl_SSG.h
    CalSignatureVerify: CalSignatureVerifyMaxCtxBufByteSize=2048, CalSignatureVerifyMaxKeySize=2048
      CalSignatureVerifyConfig_MD5 (CalSignatureVerifyConfig):
        CalSignatureVerifyInitConfiguration = CplSigBMWVrfyConfig_MD5
        CalSignatureVerifyPrimitiveName = Cpl_SigBMWVrfy
        CalSignatureVerifyIncludeFile = Cpl_SigBMWVrfy.h
      CalSignatureVerifyConfig_SHA (CalSignatureVerifyConfig):
        CalSignatureVerifyInitConfiguration = CplSigBMWVrfyConfig_SHA
        CalSignatureVerifyPrimitiveName = Cpl_SigBMWVrfy
        CalSignatureVerifyIncludeFile = Cpl_SigBMWVrfy.h
