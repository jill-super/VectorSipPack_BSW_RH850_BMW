AUTOSAR XML (schema 4-3-0)
package /ActiveEcuC
  module config FrTp: implementation-config-variant=VARIANT-PRE-COMPILE, module-description=FrTp_Impl
    FrTpGeneral:
      FrTpAckRt = false
      FrTpChanNum = 1
      FrTpChangeParamApi = false
      FrTpDevErrorDetect = true
      FrTpFullDuplexEnable = true
      FrTpMainFuncCycle = 0.005
      FrTpTransmitCancellation = false
      FrTpUnknownMsgLength = false
      FrTpVersionInfoApi = false
      FrTpRxIndEarlierThanTxConf = false
      FrTpInstanceId = 0
      FrTpMultiPurposeTp = false
      FrTpRxChanNum = 28
      FrTpTxChanNum = 14
      FrTpRuntimeMeasurementSupport = false
      FrTpReceiveCancellation = false
      FrTpSafeBswChecks = true
    FrTpMultipleConfig
      8 x FrTpConnection, all with FrTpBandwidthLimitation=false, FrTpConCtrlRef=TPCC:
        TL_MST_GW_TRNSM_FR_254_00980001_TxFCTN_0x00FC_252_TN_0x0039_41: FrTpLa=48, FrTpMultipleReceiverCon=false, FrTpRa=252, FrTpRxPduPoolRef=FrTpMultipleConfig/RxPduPool_TL_MST_GW_TRNSM_FR_254_00980001_Tp, FrTpTxPduPoolRef=FrTpMultipleConfig/TxPduPool_TL_ECU_TRNSM_FR_32_00BC0001_Tp
          TL_ECU_TRNSM_FR_32_00BC0001_RxFC (FrTpTxSdu): FrTpTxSduId=12, FrTpTxSduRef=PT_TL_ECU_TRNSM_FR_32_00BC0001_RxFC_PP_TL_ECU_TRNSM_FR_32_00BC0001_RxFC_Tx_c0e3388d_6409b170
          TL_MST_GW_TRNSM_FR_254_00980001_TxFC (FrTpRxSdu): FrTpRxSduId=26, FrTpRxSduRef=PT_TL_MST_GW_TRNSM_FR_254_00980001_TxFC_PP_TL_MST_GW_TRNSM_FR_254_00980001_TxFC_Rx_c0e3388d_6409b170
        TL_MST_GW_TRNSM_FR_254_00980001_TxFDTN_0x00FD_253_TN_0x0039_41: FrTpLa=48, FrTpMultipleReceiverCon=false, FrTpRa=253, FrTpRxPduPoolRef=FrTpMultipleConfig/RxPduPool_TL_MST_GW_TRNSM_FR_254_00980001_Tp, FrTpTxPduPoolRef=FrTpMultipleConfig/TxPduPool_TL_ECU_TRNSM_FR_32_00BC0001_Tp
          TL_ECU_TRNSM_FR_32_00BC0001_RxFD (FrTpTxSdu): FrTpTxSduId=13, FrTpTxSduRef=PT_TL_ECU_TRNSM_FR_32_00BC0001_RxFD_PP_TL_ECU_TRNSM_FR_32_00BC0001_RxFD_Tx_c0e3388d_6409b170
          TL_MST_GW_TRNSM_FR_254_00980001_TxFD (FrTpRxSdu): FrTpRxSduId=27, FrTpRxSduRef=PT_TL_MST_GW_TRNSM_FR_254_00980001_TxFD_PP_TL_MST_GW_TRNSM_FR_254_00980001_TxFD_Rx_c0e3388d_6409b170
        TL_MST_GW_TRNSM_FR_254_00980001_TxF9TN_0x00F9_249_TN_0x0039_41: FrTpLa=48, FrTpMultipleReceiverCon=false, FrTpRa=249, FrTpRxPduPoolRef=FrTpMultipleConfig/RxPduPool_TL_MST_GW_TRNSM_FR_254_00980001_Tp, FrTpTxPduPoolRef=FrTpMultipleConfig/TxPduPool_TL_ECU_TRNSM_FR_32_00BC0001_Tp
          TL_MST_GW_TRNSM_FR_254_00980001_TxF9 (FrTpRxSdu): FrTpRxSduId=23, FrTpRxSduRef=PT_TL_MST_GW_TRNSM_FR_254_00980001_TxF9_PP_TL_MST_GW_TRNSM_FR_254_00980001_TxF9_Rx_c0e3388d_6409b170
          TL_ECU_TRNSM_FR_32_00BC0001_RxF9 (FrTpTxSdu): FrTpTxSduId=9, FrTpTxSduRef=PT_TL_ECU_TRNSM_FR_32_00BC0001_RxF9_PP_TL_ECU_TRNSM_FR_32_00BC0001_RxF9_Tx_c0e3388d_6409b170
        TL_BRC_FR_32_TxFA_0xDFTN_0x00FA_250_TN_0x0039_41: FrTpLa=223, FrTpMultipleReceiverCon=true, FrTpRa=250, FrTpRxPduPoolRef=FrTpMultipleConfig/RxPduPool_TL_BRC_FR_32_Tp
          TL_BRC_FR_32_TxFA_0xDF (FrTpRxSdu): FrTpRxSduId=10, FrTpRxSduRef=PT_TL_BRC_FR_32_TxFA_0xDF_PP_TL_BRC_FR_32_TxFA_0xDF_Rx_c0e3388d_6409b170
        TL_MST_GW_TRNSM_FR_254_00980001_TxF7TN_0x00F7_247_TN_0x0039_41: FrTpLa=48, FrTpMultipleReceiverCon=false, FrTpRa=247, FrTpRxPduPoolRef=FrTpMultipleConfig/RxPduPool_TL_MST_GW_TRNSM_FR_254_00980001_Tp, FrTpTxPduPoolRef=FrTpMultipleConfig/TxPduPool_TL_ECU_TRNSM_FR_32_00BC0001_Tp
          TL_ECU_TRNSM_FR_32_00BC0001_RxF7 (FrTpTxSdu): FrTpTxSduId=7, FrTpTxSduRef=PT_TL_ECU_TRNSM_FR_32_00BC0001_RxF7_PP_TL_ECU_TRNSM_FR_32_00BC0001_RxF7_Tx_c0e3388d_6409b170
          TL_MST_GW_TRNSM_FR_254_00980001_TxF7 (FrTpRxSdu): FrTpRxSduId=21, FrTpRxSduRef=PT_TL_MST_GW_TRNSM_FR_254_00980001_TxF7_PP_TL_MST_GW_TRNSM_FR_254_00980001_TxF7_Rx_c0e3388d_6409b170
        TL_BRC_FR_32_TxF8_0xDFTN_0x00F8_248_TN_0x0039_41: FrTpLa=223, FrTpMultipleReceiverCon=true, FrTpRa=248, FrTpRxPduPoolRef=FrTpMultipleConfig/RxPduPool_TL_BRC_FR_32_Tp
          TL_BRC_FR_32_TxF8_0xDF (FrTpRxSdu): FrTpRxSduId=8, FrTpRxSduRef=PT_TL_BRC_FR_32_TxF8_0xDF_PP_TL_BRC_FR_32_TxF8_0xDF_Rx_c0e3388d_6409b170
        TL_MST_GW_TRNSM_FR_254_00980001_TxF8TN_0x00F8_248_TN_0x0039_41: FrTpLa=48, FrTpMultipleReceiverCon=false, FrTpRa=248, FrTpRxPduPoolRef=FrTpMultipleConfig/RxPduPool_TL_MST_GW_TRNSM_FR_254_00980001_Tp, FrTpTxPduPoolRef=FrTpMultipleConfig/TxPduPool_TL_ECU_TRNSM_FR_32_00BC0001_Tp
          TL_ECU_TRNSM_FR_32_00BC0001_RxF8 (FrTpTxSdu): FrTpTxSduId=8, FrTpTxSduRef=PT_TL_ECU_TRNSM_FR_32_00BC0001_RxF8_PP_TL_ECU_TRNSM_FR_32_00BC0001_RxF8_Tx_c0e3388d_6409b170
          TL_MST_GW_TRNSM_FR_254_00980001_TxF8 (FrTpRxSdu): FrTpRxSduId=22, FrTpRxSduRef=PT_TL_MST_GW_TRNSM_FR_254_00980001_TxF8_PP_TL_MST_GW_TRNSM_FR_254_00980001_TxF8_Rx_c0e3388d_6409b170
        TL_MST_GW_TRNSM_FR_254_00980001_TxF6TN_0x00F6_246_TN_0x0039_41: FrTpLa=48, FrTpMultipleReceiverCon=false, FrTpRa=246, FrTpRxPduPoolRef=FrTpMultipleConfig/RxPduPool_TL_MST_GW_TRNSM_FR_254_00980001_Tp, FrTpTxPduPoolRef=FrTpMultipleConfig/TxPduPool_TL_ECU_TRNSM_FR_32_00BC0001_Tp
          TL_ECU_TRNSM_FR_32_00BC0001_RxF6 (FrTpTxSdu): FrTpTxSduId=6, FrTpTxSduRef=PT_TL_ECU_TRNSM_FR_32_00BC0001_RxF6_PP_TL_ECU_TRNSM_FR_32_00BC0001_RxF6_Tx_c0e3388d_6409b170
          TL_MST_GW_TRNSM_FR_254_00980001_TxF6 (FrTpRxSdu): FrTpRxSduId=20, FrTpRxSduRef=PT_TL_MST_GW_TRNSM_FR_254_00980001_TxF6_PP_TL_MST_GW_TRNSM_FR_254_00980001_TxF6_Rx_c0e3388d_6409b170
      TPCC (FrTpConnectionControl):
        FrTpAckType = FRTP_ACK_WITH_RT
        FrTpMaxAr = 2
        FrTpMaxAs = 2
        FrTpMaxBufferSize = 4096
        FrTpMaxNbrOfNPduPerCycle = 1
        FrTpMaxRn = 2
        FrTpTimeBr = 0.025
        FrTpTimeBuffer = 0.005
        FrTpTimeFrIf = 0
        FrTpTimeoutAr = 0.9
        FrTpTimeoutAs = 0.285
        FrTpTimeoutBs = 1
        FrTpTimeoutCr = 1.3
        FrTpMaxFCWait = 19
        FrTpMaxFrIf = 0
        FrTpSCexp = 0
        FrTpTimeCs = 0.025
      TL_BRC_FR_32_TxF9_0xDFTN_0x00F9_249_TN_0x0039_41 (FrTpConnection):
        FrTpBandwidthLimitation = false
        FrTpLa = 223
        FrTpMultipleReceiverCon = true
        FrTpRa = 249
        FrTpConCtrlRef = TPCC
        FrTpRxPduPoolRef = FrTpMultipleConfig/RxPduPool_TL_BRC_FR_32_Tp
        TL_BRC_FR_32_TxF9_0xDF (FrTpRxSdu): FrTpRxSduId=9, FrTpRxSduRef=PT_TL_BRC_FR_32_TxF9_0xDF_PP_TL_BRC_FR_32_TxF9_0xDF_Rx_c0e3388d_6409b170
      TL_BRC_FR_32_TxF7_0xDFTN_0x00F7_247_TN_0x0039_41 (FrTpConnection):
        FrTpBandwidthLimitation = false
        FrTpLa = 223
        FrTpMultipleReceiverCon = true
        FrTpRa = 247
        FrTpConCtrlRef = TPCC
        FrTpRxPduPoolRef = FrTpMultipleConfig/RxPduPool_TL_BRC_FR_32_Tp
        TL_BRC_FR_32_TxF7_0xDF (FrTpRxSdu): FrTpRxSduId=7, FrTpRxSduRef=PT_TL_BRC_FR_32_TxF7_0xDF_PP_TL_BRC_FR_32_TxF7_0xDF_Rx_c0e3388d_6409b170
      RxPduPool_TL_BRC_FR_32_Tp (FrTpRxPduPool)
        RxPduPool_TL_BRC_FR_32_Tp (FrTpRxPdu): FrTpRxPduId=0, FrTpRxPduRef=pduTr_TL_BRC_FR_32_A_FlexRay_pduPort_EPS_A_FlexRay_IN_7d601c47_052bff33
      13 x FrTpConnection, all with FrTpBandwidthLimitation=false, FrTpConCtrlRef=TPCC:
        TL_BRC_FR_32_TxF5_0xDFTN_0x00F5_245_TN_0x0039_41: FrTpLa=223, FrTpMultipleReceiverCon=true, FrTpRa=245, FrTpRxPduPoolRef=FrTpMultipleConfig/RxPduPool_TL_BRC_FR_32_Tp
          TL_BRC_FR_32_TxF5_0xDF (FrTpRxSdu): FrTpRxSduId=5, FrTpRxSduRef=PT_TL_BRC_FR_32_TxF5_0xDF_PP_TL_BRC_FR_32_TxF5_0xDF_Rx_c0e3388d_6409b170
        TL_MST_GW_TRNSM_FR_254_00980001_TxF4TN_0x00F4_244_TN_0x0039_41: FrTpLa=48, FrTpMultipleReceiverCon=false, FrTpRa=244, FrTpRxPduPoolRef=FrTpMultipleConfig/RxPduPool_TL_MST_GW_TRNSM_FR_254_00980001_Tp, FrTpTxPduPoolRef=FrTpMultipleConfig/TxPduPool_TL_ECU_TRNSM_FR_32_00BC0001_Tp
          TL_ECU_TRNSM_FR_32_00BC0001_RxF4 (FrTpTxSdu): FrTpTxSduId=4, FrTpTxSduRef=PT_TL_ECU_TRNSM_FR_32_00BC0001_RxF4_PP_TL_ECU_TRNSM_FR_32_00BC0001_RxF4_Tx_c0e3388d_6409b170
          TL_MST_GW_TRNSM_FR_254_00980001_TxF4 (FrTpRxSdu): FrTpRxSduId=18, FrTpRxSduRef=PT_TL_MST_GW_TRNSM_FR_254_00980001_TxF4_PP_TL_MST_GW_TRNSM_FR_254_00980001_TxF4_Rx_c0e3388d_6409b170
        TL_MST_GW_TRNSM_FR_254_00980001_TxF1TN_0x00F1_241_TN_0x0039_41: FrTpLa=48, FrTpMultipleReceiverCon=false, FrTpRa=241, FrTpRxPduPoolRef=FrTpMultipleConfig/RxPduPool_TL_MST_GW_TRNSM_FR_254_00980001_Tp, FrTpTxPduPoolRef=FrTpMultipleConfig/TxPduPool_TL_ECU_TRNSM_FR_32_00BC0001_Tp
          TL_MST_GW_TRNSM_FR_254_00980001_TxF1 (FrTpRxSdu): FrTpRxSduId=15, FrTpRxSduRef=PT_TL_MST_GW_TRNSM_FR_254_00980001_TxF1_PP_TL_MST_GW_TRNSM_FR_254_00980001_TxF1_Rx_c0e3388d_6409b170
          TL_ECU_TRNSM_FR_32_00BC0001_RxF1 (FrTpTxSdu): FrTpTxSduId=1, FrTpTxSduRef=PT_TL_ECU_TRNSM_FR_32_00BC0001_RxF1_PP_TL_ECU_TRNSM_FR_32_00BC0001_RxF1_Tx_c0e3388d_6409b170
        TL_MST_GW_TRNSM_FR_254_00980001_TxF3TN_0x00F3_243_TN_0x0039_41: FrTpLa=48, FrTpMultipleReceiverCon=false, FrTpRa=243, FrTpRxPduPoolRef=FrTpMultipleConfig/RxPduPool_TL_MST_GW_TRNSM_FR_254_00980001_Tp, FrTpTxPduPoolRef=FrTpMultipleConfig/TxPduPool_TL_ECU_TRNSM_FR_32_00BC0001_Tp
          TL_ECU_TRNSM_FR_32_00BC0001_RxF3 (FrTpTxSdu): FrTpTxSduId=3, FrTpTxSduRef=PT_TL_ECU_TRNSM_FR_32_00BC0001_RxF3_PP_TL_ECU_TRNSM_FR_32_00BC0001_RxF3_Tx_c0e3388d_6409b170
          TL_MST_GW_TRNSM_FR_254_00980001_TxF3 (FrTpRxSdu): FrTpRxSduId=17, FrTpRxSduRef=PT_TL_MST_GW_TRNSM_FR_254_00980001_TxF3_PP_TL_MST_GW_TRNSM_FR_254_00980001_TxF3_Rx_c0e3388d_6409b170
        TL_MST_GW_TRNSM_FR_254_00980001_TxF2TN_0x00F2_242_TN_0x0039_41: FrTpLa=48, FrTpMultipleReceiverCon=false, FrTpRa=242, FrTpRxPduPoolRef=FrTpMultipleConfig/RxPduPool_TL_MST_GW_TRNSM_FR_254_00980001_Tp, FrTpTxPduPoolRef=FrTpMultipleConfig/TxPduPool_TL_ECU_TRNSM_FR_32_00BC0001_Tp
          TL_MST_GW_TRNSM_FR_254_00980001_TxF2 (FrTpRxSdu): FrTpRxSduId=16, FrTpRxSduRef=PT_TL_MST_GW_TRNSM_FR_254_00980001_TxF2_PP_TL_MST_GW_TRNSM_FR_254_00980001_TxF2_Rx_c0e3388d_6409b170
          TL_ECU_TRNSM_FR_32_00BC0001_RxF2 (FrTpTxSdu): FrTpTxSduId=2, FrTpTxSduRef=PT_TL_ECU_TRNSM_FR_32_00BC0001_RxF2_PP_TL_ECU_TRNSM_FR_32_00BC0001_RxF2_Tx_c0e3388d_6409b170
        TL_BRC_FR_32_TxF4_0xDFTN_0x00F4_244_TN_0x0039_41: FrTpLa=223, FrTpMultipleReceiverCon=true, FrTpRa=244, FrTpRxPduPoolRef=FrTpMultipleConfig/RxPduPool_TL_BRC_FR_32_Tp
          TL_BRC_FR_32_TxF4_0xDF (FrTpRxSdu): FrTpRxSduId=4, FrTpRxSduRef=PT_TL_BRC_FR_32_TxF4_0xDF_PP_TL_BRC_FR_32_TxF4_0xDF_Rx_c0e3388d_6409b170
        TL_MST_GW_TRNSM_FR_254_00980001_TxF5TN_0x00F5_245_TN_0x0039_41: FrTpLa=48, FrTpMultipleReceiverCon=false, FrTpRa=245, FrTpRxPduPoolRef=FrTpMultipleConfig/RxPduPool_TL_MST_GW_TRNSM_FR_254_00980001_Tp, FrTpTxPduPoolRef=FrTpMultipleConfig/TxPduPool_TL_ECU_TRNSM_FR_32_00BC0001_Tp
          TL_ECU_TRNSM_FR_32_00BC0001_RxF5 (FrTpTxSdu): FrTpTxSduId=5, FrTpTxSduRef=PT_TL_ECU_TRNSM_FR_32_00BC0001_RxF5_PP_TL_ECU_TRNSM_FR_32_00BC0001_RxF5_Tx_c0e3388d_6409b170
          TL_MST_GW_TRNSM_FR_254_00980001_TxF5 (FrTpRxSdu): FrTpRxSduId=19, FrTpRxSduRef=PT_TL_MST_GW_TRNSM_FR_254_00980001_TxF5_PP_TL_MST_GW_TRNSM_FR_254_00980001_TxF5_Rx_c0e3388d_6409b170
        TL_BRC_FR_32_TxF6_0xDFTN_0x00F6_246_TN_0x0039_41: FrTpLa=223, FrTpMultipleReceiverCon=true, FrTpRa=246, FrTpRxPduPoolRef=FrTpMultipleConfig/RxPduPool_TL_BRC_FR_32_Tp
          TL_BRC_FR_32_TxF6_0xDF (FrTpRxSdu): FrTpRxSduId=6, FrTpRxSduRef=PT_TL_BRC_FR_32_TxF6_0xDF_PP_TL_BRC_FR_32_TxF6_0xDF_Rx_c0e3388d_6409b170
        TL_BRC_FR_32_TxF2_0xDFTN_0x00F2_242_TN_0x0039_41: FrTpLa=223, FrTpMultipleReceiverCon=true, FrTpRa=242, FrTpRxPduPoolRef=FrTpMultipleConfig/RxPduPool_TL_BRC_FR_32_Tp
          TL_BRC_FR_32_TxF2_0xDF (FrTpRxSdu): FrTpRxSduId=2, FrTpRxSduRef=PT_TL_BRC_FR_32_TxF2_0xDF_PP_TL_BRC_FR_32_TxF2_0xDF_Rx_c0e3388d_6409b170
        TL_BRC_FR_32_TxF3_0xDFTN_0x00F3_243_TN_0x0039_41: FrTpLa=223, FrTpMultipleReceiverCon=true, FrTpRa=243, FrTpRxPduPoolRef=FrTpMultipleConfig/RxPduPool_TL_BRC_FR_32_Tp
          TL_BRC_FR_32_TxF3_0xDF (FrTpRxSdu): FrTpRxSduId=3, FrTpRxSduRef=PT_TL_BRC_FR_32_TxF3_0xDF_PP_TL_BRC_FR_32_TxF3_0xDF_Rx_c0e3388d_6409b170
        TL_BRC_FR_32_TxF1_0xDFTN_0x00F1_241_TN_0x0039_41: FrTpLa=223, FrTpMultipleReceiverCon=true, FrTpRa=241, FrTpRxPduPoolRef=FrTpMultipleConfig/RxPduPool_TL_BRC_FR_32_Tp
          TL_BRC_FR_32_TxF1_0xDF (FrTpRxSdu): FrTpRxSduId=1, FrTpRxSduRef=PT_TL_BRC_FR_32_TxF1_0xDF_PP_TL_BRC_FR_32_TxF1_0xDF_Rx_c0e3388d_6409b170
        TL_BRC_FR_32_TxF0_0xDFTN_0x00F0_240_TN_0x0039_41: FrTpLa=223, FrTpMultipleReceiverCon=true, FrTpRa=240, FrTpRxPduPoolRef=FrTpMultipleConfig/RxPduPool_TL_BRC_FR_32_Tp
          TL_BRC_FR_32_TxF0_0xDF (FrTpRxSdu): FrTpRxSduId=0, FrTpRxSduRef=PT_TL_BRC_FR_32_TxF0_0xDF_PP_TL_BRC_FR_32_TxF0_0xDF_Rx_c0e3388d_6409b170
        TL_MST_GW_TRNSM_FR_254_00980001_TxF0TN_0x00F0_240_TN_0x0039_41: FrTpLa=48, FrTpMultipleReceiverCon=false, FrTpRa=240, FrTpRxPduPoolRef=FrTpMultipleConfig/RxPduPool_TL_MST_GW_TRNSM_FR_254_00980001_Tp, FrTpTxPduPoolRef=FrTpMultipleConfig/TxPduPool_TL_ECU_TRNSM_FR_32_00BC0001_Tp
          TL_MST_GW_TRNSM_FR_254_00980001_TxF0 (FrTpRxSdu): FrTpRxSduId=14, FrTpRxSduRef=PT_TL_MST_GW_TRNSM_FR_254_00980001_TxF0_PP_TL_MST_GW_TRNSM_FR_254_00980001_TxF0_Rx_c0e3388d_6409b170
          TL_ECU_TRNSM_FR_32_00BC0001_RxF0 (FrTpTxSdu): FrTpTxSduId=0, FrTpTxSduRef=PT_TL_ECU_TRNSM_FR_32_00BC0001_RxF0_PP_TL_ECU_TRNSM_FR_32_00BC0001_RxF0_Tx_c0e3388d_6409b170
      TxPduPool_TL_ECU_TRNSM_FR_32_00BC0001_Tp (FrTpTxPduPool)
        TxPduPool_TL_ECU_TRNSM_FR_32_00BC0001_Tp (FrTpTxPdu): FrTpTxConfirmationPduId=0, FrTpTxPduRef=pduTr_TL_ECU_TRNSM_FR_32_A_FlexRay_pduPort_EPS_A_FlexRay_OUT_7d601c47_052bff33
      RxPduPool_TL_MST_GW_TRNSM_FR_254_00980001_Tp (FrTpRxPduPool)
        RxPduPool_TL_MST_GW_TRNSM_FR_254_00980001_Tp (FrTpRxPdu): FrTpRxPduId=1, FrTpRxPduRef=pduTr_TL_MST_GW_TRNSM_FR_254_A_FlexRay_pduPort_EPS_A_FlexRay_IN_7d601c47_052bff33
      5 x FrTpConnection, all with FrTpBandwidthLimitation=false, FrTpConCtrlRef=TPCC:
        TL_MST_GW_TRNSM_FR_254_00980001_TxFATN_0x00FA_250_TN_0x0039_41: FrTpLa=48, FrTpMultipleReceiverCon=false, FrTpRa=250, FrTpRxPduPoolRef=FrTpMultipleConfig/RxPduPool_TL_MST_GW_TRNSM_FR_254_00980001_Tp, FrTpTxPduPoolRef=FrTpMultipleConfig/TxPduPool_TL_ECU_TRNSM_FR_32_00BC0001_Tp
          TL_MST_GW_TRNSM_FR_254_00980001_TxFA (FrTpRxSdu): FrTpRxSduId=24, FrTpRxSduRef=PT_TL_MST_GW_TRNSM_FR_254_00980001_TxFA_PP_TL_MST_GW_TRNSM_FR_254_00980001_TxFA_Rx_c0e3388d_6409b170
          TL_ECU_TRNSM_FR_32_00BC0001_RxFA (FrTpTxSdu): FrTpTxSduId=10, FrTpTxSduRef=PT_TL_ECU_TRNSM_FR_32_00BC0001_RxFA_PP_TL_ECU_TRNSM_FR_32_00BC0001_RxFA_Tx_c0e3388d_6409b170
        TL_BRC_FR_32_TxFC_0xDFTN_0x00FC_252_TN_0x0039_41: FrTpLa=223, FrTpMultipleReceiverCon=true, FrTpRa=252, FrTpRxPduPoolRef=FrTpMultipleConfig/RxPduPool_TL_BRC_FR_32_Tp
          TL_BRC_FR_32_TxFC_0xDF (FrTpRxSdu): FrTpRxSduId=12, FrTpRxSduRef=PT_TL_BRC_FR_32_TxFC_0xDF_PP_TL_BRC_FR_32_TxFC_0xDF_Rx_c0e3388d_6409b170
        TL_BRC_FR_32_TxFD_0xDFTN_0x00FD_253_TN_0x0039_41: FrTpLa=223, FrTpMultipleReceiverCon=true, FrTpRa=253, FrTpRxPduPoolRef=FrTpMultipleConfig/RxPduPool_TL_BRC_FR_32_Tp
          TL_BRC_FR_32_TxFD_0xDF (FrTpRxSdu): FrTpRxSduId=13, FrTpRxSduRef=PT_TL_BRC_FR_32_TxFD_0xDF_PP_TL_BRC_FR_32_TxFD_0xDF_Rx_c0e3388d_6409b170
        TL_MST_GW_TRNSM_FR_254_00980001_TxFBTN_0x00FB_251_TN_0x0039_41: FrTpLa=48, FrTpMultipleReceiverCon=false, FrTpRa=251, FrTpRxPduPoolRef=FrTpMultipleConfig/RxPduPool_TL_MST_GW_TRNSM_FR_254_00980001_Tp, FrTpTxPduPoolRef=FrTpMultipleConfig/TxPduPool_TL_ECU_TRNSM_FR_32_00BC0001_Tp
          TL_MST_GW_TRNSM_FR_254_00980001_TxFB (FrTpRxSdu): FrTpRxSduId=25, FrTpRxSduRef=PT_TL_MST_GW_TRNSM_FR_254_00980001_TxFB_PP_TL_MST_GW_TRNSM_FR_254_00980001_TxFB_Rx_c0e3388d_6409b170
          TL_ECU_TRNSM_FR_32_00BC0001_RxFB (FrTpTxSdu): FrTpTxSduId=11, FrTpTxSduRef=PT_TL_ECU_TRNSM_FR_32_00BC0001_RxFB_PP_TL_ECU_TRNSM_FR_32_00BC0001_RxFB_Tx_c0e3388d_6409b170
        TL_BRC_FR_32_TxFB_0xDFTN_0x00FB_251_TN_0x0039_41: FrTpLa=223, FrTpMultipleReceiverCon=true, FrTpRa=251, FrTpRxPduPoolRef=FrTpMultipleConfig/RxPduPool_TL_BRC_FR_32_Tp
          TL_BRC_FR_32_TxFB_0xDF (FrTpRxSdu): FrTpRxSduId=11, FrTpRxSduRef=PT_TL_BRC_FR_32_TxFB_0xDF_PP_TL_BRC_FR_32_TxFB_0xDF_Rx_c0e3388d_6409b170
