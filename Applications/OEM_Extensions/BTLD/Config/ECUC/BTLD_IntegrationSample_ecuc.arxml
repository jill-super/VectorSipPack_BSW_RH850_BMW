AUTOSAR XML (schema 4-3-0)
package /ActiveEcuC
  module config IntegrationSample: implementation-config-variant=VARIANT-PRE-COMPILE
    CommonPublishedInformation: SwMajorVersion=5, SwMinorVersion=0, SwPatchVersion=3
    IntegrationSampleGeneral:
      IntegrationSample_Enable_PP_DemDatalElementClass_KmStand = false
      IntegrationSample_Enable_PP_DemDataElementClass_ObdMuxFehler = false
      IntegrationSample_Enable_PP_DemDataElementClass_PWF = false
      IntegrationSampleSwitchDcmNotification = false
      IntegrationSampleSwitchGlobalEcuRunState = false
      IntegrationSampleSwitchProvideTestStampDefaults = false
      IntegrationSampleSwitchProvide_ST_CON_VEH = false
      IntegrationSampleSwitchProvide_PRTNT_CON_VEH = false
      IntegrationSampleSwitchSimpleTimer = true
      IntegrationSample_Number_of_Simple_Timers = 1
      IntegrationSample_EnableServiceInterface = false
      IntegrationSample_EnableSplitVehicleStatus = false
