AUTOSAR XML (schema 4-3-0)
package /ActiveEcuC
  module config BswM: implementation-config-variant=VARIANT-PRE-COMPILE, module-description=BswM_Impl
    BswMConfig
      BswMArbitration
        SwcModeNotification_DcmDiagnosticSessionControl (BswMModeRequestPort): BswMArbitrateOnInit=false, BswMRequestProcessing=BSWM_DEFERRED
          BswMModeRequestSource
            BswMSwcModeNotification: BswMSwcModeNotificationModeDeclarationGroupPrototypeRef=DcmDiagnosticSessionControl
          BswMModeInitValue
            BswMSwcModeInitValue: BswMSwcModeInitValueRef=DEFAULT_SESSION
        BswMModeCondition_001 (BswMModeCondition): BswMConditionType=BSWM_EQUALS, BswMConditionMode=SwcModeNotification_DcmDiagnosticSessionControl
          BswMConditionValue
            BswMModeDeclaration: BswMModeValueRef=DEFAULT_SESSION
        BswMModeCondition_002 (BswMModeCondition): BswMConditionType=BSWM_EQUALS, BswMConditionMode=SwcModeNotification_DcmDiagnosticSessionControl
          BswMConditionValue
            BswMModeDeclaration: BswMModeValueRef=PROGRAMMING_SESSION
        LE_BswMRule_DcmProgGlue_ResetWhenBtldDefaultSession (BswMLogicalExpression): BswMLogicalOperator=BSWM_OR, BswMArgumentRef=BswMModeCondition_001, BswMArgumentRef=BswMModeCondition_002
        BswMRule_DcmProgGlue_ResetWhenBtldDefaultSession (BswMRule):
          BswMNestedExecutionOnly = false
          BswMRuleId = 0
          BswMRuleInitState = BSWM_FALSE
          BswMRuleExpressionRef = LE_BswMRule_DcmProgGlue_ResetWhenBtldDefaultSession
          BswMRuleTrueActionList = AL_DcmProgGlue_ResetWhenBtldDefaultSession_True
        Rule_DcmEcuReset (BswMRule):
          BswMNestedExecutionOnly = false
          BswMRuleId = 1
          BswMRuleInitState = BSWM_FALSE
          BswMRuleExpressionRef = Rule_DcmEcuReset_BswMLogicalExpression
          BswMRuleTrueActionList = AL_ResetExecution
        SwcModeNotification_DcmEcuReset (BswMModeRequestPort): BswMArbitrateOnInit=false, BswMRequestProcessing=BSWM_DEFERRED
          BswMModeRequestSource
            BswMSwcModeNotification: BswMSwcModeNotificationModeDeclarationGroupPrototypeRef=DcmEcuReset
          BswMModeInitValue
            BswMSwcModeInitValue: BswMSwcModeInitValueRef=NONE
        BswMModeCondition: BswMConditionType=BSWM_EQUALS, BswMConditionMode=SwcModeNotification_DcmEcuReset
          BswMConditionValue
            BswMModeDeclaration: BswMModeValueRef=EXECUTE
        Rule_DcmEcuReset_BswMLogicalExpression (BswMLogicalExpression): BswMArgumentRef=BswMModeCondition
      BswMModeControl: BswMInitActionListRef=INIT_AL_Initialize, BswMInitActionListRef=EcumAlOnRunII, BswMInitActionListRef=AL_switch_to_FULL_COM
        BswMUserCallout_ProgGlue_DcmDiagnosticSessionControl (BswMAction)
          BswMAvailableActions
            BswMUserCallout: BswMUserCalloutFunction=ProgGlue_DcmDiagnosticSessionControl_Callout(), BswMCreateCallout=true
        AL_DcmProgGlue_ResetWhenBtldDefaultSession_True (BswMActionList): BswMActionListExecution=BSWM_CONDITION
          BswMUserCallout_ProgGlue_DcmDiagnosticSessionControl (BswMActionListItem): BswMAbortOnFail=false, BswMActionListItemIndex=0, BswMActionListItemRef=BswMModeControl/BswMUserCallout_ProgGlue_DcmDiagnosticSessionControl
        INIT_AL_Initialize (BswMActionList): BswMActionListExecution=BSWM_CONDITION
          17 x BswMActionListItem, all with BswMAbortOnFail=false:
            INIT_Action_Fr_Init: BswMActionListItemIndex=0, BswMActionListItemRef=BswMModeControl/INIT_Action_Fr_Init
            INIT_Action_Fee_30_SmallSector_Init: BswMActionListItemIndex=1, BswMActionListItemRef=BswMModeControl/INIT_Action_Fee_30_SmallSector_Init
            INIT_Action_FrIf_Init: BswMActionListItemIndex=2, BswMActionListItemRef=BswMModeControl/INIT_Action_FrIf_Init
            INIT_Action_PduR_Init: BswMActionListItemIndex=3, BswMActionListItemRef=BswMModeControl/INIT_Action_PduR_Init
            INIT_Action_FrSM_Init: BswMActionListItemIndex=4, BswMActionListItemRef=BswMModeControl/INIT_Action_FrSM_Init
            INIT_Action_FrTp_Init: BswMActionListItemIndex=5, BswMActionListItemRef=BswMModeControl/INIT_Action_FrTp_Init
            INIT_Action_FrXcp_Init: BswMActionListItemIndex=7, BswMActionListItemRef=BswMModeControl/INIT_Action_FrXcp_Init
            INIT_Action_Xcp_Init: BswMActionListItemIndex=8, BswMActionListItemRef=BswMModeControl/INIT_Action_Xcp_Init
            INIT_Action_EnableInterrupts: BswMActionListItemIndex=10, BswMActionListItemRef=BswMModeControl/INIT_Action_EnableInterrupts
            INIT_Action_ComM_Init: BswMActionListItemIndex=11, BswMActionListItemRef=BswMModeControl/INIT_Action_ComM_Init
            INIT_Action_Dcm_Init: BswMActionListItemIndex=12, BswMActionListItemRef=BswMModeControl/INIT_Action_Dcm_Init
            INIT_Action_RteStart: BswMActionListItemIndex=16, BswMActionListItemRef=BswMModeControl/INIT_Action_RteStart
            INIT_Action_Dlog_Init: BswMActionListItemIndex=13, BswMActionListItemRef=BswMModeControl/INIT_Action_Dlog_Init
            INIT_Action_Prog_UDS_Init: BswMActionListItemIndex=14, BswMActionListItemRef=BswMModeControl/INIT_Action_Prog_UDS_Init
            INIT_Action_WaitMemDriverReady: BswMActionListItemIndex=6, BswMActionListItemRef=BswMModeControl/INIT_Action_WaitMemDriverReady
            BswMUserCallout: BswMActionListItemIndex=9, BswMActionListItemRef=BswMModeControl/BswMUserCallout
            Dlog_SetConfiguration: BswMActionListItemIndex=15, BswMActionListItemRef=BswMModeControl/Dlog_SetConfiguration
        16 x BswMAction:
          INIT_Action_Fr_Init
            BswMAvailableActions
              BswMUserCallout: BswMUserCalloutFunction=Fr_Init(&Fr_Config), BswMCreateCallout=false, BswMUserIncludeFile=Fr.h
          INIT_Action_Fee_30_SmallSector_Init
            BswMAvailableActions
              BswMUserCallout: BswMUserCalloutFunction=Fee_30_SmallSector_Init(), BswMCreateCallout=false, BswMUserIncludeFile=Fee_30_SmallSector.h
          INIT_Action_FrIf_Init
            BswMAvailableActions
              BswMUserCallout: BswMUserCalloutFunction=FrIf_Init(&FrIf_Config), BswMCreateCallout=false, BswMUserIncludeFile=FrIf.h
          INIT_Action_PduR_Init
            BswMAvailableActions
              BswMUserCallout: BswMUserCalloutFunction=PduR_Init(PduR_Config_Ptr), BswMCreateCallout=false, BswMUserIncludeFile=PduR.h
          INIT_Action_FrSM_Init
            BswMAvailableActions
              BswMUserCallout: BswMUserCalloutFunction=FrSM_Init(FrSM_Config_Ptr), BswMCreateCallout=false, BswMUserIncludeFile=FrSM.h
          INIT_Action_FrTp_Init
            BswMAvailableActions
              BswMUserCallout: BswMUserCalloutFunction=FrTp_Init(&FrTp_Config), BswMCreateCallout=false, BswMUserIncludeFile=FrTp.h
          INIT_Action_FrXcp_Init
            BswMAvailableActions
              BswMUserCallout: BswMUserCalloutFunction=FrXcp_Init(NULL_PTR), BswMCreateCallout=false, BswMUserIncludeFile=FrXcp.h
          INIT_Action_Xcp_Init
            BswMAvailableActions
              BswMUserCallout: BswMUserCalloutFunction=Xcp_Init(), BswMCreateCallout=false, BswMUserIncludeFile=Xcp.h
          INIT_Action_EnableInterrupts
            BswMAvailableActions
              BswMUserCallout: BswMUserCalloutFunction=BswM_AL_SetProgrammableInterrupts(), BswMCreateCallout=true
          INIT_Action_ComM_Init
            BswMAvailableActions
              BswMUserCallout: BswMUserCalloutFunction=ComM_Init(), BswMCreateCallout=false, BswMUserIncludeFile=ComM.h
          INIT_Action_Dcm_Init
            BswMAvailableActions
              BswMUserCallout: BswMUserCalloutFunction=Dcm_Init(NULL_PTR), BswMCreateCallout=false, BswMUserIncludeFile=Dcm.h
          INIT_Action_RteStart
            BswMAvailableActions
              BswMUserCallout: BswMUserCalloutFunction=(void)Rte_Start(), BswMCreateCallout=false, BswMUserIncludeFile=Rte_Main.h
          INIT_Action_Dlog_Init
            BswMAvailableActions
              BswMUserCallout: BswMUserCalloutFunction=Dlog_InitNvm(), BswMCreateCallout=false, BswMUserIncludeFile=Dlog_Nvm.h
          INIT_Action_Prog_UDS_Init
            BswMAvailableActions
              BswMUserCallout: BswMUserCalloutFunction=Prog_UDS_Init(), BswMCreateCallout=false, BswMUserIncludeFile=Prog_Internal.h
          INIT_Action_WaitMemDriverReady
            BswMAvailableActions
              BswMUserCallout: BswMUserCalloutFunction=(void)WaitMemDriverReady(), BswMCreateCallout=false, BswMUserIncludeFile=Boot_Main.h
          Reset
            BswMAvailableActions
              BswMUserCallout: BswMUserCalloutFunction=Mcu_PerformReset(), BswMCreateCallout=false, BswMUserIncludeFile=Mcu.h
        AL_ResetExecution (BswMActionList): BswMActionListExecution=BSWM_TRIGGER
          Reset (BswMActionListItem): BswMAbortOnFail=false, BswMActionListItemIndex=0, BswMActionListItemRef=BswMModeControl/Reset
        ALLOW_COM_A_FlexRay_5b5a9ac2 (BswMAction)
          BswMAvailableActions
            BswMComMAllowCom: BswMComAllowed=true, BswMComMAllowChannelRef=A_FlexRay_5b5a9ac2
        BSWM_FULL_COM_USR_A_FlexRay_5b5a9ac2 (BswMAction)
          BswMAvailableActions
            BswMComMModeSwitch: BswMComMRequestedMode=BSWM_FULL_COM, BswMComMUserRef=USR_A_FlexRay_5b5a9ac2
        AL_switch_to_FULL_COM (BswMActionList): BswMActionListExecution=BSWM_TRIGGER
          BSWM_FULL_COM_USR_A_FlexRay_5b5a9ac2 (BswMActionListItem): BswMAbortOnFail=false, BswMActionListItemIndex=0, BswMActionListItemRef=BswMModeControl/BSWM_FULL_COM_USR_A_FlexRay_5b5a9ac2
        EcumAlOnRunII (BswMActionList): BswMActionListExecution=BSWM_TRIGGER
          ALLOW_COM_A_FlexRay_5b5a9ac2 (BswMActionListItem): BswMAbortOnFail=false, BswMActionListItemIndex=0, BswMActionListItemRef=BswMModeControl/ALLOW_COM_A_FlexRay_5b5a9ac2
        BswMUserCallout (BswMAction)
          BswMAvailableActions
            BswMUserCallout: BswMUserCalloutFunction=(void) ApplFr_DetFilter(), BswMCreateCallout=false, BswMUserIncludeFile=ApplFr_Stubs.h
        Dlog_SetConfiguration (BswMAction)
          BswMAvailableActions
            BswMUserCallout: BswMUserCalloutFunction=Dlog_SetConfiguration(&Dlog_Config);, BswMCreateCallout=false, BswMUserIncludeFile=Dlog_PBCfg.h
      BswMDataTypeMappingSets: BswMDataTypeMappingSetRef=BswMMappingSet
    BswMGeneral:
      BswMCanSMEnabled = false
      BswMComMEnabled = true
      BswMDcmEnabled = true
      BswMDevErrorDetect = true
      BswMEcuMEnabled = true
      BswMEthIfEnabled = false
      BswMEthSMEnabled = false
      BswMFrSMEnabled = true
      BswMGenericRequestEnabled = false
      BswMJ1939DcmEnabled = false
      BswMJ1939NmEnabled = false
      BswMLinSMEnabled = false
      BswMLinTPEnabled = false
      BswMNmEnabled = false
      BswMNvMEnabled = false
      BswMPduREnabled = false
      BswMRuleControlEnabled = true
      BswMSdEnabled = false
      BswMVersionInfoApi = false
      BswMWdgMEnabled = false
      BswMModeCheck = true
      BswMMainFunctionPeriod = 0.005
      BswMCommonData
      BswMGeneration:
        BswMOutOfBoundsWriteSanitizer = false
        BswMOutOfBoundsReadSanitizer = false
        BswMReduceConstantData2Define = true
        BswMReduceDataByStreaming = false
        BswMBoolDataInArrayOfStructStrategy = BITMASKING
        BswMInterfacesForDeactivatedData = false
