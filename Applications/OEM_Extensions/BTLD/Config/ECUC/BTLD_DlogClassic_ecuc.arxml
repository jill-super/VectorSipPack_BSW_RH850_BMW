AUTOSAR XML (schema 4-3-0)
package /ActiveEcuC
  module config DlogClassic: implementation-config-variant=VARIANT-PRE-COMPILE
    CommonPublishedInformation: SwMajorVersion=5, SwMinorVersion=3, SwPatchVersion=1
    Dlog_Features:
      EnableEcuWriteVin = true
      EnableMemSegTableRead = true
      EnableNvMemory = true
      EnableRte = false
      EnableSweGet = true
      EnableSweInit = false
      EnableTimingParameters = true
      ExceptionHandlerHandleSWEErrors = false
      MemIfDeviceId = 0
      NvmInterface = DLOG_NVM_INTERFACE_MEMIF
      RteCodingSvkArraySize = 16
      RteSvkArrayMaxSize = 100
      RteUserSvkArrayMaxSize = 100
      SweGetDirectBootAndAppl1Swe = false
      SweGetPerformErrorCheck = false
      SweGetValidFlagBlankCheck = true
      SweGetVerifyCrcChecksum = false
    Dlog_General: DlogUseCoding=false, DlogWatchdogTrigger=WdgIf_SetTriggerCondition(0,100)
    Dlog_User: RomAccessExceptionHandler=0
