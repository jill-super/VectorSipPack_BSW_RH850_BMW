AUTOSAR XML (schema 4-3-0)
package /ActiveEcuC
  module config PduR: implementation-config-variant=VARIANT-PRE-COMPILE, module-description=PduR_Impl
    PduRGeneral: PduRDevErrorDetect=true, PduRVersionInfoApi=false, PduRMetaDataSupport=false, PduRPduCallback=false, PduRSwitching=false, PduRSafeBswChecks=true
      PduRGeneration:
        PduROutOfBoundsWriteProtectionStrategy = NONE
        PduROutOfBoundsWriteSanitizer = false
        PduROutOfBoundsReadSanitizer = false
        PduRNumericalDataTypeMinimizationStrategy = WITH_CAST
        PduRReduceConstantData2Define = false
        PduRBoolDataInArrayOfStructStrategy = BITMASKING
        PduRDeduplicateIndirectedData = true
        PduRDataDeduplicationStrategy = WITH_CAST
        PduRReduceBoolDataByNegationThreshold = 2
        PduRReduceBoolDataByNumericalComparisonThreshold = 2
        PduRReduceBoolDataByNumericalRelationThreshold = 2
        PduRReduceBoolDataByNumericalOperandStrategy = WITH_ANY_VALUE
        PduRReduceNumericalDataByOffsetThreshold = 2
        PduRReduceNumericalDataByArraySubtractionThreshold = 2
        PduRReduceDataByStreaming = false
        PduRShortSymbols = false
        PduRInterfacesForDeactivatedData = false
        PduRReferringKeysInComments = false
    PduRRoutingTables: PduRConfigurationId=0
      PduRRoutingTable
        42 x PduRRoutingPath, all with PduRRoutingPathCommunicationType=TRANSPORT_PROTOCOL:
          PduRRoutingPath_009
            PduRDestPdu_9 (PduRDestPdu):
              PduRDestPduDirection = RECEIVE
              PduRDestPduRoutingType = API_FORWARDING
              PduRDestPduHandleId = 9
              PduRDestPduRef = PT_TL_BRC_FR_32_TxF9_0xDF_PP_TL_BRC_FR_32_TxF9_0xDF_Rx_c0e3388d_6409b170
              PduRDestPduPduRBswModulesRef = Dcm
            PduRSrcPdu_9 (PduRSrcPdu):
              PduRSrcPduDirection = RECEIVE
              PduRSourcePduHandleId = 9
              PduRSrcPduRef = PT_TL_BRC_FR_32_TxF9_0xDF_PP_TL_BRC_FR_32_TxF9_0xDF_Rx_c0e3388d_6409b170
              PduRSrcPduPduRBswModulesRef = FrTp
          PduRRoutingPath_008
            PduRDestPdu_8 (PduRDestPdu):
              PduRDestPduDirection = RECEIVE
              PduRDestPduRoutingType = API_FORWARDING
              PduRDestPduHandleId = 8
              PduRDestPduRef = PT_TL_BRC_FR_32_TxF8_0xDF_PP_TL_BRC_FR_32_TxF8_0xDF_Rx_c0e3388d_6409b170
              PduRDestPduPduRBswModulesRef = Dcm
            PduRSrcPdu_8 (PduRSrcPdu):
              PduRSrcPduDirection = RECEIVE
              PduRSourcePduHandleId = 8
              PduRSrcPduRef = PT_TL_BRC_FR_32_TxF8_0xDF_PP_TL_BRC_FR_32_TxF8_0xDF_Rx_c0e3388d_6409b170
              PduRSrcPduPduRBswModulesRef = FrTp
          PduRRoutingPath
            PduRSrcPdu:
              PduRSrcPduDirection = RECEIVE
              PduRSourcePduHandleId = 0
              PduRSrcPduRef = PT_TL_BRC_FR_32_TxF0_0xDF_PP_TL_BRC_FR_32_TxF0_0xDF_Rx_c0e3388d_6409b170
              PduRSrcPduPduRBswModulesRef = FrTp
            PduRDestPdu:
              PduRDestPduDirection = RECEIVE
              PduRDestPduRoutingType = API_FORWARDING
              PduRDestPduHandleId = 0
              PduRDestPduRef = PT_TL_BRC_FR_32_TxF0_0xDF_PP_TL_BRC_FR_32_TxF0_0xDF_Rx_c0e3388d_6409b170
              PduRDestPduPduRBswModulesRef = Dcm
          PduRRoutingPath_041
            PduRSrcPdu_41 (PduRSrcPdu):
              PduRSrcPduDirection = RECEIVE
              PduRSourcePduHandleId = 27
              PduRSrcPduRef = PT_TL_MST_GW_TRNSM_FR_254_00980001_TxFD_PP_TL_MST_GW_TRNSM_FR_254_00980001_TxFD_Rx_c0e3388d_6409b170
              PduRSrcPduPduRBswModulesRef = FrTp
            PduRDestPdu_41 (PduRDestPdu):
              PduRDestPduDirection = RECEIVE
              PduRDestPduRoutingType = API_FORWARDING
              PduRDestPduHandleId = 27
              PduRDestPduRef = PT_TL_MST_GW_TRNSM_FR_254_00980001_TxFD_PP_TL_MST_GW_TRNSM_FR_254_00980001_TxFD_Rx_c0e3388d_6409b170
              PduRDestPduPduRBswModulesRef = Dcm
          PduRRoutingPath_040
            PduRDestPdu_40 (PduRDestPdu):
              PduRDestPduDirection = RECEIVE
              PduRDestPduRoutingType = API_FORWARDING
              PduRDestPduHandleId = 26
              PduRDestPduRef = PT_TL_MST_GW_TRNSM_FR_254_00980001_TxFC_PP_TL_MST_GW_TRNSM_FR_254_00980001_TxFC_Rx_c0e3388d_6409b170
              PduRDestPduPduRBswModulesRef = Dcm
            PduRSrcPdu_40 (PduRSrcPdu):
              PduRSrcPduDirection = RECEIVE
              PduRSourcePduHandleId = 26
              PduRSrcPduRef = PT_TL_MST_GW_TRNSM_FR_254_00980001_TxFC_PP_TL_MST_GW_TRNSM_FR_254_00980001_TxFC_Rx_c0e3388d_6409b170
              PduRSrcPduPduRBswModulesRef = FrTp
          PduRRoutingPath_005
            PduRDestPdu_5 (PduRDestPdu):
              PduRDestPduDirection = RECEIVE
              PduRDestPduRoutingType = API_FORWARDING
              PduRDestPduHandleId = 5
              PduRDestPduRef = PT_TL_BRC_FR_32_TxF5_0xDF_PP_TL_BRC_FR_32_TxF5_0xDF_Rx_c0e3388d_6409b170
              PduRDestPduPduRBswModulesRef = Dcm
            PduRSrcPdu_5 (PduRSrcPdu):
              PduRSrcPduDirection = RECEIVE
              PduRSourcePduHandleId = 5
              PduRSrcPduRef = PT_TL_BRC_FR_32_TxF5_0xDF_PP_TL_BRC_FR_32_TxF5_0xDF_Rx_c0e3388d_6409b170
              PduRSrcPduPduRBswModulesRef = FrTp
          PduRRoutingPath_004
            PduRDestPdu_4 (PduRDestPdu):
              PduRDestPduDirection = RECEIVE
              PduRDestPduRoutingType = API_FORWARDING
              PduRDestPduHandleId = 4
              PduRDestPduRef = PT_TL_BRC_FR_32_TxF4_0xDF_PP_TL_BRC_FR_32_TxF4_0xDF_Rx_c0e3388d_6409b170
              PduRDestPduPduRBswModulesRef = Dcm
            PduRSrcPdu_4 (PduRSrcPdu):
              PduRSrcPduDirection = RECEIVE
              PduRSourcePduHandleId = 4
              PduRSrcPduRef = PT_TL_BRC_FR_32_TxF4_0xDF_PP_TL_BRC_FR_32_TxF4_0xDF_Rx_c0e3388d_6409b170
              PduRSrcPduPduRBswModulesRef = FrTp
          PduRRoutingPath_007
            PduRDestPdu_7 (PduRDestPdu):
              PduRDestPduDirection = RECEIVE
              PduRDestPduRoutingType = API_FORWARDING
              PduRDestPduHandleId = 7
              PduRDestPduRef = PT_TL_BRC_FR_32_TxF7_0xDF_PP_TL_BRC_FR_32_TxF7_0xDF_Rx_c0e3388d_6409b170
              PduRDestPduPduRBswModulesRef = Dcm
            PduRSrcPdu_7 (PduRSrcPdu):
              PduRSrcPduDirection = RECEIVE
              PduRSourcePduHandleId = 7
              PduRSrcPduRef = PT_TL_BRC_FR_32_TxF7_0xDF_PP_TL_BRC_FR_32_TxF7_0xDF_Rx_c0e3388d_6409b170
              PduRSrcPduPduRBswModulesRef = FrTp
          PduRRoutingPath_006
            PduRDestPdu_6 (PduRDestPdu):
              PduRDestPduDirection = RECEIVE
              PduRDestPduRoutingType = API_FORWARDING
              PduRDestPduHandleId = 6
              PduRDestPduRef = PT_TL_BRC_FR_32_TxF6_0xDF_PP_TL_BRC_FR_32_TxF6_0xDF_Rx_c0e3388d_6409b170
              PduRDestPduPduRBswModulesRef = Dcm
            PduRSrcPdu_6 (PduRSrcPdu):
              PduRSrcPduDirection = RECEIVE
              PduRSourcePduHandleId = 6
              PduRSrcPduRef = PT_TL_BRC_FR_32_TxF6_0xDF_PP_TL_BRC_FR_32_TxF6_0xDF_Rx_c0e3388d_6409b170
              PduRSrcPduPduRBswModulesRef = FrTp
          PduRRoutingPath_001
            PduRDestPdu_1 (PduRDestPdu):
              PduRDestPduDirection = RECEIVE
              PduRDestPduRoutingType = API_FORWARDING
              PduRDestPduHandleId = 1
              PduRDestPduRef = PT_TL_BRC_FR_32_TxF1_0xDF_PP_TL_BRC_FR_32_TxF1_0xDF_Rx_c0e3388d_6409b170
              PduRDestPduPduRBswModulesRef = Dcm
            PduRSrcPdu_1 (PduRSrcPdu):
              PduRSrcPduDirection = RECEIVE
              PduRSourcePduHandleId = 1
              PduRSrcPduRef = PT_TL_BRC_FR_32_TxF1_0xDF_PP_TL_BRC_FR_32_TxF1_0xDF_Rx_c0e3388d_6409b170
              PduRSrcPduPduRBswModulesRef = FrTp
          PduRRoutingPath_003
            PduRDestPdu_3 (PduRDestPdu):
              PduRDestPduDirection = RECEIVE
              PduRDestPduRoutingType = API_FORWARDING
              PduRDestPduHandleId = 3
              PduRDestPduRef = PT_TL_BRC_FR_32_TxF3_0xDF_PP_TL_BRC_FR_32_TxF3_0xDF_Rx_c0e3388d_6409b170
              PduRDestPduPduRBswModulesRef = Dcm
            PduRSrcPdu_3 (PduRSrcPdu):
              PduRSrcPduDirection = RECEIVE
              PduRSourcePduHandleId = 3
              PduRSrcPduRef = PT_TL_BRC_FR_32_TxF3_0xDF_PP_TL_BRC_FR_32_TxF3_0xDF_Rx_c0e3388d_6409b170
              PduRSrcPduPduRBswModulesRef = FrTp
          PduRRoutingPath_002
            PduRDestPdu_2 (PduRDestPdu):
              PduRDestPduDirection = RECEIVE
              PduRDestPduRoutingType = API_FORWARDING
              PduRDestPduHandleId = 2
              PduRDestPduRef = PT_TL_BRC_FR_32_TxF2_0xDF_PP_TL_BRC_FR_32_TxF2_0xDF_Rx_c0e3388d_6409b170
              PduRDestPduPduRBswModulesRef = Dcm
            PduRSrcPdu_2 (PduRSrcPdu):
              PduRSrcPduDirection = RECEIVE
              PduRSourcePduHandleId = 2
              PduRSrcPduRef = PT_TL_BRC_FR_32_TxF2_0xDF_PP_TL_BRC_FR_32_TxF2_0xDF_Rx_c0e3388d_6409b170
              PduRSrcPduPduRBswModulesRef = FrTp
          PduRRoutingPath_030
            PduRSrcPdu_30 (PduRSrcPdu):
              PduRSrcPduDirection = RECEIVE
              PduRSourcePduHandleId = 16
              PduRSrcPduRef = PT_TL_MST_GW_TRNSM_FR_254_00980001_TxF2_PP_TL_MST_GW_TRNSM_FR_254_00980001_TxF2_Rx_c0e3388d_6409b170
              PduRSrcPduPduRBswModulesRef = FrTp
            PduRDestPdu_30 (PduRDestPdu):
              PduRDestPduDirection = RECEIVE
              PduRDestPduRoutingType = API_FORWARDING
              PduRDestPduHandleId = 16
              PduRDestPduRef = PT_TL_MST_GW_TRNSM_FR_254_00980001_TxF2_PP_TL_MST_GW_TRNSM_FR_254_00980001_TxF2_Rx_c0e3388d_6409b170
              PduRDestPduPduRBswModulesRef = Dcm
          PduRRoutingPath_032
            PduRDestPdu_32 (PduRDestPdu):
              PduRDestPduDirection = RECEIVE
              PduRDestPduRoutingType = API_FORWARDING
              PduRDestPduHandleId = 18
              PduRDestPduRef = PT_TL_MST_GW_TRNSM_FR_254_00980001_TxF4_PP_TL_MST_GW_TRNSM_FR_254_00980001_TxF4_Rx_c0e3388d_6409b170
              PduRDestPduPduRBswModulesRef = Dcm
            PduRSrcPdu_32 (PduRSrcPdu):
              PduRSrcPduDirection = RECEIVE
              PduRSourcePduHandleId = 18
              PduRSrcPduRef = PT_TL_MST_GW_TRNSM_FR_254_00980001_TxF4_PP_TL_MST_GW_TRNSM_FR_254_00980001_TxF4_Rx_c0e3388d_6409b170
              PduRSrcPduPduRBswModulesRef = FrTp
          PduRRoutingPath_031
            PduRSrcPdu_31 (PduRSrcPdu):
              PduRSrcPduDirection = RECEIVE
              PduRSourcePduHandleId = 17
              PduRSrcPduRef = PT_TL_MST_GW_TRNSM_FR_254_00980001_TxF3_PP_TL_MST_GW_TRNSM_FR_254_00980001_TxF3_Rx_c0e3388d_6409b170
              PduRSrcPduPduRBswModulesRef = FrTp
            PduRDestPdu_31 (PduRDestPdu):
              PduRDestPduDirection = RECEIVE
              PduRDestPduRoutingType = API_FORWARDING
              PduRDestPduHandleId = 17
              PduRDestPduRef = PT_TL_MST_GW_TRNSM_FR_254_00980001_TxF3_PP_TL_MST_GW_TRNSM_FR_254_00980001_TxF3_Rx_c0e3388d_6409b170
              PduRDestPduPduRBswModulesRef = Dcm
          PduRRoutingPath_038
            PduRSrcPdu_38 (PduRSrcPdu):
              PduRSrcPduDirection = RECEIVE
              PduRSourcePduHandleId = 24
              PduRSrcPduRef = PT_TL_MST_GW_TRNSM_FR_254_00980001_TxFA_PP_TL_MST_GW_TRNSM_FR_254_00980001_TxFA_Rx_c0e3388d_6409b170
              PduRSrcPduPduRBswModulesRef = FrTp
            PduRDestPdu_38 (PduRDestPdu):
              PduRDestPduDirection = RECEIVE
              PduRDestPduRoutingType = API_FORWARDING
              PduRDestPduHandleId = 24
              PduRDestPduRef = PT_TL_MST_GW_TRNSM_FR_254_00980001_TxFA_PP_TL_MST_GW_TRNSM_FR_254_00980001_TxFA_Rx_c0e3388d_6409b170
              PduRDestPduPduRBswModulesRef = Dcm
          PduRRoutingPath_037
            PduRDestPdu_37 (PduRDestPdu):
              PduRDestPduDirection = RECEIVE
              PduRDestPduRoutingType = API_FORWARDING
              PduRDestPduHandleId = 23
              PduRDestPduRef = PT_TL_MST_GW_TRNSM_FR_254_00980001_TxF9_PP_TL_MST_GW_TRNSM_FR_254_00980001_TxF9_Rx_c0e3388d_6409b170
              PduRDestPduPduRBswModulesRef = Dcm
            PduRSrcPdu_37 (PduRSrcPdu):
              PduRSrcPduDirection = RECEIVE
              PduRSourcePduHandleId = 23
              PduRSrcPduRef = PT_TL_MST_GW_TRNSM_FR_254_00980001_TxF9_PP_TL_MST_GW_TRNSM_FR_254_00980001_TxF9_Rx_c0e3388d_6409b170
              PduRSrcPduPduRBswModulesRef = FrTp
          PduRRoutingPath_039
            PduRSrcPdu_39 (PduRSrcPdu):
              PduRSrcPduDirection = RECEIVE
              PduRSourcePduHandleId = 25
              PduRSrcPduRef = PT_TL_MST_GW_TRNSM_FR_254_00980001_TxFB_PP_TL_MST_GW_TRNSM_FR_254_00980001_TxFB_Rx_c0e3388d_6409b170
              PduRSrcPduPduRBswModulesRef = FrTp
            PduRDestPdu_39 (PduRDestPdu):
              PduRDestPduDirection = RECEIVE
              PduRDestPduRoutingType = API_FORWARDING
              PduRDestPduHandleId = 25
              PduRDestPduRef = PT_TL_MST_GW_TRNSM_FR_254_00980001_TxFB_PP_TL_MST_GW_TRNSM_FR_254_00980001_TxFB_Rx_c0e3388d_6409b170
              PduRDestPduPduRBswModulesRef = Dcm
          PduRRoutingPath_034
            PduRSrcPdu_34 (PduRSrcPdu):
              PduRSrcPduDirection = RECEIVE
              PduRSourcePduHandleId = 20
              PduRSrcPduRef = PT_TL_MST_GW_TRNSM_FR_254_00980001_TxF6_PP_TL_MST_GW_TRNSM_FR_254_00980001_TxF6_Rx_c0e3388d_6409b170
              PduRSrcPduPduRBswModulesRef = FrTp
            PduRDestPdu_34 (PduRDestPdu):
              PduRDestPduDirection = RECEIVE
              PduRDestPduRoutingType = API_FORWARDING
              PduRDestPduHandleId = 20
              PduRDestPduRef = PT_TL_MST_GW_TRNSM_FR_254_00980001_TxF6_PP_TL_MST_GW_TRNSM_FR_254_00980001_TxF6_Rx_c0e3388d_6409b170
              PduRDestPduPduRBswModulesRef = Dcm
          PduRRoutingPath_033
            PduRDestPdu_33 (PduRDestPdu):
              PduRDestPduDirection = RECEIVE
              PduRDestPduRoutingType = API_FORWARDING
              PduRDestPduHandleId = 19
              PduRDestPduRef = PT_TL_MST_GW_TRNSM_FR_254_00980001_TxF5_PP_TL_MST_GW_TRNSM_FR_254_00980001_TxF5_Rx_c0e3388d_6409b170
              PduRDestPduPduRBswModulesRef = Dcm
            PduRSrcPdu_33 (PduRSrcPdu):
              PduRSrcPduDirection = RECEIVE
              PduRSourcePduHandleId = 19
              PduRSrcPduRef = PT_TL_MST_GW_TRNSM_FR_254_00980001_TxF5_PP_TL_MST_GW_TRNSM_FR_254_00980001_TxF5_Rx_c0e3388d_6409b170
              PduRSrcPduPduRBswModulesRef = FrTp
          PduRRoutingPath_036
            PduRDestPdu_36 (PduRDestPdu):
              PduRDestPduDirection = RECEIVE
              PduRDestPduRoutingType = API_FORWARDING
              PduRDestPduHandleId = 22
              PduRDestPduRef = PT_TL_MST_GW_TRNSM_FR_254_00980001_TxF8_PP_TL_MST_GW_TRNSM_FR_254_00980001_TxF8_Rx_c0e3388d_6409b170
              PduRDestPduPduRBswModulesRef = Dcm
            PduRSrcPdu_36 (PduRSrcPdu):
              PduRSrcPduDirection = RECEIVE
              PduRSourcePduHandleId = 22
              PduRSrcPduRef = PT_TL_MST_GW_TRNSM_FR_254_00980001_TxF8_PP_TL_MST_GW_TRNSM_FR_254_00980001_TxF8_Rx_c0e3388d_6409b170
              PduRSrcPduPduRBswModulesRef = FrTp
          PduRRoutingPath_035
            PduRSrcPdu_35 (PduRSrcPdu):
              PduRSrcPduDirection = RECEIVE
              PduRSourcePduHandleId = 21
              PduRSrcPduRef = PT_TL_MST_GW_TRNSM_FR_254_00980001_TxF7_PP_TL_MST_GW_TRNSM_FR_254_00980001_TxF7_Rx_c0e3388d_6409b170
              PduRSrcPduPduRBswModulesRef = FrTp
            PduRDestPdu_35 (PduRDestPdu):
              PduRDestPduDirection = RECEIVE
              PduRDestPduRoutingType = API_FORWARDING
              PduRDestPduHandleId = 21
              PduRDestPduRef = PT_TL_MST_GW_TRNSM_FR_254_00980001_TxF7_PP_TL_MST_GW_TRNSM_FR_254_00980001_TxF7_Rx_c0e3388d_6409b170
              PduRDestPduPduRBswModulesRef = Dcm
          PduRRoutingPath_021
            PduRDestPdu_21 (PduRDestPdu):
              PduRDestPduDirection = TRANSMIT
              PduRDestPduRoutingType = API_FORWARDING
              PduRDestPduHandleId = 7
              PduRDestPduRef = PT_TL_ECU_TRNSM_FR_32_00BC0001_RxF7_PP_TL_ECU_TRNSM_FR_32_00BC0001_RxF7_Tx_c0e3388d_6409b170
              PduRDestPduPduRBswModulesRef = FrTp
            PduRSrcPdu_21 (PduRSrcPdu):
              PduRSrcPduDirection = TRANSMIT
              PduRSourcePduHandleId = 7
              PduRSrcPduRef = PT_TL_ECU_TRNSM_FR_32_00BC0001_RxF7_PP_TL_ECU_TRNSM_FR_32_00BC0001_RxF7_Tx_c0e3388d_6409b170
              PduRSrcPduPduRBswModulesRef = Dcm
          PduRRoutingPath_020
            PduRSrcPdu_20 (PduRSrcPdu):
              PduRSrcPduDirection = TRANSMIT
              PduRSourcePduHandleId = 6
              PduRSrcPduRef = PT_TL_ECU_TRNSM_FR_32_00BC0001_RxF6_PP_TL_ECU_TRNSM_FR_32_00BC0001_RxF6_Tx_c0e3388d_6409b170
              PduRSrcPduPduRBswModulesRef = Dcm
            PduRDestPdu_20 (PduRDestPdu):
              PduRDestPduDirection = TRANSMIT
              PduRDestPduRoutingType = API_FORWARDING
              PduRDestPduHandleId = 6
              PduRDestPduRef = PT_TL_ECU_TRNSM_FR_32_00BC0001_RxF6_PP_TL_ECU_TRNSM_FR_32_00BC0001_RxF6_Tx_c0e3388d_6409b170
              PduRDestPduPduRBswModulesRef = FrTp
          PduRRoutingPath_027
            PduRSrcPdu_27 (PduRSrcPdu):
              PduRSrcPduDirection = TRANSMIT
              PduRSourcePduHandleId = 13
              PduRSrcPduRef = PT_TL_ECU_TRNSM_FR_32_00BC0001_RxFD_PP_TL_ECU_TRNSM_FR_32_00BC0001_RxFD_Tx_c0e3388d_6409b170
              PduRSrcPduPduRBswModulesRef = Dcm
            PduRDestPdu_27 (PduRDestPdu):
              PduRDestPduDirection = TRANSMIT
              PduRDestPduRoutingType = API_FORWARDING
              PduRDestPduHandleId = 13
              PduRDestPduRef = PT_TL_ECU_TRNSM_FR_32_00BC0001_RxFD_PP_TL_ECU_TRNSM_FR_32_00BC0001_RxFD_Tx_c0e3388d_6409b170
              PduRDestPduPduRBswModulesRef = FrTp
          PduRRoutingPath_026
            PduRDestPdu_26 (PduRDestPdu):
              PduRDestPduDirection = TRANSMIT
              PduRDestPduRoutingType = API_FORWARDING
              PduRDestPduHandleId = 12
              PduRDestPduRef = PT_TL_ECU_TRNSM_FR_32_00BC0001_RxFC_PP_TL_ECU_TRNSM_FR_32_00BC0001_RxFC_Tx_c0e3388d_6409b170
              PduRDestPduPduRBswModulesRef = FrTp
            PduRSrcPdu_26 (PduRSrcPdu):
              PduRSrcPduDirection = TRANSMIT
              PduRSourcePduHandleId = 12
              PduRSrcPduRef = PT_TL_ECU_TRNSM_FR_32_00BC0001_RxFC_PP_TL_ECU_TRNSM_FR_32_00BC0001_RxFC_Tx_c0e3388d_6409b170
              PduRSrcPduPduRBswModulesRef = Dcm
          PduRRoutingPath_029
            PduRDestPdu_29 (PduRDestPdu):
              PduRDestPduDirection = RECEIVE
              PduRDestPduRoutingType = API_FORWARDING
              PduRDestPduHandleId = 15
              PduRDestPduRef = PT_TL_MST_GW_TRNSM_FR_254_00980001_TxF1_PP_TL_MST_GW_TRNSM_FR_254_00980001_TxF1_Rx_c0e3388d_6409b170
              PduRDestPduPduRBswModulesRef = Dcm
            PduRSrcPdu_29 (PduRSrcPdu):
              PduRSrcPduDirection = RECEIVE
              PduRSourcePduHandleId = 15
              PduRSrcPduRef = PT_TL_MST_GW_TRNSM_FR_254_00980001_TxF1_PP_TL_MST_GW_TRNSM_FR_254_00980001_TxF1_Rx_c0e3388d_6409b170
              PduRSrcPduPduRBswModulesRef = FrTp
          PduRRoutingPath_028
            PduRSrcPdu_28 (PduRSrcPdu):
              PduRSrcPduDirection = RECEIVE
              PduRSourcePduHandleId = 14
              PduRSrcPduRef = PT_TL_MST_GW_TRNSM_FR_254_00980001_TxF0_PP_TL_MST_GW_TRNSM_FR_254_00980001_TxF0_Rx_c0e3388d_6409b170
              PduRSrcPduPduRBswModulesRef = FrTp
            PduRDestPdu_28 (PduRDestPdu):
              PduRDestPduDirection = RECEIVE
              PduRDestPduRoutingType = API_FORWARDING
              PduRDestPduHandleId = 14
              PduRDestPduRef = PT_TL_MST_GW_TRNSM_FR_254_00980001_TxF0_PP_TL_MST_GW_TRNSM_FR_254_00980001_TxF0_Rx_c0e3388d_6409b170
              PduRDestPduPduRBswModulesRef = Dcm
          PduRRoutingPath_023
            PduRSrcPdu_23 (PduRSrcPdu):
              PduRSrcPduDirection = TRANSMIT
              PduRSourcePduHandleId = 9
              PduRSrcPduRef = PT_TL_ECU_TRNSM_FR_32_00BC0001_RxF9_PP_TL_ECU_TRNSM_FR_32_00BC0001_RxF9_Tx_c0e3388d_6409b170
              PduRSrcPduPduRBswModulesRef = Dcm
            PduRDestPdu_23 (PduRDestPdu):
              PduRDestPduDirection = TRANSMIT
              PduRDestPduRoutingType = API_FORWARDING
              PduRDestPduHandleId = 9
              PduRDestPduRef = PT_TL_ECU_TRNSM_FR_32_00BC0001_RxF9_PP_TL_ECU_TRNSM_FR_32_00BC0001_RxF9_Tx_c0e3388d_6409b170
              PduRDestPduPduRBswModulesRef = FrTp
          PduRRoutingPath_022
            PduRDestPdu_22 (PduRDestPdu):
              PduRDestPduDirection = TRANSMIT
              PduRDestPduRoutingType = API_FORWARDING
              PduRDestPduHandleId = 8
              PduRDestPduRef = PT_TL_ECU_TRNSM_FR_32_00BC0001_RxF8_PP_TL_ECU_TRNSM_FR_32_00BC0001_RxF8_Tx_c0e3388d_6409b170
              PduRDestPduPduRBswModulesRef = FrTp
            PduRSrcPdu_22 (PduRSrcPdu):
              PduRSrcPduDirection = TRANSMIT
              PduRSourcePduHandleId = 8
              PduRSrcPduRef = PT_TL_ECU_TRNSM_FR_32_00BC0001_RxF8_PP_TL_ECU_TRNSM_FR_32_00BC0001_RxF8_Tx_c0e3388d_6409b170
              PduRSrcPduPduRBswModulesRef = Dcm
          PduRRoutingPath_025
            PduRDestPdu_25 (PduRDestPdu):
              PduRDestPduDirection = TRANSMIT
              PduRDestPduRoutingType = API_FORWARDING
              PduRDestPduHandleId = 11
              PduRDestPduRef = PT_TL_ECU_TRNSM_FR_32_00BC0001_RxFB_PP_TL_ECU_TRNSM_FR_32_00BC0001_RxFB_Tx_c0e3388d_6409b170
              PduRDestPduPduRBswModulesRef = FrTp
            PduRSrcPdu_25 (PduRSrcPdu):
              PduRSrcPduDirection = TRANSMIT
              PduRSourcePduHandleId = 11
              PduRSrcPduRef = PT_TL_ECU_TRNSM_FR_32_00BC0001_RxFB_PP_TL_ECU_TRNSM_FR_32_00BC0001_RxFB_Tx_c0e3388d_6409b170
              PduRSrcPduPduRBswModulesRef = Dcm
          PduRRoutingPath_024
            PduRSrcPdu_24 (PduRSrcPdu):
              PduRSrcPduDirection = TRANSMIT
              PduRSourcePduHandleId = 10
              PduRSrcPduRef = PT_TL_ECU_TRNSM_FR_32_00BC0001_RxFA_PP_TL_ECU_TRNSM_FR_32_00BC0001_RxFA_Tx_c0e3388d_6409b170
              PduRSrcPduPduRBswModulesRef = Dcm
            PduRDestPdu_24 (PduRDestPdu):
              PduRDestPduDirection = TRANSMIT
              PduRDestPduRoutingType = API_FORWARDING
              PduRDestPduHandleId = 10
              PduRDestPduRef = PT_TL_ECU_TRNSM_FR_32_00BC0001_RxFA_PP_TL_ECU_TRNSM_FR_32_00BC0001_RxFA_Tx_c0e3388d_6409b170
              PduRDestPduPduRBswModulesRef = FrTp
          PduRRoutingPath_019
            PduRDestPdu_19 (PduRDestPdu):
              PduRDestPduDirection = TRANSMIT
              PduRDestPduRoutingType = API_FORWARDING
              PduRDestPduHandleId = 5
              PduRDestPduRef = PT_TL_ECU_TRNSM_FR_32_00BC0001_RxF5_PP_TL_ECU_TRNSM_FR_32_00BC0001_RxF5_Tx_c0e3388d_6409b170
              PduRDestPduPduRBswModulesRef = FrTp
            PduRSrcPdu_19 (PduRSrcPdu):
              PduRSrcPduDirection = TRANSMIT
              PduRSourcePduHandleId = 5
              PduRSrcPduRef = PT_TL_ECU_TRNSM_FR_32_00BC0001_RxF5_PP_TL_ECU_TRNSM_FR_32_00BC0001_RxF5_Tx_c0e3388d_6409b170
              PduRSrcPduPduRBswModulesRef = Dcm
          PduRRoutingPath_010
            PduRDestPdu_10 (PduRDestPdu):
              PduRDestPduDirection = RECEIVE
              PduRDestPduRoutingType = API_FORWARDING
              PduRDestPduHandleId = 10
              PduRDestPduRef = PT_TL_BRC_FR_32_TxFA_0xDF_PP_TL_BRC_FR_32_TxFA_0xDF_Rx_c0e3388d_6409b170
              PduRDestPduPduRBswModulesRef = Dcm
            PduRSrcPdu_10 (PduRSrcPdu):
              PduRSrcPduDirection = RECEIVE
              PduRSourcePduHandleId = 10
              PduRSrcPduRef = PT_TL_BRC_FR_32_TxFA_0xDF_PP_TL_BRC_FR_32_TxFA_0xDF_Rx_c0e3388d_6409b170
              PduRSrcPduPduRBswModulesRef = FrTp
          PduRRoutingPath_016
            PduRSrcPdu_16 (PduRSrcPdu):
              PduRSrcPduDirection = TRANSMIT
              PduRSourcePduHandleId = 2
              PduRSrcPduRef = PT_TL_ECU_TRNSM_FR_32_00BC0001_RxF2_PP_TL_ECU_TRNSM_FR_32_00BC0001_RxF2_Tx_c0e3388d_6409b170
              PduRSrcPduPduRBswModulesRef = Dcm
            PduRDestPdu_16 (PduRDestPdu):
              PduRDestPduDirection = TRANSMIT
              PduRDestPduRoutingType = API_FORWARDING
              PduRDestPduHandleId = 2
              PduRDestPduRef = PT_TL_ECU_TRNSM_FR_32_00BC0001_RxF2_PP_TL_ECU_TRNSM_FR_32_00BC0001_RxF2_Tx_c0e3388d_6409b170
              PduRDestPduPduRBswModulesRef = FrTp
          PduRRoutingPath_015
            PduRDestPdu_15 (PduRDestPdu):
              PduRDestPduDirection = TRANSMIT
              PduRDestPduRoutingType = API_FORWARDING
              PduRDestPduHandleId = 1
              PduRDestPduRef = PT_TL_ECU_TRNSM_FR_32_00BC0001_RxF1_PP_TL_ECU_TRNSM_FR_32_00BC0001_RxF1_Tx_c0e3388d_6409b170
              PduRDestPduPduRBswModulesRef = FrTp
            PduRSrcPdu_15 (PduRSrcPdu):
              PduRSrcPduDirection = TRANSMIT
              PduRSourcePduHandleId = 1
              PduRSrcPduRef = PT_TL_ECU_TRNSM_FR_32_00BC0001_RxF1_PP_TL_ECU_TRNSM_FR_32_00BC0001_RxF1_Tx_c0e3388d_6409b170
              PduRSrcPduPduRBswModulesRef = Dcm
          PduRRoutingPath_018
            PduRDestPdu_18 (PduRDestPdu):
              PduRDestPduDirection = TRANSMIT
              PduRDestPduRoutingType = API_FORWARDING
              PduRDestPduHandleId = 4
              PduRDestPduRef = PT_TL_ECU_TRNSM_FR_32_00BC0001_RxF4_PP_TL_ECU_TRNSM_FR_32_00BC0001_RxF4_Tx_c0e3388d_6409b170
              PduRDestPduPduRBswModulesRef = FrTp
            PduRSrcPdu_18 (PduRSrcPdu):
              PduRSrcPduDirection = TRANSMIT
              PduRSourcePduHandleId = 4
              PduRSrcPduRef = PT_TL_ECU_TRNSM_FR_32_00BC0001_RxF4_PP_TL_ECU_TRNSM_FR_32_00BC0001_RxF4_Tx_c0e3388d_6409b170
              PduRSrcPduPduRBswModulesRef = Dcm
          PduRRoutingPath_017
            PduRSrcPdu_17 (PduRSrcPdu):
              PduRSrcPduDirection = TRANSMIT
              PduRSourcePduHandleId = 3
              PduRSrcPduRef = PT_TL_ECU_TRNSM_FR_32_00BC0001_RxF3_PP_TL_ECU_TRNSM_FR_32_00BC0001_RxF3_Tx_c0e3388d_6409b170
              PduRSrcPduPduRBswModulesRef = Dcm
            PduRDestPdu_17 (PduRDestPdu):
              PduRDestPduDirection = TRANSMIT
              PduRDestPduRoutingType = API_FORWARDING
              PduRDestPduHandleId = 3
              PduRDestPduRef = PT_TL_ECU_TRNSM_FR_32_00BC0001_RxF3_PP_TL_ECU_TRNSM_FR_32_00BC0001_RxF3_Tx_c0e3388d_6409b170
              PduRDestPduPduRBswModulesRef = FrTp
          PduRRoutingPath_012
            PduRSrcPdu_12 (PduRSrcPdu):
              PduRSrcPduDirection = RECEIVE
              PduRSourcePduHandleId = 12
              PduRSrcPduRef = PT_TL_BRC_FR_32_TxFC_0xDF_PP_TL_BRC_FR_32_TxFC_0xDF_Rx_c0e3388d_6409b170
              PduRSrcPduPduRBswModulesRef = FrTp
            PduRDestPdu_12 (PduRDestPdu):
              PduRDestPduDirection = RECEIVE
              PduRDestPduRoutingType = API_FORWARDING
              PduRDestPduHandleId = 12
              PduRDestPduRef = PT_TL_BRC_FR_32_TxFC_0xDF_PP_TL_BRC_FR_32_TxFC_0xDF_Rx_c0e3388d_6409b170
              PduRDestPduPduRBswModulesRef = Dcm
          PduRRoutingPath_011
            PduRDestPdu_11 (PduRDestPdu):
              PduRDestPduDirection = RECEIVE
              PduRDestPduRoutingType = API_FORWARDING
              PduRDestPduHandleId = 11
              PduRDestPduRef = PT_TL_BRC_FR_32_TxFB_0xDF_PP_TL_BRC_FR_32_TxFB_0xDF_Rx_c0e3388d_6409b170
              PduRDestPduPduRBswModulesRef = Dcm
            PduRSrcPdu_11 (PduRSrcPdu):
              PduRSrcPduDirection = RECEIVE
              PduRSourcePduHandleId = 11
              PduRSrcPduRef = PT_TL_BRC_FR_32_TxFB_0xDF_PP_TL_BRC_FR_32_TxFB_0xDF_Rx_c0e3388d_6409b170
              PduRSrcPduPduRBswModulesRef = FrTp
          PduRRoutingPath_014
            PduRDestPdu_14 (PduRDestPdu):
              PduRDestPduDirection = TRANSMIT
              PduRDestPduRoutingType = API_FORWARDING
              PduRDestPduHandleId = 0
              PduRDestPduRef = PT_TL_ECU_TRNSM_FR_32_00BC0001_RxF0_PP_TL_ECU_TRNSM_FR_32_00BC0001_RxF0_Tx_c0e3388d_6409b170
              PduRDestPduPduRBswModulesRef = FrTp
            PduRSrcPdu_14 (PduRSrcPdu):
              PduRSrcPduDirection = TRANSMIT
              PduRSourcePduHandleId = 0
              PduRSrcPduRef = PT_TL_ECU_TRNSM_FR_32_00BC0001_RxF0_PP_TL_ECU_TRNSM_FR_32_00BC0001_RxF0_Tx_c0e3388d_6409b170
              PduRSrcPduPduRBswModulesRef = Dcm
          PduRRoutingPath_013
            PduRSrcPdu_13 (PduRSrcPdu):
              PduRSrcPduDirection = RECEIVE
              PduRSourcePduHandleId = 13
              PduRSrcPduRef = PT_TL_BRC_FR_32_TxFD_0xDF_PP_TL_BRC_FR_32_TxFD_0xDF_Rx_c0e3388d_6409b170
              PduRSrcPduPduRBswModulesRef = FrTp
            PduRDestPdu_13 (PduRDestPdu):
              PduRDestPduDirection = RECEIVE
              PduRDestPduRoutingType = API_FORWARDING
              PduRDestPduHandleId = 13
              PduRDestPduRef = PT_TL_BRC_FR_32_TxFD_0xDF_PP_TL_BRC_FR_32_TxFD_0xDF_Rx_c0e3388d_6409b170
              PduRDestPduPduRBswModulesRef = Dcm
    Dcm (PduRBswModules):
      PduRCancelReceive = false
      PduRCancelTransmit = false
      PduRChangeParameterRequestApi = false
      PduRCommunicationInterface = false
      PduRLowerModule = false
      PduRTransportProtocol = true
      PduRTriggertransmit = false
      PduRTxConfirmation = false
      PduRUpperModule = true
      PduRUseTag = true
      PduRBswModuleRef = Dcm
    FrTp (PduRBswModules):
      PduRCancelReceive = false
      PduRCancelTransmit = false
      PduRChangeParameterRequestApi = false
      PduRCommunicationInterface = false
      PduRLowerModule = true
      PduRTransportProtocol = true
      PduRTriggertransmit = false
      PduRTxConfirmation = false
      PduRUpperModule = false
      PduRUseTag = false
      PduRBswModuleRef = FrTp
