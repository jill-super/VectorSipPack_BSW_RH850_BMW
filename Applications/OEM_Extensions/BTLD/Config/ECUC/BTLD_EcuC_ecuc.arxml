AUTOSAR XML (schema 4-3-0)
package /ActiveEcuC
  module config EcuC: implementation-config-variant=VARIANT-PRE-COMPILE, module-description=EcuC_Impl
    EcucPduCollection: PduIdTypeEnum=UINT16, PduLengthTypeEnum=UINT16
      101 x Pdu, all with J1939Requestable=false:
        pduTr_SECU_CHAL_A_FlexRay_pduPort_EPS_A_FlexRay_OUT_7d601c47_052bff33: PduLength=8  # SECU_CHAL
        pduTr_FR_DBG_EPS_A_FlexRay_pduPort_EPS_A_FlexRay_OUT_7d601c47_052bff33: PduLength=58, SysTPduToFrameMappingRef=sn_6b68fdbc63d54758bff55913fcd344ba_5_43f7a9daf64d4ee7b94a0fd106743903_5  # FR_DBG_EPS
        pduTr_xcpdynamic254_4_A_FlexRay_pduPort_EPS_A_FlexRay_OUT_7d601c47_052bff33: PduLength=254, SysTPduToFrameMappingRef=sn_ED55D3C388349965E0402EA019872AD5_1_ED55AF29C92D2294E0402EA019874515_1  # xcpdynamic254_4
        pduTr_DISP_CC_EPS_A_FlexRay_pduPort_EPS_A_FlexRay_OUT_7d601c47_052bff33: PduLength=5, SysTPduToFrameMappingRef=sn_bbacfb13291a4ee286c905592a1bb973_2_39a2ac19c7164f0385b879ca14e85e7b_2  # DISP_CC_EPS
        pduTr_V_VEH_A_FlexRay_pduPort_EPS_A_FlexRay_IN_7d601c47_052bff33: PduLength=5, SysTPduToFrameMappingRef=sn_2891826c350d482582f167e1fc0f401f_10_af83ce37179a45aca7ac57646532416b_18  # V_VEH
        pduTr_SECU_RESP_A_FlexRay_pduPort_EPS_A_FlexRay_IN_7d601c47_052bff33: PduLength=8  # SECU_RESP
        pduTr_FAHRGESTELLNUMMER_A_FlexRay_pduPort_EPS_A_FlexRay_IN_7d601c47_052bff33: PduLength=7, SysTPduToFrameMappingRef=sn_1e39d529353949ad94ad72cd99e0239e_13_9007d271e9154737bbd9f3c54ab3098b_12  # FAHRGESTELLNUMMER
        pduTr_DBG_EPS_BS_MOD_58_BYTE_A_FlexRay_pduPort_EPS_A_FlexRay_OUT_7d601c47_052bff33: PduLength=58  # DBG_EPS_BS_MOD_58_BYTE
        pduTr_FZZSTD_A_FlexRay_pduPort_EPS_A_FlexRay_IN_7d601c47_052bff33: PduLength=8, SysTPduToFrameMappingRef=sn_e5dc33323d8e4047bef88bdbfc641fb1_12_47c848be64324d52af177d4eda36b369_12  # FZZSTD
        pduTr_OFFS_QUAD_EPS_A_FlexRay_pduPort_EPS_A_FlexRay_IN_7d601c47_052bff33: PduLength=5, SysTPduToFrameMappingRef=sn_4b75d7aade684404a40181123f5e091e_13_2538d099b88d4657ae03c10c9544a047_14  # OFFS_QUAD_EPS
        pduTr_RQ_STG_EFAN_A_FlexRay_pduPort_EPS_A_FlexRay_OUT_7d601c47_052bff33: PduLength=8  # RQ_STG_EFAN
        pduTr_CTR_DIAG_OBD_DRDY_A_FlexRay_pduPort_EPS_A_FlexRay_IN_7d601c47_052bff33: PduLength=2, SysTPduToFrameMappingRef=sn_62b9b444be3144e4afdbe2e8f65ae37b_4_eb2aaf9fde954786857e30879fbebab8_4  # CTR_DIAG_OBD_DRDY
        pduTr_SU_EPS_A_FlexRay_pduPort_EPS_A_FlexRay_OUT_7d601c47_052bff33: PduLength=8, SysTPduToFrameMappingRef=sn_c217e50a54da493a879e8e4514e8c562_4_ecced8165aea4835a2a17dc224344598_4  # SU_EPS
        pduTr_dummy16bstatic_A_FlexRay_pduPort_EPS_A_FlexRay_OUT_7d601c47_052bff33: PduLength=16, SysTPduToFrameMappingRef=sn_d6c051138a624b7197665ea502ed9c68_3_9779c0f9609648bfa4441a0865c580a6_3  # dummy16bstatic
        pduTr_DIAG_OBD_ENG_A_FlexRay_pduPort_EPS_A_FlexRay_IN_7d601c47_052bff33: PduLength=7, SysTPduToFrameMappingRef=sn_f26c29b5554146b48da2e76fdc87f59b_13_d8833aa6063240d791b5384f59f75d9a_13  # DIAG_OBD_ENG
        pduTr_AVL_STMOM_DV_ACT_A_FlexRay_pduPort_EPS_A_FlexRay_OUT_7d601c47_052bff33: PduLength=4, SysTPduToFrameMappingRef=sn_742c7ae2ecf94fc080e798e25ca70247_16_1edf400c871b41dab29d318a6fc3ec64_13  # AVL_STMOM_DV_ACT
        SVC_434514f6_Out: PduLength=8, SysTPduToFrameMappingRef=sn_9dd8c6cee627483a83c881709979081d_77_017541877cab44569267610f7b9dbbd6_78
        pduTr_DT_EST_A_FlexRay_pduPort_EPS_A_FlexRay_OUT_7d601c47_052bff33: PduLength=16, SysTPduToFrameMappingRef=sn_47f7335f9e884cfebf3cf85a43b03f09_9_f1c2ea448b5742e6a930415b5321c120_9  # DT_EST
        pduTr_SU_CLE_DRDY_DXP_A_FlexRay_pduPort_EPS_A_FlexRay_IN_7d601c47_052bff33: PduLength=8, SysTPduToFrameMappingRef=sn_642c67ac547c477491d482d6f4297c8a_10_04b89dc3c26d4ca08465c4eec950ef56_8  # SU_CLE_DRDY_DXP
        pduTr_xcpdynamic254_6_A_FlexRay_pduPort_EPS_A_FlexRay_OUT_7d601c47_052bff33: PduLength=254, SysTPduToFrameMappingRef=sn_ED55D568B7B7E932E0402EA019874AD0_1_ED55DDBF3F3F1652E0402EA01987662B_1  # xcpdynamic254_6
        pduTr_ENSU_SFY_A_FlexRay_pduPort_EPS_A_FlexRay_IN_7d601c47_052bff33: PduLength=8, SysTPduToFrameMappingRef=sn_34b57a760af141aaa6b7f792f94a53b8_2_4145eaff72594a8e9989935517b189e9_2  # ENSU_SFY
        ANFRAGE_434514f6_In: PduLength=8
        SVC_434514f6_In: PduLength=8, SysTPduToFrameMappingRef=sn_9dd8c6cee627483a83c881709979081d_77_017541877cab44569267610f7b9dbbd6_78
        pduTr_ERRM_BN_U_A_FlexRay_pduPort_EPS_A_FlexRay_IN_7d601c47_052bff33: PduLength=2, SysTPduToFrameMappingRef=sn_8e8d5ba824d24f699ca284a4f92ea5fd_4_677e18af96434b57a7947ca5849af5e4_4  # ERRM_BN_U
        pduTr_xcpdynamic254_5_A_FlexRay_pduPort_EPS_A_FlexRay_OUT_7d601c47_052bff33: PduLength=254, SysTPduToFrameMappingRef=sn_ED55AF29C9332294E0402EA019874515_1_ED55D568B7B1E932E0402EA019874AD0_1  # xcpdynamic254_5
        pduTr_ST_STAB_DSC_A_FlexRay_pduPort_EPS_A_FlexRay_IN_7d601c47_052bff33: PduLength=8, SysTPduToFrameMappingRef=sn_2c6859f532c740fd851c07438c6639fd_20_3e35ac63fc494d0fb399c763aeb7057b_24  # ST_STAB_DSC
        pduTr_RELATIVZEIT_A_FlexRay_pduPort_EPS_A_FlexRay_IN_7d601c47_052bff33: PduLength=6, SysTPduToFrameMappingRef=sn_ccc09e8b2c1e432a8f2a272e558c8566_3_acb3c9a426bf4887ba724efd428ad5a4_3  # RELATIVZEIT
        pduTr_VYAW_VEH_A_FlexRay_pduPort_EPS_A_FlexRay_IN_7d601c47_052bff33: PduLength=6, SysTPduToFrameMappingRef=sn_1a6c54ef470342899c8af77346d5f01c_20_27f7c756a0e24349b8e230b415458184_21  # VYAW_VEH
        pduTr_ACLNY_MASSCNTR_A_FlexRay_pduPort_EPS_A_FlexRay_IN_7d601c47_052bff33: PduLength=6, SysTPduToFrameMappingRef=sn_5d864f4a266e40639fe6abc57cceb758_17_060886cf9e88403f9df14c319aa0ae95_20  # ACLNY_MASSCNTR
        pduTr_AVL_RPM_WHL_A_FlexRay_pduPort_EPS_A_FlexRay_IN_7d601c47_052bff33: PduLength=12, SysTPduToFrameMappingRef=sn_708b545e63774a48974a2e012c342c56_18_ca307c7178fd4cb8b1f0845b9598b7e4_18  # AVL_RPM_WHL
        pduTr_CTR_VIB_STW_DISP_EXMI_SP2015_A_FlexRay_pduPort_EPS_A_FlexRay_IN_7d601c47_052bff33: PduLength=8, SysTPduToFrameMappingRef=sn_6d8a461ff30049dfbb2df9138651c35b_3_8e1fc510f7a3427998068160382540c0_4  # CTR_VIB_STW_DISP_EXMI_SP2015
        pduTr_dummy32bmaster_A_FlexRay_pduPort_EPS_A_FlexRay_IN_7d601c47_052bff33: PduLength=32, SysTPduToFrameMappingRef=sn_6acd24342b914dee85c6ec4bb84bea56_4_2e91d703d77a465ba5c92f45777cf2d1_4  # dummy32bmaster
        pduTr_AVL_PO_EPS_A_FlexRay_pduPort_EPS_A_FlexRay_OUT_7d601c47_052bff33: PduLength=8, SysTPduToFrameMappingRef=sn_0b01e810a8bf4aa3b3ead1e4c09f2b68_4_e0f63d36315c4773ba837e73d6faaadd_15  # AVL_PO_EPS
        pduTr_CON_VEH_A_FlexRay_pduPort_EPS_A_FlexRay_IN_7d601c47_052bff33: PduLength=8, SysTPduToFrameMappingRef=sn_a07de7dfbad342e18d0517336a8ccb12_11_f39dc9b4f18c4462a3ca3222d270f882_11  # CON_VEH
        pduTr_xcpdynamic254_1_A_FlexRay_pduPort_EPS_A_FlexRay_OUT_7d601c47_052bff33: PduLength=254, SysTPduToFrameMappingRef=sn_fdeafba7ae254e1e80d60b106053d532_1_7d44d6d889bf437cb0ff888debf8555c_1  # xcpdynamic254_1
        pduTr_xcpdynamic254_7_A_FlexRay_pduPort_EPS_A_FlexRay_OUT_7d601c47_052bff33: PduLength=254, SysTPduToFrameMappingRef=sn_ED55EE5E9A7A36A4E0402EA019872B37_1_ED55EF63738BA24EE0402EA019872B3F_1  # xcpdynamic254_7
        pduTr_STEA_OFFS_A_FlexRay_pduPort_EPS_A_FlexRay_IN_7d601c47_052bff33: PduLength=8, SysTPduToFrameMappingRef=sn_58cceca224fe40fc80675725acb2e3e1_11_55e086fa3cb3405c9e0849033f661450_11  # STEA_OFFS
        pduTr_ST_CENG_A_FlexRay_pduPort_EPS_A_FlexRay_IN_7d601c47_052bff33: PduLength=8, SysTPduToFrameMappingRef=sn_cf4a41801d9a44e3ad6339c69f3c4e8c_9_6e55c14d93c64aaa86e33b57aac2ae43_9  # ST_CENG
        pduTr_TAR_QTA_STRMOM_DV_A_FlexRay_pduPort_EPS_A_FlexRay_IN_7d601c47_052bff33: PduLength=8, SysTPduToFrameMappingRef=sn_13aa1571427746dfa4ddec6f8fe46d9d_12_2b4b9cfb3a644a13aeec78e06779be78_9  # TAR_QTA_STRMOM_DV
        pduTr_KILOMETERSTAND_A_FlexRay_pduPort_EPS_A_FlexRay_IN_7d601c47_052bff33: PduLength=8, SysTPduToFrameMappingRef=sn_23b23ec8e79d4821a4fd4f71addacbb8_10_209e4b614ee044c4bbf1020e8ad2a6e0_10  # KILOMETERSTAND
        pduTr_xcpdynamic254_2_A_FlexRay_pduPort_EPS_A_FlexRay_OUT_7d601c47_052bff33: PduLength=254, SysTPduToFrameMappingRef=sn_ED55AF29C91C2294E0402EA019874515_1_ED55B6DAA560EF99E0402EA019870214_1  # xcpdynamic254_2
        pduTr_TAR_ESTP_VIRT_FTAX_A_FlexRay_pduPort_EPS_A_FlexRay_IN_7d601c47_052bff33: PduLength=8, SysTPduToFrameMappingRef=sn_d9f1ff037ed147f1bcd2f969afda82c4_5_12963b5f55914150b9f8aacada47bf44_5  # TAR_ESTP_VIRT_FTAX
        pduTr_ENGTORQ_EPS_A_FlexRay_pduPort_EPS_A_FlexRay_OUT_7d601c47_052bff33: PduLength=8, SysTPduToFrameMappingRef=sn_0b01e810a8bf4aa3b3ead1e4c09f2b68_4_0c0ed9ed2c324b648cea19ccfdcf4017_2  # ENGTORQ_EPS
        pduTr_ST_ENERG_GEN_A_FlexRay_pduPort_EPS_A_FlexRay_IN_7d601c47_052bff33: PduLength=8, SysTPduToFrameMappingRef=sn_efdccab807464c4ab076173048647d90_15_085b67cff4b142a59fb46d892b9938f0_15  # ST_ENERG_GEN
        pduTr_TAR_STMOM_DV_ACT_A_FlexRay_pduPort_EPS_A_FlexRay_IN_7d601c47_052bff33: PduLength=8, SysTPduToFrameMappingRef=sn_13aa1571427746dfa4ddec6f8fe46d9d_12_d81fd7307a29409f9d9a2c110d5f1a3d_9  # TAR_STMOM_DV_ACT
        pduTr_DBG_EPS_MOD_EXT_120_BYTE_A_FlexRay_pduPort_EPS_A_FlexRay_OUT_7d601c47_052bff33: PduLength=58  # DBG_EPS_MOD_EXT_120_BYTE
        pduTr_xcpdynamic254_3_A_FlexRay_pduPort_EPS_A_FlexRay_OUT_7d601c47_052bff33: PduLength=254, SysTPduToFrameMappingRef=sn_ED55AF29C91F2294E0402EA019874515_1_ED55CA2D406A1E52E0402EA01987021E_1  # xcpdynamic254_3
        ANFRAGE_434514f6_Out: PduLength=8
        pduTr_xcpdynamic254_8_A_FlexRay_pduPort_EPS_A_FlexRay_OUT_7d601c47_052bff33: PduLength=254, SysTPduToFrameMappingRef=sn_ED55EE5E9A8836A4E0402EA019872B37_1_ED55FD352928D633E0402EA019872B44_1  # xcpdynamic254_8
        pduTr_ENERG_DGR_DRDY_A_FlexRay_pduPort_EPS_A_FlexRay_IN_7d601c47_052bff33: PduLength=8, SysTPduToFrameMappingRef=sn_a8f1d204f2ad40669d1acf24a5cd893e_8_39c3f0eb640a4f78a081a30d189b0df4_8  # ENERG_DGR_DRDY
        pduTr_SECU_FAHRGESTELLNUMMER_A_FlexRay_pduPort_EPS_A_FlexRay_IN_7d601c47_052bff33: PduLength=8, SysTPduToFrameMappingRef=sn_45fe7c1444bb44a182e3c698da50983a_3_ff5ad01b69a64f2fa3482d8ab369f18a_3  # SECU_FAHRGESTELLNUMMER
        pduTr_ST_EST_A_FlexRay_pduPort_EPS_A_FlexRay_OUT_7d601c47_052bff33: PduLength=5, SysTPduToFrameMappingRef=sn_2f3b1c2990d8434f9d60c8bc0223380a_14_0d521c7c53964f869478fa5c12f4ec50_14  # ST_EST
        pduTr_A_TEMP_A_FlexRay_pduPort_EPS_A_FlexRay_IN_7d601c47_052bff33: PduLength=2, SysTPduToFrameMappingRef=sn_ffb3893c37a446b6bb48321cc292082f_18_d0ea1fc2c1ca4e2295bae82b1e156e9a_18  # A_TEMP
        pduTr_ST_DIAG_OBD_3_DRDY_A_FlexRay_pduPort_EPS_A_FlexRay_OUT_7d601c47_052bff33: PduLength=8, SysTPduToFrameMappingRef=sn_f1b37dec817945749ac7e14f80df159d_4_95dff1578f214757b23c8394af12aa48_4  # ST_DIAG_OBD_3_DRDY
        pduTr_dummy32bslave_A_FlexRay_pduPort_EPS_A_FlexRay_OUT_7d601c47_052bff33: PduLength=32, SysTPduToFrameMappingRef=sn_2ed003fa08904453b0dfb985d50da316_4_039aef2810e44f2c9248813621a8312e_4  # dummy32bslave
        pduTr_AVL_FORC_GRD_A_FlexRay_pduPort_EPS_A_FlexRay_OUT_7d601c47_052bff33: PduLength=5, SysTPduToFrameMappingRef=sn_742c7ae2ecf94fc080e798e25ca70247_16_09e4bde6148d45f99746b23c44ef9b67_14  # AVL_FORC_GRD
        PT_TL_ECU_TRNSM_FR_32_00BC0001_RxF9_PP_TL_ECU_TRNSM_FR_32_00BC0001_RxF9_Tx_c0e3388d_6409b170: PduLength=65535
        PT_TL_BRC_FR_32_TxF2_0xDF_PP_TL_BRC_FR_32_TxF2_0xDF_Rx_c0e3388d_6409b170: PduLength=24
        PT_TL_ECU_TRNSM_FR_32_00BC0001_RxF6_PP_TL_ECU_TRNSM_FR_32_00BC0001_RxF6_Tx_c0e3388d_6409b170: PduLength=65535
        PT_TL_ECU_TRNSM_FR_32_00BC0001_RxF2_PP_TL_ECU_TRNSM_FR_32_00BC0001_RxF2_Tx_c0e3388d_6409b170: PduLength=65535
        PT_TL_ECU_TRNSM_FR_32_00BC0001_RxFC_PP_TL_ECU_TRNSM_FR_32_00BC0001_RxFC_Tx_c0e3388d_6409b170: PduLength=65535
        PT_TL_BRC_FR_32_TxF6_0xDF_PP_TL_BRC_FR_32_TxF6_0xDF_Rx_c0e3388d_6409b170: PduLength=24
        PT_TL_ECU_TRNSM_FR_32_00BC0001_RxF5_PP_TL_ECU_TRNSM_FR_32_00BC0001_RxF5_Tx_c0e3388d_6409b170: PduLength=65535
        PT_TL_BRC_FR_32_TxF9_0xDF_PP_TL_BRC_FR_32_TxF9_0xDF_Rx_c0e3388d_6409b170: PduLength=24
        PT_TL_BRC_FR_32_TxFC_0xDF_PP_TL_BRC_FR_32_TxFC_0xDF_Rx_c0e3388d_6409b170: PduLength=24
        PT_TL_MST_GW_TRNSM_FR_254_00980001_TxFD_PP_TL_MST_GW_TRNSM_FR_254_00980001_TxFD_Rx_c0e3388d_6409b170: PduLength=65535
        PT_TL_BRC_FR_32_TxFA_0xDF_PP_TL_BRC_FR_32_TxFA_0xDF_Rx_c0e3388d_6409b170: PduLength=24
        PT_TL_MST_GW_TRNSM_FR_254_00980001_TxFC_PP_TL_MST_GW_TRNSM_FR_254_00980001_TxFC_Rx_c0e3388d_6409b170: PduLength=65535
        PT_TL_ECU_TRNSM_FR_32_00BC0001_RxF3_PP_TL_ECU_TRNSM_FR_32_00BC0001_RxF3_Tx_c0e3388d_6409b170: PduLength=65535
        PT_TL_MST_GW_TRNSM_FR_254_00980001_TxF1_PP_TL_MST_GW_TRNSM_FR_254_00980001_TxF1_Rx_c0e3388d_6409b170: PduLength=65535
        PT_TL_ECU_TRNSM_FR_32_00BC0001_RxFD_PP_TL_ECU_TRNSM_FR_32_00BC0001_RxFD_Tx_c0e3388d_6409b170: PduLength=65535
        PT_TL_MST_GW_TRNSM_FR_254_00980001_TxF0_PP_TL_MST_GW_TRNSM_FR_254_00980001_TxF0_Rx_c0e3388d_6409b170: PduLength=65535
        PT_TL_MST_GW_TRNSM_FR_254_00980001_TxFA_PP_TL_MST_GW_TRNSM_FR_254_00980001_TxFA_Rx_c0e3388d_6409b170: PduLength=65535
        PT_TL_MST_GW_TRNSM_FR_254_00980001_TxFB_PP_TL_MST_GW_TRNSM_FR_254_00980001_TxFB_Rx_c0e3388d_6409b170: PduLength=65535
        PT_TL_BRC_FR_32_TxF8_0xDF_PP_TL_BRC_FR_32_TxF8_0xDF_Rx_c0e3388d_6409b170: PduLength=24
        PT_TL_BRC_FR_32_TxF3_0xDF_PP_TL_BRC_FR_32_TxF3_0xDF_Rx_c0e3388d_6409b170: PduLength=24
        PT_TL_BRC_FR_32_TxF7_0xDF_PP_TL_BRC_FR_32_TxF7_0xDF_Rx_c0e3388d_6409b170: PduLength=24
        PT_TL_MST_GW_TRNSM_FR_254_00980001_TxF5_PP_TL_MST_GW_TRNSM_FR_254_00980001_TxF5_Rx_c0e3388d_6409b170: PduLength=65535
        PT_TL_MST_GW_TRNSM_FR_254_00980001_TxF4_PP_TL_MST_GW_TRNSM_FR_254_00980001_TxF4_Rx_c0e3388d_6409b170: PduLength=65535
        PT_TL_MST_GW_TRNSM_FR_254_00980001_TxF3_PP_TL_MST_GW_TRNSM_FR_254_00980001_TxF3_Rx_c0e3388d_6409b170: PduLength=65535
        PT_TL_MST_GW_TRNSM_FR_254_00980001_TxF7_PP_TL_MST_GW_TRNSM_FR_254_00980001_TxF7_Rx_c0e3388d_6409b170: PduLength=65535
        PT_TL_MST_GW_TRNSM_FR_254_00980001_TxF2_PP_TL_MST_GW_TRNSM_FR_254_00980001_TxF2_Rx_c0e3388d_6409b170: PduLength=65535
        PT_TL_MST_GW_TRNSM_FR_254_00980001_TxF6_PP_TL_MST_GW_TRNSM_FR_254_00980001_TxF6_Rx_c0e3388d_6409b170: PduLength=65535
        PT_TL_MST_GW_TRNSM_FR_254_00980001_TxF9_PP_TL_MST_GW_TRNSM_FR_254_00980001_TxF9_Rx_c0e3388d_6409b170: PduLength=65535
        PT_TL_MST_GW_TRNSM_FR_254_00980001_TxF8_PP_TL_MST_GW_TRNSM_FR_254_00980001_TxF8_Rx_c0e3388d_6409b170: PduLength=65535
        PT_TL_ECU_TRNSM_FR_32_00BC0001_RxF4_PP_TL_ECU_TRNSM_FR_32_00BC0001_RxF4_Tx_c0e3388d_6409b170: PduLength=65535
        PT_TL_BRC_FR_32_TxFB_0xDF_PP_TL_BRC_FR_32_TxFB_0xDF_Rx_c0e3388d_6409b170: PduLength=24
        PT_TL_BRC_FR_32_TxF4_0xDF_PP_TL_BRC_FR_32_TxF4_0xDF_Rx_c0e3388d_6409b170: PduLength=24
        PT_TL_ECU_TRNSM_FR_32_00BC0001_RxFB_PP_TL_ECU_TRNSM_FR_32_00BC0001_RxFB_Tx_c0e3388d_6409b170: PduLength=65535
        PT_TL_BRC_FR_32_TxF1_0xDF_PP_TL_BRC_FR_32_TxF1_0xDF_Rx_c0e3388d_6409b170: PduLength=24
        PT_TL_ECU_TRNSM_FR_32_00BC0001_RxF8_PP_TL_ECU_TRNSM_FR_32_00BC0001_RxF8_Tx_c0e3388d_6409b170: PduLength=65535
        PT_TL_ECU_TRNSM_FR_32_00BC0001_RxF0_PP_TL_ECU_TRNSM_FR_32_00BC0001_RxF0_Tx_c0e3388d_6409b170: PduLength=65535
        PT_TL_BRC_FR_32_TxFD_0xDF_PP_TL_BRC_FR_32_TxFD_0xDF_Rx_c0e3388d_6409b170: PduLength=24
        PT_TL_ECU_TRNSM_FR_32_00BC0001_RxF1_PP_TL_ECU_TRNSM_FR_32_00BC0001_RxF1_Tx_c0e3388d_6409b170: PduLength=65535
        PT_TL_ECU_TRNSM_FR_32_00BC0001_RxF7_PP_TL_ECU_TRNSM_FR_32_00BC0001_RxF7_Tx_c0e3388d_6409b170: PduLength=65535
        PT_TL_BRC_FR_32_TxF0_0xDF_PP_TL_BRC_FR_32_TxF0_0xDF_Rx_c0e3388d_6409b170: PduLength=24
        PT_TL_ECU_TRNSM_FR_32_00BC0001_RxFA_PP_TL_ECU_TRNSM_FR_32_00BC0001_RxFA_Tx_c0e3388d_6409b170: PduLength=65535
        PT_TL_BRC_FR_32_TxF5_0xDF_PP_TL_BRC_FR_32_TxF5_0xDF_Rx_c0e3388d_6409b170: PduLength=24
        pduTr_TL_BRC_FR_32_A_FlexRay_pduPort_EPS_A_FlexRay_IN_7d601c47_052bff33: PduLength=32, SysTPduToFrameMappingRef=sn_b89d750f03b54dc591beef3d97af79e1_6_99b35db8d0034c95bddada0c4e168dbd_5  # TL_BRC_FR_32
        pduTr_TL_ECU_TRNSM_FR_32_A_FlexRay_pduPort_EPS_A_FlexRay_OUT_7d601c47_052bff33: PduLength=32, SysTPduToFrameMappingRef=sn_ada9591f59be44a18409d95fca100f53_5_c623861e6a0749cc9d81d43585ea7f81_4  # TL_ECU_TRNSM_FR_32
        pduTr_TL_MST_GW_TRNSM_FR_254_A_FlexRay_pduPort_EPS_A_FlexRay_IN_7d601c47_052bff33: PduLength=254, SysTPduToFrameMappingRef=sn_d187a29661e448debbfa1c1db2495add_2_161ebe01a13246f5bc130ce6f196d980_1  # TL_MST_GW_TRNSM_FR_254
    EcucGeneral:
      CPUType = CPU32Bit
      SizeOfInt = Size32Bit
      ByteOrder = LITTLE_ENDIAN
      BitOrder = LSB_to_MSB
      AtomicBitAccessInBitfield = true
      AtomicVariableAccess = Atomic32BitAccess
      SizeOfEnum = Size32Bit
      SizeOfROMPointer = Size32Bit
      SizeOfRAMPointer = Size32Bit
      BitFieldDataType = INT
      StructAlignment = Auto
      ArrayAlignment = Auto
      StructInArrayAlignment = Auto
      DummyFunction = false
      EcuCSafeBswChecks = false
      DummyStatement = true
      DummyStatementKind = SelfAssignment
      ConditionalGenerating = true
      EcucBswImplementationCodeType = EcuCSourceCode
      EcuCUseStdReturnTypeForRte = true
      BswInitialization
        34 x InitFunction:
          FrSM_Init: Header=FrSM.h, InitPhase=INIT_TWO_SM, ConfigType=FrSM_ConfigType, ConfigPtrName=FrSM_Config_Ptr, ConfigPtrClass=FRSM_INIT_DATA, ModuleRef=FrSM
          Xcp_Init: Header=Xcp.h, InitPhase=INIT_TWO_TP, ModuleRef=Xcp
          FrSM_InitMemory: Header=FrSM.h, InitPhase=INIT_MEMORY, ModuleRef=FrSM
          Det_InitMemory: Header=Det.h, InitPhase=INIT_MEMORY, ModuleRef=Det
          Det_Init: Header=Det.h, InitPhase=INIT_ZERO, ConfigType=Det_ConfigType, ConfigPtrName=Det_Config_Ptr, ConfigPtrClass=DET_INIT_DATA, ModuleRef=Det
          Fr_InitMemory: Header=Fr.h, InitPhase=INIT_MEMORY, ModuleRef=Fr
          PduR_InitMemory: Header=PduR.h, InitPhase=INIT_MEMORY, ModuleRef=PduR
          BswM_Init: Header=BswM.h, InitPhase=NO_INIT, ConfigType=BswM_ConfigType, ConfigPtrName=BswM_Config_Ptr, ConfigPtrClass=BSWM_INIT_DATA, ModuleRef=BswM
          EcuM_Init: Header=EcuM.h, InitPhase=NO_INIT, ConfigType=EcuM_PbConfigType, ConfigPtrName=EcuM_Config_Ptr, ConfigPtrClass=ECUM_INIT_DATA, ModuleRef=EcuM
          ComM_Init: Header=ComM.h, InitPhase=INIT_TWO_POST_NVMREADALL, ModuleRef=ComM
          SchM_Init: Header=Rte_Main.h, InitPhase=NO_INIT, ModuleRef=Rte
          FrIf_InitMemory: Header=FrIf.h, InitPhase=INIT_MEMORY, ModuleRef=FrIf
          Xcp_InitMemory: Header=Xcp.h, InitPhase=INIT_MEMORY, ModuleRef=Xcp
          BswM_InitMemory: Header=BswM.h, InitPhase=INIT_MEMORY, ModuleRef=BswM
          ComM_InitMemory: Header=ComM.h, InitPhase=INIT_MEMORY, ModuleRef=ComM
          PduR_Init: Header=PduR.h, InitPhase=INIT_TWO_COM, ConfigType=PduR_PBConfigType, ConfigPtrName=PduR_Config_Ptr, ConfigPtrClass=PDUR_INIT_DATA, ModuleRef=PduR
          Fr_Init: Header=Fr.h, InitPhase=INIT_TWO_DRV, ConfigType=Fr_ConfigType, ConfigPtrName=&Fr_Config, ConfigPtrClass=FR_CONST, ModuleRef=Fr
          FrIf_Init: Header=FrIf.h, InitPhase=INIT_TWO_IF, ConfigType=FrIf_ConfigType, ConfigPtrName=&FrIf_Config, ConfigPtrClass=FRIF_CONST, ModuleRef=FrIf
          Rte_InitMemory: Header=Rte_Main.h, InitPhase=INIT_MEMORY, ModuleRef=Rte
          Fls_Init: Header=Fls.h, InitPhase=INIT_ONE_LATE, ConfigType=Fls_ConfigType, ConfigPtrName=FlsConfigSet, ConfigPtrClass=FLS_CONST, ModuleRef=Fls
          Dcm_InitMemory: Header=Dcm.h, InitPhase=INIT_MEMORY, ModuleRef=Dcm
          Dcm_Init: Header=Dcm.h, InitPhase=INIT_TWO_POST_NVMREADALL, ConfigType=Dcm_ConfigType, ConfigPtrName=NULL_PTR, ConfigPtrClass=DCM_CONST, ModuleRef=Dcm
          Mcu_Init: Header=Mcu.h, InitPhase=INIT_ONE_EARLY, ConfigType=Mcu_ConfigType, ConfigPtrName=McuModuleConfiguration, ConfigPtrClass=MCU_VAR, ModuleRef=Mcu
          Mcu_InitClock: Header=Mcu.h, InitPhase=INIT_ONE_EARLY, AdditionalInitCode=Mcu_InitClock(McuConf_McuClockSettingConfig_McuClockSettingConfig), ModuleRef=Mcu
          Mcu_DistributePllClock: Header=Mcu.h, InitPhase=INIT_ONE, ModuleRef=Mcu
          Port_Init: Header=Port.h, InitPhase=INIT_ONE_EARLY, ConfigType=Port_ConfigType, ConfigPtrName=&Port_GstConfiguration[0], ConfigPtrClass=PORT_CONST, ModuleRef=Port
          Fee_30_SmallSector_Init: Header=Fee_30_SmallSector.h, InitPhase=INIT_TWO_IF, ModuleRef=Fee
          FrTp_Init: Header=FrTp.h, InitPhase=INIT_TWO_TP, ConfigType=FrTp_ConfigType, ConfigPtrName=&FrTp_Config, ConfigPtrClass=FRTP_CONST, ModuleRef=FrTp
          FrTp_InitMemory: Header=FrTp.h, InitPhase=INIT_MEMORY, ModuleRef=FrTp
          FrXcp_InitMemory: Header=FrXcp.h, InitPhase=INIT_MEMORY, ModuleRef=Xcp
          FrXcp_Init: Header=FrXcp.h, InitPhase=INIT_TWO_TP, ConfigType=FrXcp_ConfigType, ConfigPtrName=NULL_PTR, ConfigPtrClass=FRXCP_CONST, ModuleRef=Xcp
          Dem_PreInit: Header=Dem.h, InitPhase=INIT_ZERO, ConfigType=Dem_ConfigType, ConfigPtrName=Dem_Config_Ptr, ConfigPtrClass=DEM_INIT_DATA, ModuleRef=Dem
          Dem_InitMemory: Header=Dem.h, InitPhase=INIT_MEMORY, ModuleRef=Dem
          Dem_Init: Header=Dem.h, InitPhase=INIT_TWO_POST_NVMREADALL, ConfigType=Dem_ConfigType, ConfigPtrName=Dem_Config_Ptr, ConfigPtrClass=DEM_INIT_DATA, ModuleRef=Dem
      PostbuildLoadable: AlignmentFillPattern=0, PBROMStartAddress=0, PBRAMStartAddress=0, PBROMEndAddress=0, PBRAMEndAddress=0
    EcucHardware
      EcucCore0 (EcucCoreDefinition): EcucCoreId=0
