AUTOSAR XML (schema 4-3-0)
package /ActiveEcuC
  module config Prog: implementation-config-variant=VARIANT-PRE-COMPILE
    CommonPublishedInformation: SwMajorVersion=5, SwMinorVersion=4, SwPatchVersion=0
    ProgGeneral:
      ProgEraseAddressedEnable = true
      ProgNoncompressedEnable = true
      ProgNrvEnable = true
      ProgHttpEnable = false
      ProgNrvTempBufferSize = 16384
      ProgDeleteSwPackageEnable = false
