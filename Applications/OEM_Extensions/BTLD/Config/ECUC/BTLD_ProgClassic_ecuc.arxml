AUTOSAR XML (schema 4-3-0)
package /ActiveEcuC
  module config ProgClassic: implementation-config-variant=VARIANT-PRE-COMPILE
    CommonPublishedInformation: SwMajorVersion=5, SwMinorVersion=4, SwPatchVersion=0
    ProgGeneral: ProgReadMemoryAddressSupported=true, ProgCryptoEnable=false, ProgFlashPageSize=256, ProgFlashAddressAlign=4
