AUTOSAR XML (schema 4-3-0)
package /ActiveEcuC
  module config FrIf: implementation-config-variant=VARIANT-PRE-COMPILE, module-description=FrIf_Impl
    FrIfConfig
      TL_BRC_FR_32 (FrIfPdu)
        FrIfPduDirection
          FrIfRxPdu_TL_BRC_FR_32 (FrIfRxPdu): FrIfUserRxIndicationUL=FR_TP, FrIfRxPduId=1, FrIfRxPduRef=pduTr_TL_BRC_FR_32_A_FlexRay_pduPort_EPS_A_FlexRay_IN_7d601c47_052bff33  # TL_BRC_FR_32
      FrStr_xcpstatic_7ff9780c_Out (FrIfFrameStructure): FrIfByteOrder=LITTLE_ENDIAN  # xcpstatic
        sn_d6c051138a624b7197665ea502ed9c68_3_9779c0f9609648bfa4441a0865c580a6_3 (FrIfPdusInFrame): FrIfPduOffset=0, FrIfMappedPduId=12, FrIfPduRef=dummy16bstatic
      dummy32bmaster (FrIfPdu)
        FrIfPduDirection
          FrIfRxPdu_dummy32bmaster (FrIfRxPdu): FrIfUserRxIndicationUL=XCP, FrIfRxPduId=0, FrIfRxPduRef=pduTr_dummy32bmaster_A_FlexRay_pduPort_EPS_A_FlexRay_IN_7d601c47_052bff33  # dummy32bmaster
      FrStr_TL_MST_GW_TRNSM_FR_254 (FrIfFrameStructure): FrIfByteOrder=LITTLE_ENDIAN  # TL_MST_GW_TRNSM_FR_254
        sn_d187a29661e448debbfa1c1db2495add_2_161ebe01a13246f5bc130ce6f196d980_1 (FrIfPdusInFrame): FrIfPduOffset=0, FrIfMappedPduId=6, FrIfPduRef=TL_MST_GW_TRNSM_FR_254
      FrStr_xcpstatic_1fa5cd47_Out (FrIfFrameStructure): FrIfByteOrder=LITTLE_ENDIAN  # xcpstatic
        sn_d6c051138a624b7197665ea502ed9c68_3_9779c0f9609648bfa4441a0865c580a6_3 (FrIfPdusInFrame): FrIfPduOffset=0, FrIfMappedPduId=10, FrIfPduRef=dummy16bstatic
      dummy32bslave (FrIfPdu)
        FrIfPduDirection
          FrIfTxPdu_dummy32bslave (FrIfTxPdu):  # dummy32bslave
            FrIfUserTxUL = XCP
            FrIfConfirm = true
            FrIfCounterLimit = 1
            FrIfImmediate = false
            FrIfNoneMode = false
            FrIfTxPduId = 8
            FrIfTxPduRef = pduTr_dummy32bslave_A_FlexRay_pduPort_EPS_A_FlexRay_OUT_7d601c47_052bff33
      A_FlexRay (FrIfCluster):
        FrIfDetectNITError = false
        FrIfGChannels = FR_CHANNEL_A
        FrIfGColdStartAttempts = 8
        FrIfGCycleCountMax = 63
        FrIfGListenNoise = 2
        FrIfGMacroPerCycle = 3636
        FrIfGMaxWithoutClockCorrectFatal = 2
        FrIfGMaxWithoutClockCorrectPassive = 2
        FrIfGNetworkManagementVectorLength = 0
        FrIfGNumberOfMinislots = 289
        FrIfGNumberOfStaticSlots = 91
        FrIfGPayloadLengthStatic = 8
        FrIfGSyncFrameIDCountMax = 15
        FrIfGdActionPointOffset = 2
        FrIfGdBit = T100NS
        FrIfGdCasRxLowMax = 79
        FrIfGdCycle = 0.005
        FrIfGdDynamicSlotIdlePhase = 1
        FrIfGdIgnoreAfterTx = 0
        FrIfGdMacrotick = 0.000001375
        FrIfGdMiniSlotActionPointOffset = 2
        FrIfGdMinislot = 5
        FrIfGdNit = 7
        FrIfGdSampleClockPeriod = T12_5NS
        FrIfGdStaticSlot = 24
        FrIfGdSymbolWindow = 0
        FrIfGdSymbolWindowActionPointOffset = 2
        FrIfGdTSSTransmitter = 9
        FrIfGdWakeupRxIdle = 59
        FrIfGdWakeupRxLow = 50
        FrIfGdWakeupRxWindow = 301
        FrIfGdWakeupTxActive = 60
        FrIfGdWakeupTxIdle = 180
        FrIfSafetyMargin = 100
        FrIfClstIdx = 0
        FrIfJobList
          4 x FrIfJob, all with FrIfCycle=0:
            FrIf_TxJob_01: FrIfMacrotick=2273, FrIfStartSlot=1, FrIfEndSlot=76, FrIfMaxIsrDelay=909, FrIfIsRxJob=false, FrIfJobId=0, FrIfTxConfJobRef=FrIf_RxJob_01
              5 x FrIfCommunicationOperation, all with FrIfCommunicationAction=DECOUPLED_TRANSMISSION, FrIfRxComOpMaxLoop=512, FrIfManualAssignedLPdu=false:
                DECOUPLED_TRANSMISSION_LPdu_frTrig_FR_3a54c8219f12452dafc00b243d0703e0_1201_A_FlexRay_S_12_B_0_R_1_ChA_OUT: FrIfCommunicationOperationIdx=4, FrIfLPduIdxRef=LPdu_frTrig_FR_3a54c8219f12452dafc00b243d0703e0_1201_A_FlexRay_S_12_B_0_R_1_ChA_OUT
                DECOUPLED_TRANSMISSION_LPdu_frTrig_FR_3a54c8219f12452dafc00b243d0703e0_1001_A_FlexRay_S_10_B_0_R_1_ChA_OUT: FrIfCommunicationOperationIdx=0, FrIfLPduIdxRef=LPdu_frTrig_FR_3a54c8219f12452dafc00b243d0703e0_1001_A_FlexRay_S_10_B_0_R_1_ChA_OUT
                DECOUPLED_TRANSMISSION_LPdu_frTrig_FR_3a54c8219f12452dafc00b243d0703e0_801_A_FlexRay_S_8_B_0_R_1_ChA_OUT: FrIfCommunicationOperationIdx=12, FrIfLPduIdxRef=LPdu_frTrig_FR_3a54c8219f12452dafc00b243d0703e0_801_A_FlexRay_S_8_B_0_R_1_ChA_OUT
                DECOUPLED_TRANSMISSION_LPdu_frTrig_FR_3a54c8219f12452dafc00b243d0703e0_901_A_FlexRay_S_9_B_0_R_1_ChA_OUT: FrIfCommunicationOperationIdx=14, FrIfLPduIdxRef=LPdu_frTrig_FR_3a54c8219f12452dafc00b243d0703e0_901_A_FlexRay_S_9_B_0_R_1_ChA_OUT
                DECOUPLED_TRANSMISSION_LPdu_frTrig_FR_3a54c8219f12452dafc00b243d0703e0_1101_A_FlexRay_S_11_B_0_R_1_ChA_OUT: FrIfCommunicationOperationIdx=2, FrIfLPduIdxRef=LPdu_frTrig_FR_3a54c8219f12452dafc00b243d0703e0_1101_A_FlexRay_S_11_B_0_R_1_ChA_OUT
            FrIf_TxJob_02: FrIfMacrotick=455, FrIfStartSlot=77, FrIfEndSlot=380, FrIfMaxIsrDelay=909, FrIfIsRxJob=false, FrIfJobId=1, FrIfTxConfJobRef=FrIf_RxJob_02
              10 x FrIfCommunicationOperation, all with FrIfCommunicationAction=DECOUPLED_TRANSMISSION, FrIfRxComOpMaxLoop=512, FrIfManualAssignedLPdu=false:
                DECOUPLED_TRANSMISSION_LPdu_frTrig_FR_3a54c8219f12452dafc00b243d0703e0_22001_A_FlexRay_S_220_B_0_R_1_ChA_OUT: FrIfCommunicationOperationIdx=4, FrIfLPduIdxRef=LPdu_frTrig_FR_3a54c8219f12452dafc00b243d0703e0_22001_A_FlexRay_S_220_B_0_R_1_ChA_OUT
                DECOUPLED_TRANSMISSION_LPdu_frTrig_FR_3a54c8219f12452dafc00b243d0703e0_18301_A_FlexRay_S_183_B_0_R_1_ChA_OUT: FrIfCommunicationOperationIdx=0, FrIfLPduIdxRef=LPdu_frTrig_FR_3a54c8219f12452dafc00b243d0703e0_18301_A_FlexRay_S_183_B_0_R_1_ChA_OUT
                DECOUPLED_TRANSMISSION_LPdu_frTrig_FR_3a54c8219f12452dafc00b243d0703e0_29901_A_FlexRay_S_299_B_0_R_1_ChA_OUT: FrIfCommunicationOperationIdx=24, FrIfLPduIdxRef=LPdu_frTrig_FR_3a54c8219f12452dafc00b243d0703e0_29901_A_FlexRay_S_299_B_0_R_1_ChA_OUT
                DECOUPLED_TRANSMISSION_LPdu_frTrig_FR_3a54c8219f12452dafc00b243d0703e0_29701_A_FlexRay_S_297_B_0_R_1_ChA_OUT: FrIfCommunicationOperationIdx=20, FrIfLPduIdxRef=LPdu_frTrig_FR_3a54c8219f12452dafc00b243d0703e0_29701_A_FlexRay_S_297_B_0_R_1_ChA_OUT
                DECOUPLED_TRANSMISSION_LPdu_frTrig_FR_3a54c8219f12452dafc00b243d0703e0_29801_A_FlexRay_S_298_B_0_R_1_ChA_OUT: FrIfCommunicationOperationIdx=22, FrIfLPduIdxRef=LPdu_frTrig_FR_3a54c8219f12452dafc00b243d0703e0_29801_A_FlexRay_S_298_B_0_R_1_ChA_OUT
                DECOUPLED_TRANSMISSION_LPdu_frTrig_FR_3a54c8219f12452dafc00b243d0703e0_29601_A_FlexRay_S_296_B_0_R_1_ChA_OUT: FrIfCommunicationOperationIdx=18, FrIfLPduIdxRef=LPdu_frTrig_FR_3a54c8219f12452dafc00b243d0703e0_29601_A_FlexRay_S_296_B_0_R_1_ChA_OUT
                DECOUPLED_TRANSMISSION_LPdu_frTrig_FR_3a54c8219f12452dafc00b243d0703e0_30001_A_FlexRay_S_300_B_0_R_1_ChA_OUT: FrIfCommunicationOperationIdx=26, FrIfLPduIdxRef=LPdu_frTrig_FR_3a54c8219f12452dafc00b243d0703e0_30001_A_FlexRay_S_300_B_0_R_1_ChA_OUT
                DECOUPLED_TRANSMISSION_LPdu_frTrig_FR_3a54c8219f12452dafc00b243d0703e0_29501_A_FlexRay_S_295_B_0_R_1_ChA_OUT: FrIfCommunicationOperationIdx=16, FrIfLPduIdxRef=LPdu_frTrig_FR_3a54c8219f12452dafc00b243d0703e0_29501_A_FlexRay_S_295_B_0_R_1_ChA_OUT
                DECOUPLED_TRANSMISSION_LPdu_frTrig_FR_3a54c8219f12452dafc00b243d0703e0_29401_A_FlexRay_S_294_B_0_R_1_ChA_OUT: FrIfCommunicationOperationIdx=14, FrIfLPduIdxRef=LPdu_frTrig_FR_3a54c8219f12452dafc00b243d0703e0_29401_A_FlexRay_S_294_B_0_R_1_ChA_OUT
                DECOUPLED_TRANSMISSION_LPdu_frTrig_FR_3a54c8219f12452dafc00b243d0703e0_30101_A_FlexRay_S_301_B_0_R_1_ChA_OUT: FrIfCommunicationOperationIdx=28, FrIfLPduIdxRef=LPdu_frTrig_FR_3a54c8219f12452dafc00b243d0703e0_30101_A_FlexRay_S_301_B_0_R_1_ChA_OUT
            FrIf_RxJob_02: FrIfMacrotick=17, FrIfStartSlot=77, FrIfEndSlot=380, FrIfMaxIsrDelay=1363, FrIfIsRxJob=true, FrIfJobId=1
              17 x FrIfCommunicationOperation, all with FrIfRxComOpMaxLoop=512, FrIfManualAssignedLPdu=false:
                TX_CONFIRMATION_LPdu_frTrig_FR_3a54c8219f12452dafc00b243d0703e0_29601_A_FlexRay_S_296_B_0_R_1_ChA_OUT: FrIfCommunicationAction=TX_CONFIRMATION, FrIfCommunicationOperationIdx=54, FrIfLPduIdxRef=LPdu_frTrig_FR_3a54c8219f12452dafc00b243d0703e0_29601_A_FlexRay_S_296_B_0_R_1_ChA_OUT
                TX_CONFIRMATION_LPdu_frTrig_FR_3a54c8219f12452dafc00b243d0703e0_29401_A_FlexRay_S_294_B_0_R_1_ChA_OUT: FrIfCommunicationAction=TX_CONFIRMATION, FrIfCommunicationOperationIdx=50, FrIfLPduIdxRef=LPdu_frTrig_FR_3a54c8219f12452dafc00b243d0703e0_29401_A_FlexRay_S_294_B_0_R_1_ChA_OUT
                TX_CONFIRMATION_LPdu_frTrig_FR_3a54c8219f12452dafc00b243d0703e0_30101_A_FlexRay_S_301_B_0_R_1_ChA_OUT: FrIfCommunicationAction=TX_CONFIRMATION, FrIfCommunicationOperationIdx=64, FrIfLPduIdxRef=LPdu_frTrig_FR_3a54c8219f12452dafc00b243d0703e0_30101_A_FlexRay_S_301_B_0_R_1_ChA_OUT
                RECEIVE_AND_INDICATE_LPdu_frTrig_FR_3a54c8219f12452dafc00b243d0703e0_20901_A_FlexRay_S_209_B_0_R_1_ChA_IN: FrIfCommunicationAction=RECEIVE_AND_INDICATE, FrIfCommunicationOperationIdx=14, FrIfLPduIdxRef=LPdu_frTrig_FR_3a54c8219f12452dafc00b243d0703e0_20901_A_FlexRay_S_209_B_0_R_1_ChA_IN
                RECEIVE_AND_INDICATE_LPdu_frTrig_FR_3a54c8219f12452dafc00b243d0703e0_21201_A_FlexRay_S_212_B_0_R_1_ChA_IN: FrIfCommunicationAction=RECEIVE_AND_INDICATE, FrIfCommunicationOperationIdx=20, FrIfLPduIdxRef=LPdu_frTrig_FR_3a54c8219f12452dafc00b243d0703e0_21201_A_FlexRay_S_212_B_0_R_1_ChA_IN
                RECEIVE_AND_INDICATE_LPdu_frTrig_FR_3a54c8219f12452dafc00b243d0703e0_21101_A_FlexRay_S_211_B_0_R_1_ChA_IN: FrIfCommunicationAction=RECEIVE_AND_INDICATE, FrIfCommunicationOperationIdx=18, FrIfLPduIdxRef=LPdu_frTrig_FR_3a54c8219f12452dafc00b243d0703e0_21101_A_FlexRay_S_211_B_0_R_1_ChA_IN
                TX_CONFIRMATION_LPdu_frTrig_FR_3a54c8219f12452dafc00b243d0703e0_29801_A_FlexRay_S_298_B_0_R_1_ChA_OUT: FrIfCommunicationAction=TX_CONFIRMATION, FrIfCommunicationOperationIdx=58, FrIfLPduIdxRef=LPdu_frTrig_FR_3a54c8219f12452dafc00b243d0703e0_29801_A_FlexRay_S_298_B_0_R_1_ChA_OUT
                RECEIVE_AND_INDICATE_LPdu_frTrig_FR_3a54c8219f12452dafc00b243d0703e0_14701_A_FlexRay_S_147_B_0_R_1_ChA_IN: FrIfCommunicationAction=RECEIVE_AND_INDICATE, FrIfCommunicationOperationIdx=12, FrIfLPduIdxRef=LPdu_frTrig_FR_3a54c8219f12452dafc00b243d0703e0_14701_A_FlexRay_S_147_B_0_R_1_ChA_IN
                RECEIVE_AND_INDICATE_LPdu_frTrig_FR_3a54c8219f12452dafc00b243d0703e0_21901_A_FlexRay_S_219_B_0_R_1_ChA_IN: FrIfCommunicationAction=RECEIVE_AND_INDICATE, FrIfCommunicationOperationIdx=50, FrIfLPduIdxRef=LPdu_frTrig_FR_3a54c8219f12452dafc00b243d0703e0_21901_A_FlexRay_S_219_B_0_R_1_ChA_IN
                TX_CONFIRMATION_LPdu_frTrig_FR_3a54c8219f12452dafc00b243d0703e0_30001_A_FlexRay_S_300_B_0_R_1_ChA_OUT: FrIfCommunicationAction=TX_CONFIRMATION, FrIfCommunicationOperationIdx=62, FrIfLPduIdxRef=LPdu_frTrig_FR_3a54c8219f12452dafc00b243d0703e0_30001_A_FlexRay_S_300_B_0_R_1_ChA_OUT
                TX_CONFIRMATION_LPdu_frTrig_FR_3a54c8219f12452dafc00b243d0703e0_22001_A_FlexRay_S_220_B_0_R_1_ChA_OUT: FrIfCommunicationAction=TX_CONFIRMATION, FrIfCommunicationOperationIdx=40, FrIfLPduIdxRef=LPdu_frTrig_FR_3a54c8219f12452dafc00b243d0703e0_22001_A_FlexRay_S_220_B_0_R_1_ChA_OUT
                TX_CONFIRMATION_LPdu_frTrig_FR_3a54c8219f12452dafc00b243d0703e0_29501_A_FlexRay_S_295_B_0_R_1_ChA_OUT: FrIfCommunicationAction=TX_CONFIRMATION, FrIfCommunicationOperationIdx=52, FrIfLPduIdxRef=LPdu_frTrig_FR_3a54c8219f12452dafc00b243d0703e0_29501_A_FlexRay_S_295_B_0_R_1_ChA_OUT
                TX_CONFIRMATION_LPdu_frTrig_FR_3a54c8219f12452dafc00b243d0703e0_29901_A_FlexRay_S_299_B_0_R_1_ChA_OUT: FrIfCommunicationAction=TX_CONFIRMATION, FrIfCommunicationOperationIdx=60, FrIfLPduIdxRef=LPdu_frTrig_FR_3a54c8219f12452dafc00b243d0703e0_29901_A_FlexRay_S_299_B_0_R_1_ChA_OUT
                TX_CONFIRMATION_LPdu_frTrig_FR_3a54c8219f12452dafc00b243d0703e0_29701_A_FlexRay_S_297_B_0_R_1_ChA_OUT: FrIfCommunicationAction=TX_CONFIRMATION, FrIfCommunicationOperationIdx=56, FrIfLPduIdxRef=LPdu_frTrig_FR_3a54c8219f12452dafc00b243d0703e0_29701_A_FlexRay_S_297_B_0_R_1_ChA_OUT
                RECEIVE_AND_INDICATE_LPdu_frTrig_FR_3a54c8219f12452dafc00b243d0703e0_21301_A_FlexRay_S_213_B_0_R_1_ChA_IN: FrIfCommunicationAction=RECEIVE_AND_INDICATE, FrIfCommunicationOperationIdx=22, FrIfLPduIdxRef=LPdu_frTrig_FR_3a54c8219f12452dafc00b243d0703e0_21301_A_FlexRay_S_213_B_0_R_1_ChA_IN
                RECEIVE_AND_INDICATE_LPdu_frTrig_FR_3a54c8219f12452dafc00b243d0703e0_21001_A_FlexRay_S_210_B_0_R_1_ChA_IN: FrIfCommunicationAction=RECEIVE_AND_INDICATE, FrIfCommunicationOperationIdx=16, FrIfLPduIdxRef=LPdu_frTrig_FR_3a54c8219f12452dafc00b243d0703e0_21001_A_FlexRay_S_210_B_0_R_1_ChA_IN
                TX_CONFIRMATION_LPdu_frTrig_FR_3a54c8219f12452dafc00b243d0703e0_18301_A_FlexRay_S_183_B_0_R_1_ChA_OUT: FrIfCommunicationAction=TX_CONFIRMATION, FrIfCommunicationOperationIdx=36, FrIfLPduIdxRef=LPdu_frTrig_FR_3a54c8219f12452dafc00b243d0703e0_18301_A_FlexRay_S_183_B_0_R_1_ChA_OUT
            FrIf_RxJob_01: FrIfMacrotick=1842, FrIfStartSlot=1, FrIfEndSlot=76, FrIfMaxIsrDelay=1363, FrIfIsRxJob=true, FrIfJobId=0
              5 x FrIfCommunicationOperation, all with FrIfCommunicationAction=TX_CONFIRMATION, FrIfRxComOpMaxLoop=512, FrIfManualAssignedLPdu=false:
                TX_CONFIRMATION_LPdu_frTrig_FR_3a54c8219f12452dafc00b243d0703e0_1101_A_FlexRay_S_11_B_0_R_1_ChA_OUT: FrIfCommunicationOperationIdx=11, FrIfLPduIdxRef=LPdu_frTrig_FR_3a54c8219f12452dafc00b243d0703e0_1101_A_FlexRay_S_11_B_0_R_1_ChA_OUT
                TX_CONFIRMATION_LPdu_frTrig_FR_3a54c8219f12452dafc00b243d0703e0_1201_A_FlexRay_S_12_B_0_R_1_ChA_OUT: FrIfCommunicationOperationIdx=13, FrIfLPduIdxRef=LPdu_frTrig_FR_3a54c8219f12452dafc00b243d0703e0_1201_A_FlexRay_S_12_B_0_R_1_ChA_OUT
                TX_CONFIRMATION_LPdu_frTrig_FR_3a54c8219f12452dafc00b243d0703e0_1001_A_FlexRay_S_10_B_0_R_1_ChA_OUT: FrIfCommunicationOperationIdx=9, FrIfLPduIdxRef=LPdu_frTrig_FR_3a54c8219f12452dafc00b243d0703e0_1001_A_FlexRay_S_10_B_0_R_1_ChA_OUT
                TX_CONFIRMATION_LPdu_frTrig_FR_3a54c8219f12452dafc00b243d0703e0_801_A_FlexRay_S_8_B_0_R_1_ChA_OUT: FrIfCommunicationOperationIdx=21, FrIfLPduIdxRef=LPdu_frTrig_FR_3a54c8219f12452dafc00b243d0703e0_801_A_FlexRay_S_8_B_0_R_1_ChA_OUT
                TX_CONFIRMATION_LPdu_frTrig_FR_3a54c8219f12452dafc00b243d0703e0_901_A_FlexRay_S_9_B_0_R_1_ChA_OUT: FrIfCommunicationOperationIdx=23, FrIfLPduIdxRef=LPdu_frTrig_FR_3a54c8219f12452dafc00b243d0703e0_901_A_FlexRay_S_9_B_0_R_1_ChA_OUT
        contr_EPS_A_FlexRay (FrIfController): FrIfCtrlIdx=0, FrIfFrCtrlRef=contr_EPS_A_FlexRay
          5 x FrIfLPdu, all with FrIfReconfigurable=false:
            LPdu_frTrig_FR_3a54c8219f12452dafc00b243d0703e0_21301_A_FlexRay_S_213_B_0_R_1_ChA_IN: FrIfLPduIdx=16, FrIfVBTriggeringRef=frTrig_FR_3a54c8219f12452dafc00b243d0703e0_21301_A_FlexRay_S_213_B_0_R_1_ChA_IN  # frTrig_FR_3a54c8219f12452dafc00b243d0703e0_21301_A_FlexRay
            LPdu_frTrig_FR_3a54c8219f12452dafc00b243d0703e0_1001_A_FlexRay_S_10_B_0_R_1_ChA_OUT: FrIfLPduIdx=12, FrIfVBTriggeringRef=frTrig_FR_3a54c8219f12452dafc00b243d0703e0_1001_A_FlexRay_S_10_B_0_R_1_ChA_OUT  # frTrig_FR_3a54c8219f12452dafc00b243d0703e0_1001_A_FlexRay
            LPdu_frTrig_FR_3a54c8219f12452dafc00b243d0703e0_29701_A_FlexRay_S_297_B_0_R_1_ChA_OUT: FrIfLPduIdx=4, FrIfVBTriggeringRef=frTrig_FR_3a54c8219f12452dafc00b243d0703e0_29701_A_FlexRay_S_297_B_0_R_1_ChA_OUT  # frTrig_FR_3a54c8219f12452dafc00b243d0703e0_29701_A_FlexRay
            LPdu_frTrig_FR_3a54c8219f12452dafc00b243d0703e0_21001_A_FlexRay_S_210_B_0_R_1_ChA_IN: FrIfLPduIdx=19, FrIfVBTriggeringRef=frTrig_FR_3a54c8219f12452dafc00b243d0703e0_21001_A_FlexRay_S_210_B_0_R_1_ChA_IN  # frTrig_FR_3a54c8219f12452dafc00b243d0703e0_21001_A_FlexRay
            LPdu_frTrig_FR_3a54c8219f12452dafc00b243d0703e0_30001_A_FlexRay_S_300_B_0_R_1_ChA_OUT: FrIfLPduIdx=1, FrIfVBTriggeringRef=frTrig_FR_3a54c8219f12452dafc00b243d0703e0_30001_A_FlexRay_S_300_B_0_R_1_ChA_OUT  # frTrig_FR_3a54c8219f12452dafc00b243d0703e0_30001_A_FlexRay
          frTrig_FR_3a54c8219f12452dafc00b243d0703e0_20901_A_FlexRay_S_209_B_0_R_1_ChA_IN (FrIfFrameTriggering):
            FrIfAllowDynamicLSduLength = false
            FrIfBaseCycle = 0
            FrIfChannel = FRIF_CHANNEL_A
            FrIfCycleRepetition = 1
            FrIfLSduLength = 32
            FrIfPayloadPreamble = false
            FrIfSlotId = 209
            FrIfAlwaysTransmit = false
            FrIfFrameStructureRef = FrStr_TL_BRC_FR_32_7c67e8dd_In
          frTrig_FR_3a54c8219f12452dafc00b243d0703e0_801_A_FlexRay_S_8_B_0_R_1_ChA_OUT (FrIfFrameTriggering):
            FrIfAllowDynamicLSduLength = false
            FrIfBaseCycle = 0
            FrIfChannel = FRIF_CHANNEL_A
            FrIfCycleRepetition = 1
            FrIfLSduLength = 16
            FrIfPayloadPreamble = false
            FrIfSlotId = 8
            FrIfAlwaysTransmit = false
            FrIfFrameStructureRef = FrStr_xcpstatic_31d6b02c_Out
          LPdu_frTrig_FR_3a54c8219f12452dafc00b243d0703e0_21901_A_FlexRay_S_219_B_0_R_1_ChA_IN (FrIfLPdu): FrIfLPduIdx=15, FrIfReconfigurable=false, FrIfVBTriggeringRef=frTrig_FR_3a54c8219f12452dafc00b243d0703e0_21901_A_FlexRay_S_219_B_0_R_1_ChA_IN  # frTrig_FR_3a54c8219f12452dafc00b243d0703e0_21901_A_FlexRay
          frTrig_FR_3a54c8219f12452dafc00b243d0703e0_21201_A_FlexRay_S_212_B_0_R_1_ChA_IN (FrIfFrameTriggering):
            FrIfAllowDynamicLSduLength = false
            FrIfBaseCycle = 0
            FrIfChannel = FRIF_CHANNEL_A
            FrIfCycleRepetition = 1
            FrIfLSduLength = 32
            FrIfPayloadPreamble = false
            FrIfSlotId = 212
            FrIfAlwaysTransmit = false
            FrIfFrameStructureRef = FrStr_TL_BRC_FR_32_06a1b608_In
          frTrig_FR_3a54c8219f12452dafc00b243d0703e0_29701_A_FlexRay_S_297_B_0_R_1_ChA_OUT (FrIfFrameTriggering):
            FrIfAllowDynamicLSduLength = false
            FrIfBaseCycle = 0
            FrIfChannel = FRIF_CHANNEL_A
            FrIfCycleRepetition = 1
            FrIfLSduLength = 254
            FrIfPayloadPreamble = false
            FrIfSlotId = 297
            FrIfAlwaysTransmit = false
            FrIfFrameStructureRef = FrStr_xcpdynamic254_4
          3 x FrIfLPdu, all with FrIfReconfigurable=false:
            LPdu_frTrig_FR_3a54c8219f12452dafc00b243d0703e0_29401_A_FlexRay_S_294_B_0_R_1_ChA_OUT: FrIfLPduIdx=7, FrIfVBTriggeringRef=frTrig_FR_3a54c8219f12452dafc00b243d0703e0_29401_A_FlexRay_S_294_B_0_R_1_ChA_OUT  # frTrig_FR_3a54c8219f12452dafc00b243d0703e0_29401_A_FlexRay
            LPdu_frTrig_FR_3a54c8219f12452dafc00b243d0703e0_14701_A_FlexRay_S_147_B_0_R_1_ChA_IN: FrIfLPduIdx=21, FrIfVBTriggeringRef=frTrig_FR_3a54c8219f12452dafc00b243d0703e0_14701_A_FlexRay_S_147_B_0_R_1_ChA_IN  # frTrig_FR_3a54c8219f12452dafc00b243d0703e0_14701_A_FlexRay
            LPdu_frTrig_FR_3a54c8219f12452dafc00b243d0703e0_29801_A_FlexRay_S_298_B_0_R_1_ChA_OUT: FrIfLPduIdx=3, FrIfVBTriggeringRef=frTrig_FR_3a54c8219f12452dafc00b243d0703e0_29801_A_FlexRay_S_298_B_0_R_1_ChA_OUT  # frTrig_FR_3a54c8219f12452dafc00b243d0703e0_29801_A_FlexRay
          frTrig_FR_3a54c8219f12452dafc00b243d0703e0_30001_A_FlexRay_S_300_B_0_R_1_ChA_OUT (FrIfFrameTriggering):
            FrIfAllowDynamicLSduLength = false
            FrIfBaseCycle = 0
            FrIfChannel = FRIF_CHANNEL_A
            FrIfCycleRepetition = 1
            FrIfLSduLength = 254
            FrIfPayloadPreamble = false
            FrIfSlotId = 300
            FrIfAlwaysTransmit = false
            FrIfFrameStructureRef = FrStr_xcpdynamic254_7
          3 x FrIfLPdu, all with FrIfReconfigurable=false:
            LPdu_frTrig_FR_3a54c8219f12452dafc00b243d0703e0_30101_A_FlexRay_S_301_B_0_R_1_ChA_OUT: FrIfLPduIdx=0, FrIfVBTriggeringRef=frTrig_FR_3a54c8219f12452dafc00b243d0703e0_30101_A_FlexRay_S_301_B_0_R_1_ChA_OUT  # frTrig_FR_3a54c8219f12452dafc00b243d0703e0_30101_A_FlexRay
            LPdu_frTrig_FR_3a54c8219f12452dafc00b243d0703e0_18301_A_FlexRay_S_183_B_0_R_1_ChA_OUT: FrIfLPduIdx=9, FrIfVBTriggeringRef=frTrig_FR_3a54c8219f12452dafc00b243d0703e0_18301_A_FlexRay_S_183_B_0_R_1_ChA_OUT  # frTrig_FR_3a54c8219f12452dafc00b243d0703e0_18301_A_FlexRay
            LPdu_frTrig_FR_3a54c8219f12452dafc00b243d0703e0_901_A_FlexRay_S_9_B_0_R_1_ChA_OUT: FrIfLPduIdx=13, FrIfVBTriggeringRef=frTrig_FR_3a54c8219f12452dafc00b243d0703e0_901_A_FlexRay_S_9_B_0_R_1_ChA_OUT  # frTrig_FR_3a54c8219f12452dafc00b243d0703e0_901_A_FlexRay
          frTrig_FR_3a54c8219f12452dafc00b243d0703e0_21101_A_FlexRay_S_211_B_0_R_1_ChA_IN (FrIfFrameTriggering):
            FrIfAllowDynamicLSduLength = false
            FrIfBaseCycle = 0
            FrIfChannel = FRIF_CHANNEL_A
            FrIfCycleRepetition = 1
            FrIfLSduLength = 32
            FrIfPayloadPreamble = false
            FrIfSlotId = 211
            FrIfAlwaysTransmit = false
            FrIfFrameStructureRef = FrStr_TL_BRC_FR_32_bb6bdac6_In
          LPdu_frTrig_FR_3a54c8219f12452dafc00b243d0703e0_21201_A_FlexRay_S_212_B_0_R_1_ChA_IN (FrIfLPdu): FrIfLPduIdx=17, FrIfReconfigurable=false, FrIfVBTriggeringRef=frTrig_FR_3a54c8219f12452dafc00b243d0703e0_21201_A_FlexRay_S_212_B_0_R_1_ChA_IN  # frTrig_FR_3a54c8219f12452dafc00b243d0703e0_21201_A_FlexRay
          frTrig_FR_3a54c8219f12452dafc00b243d0703e0_29601_A_FlexRay_S_296_B_0_R_1_ChA_OUT (FrIfFrameTriggering):
            FrIfAllowDynamicLSduLength = false
            FrIfBaseCycle = 0
            FrIfChannel = FRIF_CHANNEL_A
            FrIfCycleRepetition = 1
            FrIfLSduLength = 254
            FrIfPayloadPreamble = false
            FrIfSlotId = 296
            FrIfAlwaysTransmit = false
            FrIfFrameStructureRef = FrStr_xcpdynamic254_3
          frTrig_FR_3a54c8219f12452dafc00b243d0703e0_1201_A_FlexRay_S_12_B_0_R_1_ChA_OUT (FrIfFrameTriggering):
            FrIfAllowDynamicLSduLength = false
            FrIfBaseCycle = 0
            FrIfChannel = FRIF_CHANNEL_A
            FrIfCycleRepetition = 1
            FrIfLSduLength = 16
            FrIfPayloadPreamble = false
            FrIfSlotId = 12
            FrIfAlwaysTransmit = false
            FrIfFrameStructureRef = FrStr_xcpstatic_1fa5cd47_Out
          LPdu_frTrig_FR_3a54c8219f12452dafc00b243d0703e0_22001_A_FlexRay_S_220_B_0_R_1_ChA_OUT (FrIfLPdu): FrIfLPduIdx=8, FrIfReconfigurable=false, FrIfVBTriggeringRef=frTrig_FR_3a54c8219f12452dafc00b243d0703e0_22001_A_FlexRay_S_220_B_0_R_1_ChA_OUT  # frTrig_FR_3a54c8219f12452dafc00b243d0703e0_22001_A_FlexRay
          LPdu_frTrig_FR_3a54c8219f12452dafc00b243d0703e0_29501_A_FlexRay_S_295_B_0_R_1_ChA_OUT (FrIfLPdu): FrIfLPduIdx=6, FrIfReconfigurable=false, FrIfVBTriggeringRef=frTrig_FR_3a54c8219f12452dafc00b243d0703e0_29501_A_FlexRay_S_295_B_0_R_1_ChA_OUT  # frTrig_FR_3a54c8219f12452dafc00b243d0703e0_29501_A_FlexRay
          3 x FrIfFrameTriggering, all with FrIfAllowDynamicLSduLength=false, FrIfBaseCycle=0, FrIfChannel=FRIF_CHANNEL_A, FrIfCycleRepetition=1, FrIfPayloadPreamble=false, FrIfAlwaysTransmit=false:
            frTrig_FR_3a54c8219f12452dafc00b243d0703e0_14701_A_FlexRay_S_147_B_0_R_1_ChA_IN: FrIfLSduLength=254, FrIfSlotId=147, FrIfFrameStructureRef=FrStr_TL_MST_GW_TRNSM_FR_254
            frTrig_FR_3a54c8219f12452dafc00b243d0703e0_30101_A_FlexRay_S_301_B_0_R_1_ChA_OUT: FrIfLSduLength=254, FrIfSlotId=301, FrIfFrameStructureRef=FrStr_xcpdynamic254_8
            frTrig_FR_3a54c8219f12452dafc00b243d0703e0_21001_A_FlexRay_S_210_B_0_R_1_ChA_IN: FrIfLSduLength=32, FrIfSlotId=210, FrIfFrameStructureRef=FrStr_TL_BRC_FR_32_66fd0343_In
          LPdu_frTrig_FR_3a54c8219f12452dafc00b243d0703e0_21101_A_FlexRay_S_211_B_0_R_1_ChA_IN (FrIfLPdu): FrIfLPduIdx=18, FrIfReconfigurable=false, FrIfVBTriggeringRef=frTrig_FR_3a54c8219f12452dafc00b243d0703e0_21101_A_FlexRay_S_211_B_0_R_1_ChA_IN  # frTrig_FR_3a54c8219f12452dafc00b243d0703e0_21101_A_FlexRay
          LPdu_frTrig_FR_3a54c8219f12452dafc00b243d0703e0_1101_A_FlexRay_S_11_B_0_R_1_ChA_OUT (FrIfLPdu): FrIfLPduIdx=11, FrIfReconfigurable=false, FrIfVBTriggeringRef=frTrig_FR_3a54c8219f12452dafc00b243d0703e0_1101_A_FlexRay_S_11_B_0_R_1_ChA_OUT  # frTrig_FR_3a54c8219f12452dafc00b243d0703e0_1101_A_FlexRay
          6 x FrIfFrameTriggering, all with FrIfAllowDynamicLSduLength=false, FrIfBaseCycle=0, FrIfChannel=FRIF_CHANNEL_A, FrIfCycleRepetition=1, FrIfPayloadPreamble=false, FrIfAlwaysTransmit=false:
            frTrig_FR_3a54c8219f12452dafc00b243d0703e0_18301_A_FlexRay_S_183_B_0_R_1_ChA_OUT: FrIfLSduLength=32, FrIfSlotId=183, FrIfFrameStructureRef=FrStr_TL_ECU_TRNSM_FR_32
            frTrig_FR_3a54c8219f12452dafc00b243d0703e0_22001_A_FlexRay_S_220_B_0_R_1_ChA_OUT: FrIfLSduLength=32, FrIfSlotId=220, FrIfFrameStructureRef=FrStr_xcpslave
            frTrig_FR_3a54c8219f12452dafc00b243d0703e0_29501_A_FlexRay_S_295_B_0_R_1_ChA_OUT: FrIfLSduLength=254, FrIfSlotId=295, FrIfFrameStructureRef=FrStr_xcpdynamic254_2
            frTrig_FR_3a54c8219f12452dafc00b243d0703e0_901_A_FlexRay_S_9_B_0_R_1_ChA_OUT: FrIfLSduLength=16, FrIfSlotId=9, FrIfFrameStructureRef=FrStr_xcpstatic_ec4069a9_Out
            frTrig_FR_3a54c8219f12452dafc00b243d0703e0_29901_A_FlexRay_S_299_B_0_R_1_ChA_OUT: FrIfLSduLength=254, FrIfSlotId=299, FrIfFrameStructureRef=FrStr_xcpdynamic254_6
            frTrig_FR_3a54c8219f12452dafc00b243d0703e0_21301_A_FlexRay_S_213_B_0_R_1_ChA_IN: FrIfLSduLength=32, FrIfSlotId=213, FrIfFrameStructureRef=FrStr_TL_BRC_FR_32_db376f8d_In
          LPdu_frTrig_FR_3a54c8219f12452dafc00b243d0703e0_29601_A_FlexRay_S_296_B_0_R_1_ChA_OUT (FrIfLPdu): FrIfLPduIdx=5, FrIfReconfigurable=false, FrIfVBTriggeringRef=frTrig_FR_3a54c8219f12452dafc00b243d0703e0_29601_A_FlexRay_S_296_B_0_R_1_ChA_OUT  # frTrig_FR_3a54c8219f12452dafc00b243d0703e0_29601_A_FlexRay
          LPdu_frTrig_FR_3a54c8219f12452dafc00b243d0703e0_1201_A_FlexRay_S_12_B_0_R_1_ChA_OUT (FrIfLPdu): FrIfLPduIdx=10, FrIfReconfigurable=false, FrIfVBTriggeringRef=frTrig_FR_3a54c8219f12452dafc00b243d0703e0_1201_A_FlexRay_S_12_B_0_R_1_ChA_OUT  # frTrig_FR_3a54c8219f12452dafc00b243d0703e0_1201_A_FlexRay
          frTrig_FR_3a54c8219f12452dafc00b243d0703e0_1101_A_FlexRay_S_11_B_0_R_1_ChA_OUT (FrIfFrameTriggering):
            FrIfAllowDynamicLSduLength = false
            FrIfBaseCycle = 0
            FrIfChannel = FRIF_CHANNEL_A
            FrIfCycleRepetition = 1
            FrIfLSduLength = 16
            FrIfPayloadPreamble = false
            FrIfSlotId = 11
            FrIfAlwaysTransmit = false
            FrIfFrameStructureRef = FrStr_xcpstatic_a26fa189_Out
          frTrig_FR_3a54c8219f12452dafc00b243d0703e0_29401_A_FlexRay_S_294_B_0_R_1_ChA_OUT (FrIfFrameTriggering):
            FrIfAllowDynamicLSduLength = false
            FrIfBaseCycle = 0
            FrIfChannel = FRIF_CHANNEL_A
            FrIfCycleRepetition = 1
            FrIfLSduLength = 254
            FrIfPayloadPreamble = false
            FrIfSlotId = 294
            FrIfAlwaysTransmit = false
            FrIfFrameStructureRef = FrStr_xcpdynamic254_1
          LPdu_frTrig_FR_3a54c8219f12452dafc00b243d0703e0_801_A_FlexRay_S_8_B_0_R_1_ChA_OUT (FrIfLPdu): FrIfLPduIdx=14, FrIfReconfigurable=false, FrIfVBTriggeringRef=frTrig_FR_3a54c8219f12452dafc00b243d0703e0_801_A_FlexRay_S_8_B_0_R_1_ChA_OUT  # frTrig_FR_3a54c8219f12452dafc00b243d0703e0_801_A_FlexRay
          frTrig_FR_3a54c8219f12452dafc00b243d0703e0_1001_A_FlexRay_S_10_B_0_R_1_ChA_OUT (FrIfFrameTriggering):
            FrIfAllowDynamicLSduLength = false
            FrIfBaseCycle = 0
            FrIfChannel = FRIF_CHANNEL_A
            FrIfCycleRepetition = 1
            FrIfLSduLength = 16
            FrIfPayloadPreamble = false
            FrIfSlotId = 10
            FrIfAlwaysTransmit = false
            FrIfFrameStructureRef = FrStr_xcpstatic_7ff9780c_Out
          frTrig_FR_3a54c8219f12452dafc00b243d0703e0_21901_A_FlexRay_S_219_B_0_R_1_ChA_IN (FrIfFrameTriggering):
            FrIfAllowDynamicLSduLength = false
            FrIfBaseCycle = 0
            FrIfChannel = FRIF_CHANNEL_A
            FrIfCycleRepetition = 1
            FrIfLSduLength = 32
            FrIfPayloadPreamble = false
            FrIfSlotId = 219
            FrIfAlwaysTransmit = false
            FrIfFrameStructureRef = FrStr_xcpmaster
          LPdu_frTrig_FR_3a54c8219f12452dafc00b243d0703e0_29901_A_FlexRay_S_299_B_0_R_1_ChA_OUT (FrIfLPdu): FrIfLPduIdx=2, FrIfReconfigurable=false, FrIfVBTriggeringRef=frTrig_FR_3a54c8219f12452dafc00b243d0703e0_29901_A_FlexRay_S_299_B_0_R_1_ChA_OUT  # frTrig_FR_3a54c8219f12452dafc00b243d0703e0_29901_A_FlexRay
          frTrig_FR_3a54c8219f12452dafc00b243d0703e0_29801_A_FlexRay_S_298_B_0_R_1_ChA_OUT (FrIfFrameTriggering):
            FrIfAllowDynamicLSduLength = false
            FrIfBaseCycle = 0
            FrIfChannel = FRIF_CHANNEL_A
            FrIfCycleRepetition = 1
            FrIfLSduLength = 254
            FrIfPayloadPreamble = false
            FrIfSlotId = 298
            FrIfAlwaysTransmit = false
            FrIfFrameStructureRef = FrStr_xcpdynamic254_5
          LPdu_frTrig_FR_3a54c8219f12452dafc00b243d0703e0_20901_A_FlexRay_S_209_B_0_R_1_ChA_IN (FrIfLPdu): FrIfLPduIdx=20, FrIfReconfigurable=false, FrIfVBTriggeringRef=frTrig_FR_3a54c8219f12452dafc00b243d0703e0_20901_A_FlexRay_S_209_B_0_R_1_ChA_IN  # frTrig_FR_3a54c8219f12452dafc00b243d0703e0_20901_A_FlexRay
        FrIfClusterDemEventParameterRefs:
          FRIF_E_ACS_CH_A = AutoCreatedDemEvent_A_FlexRay_FRIF_E_ACS_CH_A
          FRIF_E_ACS_CH_B = AutoCreatedDemEvent_A_FlexRay_FRIF_E_ACS_CH_B
          FRIF_E_NIT_CH_A = AutoCreatedDemEvent_A_FlexRay_FRIF_E_NIT_CH_A
          FRIF_E_NIT_CH_B = AutoCreatedDemEvent_A_FlexRay_FRIF_E_NIT_CH_B
          FRIF_E_SW_CH_A = AutoCreatedDemEvent_A_FlexRay_FRIF_E_SW_CH_A
          FRIF_E_SW_CH_B = AutoCreatedDemEvent_A_FlexRay_FRIF_E_SW_CH_B
      TL_ECU_TRNSM_FR_32 (FrIfPdu)
        FrIfPduDirection
          FrIfTxPdu_TL_ECU_TRNSM_FR_32 (FrIfTxPdu):  # TL_ECU_TRNSM_FR_32
            FrIfUserTxUL = FR_TP
            FrIfConfirm = true
            FrIfCounterLimit = 1
            FrIfImmediate = false
            FrIfNoneMode = false
            FrIfTxPduId = 9
            FrIfTxPduRef = pduTr_TL_ECU_TRNSM_FR_32_A_FlexRay_pduPort_EPS_A_FlexRay_OUT_7d601c47_052bff33
      FrStr_TL_BRC_FR_32_06a1b608_In (FrIfFrameStructure): FrIfByteOrder=LITTLE_ENDIAN  # TL_BRC_FR_32
        sn_b89d750f03b54dc591beef3d97af79e1_6_99b35db8d0034c95bddada0c4e168dbd_5 (FrIfPdusInFrame): FrIfPduOffset=0, FrIfMappedPduId=2, FrIfPduRef=TL_BRC_FR_32
      xcpdynamic254_8 (FrIfPdu)
        FrIfPduDirection
          FrIfTxPdu_xcpdynamic254_8 (FrIfTxPdu):  # xcpdynamic254_8
            FrIfUserTxUL = XCP
            FrIfConfirm = true
            FrIfCounterLimit = 1
            FrIfImmediate = false
            FrIfNoneMode = false
            FrIfTxPduId = 0
            FrIfTxPduRef = pduTr_xcpdynamic254_8_A_FlexRay_pduPort_EPS_A_FlexRay_OUT_7d601c47_052bff33
      FrStr_xcpstatic_31d6b02c_Out (FrIfFrameStructure): FrIfByteOrder=LITTLE_ENDIAN  # xcpstatic
        sn_d6c051138a624b7197665ea502ed9c68_3_9779c0f9609648bfa4441a0865c580a6_3 (FrIfPdusInFrame): FrIfPduOffset=0, FrIfMappedPduId=14, FrIfPduRef=dummy16bstatic
      FrStr_xcpstatic_ec4069a9_Out (FrIfFrameStructure): FrIfByteOrder=LITTLE_ENDIAN  # xcpstatic
        sn_d6c051138a624b7197665ea502ed9c68_3_9779c0f9609648bfa4441a0865c580a6_3 (FrIfPdusInFrame): FrIfPduOffset=0, FrIfMappedPduId=13, FrIfPduRef=dummy16bstatic
      TL_MST_GW_TRNSM_FR_254 (FrIfPdu)
        FrIfPduDirection
          FrIfRxPdu_TL_MST_GW_TRNSM_FR_254 (FrIfRxPdu): FrIfUserRxIndicationUL=FR_TP, FrIfRxPduId=2, FrIfRxPduRef=pduTr_TL_MST_GW_TRNSM_FR_254_A_FlexRay_pduPort_EPS_A_FlexRay_IN_7d601c47_052bff33  # TL_MST_GW_TRNSM_FR_254
      FrStr_xcpmaster (FrIfFrameStructure): FrIfByteOrder=LITTLE_ENDIAN  # xcpmaster
        sn_6acd24342b914dee85c6ec4bb84bea56_4_2e91d703d77a465ba5c92f45777cf2d1_4 (FrIfPdusInFrame): FrIfPduOffset=0, FrIfMappedPduId=0, FrIfPduRef=dummy32bmaster
      7 x FrIfPdu:
        xcpdynamic254_7
          FrIfPduDirection
            FrIfTxPdu_xcpdynamic254_7 (FrIfTxPdu):  # xcpdynamic254_7
              FrIfUserTxUL = XCP
              FrIfConfirm = true
              FrIfCounterLimit = 1
              FrIfImmediate = false
              FrIfNoneMode = false
              FrIfTxPduId = 1
              FrIfTxPduRef = pduTr_xcpdynamic254_7_A_FlexRay_pduPort_EPS_A_FlexRay_OUT_7d601c47_052bff33
        xcpdynamic254_6
          FrIfPduDirection
            FrIfTxPdu_xcpdynamic254_6 (FrIfTxPdu):  # xcpdynamic254_6
              FrIfUserTxUL = XCP
              FrIfConfirm = true
              FrIfCounterLimit = 1
              FrIfImmediate = false
              FrIfNoneMode = false
              FrIfTxPduId = 2
              FrIfTxPduRef = pduTr_xcpdynamic254_6_A_FlexRay_pduPort_EPS_A_FlexRay_OUT_7d601c47_052bff33
        xcpdynamic254_5
          FrIfPduDirection
            FrIfTxPdu_xcpdynamic254_5 (FrIfTxPdu):  # xcpdynamic254_5
              FrIfUserTxUL = XCP
              FrIfConfirm = true
              FrIfCounterLimit = 1
              FrIfImmediate = false
              FrIfNoneMode = false
              FrIfTxPduId = 3
              FrIfTxPduRef = pduTr_xcpdynamic254_5_A_FlexRay_pduPort_EPS_A_FlexRay_OUT_7d601c47_052bff33
        xcpdynamic254_4
          FrIfPduDirection
            FrIfTxPdu_xcpdynamic254_4 (FrIfTxPdu):  # xcpdynamic254_4
              FrIfUserTxUL = XCP
              FrIfConfirm = true
              FrIfCounterLimit = 1
              FrIfImmediate = false
              FrIfNoneMode = false
              FrIfTxPduId = 4
              FrIfTxPduRef = pduTr_xcpdynamic254_4_A_FlexRay_pduPort_EPS_A_FlexRay_OUT_7d601c47_052bff33
        xcpdynamic254_3
          FrIfPduDirection
            FrIfTxPdu_xcpdynamic254_3 (FrIfTxPdu):  # xcpdynamic254_3
              FrIfUserTxUL = XCP
              FrIfConfirm = true
              FrIfCounterLimit = 1
              FrIfImmediate = false
              FrIfNoneMode = false
              FrIfTxPduId = 5
              FrIfTxPduRef = pduTr_xcpdynamic254_3_A_FlexRay_pduPort_EPS_A_FlexRay_OUT_7d601c47_052bff33
        xcpdynamic254_2
          FrIfPduDirection
            FrIfTxPdu_xcpdynamic254_2 (FrIfTxPdu):  # xcpdynamic254_2
              FrIfUserTxUL = XCP
              FrIfConfirm = true
              FrIfCounterLimit = 1
              FrIfImmediate = false
              FrIfNoneMode = false
              FrIfTxPduId = 6
              FrIfTxPduRef = pduTr_xcpdynamic254_2_A_FlexRay_pduPort_EPS_A_FlexRay_OUT_7d601c47_052bff33
        xcpdynamic254_1
          FrIfPduDirection
            FrIfTxPdu_xcpdynamic254_1 (FrIfTxPdu):  # xcpdynamic254_1
              FrIfUserTxUL = XCP
              FrIfConfirm = true
              FrIfCounterLimit = 1
              FrIfImmediate = false
              FrIfNoneMode = false
              FrIfTxPduId = 7
              FrIfTxPduRef = pduTr_xcpdynamic254_1_A_FlexRay_pduPort_EPS_A_FlexRay_OUT_7d601c47_052bff33
      13 x FrIfFrameStructure, all with FrIfByteOrder=LITTLE_ENDIAN:
        FrStr_xcpslave  # xcpslave
          sn_2ed003fa08904453b0dfb985d50da316_4_039aef2810e44f2c9248813621a8312e_4 (FrIfPdusInFrame): FrIfPduOffset=0, FrIfMappedPduId=8, FrIfPduRef=dummy32bslave
        FrStr_TL_BRC_FR_32_66fd0343_In  # TL_BRC_FR_32
          sn_b89d750f03b54dc591beef3d97af79e1_6_99b35db8d0034c95bddada0c4e168dbd_5 (FrIfPdusInFrame): FrIfPduOffset=0, FrIfMappedPduId=4, FrIfPduRef=TL_BRC_FR_32
        FrStr_xcpdynamic254_1  # xcpdynamic254_1
          sn_fdeafba7ae254e1e80d60b106053d532_1_7d44d6d889bf437cb0ff888debf8555c_1 (FrIfPdusInFrame): FrIfPduOffset=0, FrIfMappedPduId=7, FrIfPduRef=xcpdynamic254_1
        FrStr_xcpdynamic254_2  # xcpdynamic254_2
          sn_ED55AF29C91C2294E0402EA019874515_1_ED55B6DAA560EF99E0402EA019870214_1 (FrIfPdusInFrame): FrIfPduOffset=0, FrIfMappedPduId=6, FrIfPduRef=xcpdynamic254_2
        FrStr_xcpdynamic254_3  # xcpdynamic254_3
          sn_ED55AF29C91F2294E0402EA019874515_1_ED55CA2D406A1E52E0402EA01987021E_1 (FrIfPdusInFrame): FrIfPduOffset=0, FrIfMappedPduId=5, FrIfPduRef=xcpdynamic254_3
        FrStr_xcpdynamic254_4  # xcpdynamic254_4
          sn_ED55D3C388349965E0402EA019872AD5_1_ED55AF29C92D2294E0402EA019874515_1 (FrIfPdusInFrame): FrIfPduOffset=0, FrIfMappedPduId=4, FrIfPduRef=xcpdynamic254_4
        FrStr_xcpdynamic254_5  # xcpdynamic254_5
          sn_ED55AF29C9332294E0402EA019874515_1_ED55D568B7B1E932E0402EA019874AD0_1 (FrIfPdusInFrame): FrIfPduOffset=0, FrIfMappedPduId=3, FrIfPduRef=xcpdynamic254_5
        FrStr_TL_ECU_TRNSM_FR_32  # TL_ECU_TRNSM_FR_32
          sn_ada9591f59be44a18409d95fca100f53_5_c623861e6a0749cc9d81d43585ea7f81_4 (FrIfPdusInFrame): FrIfPduOffset=0, FrIfMappedPduId=9, FrIfPduRef=TL_ECU_TRNSM_FR_32
        FrStr_xcpdynamic254_6  # xcpdynamic254_6
          sn_ED55D568B7B7E932E0402EA019874AD0_1_ED55DDBF3F3F1652E0402EA01987662B_1 (FrIfPdusInFrame): FrIfPduOffset=0, FrIfMappedPduId=2, FrIfPduRef=xcpdynamic254_6
        FrStr_TL_BRC_FR_32_7c67e8dd_In  # TL_BRC_FR_32
          sn_b89d750f03b54dc591beef3d97af79e1_6_99b35db8d0034c95bddada0c4e168dbd_5 (FrIfPdusInFrame): FrIfPduOffset=0, FrIfMappedPduId=5, FrIfPduRef=TL_BRC_FR_32
        FrStr_xcpdynamic254_7  # xcpdynamic254_7
          sn_ED55EE5E9A7A36A4E0402EA019872B37_1_ED55EF63738BA24EE0402EA019872B3F_1 (FrIfPdusInFrame): FrIfPduOffset=0, FrIfMappedPduId=1, FrIfPduRef=xcpdynamic254_7
        FrStr_xcpdynamic254_8  # xcpdynamic254_8
          sn_ED55EE5E9A8836A4E0402EA019872B37_1_ED55FD352928D633E0402EA019872B44_1 (FrIfPdusInFrame): FrIfPduOffset=0, FrIfMappedPduId=0, FrIfPduRef=xcpdynamic254_8
        FrStr_TL_BRC_FR_32_bb6bdac6_In  # TL_BRC_FR_32
          sn_b89d750f03b54dc591beef3d97af79e1_6_99b35db8d0034c95bddada0c4e168dbd_5 (FrIfPdusInFrame): FrIfPduOffset=0, FrIfMappedPduId=3, FrIfPduRef=TL_BRC_FR_32
      dummy16bstatic (FrIfPdu)
        FrIfPduDirection
          FrIfTxPdu_dummy16bstatic (FrIfTxPdu):  # dummy16bstatic
            FrIfUserTxUL = XCP
            FrIfConfirm = true
            FrIfCounterLimit = 1
            FrIfImmediate = false
            FrIfNoneMode = false
            FrIfTxPduId = 10
            FrIfTxPduRef = pduTr_dummy16bstatic_A_FlexRay_pduPort_EPS_A_FlexRay_OUT_7d601c47_052bff33
      FrStr_TL_BRC_FR_32_db376f8d_In (FrIfFrameStructure): FrIfByteOrder=LITTLE_ENDIAN  # TL_BRC_FR_32
        sn_b89d750f03b54dc591beef3d97af79e1_6_99b35db8d0034c95bddada0c4e168dbd_5 (FrIfPdusInFrame): FrIfPduOffset=0, FrIfMappedPduId=1, FrIfPduRef=TL_BRC_FR_32
      FrStr_xcpstatic_a26fa189_Out (FrIfFrameStructure): FrIfByteOrder=LITTLE_ENDIAN  # xcpstatic
        sn_d6c051138a624b7197665ea502ed9c68_3_9779c0f9609648bfa4441a0865c580a6_3 (FrIfPdusInFrame): FrIfPduOffset=0, FrIfMappedPduId=11, FrIfPduRef=dummy16bstatic
    FrIfGeneral:
      FrIfAbsTimerIdx = 1
      FrIfAllSlotsSupport = false
      FrIfCancelTransmitSupport = false
      FrIfDevErrorDetect = true
      FrIfDisableLPduSupport = false
      FrIfDisableTransceiverBranchSupport = false
      FrIfEnableTransceiverBranchSupport = false
      FrIfGetClockCorrectionSupport = false
      FrIfGetGetChannelStatusSupport = false
      FrIfGetNmVectorSupport = false
      FrIfGetNumOfStartupFramesSupport = false
      FrIfGetSyncFrameListSupport = false
      FrIfGetTransceiverErrorSupport = false
      FrIfGetWakeupRxStatusSupport = false
      FrIfNumClstSupported = 1
      FrIfNumCtrlSupported = 1
      FrIfReadCCConfigApi = false
      FrIfReconfigLPduSupport = false
      FrIfUnusedBitValue = 0
      FrIfVersionInfoApi = false
      FrIfFrameBufferLength = 254
      FrIfJobConcatenationEnable = false
      FrIfAbortCommunicationDisable = false
      FrIfCounterLimitDisable = false
      FrIfPduDirtyByteUsage = false
      FrIfSchedulingAlgorithm = Default
      FrIfSetWakeupChannelDisable = false
      FrIfSingleChannelAPI = false
      FrIfTxVirtualBufferIndexType = uint8
      FrIfRxVirtualBufferIndexType = uint8
      FrIfWrapperAPIsAsMacro = false
      FrIfUniformUpdateBytePos = false
      FrIfGlobalUniformUpdateBytePos = false
      FrIfFreeOpCallbackSupport = false
      FrIfJobsUseFreeOpCallback = false
      FrIfDualChannelRedundancySupport = false
      FrIfEnablePrepareLpdu = false
      FrIfDelayedTxConfirmationSupport = false
      FrIf3rdPartyDriverSupport = false
      FrIfSuppressProtectedRangeCheck = false
      FrIfRuntimeMeasurementSupport = false
      FrIfSafeBswChecks = true
