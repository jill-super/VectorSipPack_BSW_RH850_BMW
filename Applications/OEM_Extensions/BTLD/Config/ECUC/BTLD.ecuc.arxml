AUTOSAR XML (schema 4-3-0)
package /ActiveEcuC
  ecuc value collection ActiveEcuC: ecu-extract=SYSTEM
    ecuc-values:
      Rte
      Os
      Xcp
      FrSM
      FrIf
      ComM
      EcuC
      Fr
      Det
      PduR
      EcuM
      BswM
      Dlog
      Nrv
      Prog
      Cal
      Fls
      MemIf
      Crc
      DlogShared
      Dcm
      Mcu
      Port
      Fee
      FrTp
      Crypto
      CryptoClassic
      DlogClassic
      IntegrationSample
      ProgClassic
      Dem
      StmClassic
