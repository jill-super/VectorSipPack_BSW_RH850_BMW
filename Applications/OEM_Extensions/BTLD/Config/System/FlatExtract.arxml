AUTOSAR XML (schema 4-3-0)
package /COM/VECTOR/CFG/WORKFLOW/SYSDESC/SYNC
  system SYSTEM
    system mapping MAPPINGS
    root-software-compositions:
      root sw composition prototype COMPOSITIONTYPE: flat-map=FLATMAP, software-composition=COMPOSITIONTYPE
  composition sw component type COMPOSITIONTYPE  # UB:Derived from original system description
    8 x component:
      BswM: type=BswM
      ComM: type=ComM
      Det: type=Det
      EcuM: type=EcuM
      Os_OsCore_CORE0_swc: type=Os_OsCore_CORE0_swc
      Dcm: type=Dcm
      DemMaster_0: type=DemMaster_0
      DemSatellite_0: type=DemSatellite_0
    connect Dcm.DcmEcuReset -> BswM.Notification_SwcModeNotification_DcmEcuReset
  end to end protection set E2EPROTECTIONSET
  port interface mapping set PORTINTERFACEMAPPINGSET
