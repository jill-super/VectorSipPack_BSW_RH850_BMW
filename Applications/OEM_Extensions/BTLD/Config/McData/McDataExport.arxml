AUTOSAR XML (schema 4-3-0)
package /MICROSAR
  7 x bsw implementation, all with programming-language=C, vendor-id=30:
    BswM_Impl: sw-version=9.02.00, used-code-generator=DaVinci Configurator, ar-release-version=4.00.03, behavior=BswMBehavior
    ComM_Impl: sw-version=8.01.01, used-code-generator=DaVinci Configurator, ar-release-version=4.00.03, behavior=ComMBehavior
    EcuM_Impl: sw-version=8.00.02, used-code-generator=DaVinci Configurator, ar-release-version=4.00.03, behavior=EcuMBehavior
    FrIf_Impl: sw-version=5.01.02, used-code-generator=cMSR, ar-release-version=4.00.03, behavior=FrIfBehavior
    FrSM_Impl: sw-version=2.02.01, used-code-generator=DaVinci Configurator, ar-release-version=4.00.03, behavior=FrSMBehavior
    PduR_Impl: sw-version=10.00.00, used-code-generator=DaVinci Configurator, ar-release-version=4.01.02, behavior=PduRBehavior
    FrTp_Impl: sw-version=2.04.03, used-code-generator=cMSR, ar-release-version=4.00.03, behavior=FrTpBehavior
package /MICROSAR/Fr_V85xEray
  bsw implementation Fr_Impl: programming-language=C, sw-version=5.00.01, used-code-generator=DaVinci Configurator, vendor-id=30, ar-release-version=4.00.03, behavior=Fr_V85xErayBehavior
package /MICROSAR/BswM_ib_bswmd/BswModuleDescriptions
  bsw module description BswM
    bsw internal behavior BswMBehavior
      exclusive area BSWM_EXCLUSIVE_AREA_0
      bsw schedulable entity BswM_MainFunction: implemented-entry=BswM_MainFunction
      bsw timing event BswM_MainFunctionTimingEvent0: starts-on-event=BswM_MainFunction, period=0.005
  bsw module entry BswM_MainFunction: call-type=SCHEDULED, execution-context=TASK
package /MICROSAR/ComM_ib_bswmd/BswModuleDescriptions
  bsw module description ComM
    bsw internal behavior ComMBehavior
      exclusive area COMM_EXCLUSIVE_AREA_0
      exclusive area COMM_EXCLUSIVE_AREA_1
      bsw schedulable entity ComM_MainFunction_0: implemented-entry=ComM_MainFunction_0
      bsw timing event ComM_MainFunction_0TimingEvent0: starts-on-event=ComM_MainFunction_0, period=0.02
  bsw module entry ComM_MainFunction_0: call-type=SCHEDULED, execution-context=TASK
package /MICROSAR/EcuM_ib_bswmd/BswModuleDescriptions
  bsw module description EcuM
    bsw internal behavior EcuMBehavior
      exclusive area ECUM_EXCLUSIVE_AREA_0  # This exclusive area shall disable all wake up interrupts to prevent overwriting of some global variables.
      exclusive area ECUM_EXCLUSIVE_AREA_1  # This exclusive area is only used in case of multi core and if the the EcuM is configured to handle also the slave cores. It must be configured as a spinlock to allow access to some variables simultaneously from multiple cores.
      exclusive area ECUM_EXCLUSIVE_AREA_2  # This exclusive area is used for accessing the clock variable. It shall disable GPT interrupts and task changes. Only necessary if 32 Bit access is not atomic and Alarm Clock is present.
      bsw schedulable entity EcuM_MainFunction: implemented-entry=EcuM_MainFunction
      bsw timing event EcuM_MainFunctionTimingEvent0: starts-on-event=EcuM_MainFunction, period=0.01
  bsw module entry EcuM_MainFunction: call-type=SCHEDULED, execution-context=TASK
package /MICROSAR/FrIf_ib_bswmd/BswModuleDescriptions
  bsw module description FrIf
    bsw internal behavior FrIfBehavior
      exclusive area FRIF_EXCLUSIVE_AREA_{0..2}
      bsw schedulable entity FrIf_MainFunction_0: implemented-entry=FrIf_MainFunction_0
      bsw timing event FrIf_MainFunction_0TimingEvent0: starts-on-event=FrIf_MainFunction_0, period=0.005
  bsw module entry FrIf_MainFunction_0: call-type=SCHEDULED, execution-context=TASK
package /MICROSAR/FrSM_ib_bswmd/BswModuleDescriptions
  bsw module description FrSM
    bsw internal behavior FrSMBehavior
      4 x exclusive area:
        FRSM_EXCLUSIVE_AREA_{0..3}
      bsw schedulable entity FrSM_MainFunction_0: implemented-entry=FrSM_MainFunction_0
      bsw timing event FrSM_MainFunction_0TimingEvent0: starts-on-event=FrSM_MainFunction_0, period=0.005
  bsw module entry FrSM_MainFunction_0: call-type=SCHEDULED, execution-context=TASK
package /MICROSAR/FrTp_ib_bswmd/BswModuleDescriptions
  bsw module description FrTp
    bsw internal behavior FrTpBehavior
      exclusive area FRTP_EXCLUSIVE_AREA_{0..2}
      bsw schedulable entity FrTp_MainFunction: implemented-entry=FrTp_MainFunction
      bsw timing event FrTp_MainFunctionTimingEvent0: starts-on-event=FrTp_MainFunction, period=0.005
  bsw module entry FrTp_MainFunction: call-type=SCHEDULED, execution-context=TASK
package /MICROSAR/Fr_V85xEray_ib_bsmwd/BswModuleDescriptions
  bsw module description Fr
    bsw internal behavior Fr_V85xErayBehavior
      exclusive area FR_EXCLUSIVE_AREA_0
      exclusive area FR_EXCLUSIVE_AREA_1
package /MICROSAR/PduR_ib_bswmd/BswModuleDescriptions
  bsw module description PduR
    bsw internal behavior PduRBehavior
      exclusive area PDUR_EXCLUSIVE_AREA_0
