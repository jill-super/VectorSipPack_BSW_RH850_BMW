/**********************************************************************************************************************
* COPYRIGHT
* \verbatim
* This software is copyright protected and proprietary to Vector Informatik GmbH.
* Vector Informatik GmbH grants to you only those rights as set out in the license conditions.
* All other rights remain with Vector Informatik GmbH.
* \endverbatim
* LICENSE
* Module: Xcp
* Program: MSR BAC 4.x (MSR_Bmw_SLP4)
* Customer: Nexteer Automotive Corporation
* Expiry Date: Not restricted
* Ordered Derivat.: Renesas RH850 P1M R7F701363EAFP
* License Scope : The usage is restricted to CBD1700369_D04
* FILE DESCRIPTION
* File: FrXcp_0.a2l
* Generation Time: 2018-01-22 11:02:29
* Project: BTLD - Version 1.0
* Delivery: CBD1700369_D04
* Tool Version: DaVinci Configurator (beta) 5.16.31 SP1
*********************************************************************************************************************/
/**********************************************************************************************************************
! BETA VERSION !
! These programs are fully operative programs. With regard to the fact that the programs are a beta-version only, !
! Vector Informatik's liability shall be expressly excluded in cases of ordinary negligence, to the extent !
! admissible by law or statute. !
**********************************************************************************************************************/
/begin XCP_ON_FLX 256 1000 "" "" 0 HEADER_NAX_CTR PACKET_ALIGNMENT_8
 /begin POOL_BUFFER 0 MAX_FLX_LEN_BUF FIXED 254
  /begin LPDU_ID FLX_SLOT_ID FIXED 299 OFFSET FIXED 0 CYCLE_REPETITION FIXED 1 CHANNEL FIXED A /end LPDU_ID
  /begin XCP_PACKET CMD NOT_ALLOWED RES_ERR VARIABLE EV_SERV VARIABLE DAQ VARIABLE STIM NOT_ALLOWED /end XCP_PACKET
 /end POOL_BUFFER
 /begin POOL_BUFFER 1 MAX_FLX_LEN_BUF FIXED 254
  /begin LPDU_ID FLX_SLOT_ID FIXED 296 OFFSET FIXED 0 CYCLE_REPETITION FIXED 1 CHANNEL FIXED A /end LPDU_ID
  /begin XCP_PACKET CMD NOT_ALLOWED RES_ERR VARIABLE EV_SERV VARIABLE DAQ VARIABLE STIM NOT_ALLOWED /end XCP_PACKET
 /end POOL_BUFFER
 /begin POOL_BUFFER 2 MAX_FLX_LEN_BUF FIXED 254
  /begin LPDU_ID FLX_SLOT_ID FIXED 301 OFFSET FIXED 0 CYCLE_REPETITION FIXED 1 CHANNEL FIXED A /end LPDU_ID
  /begin XCP_PACKET CMD NOT_ALLOWED RES_ERR VARIABLE EV_SERV VARIABLE DAQ VARIABLE STIM NOT_ALLOWED /end XCP_PACKET
 /end POOL_BUFFER
 /begin POOL_BUFFER 3 MAX_FLX_LEN_BUF FIXED 16
  /begin LPDU_ID FLX_SLOT_ID FIXED 10 OFFSET FIXED 0 CYCLE_REPETITION FIXED 1 CHANNEL FIXED A /end LPDU_ID
  /begin XCP_PACKET CMD NOT_ALLOWED RES_ERR VARIABLE EV_SERV VARIABLE DAQ VARIABLE STIM NOT_ALLOWED /end XCP_PACKET
 /end POOL_BUFFER
 /begin POOL_BUFFER 4 MAX_FLX_LEN_BUF FIXED 254
  /begin LPDU_ID FLX_SLOT_ID FIXED 300 OFFSET FIXED 0 CYCLE_REPETITION FIXED 1 CHANNEL FIXED A /end LPDU_ID
  /begin XCP_PACKET CMD NOT_ALLOWED RES_ERR VARIABLE EV_SERV VARIABLE DAQ VARIABLE STIM NOT_ALLOWED /end XCP_PACKET
 /end POOL_BUFFER
 /begin POOL_BUFFER 5 MAX_FLX_LEN_BUF FIXED 254
  /begin LPDU_ID FLX_SLOT_ID FIXED 294 OFFSET FIXED 0 CYCLE_REPETITION FIXED 1 CHANNEL FIXED A /end LPDU_ID
  /begin XCP_PACKET CMD NOT_ALLOWED RES_ERR VARIABLE EV_SERV VARIABLE DAQ VARIABLE STIM NOT_ALLOWED /end XCP_PACKET
 /end POOL_BUFFER
 /begin POOL_BUFFER 6 MAX_FLX_LEN_BUF FIXED 254
  /begin LPDU_ID FLX_SLOT_ID FIXED 297 OFFSET FIXED 0 CYCLE_REPETITION FIXED 1 CHANNEL FIXED A /end LPDU_ID
  /begin XCP_PACKET CMD NOT_ALLOWED RES_ERR VARIABLE EV_SERV VARIABLE DAQ VARIABLE STIM NOT_ALLOWED /end XCP_PACKET
 /end POOL_BUFFER
 /begin POOL_BUFFER 7 MAX_FLX_LEN_BUF FIXED 32
  /begin LPDU_ID FLX_SLOT_ID FIXED 220 OFFSET FIXED 0 CYCLE_REPETITION FIXED 1 CHANNEL FIXED A /end LPDU_ID
  /begin XCP_PACKET CMD NOT_ALLOWED RES_ERR VARIABLE EV_SERV VARIABLE DAQ VARIABLE STIM NOT_ALLOWED /end XCP_PACKET
 /end POOL_BUFFER
 /begin POOL_BUFFER 8 MAX_FLX_LEN_BUF FIXED 254
  /begin LPDU_ID FLX_SLOT_ID FIXED 295 OFFSET FIXED 0 CYCLE_REPETITION FIXED 1 CHANNEL FIXED A /end LPDU_ID
  /begin XCP_PACKET CMD NOT_ALLOWED RES_ERR VARIABLE EV_SERV VARIABLE DAQ VARIABLE STIM NOT_ALLOWED /end XCP_PACKET
 /end POOL_BUFFER
 /begin POOL_BUFFER 9 MAX_FLX_LEN_BUF FIXED 254
  /begin LPDU_ID FLX_SLOT_ID FIXED 298 OFFSET FIXED 0 CYCLE_REPETITION FIXED 1 CHANNEL FIXED A /end LPDU_ID
  /begin XCP_PACKET CMD NOT_ALLOWED RES_ERR VARIABLE EV_SERV VARIABLE DAQ VARIABLE STIM NOT_ALLOWED /end XCP_PACKET
 /end POOL_BUFFER
 /begin POOL_BUFFER 10 MAX_FLX_LEN_BUF FIXED 32
  /begin LPDU_ID FLX_SLOT_ID FIXED 219 OFFSET FIXED 0 CYCLE_REPETITION FIXED 1 CHANNEL FIXED A /end LPDU_ID
  /begin XCP_PACKET CMD VARIABLE RES_ERR NOT_ALLOWED EV_SERV NOT_ALLOWED DAQ NOT_ALLOWED STIM VARIABLE /end XCP_PACKET
 /end POOL_BUFFER
/end XCP_ON_FLX
