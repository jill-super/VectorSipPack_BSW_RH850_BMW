AUTOSAR XML (schema 4-0-3)
# COPYRIGHT
# Copyright (c) 2016 by Vector Informatik GmbH. All rights reserved.
# This software is copyright protected and proprietary to Vector Informatik GmbH.
# Vector Informatik GmbH grants to you only those rights as set out in the license conditions.
package /MICROSAR/Cry_30_Rh850Icus
  module config Cry_Rec: definition=Cry
    CryGeneral:
      CryFhveSupport = 1
      CryFhve3RegisterAddress = 4294452240
      CryFhve15RegisterAddress = 4294485040
      CryIcusBaseAddress = 4291184640
      CryIcusVersion = CRY_ICUS_VERSION_ICUSC
      CryNumberOfKeyslots = 20
