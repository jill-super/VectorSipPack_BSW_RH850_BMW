AUTOSAR XML (schema 4-0-3)
# COPYRIGHT
# Copyright (c) 2017 by Vector Informatik GmbH. All rights reserved.
# This software is copyright protected and proprietary to Vector Informatik GmbH.
# Vector Informatik GmbH grants to you only those rights as set out in the license conditions.
package /MICROSAR/Cry_30_Rh850Icus
  module definition Cry [0..1]: category=VENDOR_SPECIFIC_MODULE_DEFINITION, refined-module-def=Cry, variants pre-compile  # Module Description of the Cry driver for RH 850 ICUS
    container CryGeneral  # General settings of the Cry
      boolean CryUseSyncJobProcessing: set at pre-compile, origin=Vector Informatik, default-value=true  # Pre-processor switch to enable and disable synchronous job processing.
      boolean CryVersionInfoApi: set at pre-compile, origin=Vector Informatik, default-value=false  # Pre-processor switch to enable and disable availability of the API Cry_GetVersionInfo(). True: API Cry_GetVersionInfo() is available. False: API Cry_GetVersionInfo() is not available.
      enumeration CryIcusVersion: set at pre-compile, origin=Vector Informatik, default-value=CRY_ICUS_VERSION_ICUSB  # Version of the ICUS module. F1L: ICUS-B F1M: ICUS-C F1K: ICUS-E P1M: ICUS-C P1M-E: ICUS-E P1L-C: ICUS-E D1Lx: ICUS-D D1Mx: ICUS-D E1x: ICUS-D
        CRY_ICUS_VERSION_ICUSB  # ICUS-B
        CRY_ICUS_VERSION_ICUSC  # ICUS-C
        CRY_ICUS_VERSION_ICUSD  # ICUS-D
        CRY_ICUS_VERSION_ICUSE  # ICUS-E
      integer CryIcusBaseAddress: 0..4294967295, set at pre-compile, origin=Vector Informatik, default-value=4294311936  # Base Address of the ICUS module F1x: 0xFFF60000 P1M: 0xFFC64800 P1M-E: 0xFFC5D000 E1x: 0xFF000000 D1L/D1M: 0xFFF60000
      boolean CryTimeoutApi: set at pre-compile, origin=Vector Informatik, default-value=false  # Pre-processor switch to enable and disable availability of the timeout API. True: Timeout API is available.The timeout callout functions are invoked by the CRY. False: Timeout API is not available.
      integer CryNumberOfKeyslots: 10..20, set at pre-compile, origin=Vector Informatik, default-value=10  # Define the number of Keyslots which shall be used.
      function name CryTimeoutApiLocationCallout [0..1]: set at pre-compile, origin=Vector Informatik, default-value=Appl_Cry_TimeoutLocationCallout  # Name of the function which is called to indicate the location of the currently executing code. e.g. before a loop, or after a loop or which service is currently executed
      function name CryTimeoutApiLoopCallout [0..1]: set at pre-compile, origin=Vector Informatik, default-value=Appl_Cry_TimeoutLoopCallout  # Name of the function which is called in a loop. If the function returns CSM_E_NOT_OK, the loop will be leaved and a cancel command will be send to the SHE.
      boolean CryFhveSupport: set at pre-compile, origin=Vector Informatik, default-value=false  # Support for "software protection of flash memory against programming and erasure" Must be enabled on devices like P1M to store keys to the NVM storage. When enabled, the corresponding registers (FHVE3 and FHVE15) have to be defined in the coniguration.
      integer CryFhve3RegisterAddress [0..1]: 0..4294967295, set at pre-compile, origin=Vector Informatik, default-value=4294452240  # Address of FHVE3 Register e.g. P1M = 0xFFF82410u
      integer CryFhve15RegisterAddress [0..1]: 0..4294967295, set at pre-compile, origin=Vector Informatik, default-value=4294485040  # Address of FHVE15 Register e.g. P1M = 0xFFF8A430u
      boolean CryDevErrorDetect: set at pre-compile, origin=Vector Informatik, default-value=true  # Enables/disables the checking of the API input parameters. Attention: Det is not informed, only CSM_E_NOT_OK is returned!
      boolean CryDataFlashSynchronisation: set at pre-compile, origin=Vector Informatik, default-value=false  # Enables/disables the usage of the FlashRead callouts.
      boolean CryHardwareErrorCode: set at pre-compile, origin=Vector Informatik, default-value=false  # Enables/disables the usage of the hardware error code callout.
      boolean CryDataFlashControl: set at pre-compile, origin=Vector Informatik, default-value=false  # Enables Callouts regarding the handling of the FACI interface of the data flash. (e.g. Switch to User-Mode after canceling a command which does write access to the dataflash or recovering from command locked state)
      boolean CrySelfTest: set at pre-compile, origin=Vector Informatik, default-value=false  # When enabled, a self test of the CMAC verification is performed by using a valid and invalid test vector to test both verification results during init.
      boolean CrySelfTestHardwareSupport: set at pre-compile, origin=Vector Informatik, default-value=false  # Enable this option to use the commands provided by the hardware. Otherwise a software implementation will be used. This option is only relevant when CrySelfTest is enabled. Hardware support for CMAC self check should be available on: - F1K - P1M - E1x
    container CryAesEncrypt128 [0..1]  # Contains the AES Encrypt Configurations
      container CryAesEncrypt128Config [1..32]  # Contains an AES Encrypt Configuration
        enumeration CryAesEncrypt128BlockMode: set at pre-compile, origin=Vector Informatik, default-value=CRY_AESBLOCKMODE_ECB  # AES-128 Encryption Block Mode | The block mode describes how to handle data which exceeds the block length.
          CRY_AESBLOCKMODE_ECB  # Block Mode ECB
          CRY_AESBLOCKMODE_CBC  # Block Mode CBC
        enumeration CryKeyIdType: {CRY_KEYIDTYPE_RAW, CRY_KEYIDTYPE_MAPPED}, set at pre-compile, origin=Vector Informatik, default-value=CRY_KEYIDTYPE_MAPPED  # Selects how the KeyId which is passed to the service is interpreted.
    container CryAesDecrypt128 [0..1]  # Contains the AES Decrypt Configurations
      container CryAesDecrypt128Config [1..32]  # Contains an AES Encrypt Configuration
        enumeration CryAesDecrypt128BlockMode: set at pre-compile, origin=Vector Informatik, default-value=CRY_AESBLOCKMODE_ECB  # AES-128 Decryption Block Mode | The block mode describes how to handle data which exceeds the block length.
          CRY_AESBLOCKMODE_ECB  # Block Mode ECB
          CRY_AESBLOCKMODE_CBC  # Block Mode CBC
        enumeration CryKeyIdType: {CRY_KEYIDTYPE_RAW, CRY_KEYIDTYPE_MAPPED}, set at pre-compile, origin=Vector Informatik, default-value=CRY_KEYIDTYPE_MAPPED  # Selects how the KeyId which is passed to the service is interpreted.
    container CryRng [0..1]  # Contains the Random Number Generator Configurations
      container CryRngConfig [1..32]  # Contains a Random Number Generator Configuration
    container CryCmacAes128Ver [0..1]  # Contains the AES-Cmac Verification Configurations
      container CryCmacAes128VerConfig [1..32]  # Contains an AES-Cmac Verification Configuration
        boolean CryLengthInBytes: set at pre-compile, origin=Vector Informatik, default-value=true  # If enabled, Cry interprets the data length of the given MAC in bytes, otherwise in bits.
        enumeration CryKeyIdType: {CRY_KEYIDTYPE_RAW, CRY_KEYIDTYPE_MAPPED}, set at pre-compile, origin=Vector Informatik, default-value=CRY_KEYIDTYPE_MAPPED  # Selects how the KeyId which is passed to the service is interpreted.
    container CryCmacAes128Gen [0..1]  # Contains the AES-Cmac Generate Configurations
      container CryCmacAes128GenConfig [1..32]  # Containsan AES-Cmac Generate Configuration
        enumeration CryKeyIdType: {CRY_KEYIDTYPE_RAW, CRY_KEYIDTYPE_MAPPED}, set at pre-compile, origin=Vector Informatik, default-value=CRY_KEYIDTYPE_MAPPED  # Selects how the KeyId which is passed to the service is interpreted.
    container CryKeyWrapSym [0..1]  # Contains the Key Export Configurations
      container CryKeyWrapSymConfig [1..32]  # Contains a Key Export Configuration
        enumeration CryKeyIdType: {CRY_KEYIDTYPE_RAW, CRY_KEYIDTYPE_MAPPED}, set at pre-compile, origin=Vector Informatik, default-value=CRY_KEYIDTYPE_MAPPED  # Selects how the KeyId which is passed to the service is interpreted.
    container CryKeyExtract [0..1]  # Contains the Key Import Configurations
      container CryKeyExtractConfig [1..32]  # Contains a Key Import Configuration
        enumeration CryKeyIdType: {CRY_KEYIDTYPE_RAW, CRY_KEYIDTYPE_MAPPED}, set at pre-compile, origin=Vector Informatik, default-value=CRY_KEYIDTYPE_MAPPED  # Selects how the KeyId which is passed to the service is interpreted.
  bsw implementation Cry_Impl: programming-language=C, sw-version=2.03.01, used-code-generator=DaVinci Configurator, vendor-id=30, ar-release-version=4.00.03, behavior=Cry_30_Rh850Icus, preconfigured-configuration=Cry_Pre, recommended-configuration=Cry_Rec, vendor-api-infix=Rh850Icus, vendor-specific-module-def=Cry
