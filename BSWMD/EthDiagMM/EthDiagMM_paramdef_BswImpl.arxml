AUTOSAR XML (schema 4-2-1)
package /BMW/EthDiagMM/BswImplementation
  bsw implementation EthDiagMMImplementation: vendor-specific-module-def=Cdd
