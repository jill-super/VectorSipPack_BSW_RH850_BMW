AUTOSAR XML (schema 4-3-0)
package /BMW/Platform/StdDiag/BswImplementations
  bsw implementation Impl_StdDiag_Bsw: vendor-specific-module-def=StdDiagClassic
