AUTOSAR XML (schema 4-0-3)
# COPYRIGHT
# Copyright (c) 2017 by Vector Informatik GmbH. All rights reserved.
# This software is copyright protected and proprietary to Vector Informatik GmbH.
# Vector Informatik GmbH grants to you only those rights as set out in the license conditions.
package /MICROSAR/Crypto_30_CryWrapper
  bsw implementation Crypto_Impl: programming-language=C, sw-version=2.01.01, used-code-generator=DaVinci Configurator, vendor-id=30, ar-release-version=4.03.00, behavior=Crypto_30_CryWrapper, preconfigured-configuration=Crypto_Pre, recommended-configuration=Crypto_Rec, vendor-api-infix=CryWrapper, vendor-specific-module-def=Crypto
  module definition Crypto [0..1]: category=VENDOR_SPECIFIC_MODULE_DEFINITION, refined-module-def=Crypto, variants pre-compile  # Crypto Driver Wrapper for HW CRY. The Wrapper provides an ASR4.3 Crypto Stack API and can use ASR4.2 Crys to provide the cryptographic primitives.
    container CryptoGeneral  # Container for common configuration options.
      boolean CryptoDevErrorDetect: set at pre-compile, default-value=true  # Switches the development error detection and notification on or off. - true: detection and notification is enabled. - false: detection and notification is disabled. | True: Development error detection enabled. False: Development error detection disabled
      boolean CryptoVersionInfoApi: set at pre-compile, default-value=false  # Pre-processor switch to enable and disable availability of the API Crypto_GetVersionInfo(). - True: API Crypto_GetVersionInfo() is available - False: API Crypto_GetVersionInfo() is not available.
      float CryptoMainFunctionPeriod: 0..3600, set at pre-compile, default-value=0.01  # Specifies the period of main function Crypto_MainFunction in seconds.
    container CryptoDriverObjects  # Container for Crypto Driver Objects
      container CryptoDriverObject [0..*]  # Container for configuration of Crypto Driver Object. The container name serves as a symbolic name for the identifier of a Crypto Driver Object.
        integer CryptoDriverObjectId: 0..4294967295, set at pre-compile, symbolic-name-value=true, default-value=0  # Identifier of the Crypto Driver Object. The Crypto Driver Object offers different crypto primitives.
        integer CryptoDriverObjectQueueSize: 1..1, set at pre-compile, default-value=1  # Size of the queue in the Crypto Driver. Defines the maximum number of jobs in the Crypto Driver Object queue. If it is set to 0, queueing is disabled in the Crypto Driver Object. This Crypto Driver does not support queuing but uses the buffer for asynchronous processing.
        reference CryptoPrimitiveRef [1..*]: set at pre-compile, destination=CryptoPrimitive  # Refers to primitive in the CRYPTO. The CryptoPrimitive is a pre-configured container of the crypto service that shall be used.
    container CryptoKeys [0..1]  # Container for CRYPTO keys
      container CryptoKey [1..*]  # Configuration for CRYPTO keys
        integer CryptoKeyId: 0..4294967295, set at pre-compile, symbolic-name-value=true, default-value=0  # Identifier of the CRYPTO Key
        reference CryptoKeyTypeRef: set at pre-compile, destination=CryptoKeyType  # Refers to a pointer in the CRYPTO to a CryptoKeyType. The CryptoKeyType provides the information which key elements are contained in a CryptoKey.
    container CryptoPrimitives  # Container for CRYPTO primitives
      container CryptoPrimitive [0..*]  # Configuration of a CryptoPrimitive
        enumeration CryptoPrimitiveAlgorithmFamily [1..*]: {CRYPTO_ALGOFAM_NOT_SET, CRYPTO_ALGOFAM_SHA1, CRYPTO_ALGOFAM_SHA2_224, CRYPTO_ALGOFAM_SHA2_256, CRYPTO_ALGOFAM_SHA2_384, CRYPTO_ALGOFAM_SHA2_512, CRYPTO_ALGOFAM_SHA2_512_224, CRYPTO_ALGOFAM_SHA2_512_256, CRYPTO_ALGOFAM_SHA3_224, CRYPTO_ALGOFAM_SHA3_256, CRYPTO_ALGOFAM_SHA3_384, CRYPTO_ALGOFAM_SHA3_512, CRYPTO_ALGOFAM_SHAKE128, CRYPTO_ALGOFAM_SHAKE256, CRYPTO_ALGOFAM_RIPEMD160, CRYPTO_ALGOFAM_BLAKE_1_256, CRYPTO_ALGOFAM_BLAKE_1_512, CRYPTO_ALGOFAM_BLAKE_2s_256, CRYPTO_ALGOFAM_BLAKE_2s_512, CRYPTO_ALGOFAM_3DES, CRYPTO_ALGOFAM_AES, CRYPTO_ALGOFAM_CHACHA, CRYPTO_ALGOFAM_RSA, CRYPTO_ALGOFAM_ED25519, CRYPTO_ALGOFAM_BRAINPOOL, CRYPTO_ALGOFAM_ECCNIST, CRYPTO_ALGOFAM_SECURECOUNTER, CRYPTO_ALGOFAM_RNG, CRYPTO_ALGOFAM_SIPHASH, CRYPTO_ALGOFAM_ECIES, CRYPTO_ALGOFAM_CUSTOM}, set at pre-compile  # Determines the algorithm family used for the crypto service
        enumeration CryptoPrimitiveAlgorithmMode [1..*]: {CRYPTO_ALGOMODE_NOT_SET, CRYPTO_ALGOMODE_ECB, CRYPTO_ALGOMODE_CBC, CRYPTO_ALGOMODE_CFB, CRYPTO_ALGOMODE_OFB, CRYPTO_ALGOMODE_CTR, CRYPTO_ALGOMODE_GCM, CRYPTO_ALGOMODE_XTS, CRYPTO_ALGOMODE_RSAES_OAEP, CRYPTO_ALGOMODE_RSAES_PKCS1_v1_5, CRYPTO_ALGOMODE_RSASSA_PSS, CRYPTO_ALGOMODE_RSASSA_PKCS1_v1_5, CRYPTO_ALGOMODE_8ROUNDS, CRYPTO_ALGOMODE_12ROUNDS, CRYPTO_ALGOMODE_20ROUNDS, CRYPTO_ALGOMODE_HMAC, CRYPTO_ALGOMODE_CMAC, CRYPTO_ALGOMODE_GMAC, CRYPTO_ALGOMODE_CTRDRBG, CRYPTO_ALGOMODE_SIPHASH_2_4, CRYPTO_ALGOMODE_SIPHASH_4_8, CRYPTO_ALGOMODE_CUSTOM}, set at pre-compile  # Determines the algorithm mode used for the crypto service
        enumeration CryptoPrimitiveAlgorithmSecondaryFamily [1..*]: {CRYPTO_ALGOFAM_NOT_SET, CRYPTO_ALGOFAM_SHA1, CRYPTO_ALGOFAM_SHA2_224, CRYPTO_ALGOFAM_SHA2_256, CRYPTO_ALGOFAM_SHA2_384, CRYPTO_ALGOFAM_SHA2_512, CRYPTO_ALGOFAM_SHA2_512_224, CRYPTO_ALGOFAM_SHA2_512_256, CRYPTO_ALGOFAM_SHA3_224, CRYPTO_ALGOFAM_SHA3_256, CRYPTO_ALGOFAM_SHA3_384, CRYPTO_ALGOFAM_SHA3_512, CRYPTO_ALGOFAM_SHAKE128, CRYPTO_ALGOFAM_SHAKE256, CRYPTO_ALGOFAM_RIPEMD160, CRYPTO_ALGOFAM_BLAKE_1_256, CRYPTO_ALGOFAM_BLAKE_1_512, CRYPTO_ALGOFAM_BLAKE_2s_256, CRYPTO_ALGOFAM_BLAKE_2s_512, CRYPTO_ALGOFAM_3DES, CRYPTO_ALGOFAM_AES, CRYPTO_ALGOFAM_CHACHA, CRYPTO_ALGOFAM_RSA, CRYPTO_ALGOFAM_ED25519, CRYPTO_ALGOFAM_BRAINPOOL, CRYPTO_ALGOFAM_ECCNIST, CRYPTO_ALGOFAM_SECURECOUNTER, CRYPTO_ALGOFAM_RNG, CRYPTO_ALGOFAM_SIPHASH, CRYPTO_ALGOFAM_ECIES, CRYPTO_ALGOFAM_CUSTOM}, set at pre-compile  # Determines the algorithm family used for the crypto service
        enumeration CryptoPrimitiveService [1..*]: {CRYPTO_MAC_VERIFY, CRYPTO_MAC_GENERATE, CRYPTO_SIGNATURE_VERIFY, CRYPTO_SIGNATURE_GENERATE, CRYPTO_ENCRYPT, CRYPTO_DECRYPT, CRYPTO_AEADENCRYPT, CRYPTO_AEADDECRYPT, CRYPTO_HASH, CRYPTO_RANDOM}, set at pre-compile  # Determines the crypto service used for defining the capabilities
    container CryptoKeyElements [0..1]  # Container for CRYPTO key elements
      container CryptoKeyElement [1..*]  # Configuration of a CryptoKeyElement
        integer CryptoKeyElementId: 0..4294967295, set at pre-compile, symbolic-name-value=true  # Identifier of the CRYPTO key element
        integer CryptoKeyElementSize: 1..4294967295, set at pre-compile  # Maximum Size size of a CRYPTO key element in bytes
        string CryptoKeyElementInitValue [0..1]: set at pre-compile  # Value which will be used to fill the element during initialisation, when the element is not already initialized.
        boolean CryptoKeyElementAllowPartialAccess: set at pre-compile, default-value=false  # Enable or disable writing and reading the key element with data smaller than the size of the element. True: enable partial access of the key element False: disable partial access of the key element
        boolean CryptoKeyElementPersist: set at pre-compile, default-value=false  # Enable or disable persisting of the key element in non-volatile storage. True: enable persisting of the key element. False: disable persisting of the key element.
        enumeration CryptoKeyElementReadAccess: {RA_ALLOWED, RA_DENIED, RA_ENCRYPTED, RA_INTERNAL_COPY}, set at pre-compile, default-value=RA_ALLOWED  # Define the reading access rights of the key element. CRYPTO_RA_DENIED = key element cannot be read from outside the Crypto Driver CRYPTO_RA INTERNAL_COPY = key element can be copied to another key element in the same crypto driver. CRYPTO_RA_ALLOWED = key element can be read as plaintext CRYPTO_RA_ENCRYPTED = key element can be read encrypted. E.g. SHE Ram-Key export.
        enumeration CryptoKeyElementWriteAccess: {WA_ALLOWED, WA_DENIED, WA_ENCRYPTED, WA_INTERNAL_COPY}, set at pre-compile, default-value=WA_ALLOWED  # Define the writing access rights of the key element CRYPTO_WA_DENIED = key element can not be written from outside the Crypto Driver CRYPTO_WA INTERNAL_COPY = key element can be filled with another key element in the same crypto driver. CRYPTO_WA_ALLOWED = key element can be rwritten as plaintext CRYPTO_WA_ENCRYPTED = key element can be written encrypted. E.g. SHE load key.
        reference CryptoKeyElementVirtualTargetRef [0..1]: set at pre-compile, destination=CryptoKeyElement  # Refers to a key element which will contain the actual data. If the Reference is configured, the key element will be a virtual key element.
    container CryptoKeyTypes  # Container for CRYPTO key types
      container CryptoKeyType [1..*]  # Container to declare a Key Type.
        reference CryptoKeyElementRef [1..*]: set at pre-compile, destination=CryptoKeyElement  # Refers to a pointer in the CRYPTO Key Element, which holds the data of the crypto key element.
    container CryptoWrapper  # Container for specific options used to map ASR4.3 Crypto Stack to ASR4.2 Cry services.
      container CryptoSymEncryptConfig [0..*]  # Cry service which is used to do a AES Encryption in CBC mode. If a Vector Cry is used, this configuration is also used for ECB mode.
        string CryptoSymEncryptPrimitiveName: set at pre-compile, origin=Vector Informatik  # Name of Symmetrical Encryption Primitive | This is the name of the cryptographic primitive to use. This name will be used to form the function pointers to the Start, Update and Finish functions of the corresponding cryptographic primitive according to the following rule: <name>[Start|Update|Finish] Usually these functions are provided by the CRY module.
        string CryptoSymEncryptIncludeFile: set at pre-compile, origin=Vector Informatik  # Include file of specific Service | Header file of the underlying cryptographic service that shall be used.
        string CryptoSymEncryptInitConfiguration: set at pre-compile, origin=Vector Informatik  # Symbolic Name of Init Configuration Structure | This is the name of the C symbol, which contains the configuration of the underlying cryptographic primitive. Usually, this symbol represents a structure provided by the CRY module.
        choice reference CryptoSymEncryptCryRef [0..1]: set at pre-compile, origin=Vector Informatik, destination=CryAesEncrypt128Config  # Reference to a Cry configuration in case a Vector Cry is used.
        reference CryptoSymEncryptCsmJobRef [1..*]: set at pre-compile, origin=Vector Informatik, destination=CsmJob  # Job which will indicate that this configuration shall be used.
      container CryptoSymDecryptConfig [0..*]  # Cry service which is used to do a AES Decryption in CBC mode. If a Vector Cry is used, this configuration is also used for ECB mode.
        string CryptoSymDecryptPrimitiveName: set at pre-compile, origin=Vector Informatik  # Name of Symmetrical Encryption Primitive | This is the name of the cryptographic primitive to use. This name will be used to form the function pointers to the Start, Update and Finish functions of the corresponding cryptographic primitive according to the following rule: <name>[Start|Update|Finish] Usually these functions are provided by the CRY module.
        string CryptoSymDecryptIncludeFile: set at pre-compile, origin=Vector Informatik  # Include file of specific Service | Header file of the underlying cryptographic service that shall be used.
        string CryptoSymDecryptInitConfiguration: set at pre-compile, origin=Vector Informatik  # Symbolic Name of Init Configuration Structure | This is the name of the C symbol, which contains the configuration of the underlying cryptographic primitive. Usually, this symbol represents a structure provided by the CRY module.
        choice reference CryptoSymDecryptCryRef [0..1]: set at pre-compile, origin=Vector Informatik, destination=CryAesDecrypt128Config  # Reference to a Cry configuration in case a Vector Cry is used.
        reference CryptoSymDecryptCsmJobRef [1..*]: set at pre-compile, origin=Vector Informatik, destination=CsmJob  # Job which will indicate that this configuration shall be used.
      container CryptoMacGenerateConfig [0..*]  # Cry service which is used to do a CMAC Generation.
        string CryptoMacGenerateInitConfiguration: set at pre-compile, origin=Vector Informatik  # Symbolic Name of Init Configuration Structure | This is the name of the C symbol, which contains the configuration of the underlying cryptographic primitive. Usually, this symbol represents a structure provided by the CRY module.
        string CryptoMacGeneratePrimitiveName: set at pre-compile, origin=Vector Informatik  # Name of MAC Generation Primitive | This is the name of the cryptographic primitive to use. This name will be used to form the function pointers to the Start, Update and Finish functions of the corresponding cryptographic primitive according to the following rule: <name>[Start|Update|Finish] Usually these functions are provided by the CRY module.
        string CryptoMacGenerateIncludeFile: set at pre-compile, origin=Vector Informatik  # Include file of specific Service | Header file of the underlying cryptographic service that shall be used.
        choice reference CryptoMacGenerateCryRef [0..1]: set at pre-compile, origin=Vector Informatik, destination=CryCmacAes128GenConfig  # Reference to a Cry configuration in case a Vector Cry is used.
        reference CryptoMacGenerateCsmJobRef [1..*]: set at pre-compile, origin=Vector Informatik, destination=CsmJob  # Job which will indicate that this configuration shall be used.
      container CryptoMacVerifyConfig [0..*]  # Cry service which is used to do a CMAC Verification. Be aware that the MacVerify services has to be configured to interpret the length of the MAC in bits.
        string CryptoMacVerifyInitConfiguration: set at pre-compile, origin=Vector Informatik  # Symbolic Name of Init Configuration Structure | This is the name of the C symbol, which contains the configuration of the underlying cryptographic primitive. Usually, this symbol represents a structure provided by the CRY module.
        string CryptoMacVerifyPrimitiveName: set at pre-compile, origin=Vector Informatik  # Name of MAC Verification Primitive | This is the name of the cryptographic primitive to use. This name will be used to form the function pointers to the Start, Update and Finish functions of the corresponding cryptographic primitive according to the following rule: <name>[Start|Update|Finish] Usually these functions are provided by the CRY module.
        string CryptoMacVerifyIncludeFile: set at pre-compile, origin=Vector Informatik  # Include file of specific Service | Header file of the underlying cryptographic service that shall be used.
        boolean CryptoConvertLengthToBytes: set at pre-compile, origin=Vector Informatik, default-value=false  # Convert the length from Bits in Bytes
        choice reference CryptoMacVerifyCryRef [0..1]: set at pre-compile, origin=Vector Informatik, destination=[CryHmacSha1VerifyConfig, CryCmacAes128VerConfig]  # Reference to a Cry configuration in case a Vector Cry is used.
        reference CryptoMacVerifyCsmJobRef [1..*]: set at pre-compile, origin=Vector Informatik, destination=CsmJob  # Job which will indicate that this configuration shall be used.
      container CryptoRandomGenerateConfig [0..*]  # Cry service which is used to generate a random number.
        string CryptoRandomGenerateInitConfiguration: set at pre-compile, origin=Vector Informatik  # Symbolic Name of Init Configuration Structure | This is the name of the C symbol, which contains the configuration of the underlying cryptographic primitive. Usually, this symbol represents a structure provided by the CRY module.
        string CryptoRandomGeneratePrimitiveName: set at pre-compile, origin=Vector Informatik  # Name of Random Generation Primitive | This is the name of the cryptographic primitive to use. This name will be used to form the function pointers to the Start, Update and Finish functions of the corresponding cryptographic primitive according to the following rule: <name>[Start|Update|Finish] Usually these functions are provided by the CRY module.
        string CryptoRandomGenerateIncludeFile: set at pre-compile, origin=Vector Informatik  # Include file of specific Service | Header file of the underlying cryptographic service that shall be used.
        choice reference CryptoRandomGenerateCryRef [0..1]: set at pre-compile, origin=Vector Informatik, destination=[CryFips186Config, CryRngConfig]  # Reference to a Cry configuration in case a Vector Cry is used.
        reference CryptoRandomGenerateCsmJobRef [1..*]: set at pre-compile, origin=Vector Informatik, destination=CsmJob  # Job which will indicate that this configuration shall be used.
      container CryptoRandomSeedConfig [0..1]  # Cry service which is used to provide a seed to the hardware.
        string CryptoRandomSeedInitConfiguration: set at pre-compile, origin=Vector Informatik  # Symbolic Name of Init Configuration Structure | This is the name of the C symbol, which contains the configuration of the underlying cryptographic primitive. Usually, this symbol represents a structure provided by the CRY module.
        string CryptoRandomSeedPrimitiveName: set at pre-compile, origin=Vector Informatik  # Name of Random Seed Primitive | This is the name of the cryptographic primitive to use. This name will be used to form the function pointers to the Start, Update and Finish functions of the corresponding cryptographic primitive according to the following rule: <name>[Start|Update|Finish] Usually these functions are provided by the CRY module.
        string CryptoRandomSeedIncludeFile: set at pre-compile, origin=Vector Informatik  # Include file of specific Service | Header file of the underlying cryptographic service that shall be used.
        choice reference CryptoRandomSeedCryRef [0..1]: set at pre-compile, origin=Vector Informatik, destination=[CryFips186Config, CryRngConfig]  # Reference to a Cry configuration in case a Vector Cry is used.
      container CryptoSymKeyExtractConfig [0..5]  # Cry Service which is used to load a plain text key into the KEY_RAM of the SHE. In case of a Vector CRY, use the same Reference for all CryptoKeyExtractConfig containers.
        string CryptoSymKeyExtractInitConfiguration: set at pre-compile, origin=Vector Informatik  # Symbolic Name of Init Configuration Structure | This is the name of the C symbol, which contains the configuration of the underlying cryptographic primitive. Usually, this symbol represents a structure provided by the CRY module.
        string CryptoSymKeyExtractPrimitiveName: set at pre-compile, origin=Vector Informatik  # Name of Symmetrical Key Extraction Primitive | This is the name of the cryptographic primitive to use. This name will be used to form the function pointers to the Start, Update and Finish functions of the corresponding cryptographic primitive according to the following rule: <name>[Start|Update|Finish] Usually these functions are provided by the CRY module.
        string CryptoSymKeyExtractIncludeFile: set at pre-compile, origin=Vector Informatik  # Include file of specific Service | Header file of the underlying cryptographic service that shall be used.
        enumeration CryptoSymKeyExtractUsage: {CRYPTO_ALL_KEYS, CRYPTO_PAGE_0, CRYPTO_PAGE_1, CRYPTO_RAMKEY, CRYPTO_PLAINKEY}, set at pre-compile, origin=Vector Informatik, default-value=CRYPTO_ALL_KEYS  # This defines how the Cry configuartion shall be used. Vector Cry: Configure one Cry configuartion with CRYPTO_ALL_KEYS Infineon or Traveo Cry: Configure 4 different Cry configurations: - CRYPTO_PAGE_0 is used to update the first key page - CRYPTO_PAGE_1 is used to update the second key page - CRYPTO_RAMKEY is used to update the Ram key with M1-M3 - CRYPTO_PLAINKEY is used to update the Ram key with a 16 byte plaintext key
        choice reference CryptoSymKeyExtractCryRef [0..1]: set at pre-compile, origin=Vector Informatik, destination=CryKeyExtractConfig  # Reference to a Cry configuration in case a Vector Cry is used.
      container CryptoSymKeyWrapSymConfig [0..1]  # Cry service which is used to export the SHE Ram key as M1-M3 or M1-M5 depending on the provided buffer length.
        string CryptoSymKeyWrapSymInitConfiguration: set at pre-compile, origin=Vector Informatik  # Symbolic Name of Init Configuration Structure | This is the name of the C symbol, which contains the configuration of the underlying cryptographic primitive. Usually, this symbol represents a structure provided by the CRY module.
        string CryptoSymKeyWrapSymPrimitiveName: set at pre-compile, origin=Vector Informatik  # Name of Symmetrical Key Wrapping Primitive | This is the name of the cryptographic primitive to use. This name will be used to form the function pointers to the Start, Update and Finish functions of the corresponding cryptographic primitive according to the following rule: <name>[Start|Update|Finish] Usually these functions are provided by the CRY module. .
        string CryptoSymKeyWrapSymIncludeFile: set at pre-compile, origin=Vector Informatik  # Include file of specific Service | Header file of the underlying cryptographic service that shall be used.
        choice reference CryptoSymKeyWrapSymCryRef [0..1]: set at pre-compile, origin=Vector Informatik, destination=CryKeyWrapSymConfig  # Reference to a Cry configuration in case a Vector Cry is used.
      container CryptoSymBlockEncryptConfig [0..*]  # Cry service which is used to do a AES Encryption in ECB mode with a Infineon or Traveo Cry.
        string CryptoSymBlockEncryptPrimitiveName: set at pre-compile, origin=Vector Informatik  # Name of Symmetrical Encryption Primitive | This is the name of the cryptographic primitive to use. This name will be used to form the function pointers to the Start, Update and Finish functions of the corresponding cryptographic primitive according to the following rule: <name>[Start|Update|Finish] Usually these functions are provided by the CRY module.
        string CryptoSymBlockEncryptIncludeFile: set at pre-compile, origin=Vector Informatik  # Include file of specific Service | Header file of the underlying cryptographic service that shall be used.
        string CryptoSymBlockEncryptInitConfiguration: set at pre-compile, origin=Vector Informatik  # Symbolic Name of Init Configuration Structure | This is the name of the C symbol, which contains the configuration of the underlying cryptographic primitive. Usually, this symbol represents a structure provided by the CRY module.
        reference CryptoSymBlockEncryptCsmJobRef [1..*]: set at pre-compile, origin=Vector Informatik, destination=CsmJob  # Job which will indicate that this configuration shall be used.
      container CryptoSymBlockDecryptConfig [0..*]  # Cry service which is used to do a AES Decryption in ECB mode with a Infineon or Traveo Cry.
        string CryptoSymBlockDecryptPrimitiveName: set at pre-compile, origin=Vector Informatik  # Name of Symmetrical Encryption Primitive | This is the name of the cryptographic primitive to use. This name will be used to form the function pointers to the Start, Update and Finish functions of the corresponding cryptographic primitive according to the following rule: <name>[Start|Update|Finish] Usually these functions are provided by the CRY module.
        string CryptoSymBlockDecryptIncludeFile: set at pre-compile, origin=Vector Informatik  # Include file of specific Service | Header file of the underlying cryptographic service that shall be used.
        string CryptoSymBlockDecryptInitConfiguration: set at pre-compile, origin=Vector Informatik  # Symbolic Name of Init Configuration Structure | This is the name of the C symbol, which contains the configuration of the underlying cryptographic primitive. Usually, this symbol represents a structure provided by the CRY module.
        reference CryptoSymBlockDecryptCsmJobRef [1..*]: set at pre-compile, origin=Vector Informatik, destination=CsmJob  # Job which will indicate that this configuration shall be used.
      container CryptoWrapperGeneral  # Container for specific options
        integer CryptoSecondKeyPageOffset: 15..20, set at pre-compile, origin=Vector Informatik, default-value=15  # Vector: 15 Infineon: 15 Traveo: 20
        enumeration CryptoKeyUpdateScheme: {KEYID_M1_M2_M3, MULTIPLE_CONFIGS}, set at pre-compile, origin=Vector Informatik, default-value=KEYID_M1_M2_M3  # Vector: KEYID_M1_M2_M3 (provide a buffer which is 65 Bytes long and has a prepending KeyId) Infineo: MULTIPLE_CONFIGS (e.g. one config for first keypage and another config for the second keypage) Traveo: MULTIPLE_CONFIGS
        boolean CryptoUseKeyExtractForPlaintextKey: set at pre-compile, origin=Vector Informatik, default-value=true  # Vector: TRUE or FALSE Infineon: TRUE Traveo: TRUE
        boolean CryptoProvideBufferInBlockFinish: set at pre-compile, origin=Vector Informatik, default-value=false  # SymBlockEncrypt/Decrypt do not expect a buffer to be provided in the finish funtion. I a Cry expects these parameters, the option has to be enabled. Vector: Option is ignored Infineon: TRUE Traveo: FALSE
        boolean CryptoProvideIdInsteadOfPointer: set at pre-compile, origin=Vector Informatik, default-value=false  # If a Cry expects Ids of type Csm_ConfigIdType instead of a void pointer in the update and finish function, this option has to be enabled. Vector: FALSE Infineon: FALSE Traveo: TRUE
        enumeration CryptoKeyIdMapping: {CRYPTO_KEYIDTYPE_RAW, CRYPTO_KEYIDTYPE_MAPPED}, set at pre-compile, origin=Vector Informatik, default-value=CRYPTO_KEYIDTYPE_MAPPED  # Specify the mapping of the keyIds from Crypto to Cry. Examples: RAW: Key_1 -> ID passed to Cry = 4 MAPPED: Key_1 -> ID passed to Cry = 1 Vector Cry: Set all service configurations in the CRY to the value selected here. Infineon Cry: Set this Value to CRYPTO_KEYIDTYPE_MAPPED
        boolean CryptoProvideCsmNotificationApi: set at pre-compile, origin=Vector Informatik, default-value=false  # Provides the notification API of the Csm for the Cry
  module config Crypto_Pre: definition=Crypto
    CryptoPrimitives
      5 x CryptoPrimitive, all with CryptoPrimitiveAlgorithmSecondaryFamily=CRYPTO_ALGOFAM_NOT_SET:
        AesEncrypt: CryptoPrimitiveAlgorithmFamily=CRYPTO_ALGOFAM_AES, CryptoPrimitiveAlgorithmMode=CRYPTO_ALGOMODE_ECB, CryptoPrimitiveService=CRYPTO_ENCRYPT, CryptoPrimitiveAlgorithmMode=CRYPTO_ALGOMODE_CBC
        AesDecrypt: CryptoPrimitiveAlgorithmFamily=CRYPTO_ALGOFAM_AES, CryptoPrimitiveAlgorithmMode=CRYPTO_ALGOMODE_ECB, CryptoPrimitiveService=CRYPTO_DECRYPT, CryptoPrimitiveAlgorithmMode=CRYPTO_ALGOMODE_CBC
        AesCmacGenerate: CryptoPrimitiveAlgorithmFamily=CRYPTO_ALGOFAM_AES, CryptoPrimitiveAlgorithmMode=CRYPTO_ALGOMODE_CMAC, CryptoPrimitiveService=CRYPTO_MAC_GENERATE
        AesCmacVerify: CryptoPrimitiveAlgorithmFamily=CRYPTO_ALGOFAM_AES, CryptoPrimitiveAlgorithmMode=CRYPTO_ALGOMODE_CMAC, CryptoPrimitiveService=CRYPTO_MAC_VERIFY
        Random: CryptoPrimitiveAlgorithmFamily=CRYPTO_ALGOFAM_RNG, CryptoPrimitiveAlgorithmMode=CRYPTO_ALGOMODE_NOT_SET, CryptoPrimitiveService=CRYPTO_RANDOM
    CryptoKeyTypes
      10 x CryptoKeyType:
        SheNvmKey: CryptoKeyElementRef=Crypto_30_CryWrapper_SheNvmKey
        SheRamKey: CryptoKeyElementRef=Crypto_30_CryWrapper_SheRamKey
        SheNvmKey_Proof: CryptoKeyElementRef=Crypto_30_CryWrapper_SheNvmKey, CryptoKeyElementRef=Crypto_30_CryWrapper_SheProof
        SheRamKey_IV: CryptoKeyElementRef=Crypto_30_CryWrapper_SheRamKey, CryptoKeyElementRef=Crypto_30_CryWrapper_AesIV
        SheNvmKey_IV: CryptoKeyElementRef=Crypto_30_CryWrapper_SheNvmKey, CryptoKeyElementRef=Crypto_30_CryWrapper_AesIV
        SheNvmKey_Proof_IV: CryptoKeyElementRef=Crypto_30_CryWrapper_SheNvmKey, CryptoKeyElementRef=Crypto_30_CryWrapper_AesIV, CryptoKeyElementRef=Crypto_30_CryWrapper_SheProof
        SheRamKey_Proof: CryptoKeyElementRef=Crypto_30_CryWrapper_SheRamKey, CryptoKeyElementRef=Crypto_30_CryWrapper_SheProof
        SheRamKey_Proof_IV: CryptoKeyElementRef=Crypto_30_CryWrapper_SheRamKey, CryptoKeyElementRef=Crypto_30_CryWrapper_SheProof, CryptoKeyElementRef=Crypto_30_CryWrapper_AesIV
        CryptoKey_IV: CryptoKeyElementRef=Crypto_30_CryWrapper_CryptoKey, CryptoKeyElementRef=Crypto_30_CryWrapper_AesIV
        CryptoKey: CryptoKeyElementRef=Crypto_30_CryWrapper_CryptoKey
    CryptoGeneral
    CryptoKeyElements
      5 x CryptoKeyElement:
        Crypto_30_CryWrapper_SheNvmKey: CryptoKeyElementId=1, CryptoKeyElementAllowPartialAccess=0, CryptoKeyElementPersist=1, CryptoKeyElementReadAccess=RA_DENIED, CryptoKeyElementSize=64, CryptoKeyElementWriteAccess=WA_ENCRYPTED, CryptoKeyElementVirtualTargetRef=Crypto_30_CryWrapper_SheNvmKey
        Crypto_30_CryWrapper_AesIV: CryptoKeyElementId=5, CryptoKeyElementAllowPartialAccess=0, CryptoKeyElementPersist=0, CryptoKeyElementReadAccess=RA_ALLOWED, CryptoKeyElementWriteAccess=WA_ALLOWED, CryptoKeyElementSize=16
        Crypto_30_CryWrapper_SheProof: CryptoKeyElementId=2, CryptoKeyElementReadAccess=RA_ALLOWED, CryptoKeyElementAllowPartialAccess=1, CryptoKeyElementPersist=0, CryptoKeyElementSize=48, CryptoKeyElementWriteAccess=WA_ALLOWED
        Crypto_30_CryWrapper_SheRamKey: CryptoKeyElementId=1, CryptoKeyElementAllowPartialAccess=0, CryptoKeyElementPersist=0, CryptoKeyElementReadAccess=RA_ENCRYPTED, CryptoKeyElementSize=16, CryptoKeyElementWriteAccess=WA_ALLOWED, CryptoKeyElementVirtualTargetRef=Crypto_30_CryWrapper_SheRamKey
        Crypto_30_CryWrapper_CryptoKey: CryptoKeyElementId=1, CryptoKeyElementAllowPartialAccess=1, CryptoKeyElementPersist=0, CryptoKeyElementReadAccess=RA_ENCRYPTED, CryptoKeyElementSize=16, CryptoKeyElementWriteAccess=WA_ALLOWED
    CryptoKeys
      25 x CryptoKey:
        SecretKey: CryptoKeyId=0, CryptoKeyTypeRef=SheNvmKey
        MasterEcuKey: CryptoKeyId=1
        BootMacKey: CryptoKeyId=2
        BootMac: CryptoKeyId=3
        Key_1: CryptoKeyId=4
        Key_2: CryptoKeyId=5
        Key_3: CryptoKeyId=6
        Key_4: CryptoKeyId=7
        Key_5: CryptoKeyId=8
        Key_6: CryptoKeyId=9
        Key_7: CryptoKeyId=10
        Key_8: CryptoKeyId=11
        Key_9: CryptoKeyId=12
        Key_10: CryptoKeyId=13
        Key_11: CryptoKeyId=15
        Key_12: CryptoKeyId=16
        Key_13: CryptoKeyId=17
        Key_14: CryptoKeyId=18
        Key_15: CryptoKeyId=19
        Key_16: CryptoKeyId=20
        Key_17: CryptoKeyId=21
        Key_18: CryptoKeyId=22
        Key_19: CryptoKeyId=23
        Key_20: CryptoKeyId=24
        Key_Ram: CryptoKeyId=14
    CryptoWrapper
  module config Crypto_Rec: definition=Crypto
    CryptoKeyElements
    CryptoKeyTypes
    CryptoDriverObjects
      Crypto_30_CryWrapper (CryptoDriverObject):
        CryptoDriverObjectQueueSize = 1
        CryptoDriverObjectId = 1
        CryptoPrimitiveRef = AesEncrypt
        CryptoPrimitiveRef = AesDecrypt
        CryptoPrimitiveRef = AesCmacGenerate
        CryptoPrimitiveRef = AesCmacVerify
        CryptoPrimitiveRef = Random
    CryptoKeys
      26 x CryptoKey:
        SecretKey: CryptoKeyId=0, CryptoKeyTypeRef=SheNvmKey
        MasterEcuKey: CryptoKeyId=1, CryptoKeyTypeRef=SheNvmKey
        BootMacKey: CryptoKeyId=2, CryptoKeyTypeRef=SheNvmKey
        BootMac: CryptoKeyId=3, CryptoKeyTypeRef=SheNvmKey
        Key_1: CryptoKeyId=4, CryptoKeyTypeRef=SheNvmKey_Proof_IV
        Key_2: CryptoKeyId=5, CryptoKeyTypeRef=SheNvmKey
        Key_3: CryptoKeyId=6, CryptoKeyTypeRef=SheNvmKey
        Key_4: CryptoKeyId=7, CryptoKeyTypeRef=SheNvmKey
        Key_5: CryptoKeyId=8, CryptoKeyTypeRef=SheNvmKey
        Key_6: CryptoKeyId=9, CryptoKeyTypeRef=SheNvmKey
        Key_7: CryptoKeyId=10, CryptoKeyTypeRef=SheNvmKey
        Key_8: CryptoKeyId=11, CryptoKeyTypeRef=SheNvmKey
        Key_9: CryptoKeyId=12, CryptoKeyTypeRef=SheNvmKey
        Key_10: CryptoKeyId=13, CryptoKeyTypeRef=SheNvmKey
        Key_11: CryptoKeyId=15, CryptoKeyTypeRef=SheNvmKey
        Key_12: CryptoKeyId=16, CryptoKeyTypeRef=SheNvmKey
        Key_13: CryptoKeyId=17, CryptoKeyTypeRef=SheNvmKey
        Key_14: CryptoKeyId=18, CryptoKeyTypeRef=SheNvmKey
        Key_15: CryptoKeyId=19, CryptoKeyTypeRef=SheNvmKey
        Key_16: CryptoKeyId=20, CryptoKeyTypeRef=SheNvmKey
        Key_17: CryptoKeyId=21, CryptoKeyTypeRef=SheNvmKey
        Key_18: CryptoKeyId=22, CryptoKeyTypeRef=SheNvmKey
        Key_19: CryptoKeyId=23, CryptoKeyTypeRef=SheNvmKey
        Key_20: CryptoKeyId=24, CryptoKeyTypeRef=SheNvmKey
        Key_Ram: CryptoKeyId=14, CryptoKeyTypeRef=SheRamKey_IV
        CryWrapper_CryptoKey: CryptoKeyId=25, CryptoKeyTypeRef=CryptoKey_IV
