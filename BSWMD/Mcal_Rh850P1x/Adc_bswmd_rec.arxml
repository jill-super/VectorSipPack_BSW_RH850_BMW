AUTOSAR XML (schema 4-0-3)
package /Renesas/EcucDefs_Adc
  module config Adc_Rec: definition=Adc
    AdcGeneral: AdcVersionCheckExternalModules=0
  bsw implementation Adc_Impl: programming-language=C, behavior=AdcBehavior, recommended-configuration=Adc_Rec, vendor-specific-module-def=Adc
