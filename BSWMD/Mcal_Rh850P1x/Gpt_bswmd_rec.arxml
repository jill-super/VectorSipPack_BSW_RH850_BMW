AUTOSAR XML (schema 4-0-3)
package /Renesas/EcucDefs_Gpt
  module config Gpt_Rec: definition=Gpt
    GptDriverConfiguration: GptVersionCheckExternalModules=0
  bsw implementation Gpt_Impl: programming-language=C, behavior=GptBehavior, recommended-configuration=Gpt_Rec, vendor-specific-module-def=Gpt
