AUTOSAR XML (schema 4-0-3)
# COPYRIGHT
# Copyright (c) 2014 by Vector Informatik GmbH. All rights reserved.
# This software is copyright protected and proprietary to Vector Informatik GmbH.
# Vector Informatik GmbH grants to you only those rights as set out in the license conditions.
package /MICROSAR
  module definition Cal [0..1]: category=VENDOR_SPECIFIC_MODULE_DEFINITION, refined-module-def=Cal, variants pre-compile  # Configuration of the CAL (Crypto Abstraction Library) module.
    container CalAsymDecrypt [0..1]  # This container incorporates all asymmetrical decryption primitives.
      integer CalAsymDecryptMaxCtxBufByteSize: 1..4294967295, set at pre-compile  # Max. Context Buffer Size | This is the maximum size over all context buffers used in all CPL primitives, which implement an asymmetrical decryption. Please note that the calling application has to provide the context buffer. So, it has to be ensured that the size of this buffer matches with the configured value here.
      integer CalAsymDecryptMaxKeySize: 1..4294967295, set at pre-compile  # Max. Key Size | This is the maximum size over all key lengths used in all CPL primitives, which implement an asymmetrical decryption. Please note that the calling application has to provide the key buffer. So, it has to be ensured that the size of this buffer matches with the configured value here.
      container CalAsymDecryptConfig [0..32]  # This container holds the configuration of one asymmetrical decryption service. The container name serves as a symbolic name for the identifier of a service configuration. An asymmetrical decryption service accumulates function pointers to the Start, Update and Finish functions and a pointer to the initialization structure of an asymmetrical decryption primitive. Usually, this primitive is provided by the CPL module. Up to 32 different asymmetrical decryption primitives are supported.
        string CalAsymDecryptInitConfiguration: set at pre-compile  # Symbolic Name of Init Configuration Structure | This is the name of the C symbol, which contains the configuration of the underlying cryptographic primitive. Usually, this symbol represents a structure provided by the CPL module.
        string CalAsymDecryptPrimitiveName: set at pre-compile  # Name of Asymmetrical Decryption Primitive | This is the name of the cryptographic primitive to use. This name will be used to form the function pointers to the Start, Update and Finish functions of the corresponding cryptographic primitive according to the following rule: <name>[Start|Update|Finish] Usually these functions are provided by the CPL module.
        string CalAsymDecryptIncludeFile: set at pre-compile, origin=Vector Informatik  # Name of the Cpl header that shall be included for the specific service.
    container CalAsymEncrypt [0..1]  # This container incorporates all asymmetrical encryption primitives.
      integer CalAsymEncryptMaxCtxBufByteSize: 1..4294967295, set at pre-compile  # Max. Context Buffer | This is the maximum size over all context buffers used in all CPL primitives, which implement an asymmetrical encryption. Please note that the calling application has to provide the context buffer. So, it has to be ensured that the size of this buffer matches with the configured value here.
      integer CalAsymEncryptMaxKeySize: 1..4294967295, set at pre-compile  # Max. Key Size | This is the maximum size over all key lengths used in all CPL primitives, which implement an asymmetrical encryption. Please note that the calling application has to provide the key buffer. So, it has to be ensured that the size of this buffer matches with the configured value here.
      container CalAsymEncryptConfig [0..32]  # This container holds the configuration of one asymmetrical encryption service. The container name serves as a symbolic name for the identifier of a service configuration. An asymmetrical encryption service accumulates function pointers to the Start, Update and Finish functions and a pointer to the initialization structure of an asymmetrical encryption primitive. Usually, this primitive is provided by the CPL module. Up to 32 different asymmetrical encryption primitives are supported.
        string CalAsymEncryptInitConfiguration: set at pre-compile  # Symbolic Name of Init Configuration Structure | This is the name of the C symbol, which contains the configuration of the underlying cryptographic primitive. Usually, this symbol represents a structure provided by the CPL module.
        string CalAsymEncryptPrimitiveName: set at pre-compile  # This is the name of the cryptographic primitive to use. This name will be used to form the function pointers to the Start, Update and Finish functions of the corresponding cryptographic primitive according to the following rule: <name>[Start|Update|Finish] Usually these functions are provided by the CPL module.
        string CalAsymEncryptIncludeFile: set at pre-compile, origin=Vector Informatik  # Name of the Cpl header that shall be included for the specific service.
    container CalAsymPrivateKeyExtract [0..1]  # This container comprises all asymmetrical private key extraction primitives.
      integer CalAsymPrivateKeyExtractMaxCtxBufByteSize: 1..4294967295, set at pre-compile  # Max. Key Size | This is the maximum size over all key lengths used in all CPL primitives, which implement an asymmetrical private key extraction. Please note that the calling application has to provide the key buffer. So, it has to be ensured that the size of this buffer matches with the configured value here.
      integer CalAsymPrivateKeyExtractMaxKeySize: 1..4294967295, set at pre-compile  # Max. Context Buffer Size | This is the maximum size over all context buffers used in all CPL primitives, which implement an asymmetrical private key extraction. Please note that the calling application has to provide the context buffer. So, it has to be ensured that the size of this buffer matches with the configured value here.
      container CalAsymPrivateKeyExtractConfig [0..32]  # This container comprises the configuration of one asymmetrical private key extraction service. The container name serves as a symbolic name for the identifier of a service configuration. An asymmetrical private key extraction service accumulates function pointers to the Start, Update and Finish functions and a pointer to the initialization structure of an asymmetrical private key extraction primitive. Usually, this primitive is provided by the CPL module. Up to 32 different asymmetrical private key extraction primitives are supported. | The container name serves as a symbolic name for the identifier of a service configuration.
        string CalAsymPrivateKeyExtractInitConfiguration: set at pre-compile  # Symbolic Name of Init Configuration Structure | This is the name of the C symbol, which contains the configuration of the underlying cryptographic primitive. Usually, this symbol represents a structure provided by the CPL module.
        string CalAsymPrivateKeyExtractPrimitiveName: set at pre-compile  # Name of Asymmetrical Private Key Extraction Primitive | This is the name of the cryptographic primitive to use. This name will be used to form the function pointers to the Start, Update and Finish functions of the corresponding cryptographic primitive according to the following rule: <name>_[Start|Update|Finish] Usually these functions are provided by the CPL module.
        string CalAsymPrivateKeyExtractIncludeFile: set at pre-compile, origin=Vector Informatik  # Name of the Cpl header that shall be included for the specific service.
    container CalAsymPrivateKeyWrapAsym [0..1]  # This container comprises all asymmetrical private key wrapping primitives.
      integer CalAsymPrivateKeyWrapAsymMaxPrivKeySize: 1..4294967295, set at pre-compile  # Max. Private Key Size | This is the maximum size over all private key types used in all CPL primitives, which implement an asymmetrical private key wrapping. Please note that the calling application has to provide the key type buffer. So, it has to be ensured that the size of this buffer matches with the configured value here.
      integer CalAsymPrivateKeyWrapAsymMaxPubKeySize: 1..4294967295, set at pre-compile  # Max. Public Key Size | This is the maximum size over all public key types used in all CPL primitives, which implement an asymmetrical private key wrapping. Please note that the calling application has to provide the key type buffer. So, it has to be ensured that the size of this buffer matches with the configured value here.
      container CalAsymPrivateKeyWrapAsymConfig [0..32]  # This container comprises the configuration of one asymmetrical private key wrapping service. The container name serves as a symbolic name for the identifier of a service configuration. An asymmetrical private key wrapping service accumulates function pointers to the Start, Update and Finish functions and a pointer to the initialization structure of an asymmetrical private key wrapping primitive. Usually, this primitive is provided by the CPL module. Up to 32 different asymmetrical private key wrapping primitives are supported. | The container name serves as a symbolic name for the identifier of a service configuration.
        string CalAsymPrivateKeyWrapAsymInitConfiguration: set at pre-compile  # Symbolic Name of Init Configuration Structure | This is the name of the C symbol, which contains the configuration of the underlying cryptographic primitive. Usually, this symbol represents a structure provided by the CPL module.
        string CalAsymPrivateKeyWrapAsymPrimitiveName: set at pre-compile  # Name of Asymmetrical Private Key Wrapping Primitive | This is the name of the cryptographic primitive to use. This name will be used to form the function pointers to the Start, Update and Finish functions of the corresponding cryptographic primitive according to the following rule: <name>_[Start|Update|Finish] Usually these functions are provided by the CPL module.
        string CalAsymPrivateKeyWrapAsymIncludeFile: set at pre-compile, origin=Vector Informatik  # Name of the Cpl header that shall be included for the specific service.
    container CalAsymPrivateKeyWrapSym [0..1]  # This container comprises all symmetrical private key wrapping primitives.
      integer CalAsymPrivateKeyWrapSymMaxPrivKeySize: 1..4294967295, set at pre-compile  # Max. Private Key Size | This is the maximum size over all private keys used in all CPL primitives, which implement an asymmetrical private key wrapping. Please note that the calling application has to provide the key buffer. So, it has to be ensured that the size of this buffer matches with the configured value here.
      integer CalAsymPrivateKeyWrapSymMaxSymKeySize: 1..4294967295, set at pre-compile  # Max. Symmetrical Key Size | This is the maximum size over all symmetrical key lengths used in all CPL primitives, which implement an asymmetrical private key wrapping. Please note that the calling application has to provide the key buffer. So, it has to be ensured that the size of this buffer matches with the configured value here.
      container CalAsymPrivateKeyWrapSymConfig [0..32]  # This container comprises the configuration of one asymmetrical private key wrapping service. The container name serves as a symbolic name for the identifier of a service configuration. An asymmetrical private key wrapping service accumulates function pointers to the Start, Update and Finish functions and a pointer to the initialization structure of an asymmetrical private key wrapping primitive. Usually, this primitive is provided by the CPL module. Up to 32 different asymmetrical private key wrapping primitives are supported. | The container name serves as a symbolic name for the identifier of a service configuration.
        string CalAsymPrivateKeyWrapSymInitConfiguration: set at pre-compile  # Symbolic Name of Init Configuration Structure | This is the name of the C symbol, which contains the configuration of the underlying cryptographic primitive. Usually, this symbol represents a structure provided by the CPL module.
        string CalAsymPrivateKeyWrapSymPrimitiveName: set at pre-compile  # Name of Asymmetrical Private Key Wrapping Primitive | This is the name of the cryptographic primitive to use. This name will be used to form the function pointers to the Start, Update and Finish functions of the corresponding cryptographic primitive according to the following rule: <name>_[Start|Update|Finish] Usually these functions are provided by the CPL module.
        string CalAsymPrivateKeyWrapSymIncludeFile: set at pre-compile, origin=Vector Informatik  # Name of the Cpl header that shall be included for the specific service.
    container CalAsymPublicKeyExtract [0..1]  # This container comprises all asymmetrical public key extraction primitives.
      integer CalAsymPublicKeyExtractMaxCtxBufByteSize: 1..4294967295, set at pre-compile  # Max. Context Buffer | This is the maximum size over all context buffers used in all CPL primitives, which implement an asymmetrical public key extraction. Please note that the calling application has to provide the context buffer. So, it has to be ensured that the size of this buffer matches with the configured value here.
      integer CalAsymPublicKeyExtractMaxKeySize: 1..4294967295, set at pre-compile  # Max. Key Size | This is the maximum size over all key lengths used in all CPL primitives, which implement an asymmetrical public key extraction. Please note that the calling application has to provide the key buffer. So, it has to be ensured that the size of this buffer matches with the configured value here.
      container CalAsymPublicKeyExtractConfig [0..32]  # This container comprises the configuration of one asymmetrical public key extraction service. The container name serves as a symbolic name for the identifier of a service configuration. An asymmetrical public key extraction service accumulates function pointers to the Start, Update and Finish functions and a pointer to the initialization structure of an asymmetrical public key extraction primitive. Usually, this primitive is provided by the CPL module. Up to 32 different asymmetrical public key extraction primitives are supported. | The container name serves as a symbolic name for the identifier of a service configuration.
        string CalAsymPublicKeyExtractInitConfiguration: set at pre-compile  # Symbolic Name of Init Configuration | This is the name of the C symbol, which contains the configuration of the underlying cryptographic primitive. Usually, this symbol represents a structure provided by the CPL module.
        string CalAsymPublicKeyExtractPrimitiveName: set at pre-compile  # Name of Asymmetrical Public Key Extraction | This is the name of the cryptographic primitive to use. This name will be used to form the function pointers to the Start, Update and Finish functions of the corresponding cryptographic primitive according to the following rule: <name>_[Start|Update|Finish] Usually these functions are provided by the CPL module.
        string CalAsymPublicKeyExtractIncludeFile: set at pre-compile, origin=Vector Informatik  # Name of the Cpl header that shall be included for the specific service.
    container CalChecksum [0..1]  # This container comprises all checksum primitives.
      integer CalChecksumMaxCtxBufByteSize: 1..4294967295, set at pre-compile  # Max. Context Buffer | This is the maximum size over all context buffers used in all CPL primitives, which implement a checksum computation. Please note that the calling application has to provide the context buffer. So, it has to be ensured that the size of this buffer matches with the configured value here.
      container CalChecksumConfig [0..32]  # This container comprises the configuration of one checksum computation service. The container name serves as a symbolic name for the identifier of a service configuration. A checksum computation service accumulates function pointers to the Start, Update and Finish functions and a pointer to the initialization structure of a checksum computation primitive. Usually, this primitive is provided by the CPL module. Up to 32 different checksum computation primitives are supported.
        string CalChecksumInitConfiguration: set at pre-compile  # Symbolic Name of Init Configuration | This is the name of the C symbol, which contains the configuration of the underlying cryptographic primitive. Usually, this symbol represents a structure provided by the CPL module.
        string CalChecksumPrimitiveName: set at pre-compile  # Name of Checksum Primitive | This is the name of the cryptographic primitive to use. This name will be used to form the function pointers to the Start, Update and Finish functions of the corresponding cryptographic primitive according to the following rule: <name>_[Start|Update|Finish] Usually these functions are provided by the CPL module.
        string CalChecksumIncludeFile: set at pre-compile, origin=Vector Informatik  # Name of the Cpl header that shall be included for the specific service.
    container CalGeneral  # Container for common configuration options.
      string CalMaxAlignScalarType: set at pre-compile  # Maximum Alignment | This is the maximum alignment on the given platform. Valid Values: 8, 16, 32 | This type can be e.g. uint8, uint16 or uint32.
      boolean CalVersionInfoApi: set at pre-compile, origin=Vector Informatik, default-value=true  # This parameter enables/disables the function Cal_GetVersionInfo() to get major, minor and patch version information.
      boolean CalDisableNotConfiguredApis: set at pre-compile, origin=Vector Informatik, default-value=true  # If enabled, API functions of not configured services will be disabled in code
    container CalHash [0..1]  # This container comprises all hash primitives.
      integer CalHashMaxCtxBufByteSize: 1..4294967295, set at pre-compile  # Max. Context Buffer Size | This is the maximum size over all context buffers used in all CPL primitives, which implement a hash computation. Please note that the calling application has to provide the context buffer. So, it has to be ensured that the size of this buffer matches with the configured value here.
      container CalHashConfig [0..32]  # This container comprises the configuration of one hash computation service. The container name serves as a symbolic name for the identifier of a service configuration. A hash computation service accumulates function pointers to the Start, Update and Finish functions and a pointer to the initialization structure of a hash primitive. Usually, this primitive is provided by the CPL module. Up to 32 different hash primitives are supported.
        string CalHashInitConfiguration: set at pre-compile  # Symbolic Name of Init Configuration Structure | This is the name of the C symbol, which contains the configuration of the underlying cryptographic primitive. Usually, this symbol represents a structure provided by the CPL module.
        string CalHashPrimitiveName: set at pre-compile  # Name of Hash Primitive | This is the name of the cryptographic primitive to use. This name will be used to form the function pointers to the Start, Update and Finish functions of the corresponding cryptographic primitive according to the following rule: <name>_[Start|Update|Finish] Usually these functions are provided by the CPL module.
        string CalHashIncludeFile: set at pre-compile, origin=Vector Informatik  # Name of the Cpl header that shall be included for the specific service.
        choice reference CalHashCplRef [0..1]: set at pre-compile, origin=Vector Informatik, destination=[CplMD5Config, CplSHAConfig]  # Hash CPL Reference | Reference to the services provided by the CPL. Selecting a reference will populate the configuration fields. Note that the 'Include File' and 'Primitive Name' entries are generated and may have to be corrected.
    container CalKeyDerive [0..1]  # This container comprises all key derivation primitives.
      integer CalKeyDeriveMaxCtxBufByteSize: 1..4294967295, set at pre-compile  # Max. Context Buffer | This is the maximum size over all context buffers used in all CPL primitives, which implement a key derivation. Please note that the calling application has to provide the context buffer. So, it has to be ensured that the size of this buffer matches with the configured value here.
      integer CalKeyDeriveMaxKeySize: 1..4294967295, set at pre-compile  # Max. Key Size | This is the maximum size over all key lengths used in all CPL primitives, which implement a key derivation. Please note that the calling application has to provide the key buffer. So, it has to be ensured that the size of this buffer matches with the configured value here.
      container CalKeyDeriveConfig [0..32]  # This container comprises the configuration of one key derivation service. The container name serves as a symbolic name for the identifier of a service configuration. A key derivation service accumulates function pointers to the Start, Update and Finish functions and a pointer to the initialization structure of a key derivation primitive. Usually, this primitive is provided by the CPL module. Up to 32 different key derivation primitives are supported.
        string CalKeyDeriveInitConfiguration: set at pre-compile  # Symbolic Name of Init Configuration Structure | This is the name of the C symbol, which contains the configuration of the underlying cryptographic primitive. Usually, this symbol represents a structure provided by the CPL module.
        string CalKeyDerivePrimitiveName: set at pre-compile  # Name of Key Derive Primitive | This is the name of the cryptographic primitive to use. This name will be used to form the function pointers to the Start, Update and Finish functions of the corresponding cryptographic primitive according to the following rule: <name>_[Start|Update|Finish] Usually these functions are provided by the CPL module.
        string CalKeyDeriveIncludeFile: set at pre-compile, origin=Vector Informatik  # Name of the Cpl header that shall be included for the specific service.
        choice reference CalKeyDeriveCplRef [0..1]: set at pre-compile, origin=Vector Informatik, destination=CplPBKDF1Config  # Key Derive CPL Reference | Reference to the services provided by the CPL. Selecting a reference will populate the configuration fields. Note that the 'Include File' and 'Primitive Name' entries are generated and may have to be corrected.
    container CalKeyExchangeCalcPubVal [0..1]  # This container comprises all key exchange public value primitives.
      integer CalKeyExchangeCalcPubValMaxBaseTypeSize: 1..4294967295, set at pre-compile  # Max. Base Type Size | This is the maximum size over all base types used in all CPL primitives, which implement a key exchange public value calculation.
      integer CalKeyExchangeCalcPubValMaxCtxBufByteSize: 1..4294967295, set at pre-compile  # Max. Context Buffer Size | This is the maximum size over all context buffers used in all CPL primitives, which implement a key exchange public value calculation. Please note that the calling application has to provide the context buffer. So, it has to be ensured that the size of this buffer matches with the configured value here.
      integer CalKeyExchangeCalcPubValMaxPrivateTypeSize: 1..4294967295, set at pre-compile  # Max. Private Type Size | This is the maximum size over all private information types used in all CPL primitives, which implement a key exchange public value calculation.
      container CalKeyExchangeCalcPubValConfig [0..32]  # This container comprises the configuration of one key exchange public value calculation service. The container name serves as a symbolic name for the identifier of a service configuration. A key exchange public value calculation service accumulates function pointers to the Start, Update and Finish functions and a pointer to the initialization structure of a key exchange public value calculation primitive. Usually, this primitive is provided by the CPL module. Up to 32 different key exchange public value calculation primitives are supported.
        string CalKeyExchangeCalcPubValInitConfiguration: set at pre-compile  # Symbolic Name of Init Configuration Structure | This is the name of the C symbol, which contains the configuration of the underlying cryptographic primitive. Usually, this symbol represents a structure provided by the CPL module.
        string CalKeyExchangeCalcPubValPrimitiveName: set at pre-compile  # Name of Key Exchange Public Value Primitive | This is the name of the cryptographic primitive to use. This name will be used to form the function pointers to the Start, Update and Finish functions of the corresponding cryptographic primitive according to the following rule: <name>_[Start|Update|Finish] Usually these functions are provided by the CPL module.
        string CalKeyExchangeCalcPubValIncludeFile: set at pre-compile, origin=Vector Informatik  # Name of the Cpl header that shall be included for the specific service.
    container CalKeyExchangeCalcSecret [0..1]  # This container comprises all key exchange secret calculation primitives.
      integer CalKeyExchangeCalcSecretMaxBaseTypeSize: 1..4294967295, set at pre-compile  # Max. Base Type Size | This is the maximum size over all base types used in all CPL primitives, which implement a key exchange secret calculation.
      integer CalKeyExchangeCalcSecretMaxCtxBufByteSize: 1..4294967295, set at pre-compile  # Max. Context Buffer Size | This is the maximum size over all context buffers used in all CPL primitives, which implement a key exchange secret calculation. Please note that the calling application has to provide the context buffer. So, it has to be ensured that the size of this buffer matches with the configured value here.
      integer CalKeyExchangeCalcSecretMaxPrivateTypeSize: 1..4294967295, set at pre-compile  # Max. Private Type Size | This is the maximum size over all private types used in all CPL primitives, which implement a key exchange secret calculation.
      container CalKeyExchangeCalcSecretConfig [0..32]  # This container comprises the configuration of one key exchange secret calculation service. The container name serves as a symbolic name for the identifier of a service configuration. A key exchange secret calculation service accumulates function pointers to the Start, Update and Finish functions and a pointer to the initialization structure of a key exchange secret calculation primitive. Usually, this primitive is provided by the CPL module. Up to 32 different key exchange secret calculation primitives are supported.
        string CalKeyExchangeCalcSecretInitConfiguration: set at pre-compile  # Symbolic Name of Init Configuration Structure | This is the name of the C symbol, which contains the configuration of the underlying cryptographic primitive. Usually, this symbol represents a structure provided by the CPL module.
        string CalKeyExchangeCalcSecretPrimitiveName: set at pre-compile  # Name of Key Exchange Secret Calculation Primitive | This is the name of the cryptographic primitive to use. This name will be used to form the function pointers to the Start, Update and Finish functions of the corresponding cryptographic primitive according to the following rule: <name>_[Start|Update|Finish] Usually these functions are provided by the CPL module.
        string CalKeyExchangeCalcSecretIncludeFile: set at pre-compile, origin=Vector Informatik  # Name of the Cpl header that shall be included for the specific service.
        choice reference CalKeyExchangeCalcSecretCplRef [0..1]: set at pre-compile, origin=Vector Informatik, destination=CplDifHellmanCalcSecretConfig  # Key Exchange Calc Secret CPL Reference | Reference to the services provided by the CPL. Selecting a reference will populate the configuration fields. Note that the 'Include File' and 'Primitive Name' entries are generated and may have to be corrected.
    container CalMacGenerate [0..1]  # This container comprises all MAC generation primitives.
      integer CalMacGenerateMaxCtxBufByteSize: 1..4294967295, set at pre-compile  # Max. Context Buffer Size | This is the maximum size over all context buffers used in all CPL primitives, which implement a MAC generation. Please note that the calling application has to provide the context buffer. So, it has to be ensured that the size of this buffer matches with the configured value here.
      integer CalMacGenerateMaxKeySize: 1..4294967295, set at pre-compile  # Max. Key Size | This is the maximum size over all key lengths used in all CPL primitives, which implement a MAC generation. Please note that the calling application has to provide the key buffer. So, it has to be ensured that the size of this buffer matches with the configured value here.
      container CalMacGenerateConfig [0..32]  # This container comprises the configuration of one MAC generation service. The container name serves as a symbolic name for the identifier of a service configuration. A MAC generation service accumulates function pointers to the Start, Update and Finish functions and a pointer to the initialization structure of a MAC generation primitive. Usually, this primitive is provided by the CPL module. Up to 32 different MAC generation primitives are supported.
        string CalMacGenerateInitConfiguration: set at pre-compile  # Symbolic Name of Init Configuration Structure | This is the name of the C symbol, which contains the configuration of the underlying cryptographic primitive. Usually, this symbol represents a structure provided by the CPL module.
        string CalMacGeneratePrimitiveName: set at pre-compile  # Name of MAC Generation Primitive | This is the name of the cryptographic primitive to use. This name will be used to form the function pointers to the Start, Update and Finish functions of the corresponding cryptographic primitive according to the following rule: <name>_[Start|Update|Finish] Usually these functions are provided by the CPL module.
        string CalMacGenerateIncludeFile: set at pre-compile, origin=Vector Informatik  # Name of the Cpl header that shall be included for the specific service.
        choice reference CalMacGenerateCplRef [0..1]: set at pre-compile, origin=Vector Informatik, destination=[CplCBCMacGenerateConfig, CplAesCmacGenerateConfig]  # MAC Generate CPL Reference | Reference to the services provided by the CPL. Selecting a reference will populate the configuration fields. Note that the 'Include File' and 'Primitive Name' entries are generated and may have to be corrected.
    container CalMacVerify [0..1]  # This container comprises all MAC verification primitives.
      integer CalMacVerifyMaxCtxBufByteSize: 1..4294967295, set at pre-compile  # Max. Context Buffer Size | This is the maximum size over all context buffers used in all CPL primitives, which implement a MAC verification. Please note that the calling application has to provide the context buffer. So, it has to be ensured that the size of this buffer matches with the configured value here.
      integer CalMacVerifyMaxKeySize: 1..4294967295, set at pre-compile  # Max. Key Size | This is the maximum size over all key lengths used in all CPL primitives, which implement a MAC verification. Please note that the calling application has to provide the key buffer. So, it has to be ensured that the size of this buffer matches with the configured value here.
      container CalMacVerifyConfig [0..32]  # This container comprises the configuration of one MAC verification service. The container name serves as a symbolic name for the identifier of a service configuration. A MAC verification service accumulates function pointers to the Start, Update and Finish functions and a pointer to the initialization structure of a MAC verification primitive. Usually, this primitive is provided by the CPL module. Up to 32 different MAC verification primitives are supported.
        string CalMacVerifyInitConfiguration: set at pre-compile  # Symbolic Name of Init Configuration Structure | This is the name of the C symbol, which contains the configuration of the underlying cryptographic primitive. Usually, this symbol represents a structure provided by the CPL module.
        string CalMacVerifyPrimitiveName: set at pre-compile  # Name of MAC Verification Primitive | This is the name of the cryptographic primitive to use. This name will be used to form the function pointers to the Start, Update and Finish functions of the corresponding cryptographic primitive according to the following rule: <name>_[Start|Update|Finish] Usually these functions are provided by the CPL module.
        string CalMacVerifyIncludeFile: set at pre-compile, origin=Vector Informatik  # Name of the Cpl header that shall be included for the specific service.
        choice reference CalMacVerifyCplRef [0..1]: set at pre-compile, origin=Vector Informatik, destination=[CplCBCMacVerifyConfig, CplAesCmacVerifyConfig]  # MAC Verify CPL Reference | Reference to the services provided by the CPL. Selecting a reference will populate the configuration fields. Note that the 'Include File' and 'Primitive Name' entries are generated and may have to be corrected.
    container CalRandomGenerate [0..1]  # This container comprises all random generation primitives.
      container CalRandomGenerateConfig [0..32]  # This container comprises the configuration of one random generation service. The container name serves as a symbolic name for the identifier of a service configuration. A random generation service accumulates function pointers to the Start, Update and Finish functions and a pointer to the initialization structure of a random generation primitive. Usually, this primitive is provided by the CPL module. Up to 32 different random generation primitives are supported.
        string CalRandomGenerateInitConfiguration: set at pre-compile  # Symbolic Name of Init Configuration Structure | This is the name of the C symbol, which contains the configuration of the underlying cryptographic primitive. Usually, this symbol represents a structure provided by the CPL module.
        string CalRandomGeneratePrimitiveName: set at pre-compile  # Name of Random Generation Primitive | This is the name of the cryptographic primitive to use. This name will be used to form the function pointers to the Start, Update and Finish functions of the corresponding cryptographic primitive according to the following rule: <name>_[Start|Update|Finish] Usually these functions are provided by the CPL module.
        string CalRandomGenerateIncludeFile: set at pre-compile, origin=Vector Informatik  # Name of the Cpl header that shall be included for the specific service.
        choice reference CalRandomGenerateCplRef [0..1]: set at pre-compile, origin=Vector Informatik, destination=[CplSSGConfig, CplFips186Config, CplAesCtrDrbgConfig]  # Random Generate CPL Reference | Reference to the services provided by the CPL. Selecting a reference will populate the configuration fields. Note that the 'Include File' and 'Primitive Name' entries are generated and may have to be corrected.
    container CalRandomSeed [0..1]  # This container comprises all random number seeding primitives.
      integer CalRandomMaxCtxBufByteSize: 1..4294967295, set at pre-compile  # Max. Context Buffer Size | This is the maximum size over all context buffers used in all CPL primitives, which implement a random number seeding or generation. Please note that the calling application has to provide the context buffer. So, it has to be ensured that the size of this buffer matches with the configured value here.
      container CalRandomSeedConfig [0..32]  # This container comprises the configuration of one random number seeding service. The container name serves as a symbolic name for the identifier of a service configuration. A random number seeding service accumulates function pointers to the Start, Update and Finish functions and a pointer to the initialization structure of a random number seeding primitive. Usually, this primitive is provided by the CPL module. Up to 32 different random number seeding primitives are supported.
        string CalRandomSeedInitConfiguration: set at pre-compile  # Symbolic Name of Init Configuration Structure | This is the name of the C symbol, which contains the configuration of the underlying cryptographic primitive. Usually, this symbol represents a structure provided by the CPL module.
        string CalRandomSeedPrimitiveName: set at pre-compile  # Name of Random Seed Primitive | This is the name of the cryptographic primitive to use. This name will be used to form the function pointers to the Start, Update and Finish functions of the corresponding cryptographic primitive according to the following rule: <name>_[Start|Update|Finish] Usually these functions are provided by the CPL module.
        string CalRandomSeedIncludeFile: set at pre-compile, origin=Vector Informatik  # Name of the Cpl header that shall be included for the specific service.
        choice reference CalRandomSeedCplRef [0..1]: set at pre-compile, origin=Vector Informatik, destination=[CplSSGConfig, CplFips186Config, CplAesCtrDrbgConfig]  # Random Seed CPL Reference | Reference to the services provided by the CPL. Selecting a reference will populate the configuration fields. Note that the 'Include File' and 'Primitive Name' entries are generated and may have to be corrected.
    container CalSignatureGenerate [0..1]  # This container comprises all signature generation primitives.
      integer CalSignatureGenerateMaxCtxBufByteSize: 1..4294967295, set at pre-compile  # Max. Context Buffer Size | This is the maximum size over all context buffers used in all CPL primitives, which implement a signature generation. Please note that the calling application has to provide the context buffer. So, it has to be ensured that the size of this buffer matches with the configured value here.
      integer CalSignatureGenerateMaxKeySize: 1..4294967295, set at pre-compile  # Max. Key Size | This is the maximum size over all key lengths used in all CPL primitives, which implement a signature generation. Please note that the calling application has to provide the key buffer. So, it has to be ensured that the size of this buffer matches with the configured value here.
      container CalSignatureGenerateConfig [0..32]  # This container comprises the configuration of one signature generation service. The container name serves as a symbolic name for the identifier of a service configuration. A signature generation service accumulates function pointers to the Start, Update and Finish functions and a pointer to the initialization structure of a signature generation primitive. Usually, this primitive is provided by the CPL module. Up to 32 different signature generation primitives are supported.
        string CalSignatureGenerateInitConfiguration: set at pre-compile  # Symbolic Name of Init Configuration Structure | This is the name of the C symbol, which contains the configuration of the underlying cryptographic primitive. Usually, this symbol represents a structure provided by the CPL module.
        string CalSignatureGeneratePrimitiveName: set at pre-compile  # Name of Signature Primitive | This is the name of the cryptographic primitive to use. This name will be used to form the function pointers to the Start, Update and Finish functions of the corresponding cryptographic primitive according to the following rule: <name>_[Start|Update|Finish] Usually these functions are provided by the CPL module.
        string CalSignatureGenerateIncludeFile: set at pre-compile, origin=Vector Informatik  # Name of the Cpl header that shall be included for the specific service.
    container CalSignatureVerify [0..1]  # This container comprises all signature verification primitives.
      integer CalSignatureVerifyMaxCtxBufByteSize: 1..4294967295, set at pre-compile  # Max. Context Buffer Size | This is the maximum size over all context buffers used in all CPL primitives, which implement a signature verification. Please note that the calling application has to provide the context buffer. So, it has to be ensured that the size of this buffer matches with the configured value here.
      integer CalSignatureVerifyMaxKeySize: 1..4294967295, set at pre-compile  # Max. Key Size | This is the maximum size over all key lengths used in all CPL primitives, which implement a signature verification. Please note that the calling application has to provide the key buffer. So, it has to be ensured that the size of this buffer matches with the configured value here.
      container CalSignatureVerifyConfig [0..32]  # This container comprises the configuration of one signature verification service. The container name serves as a symbolic name for the identifier of a service configuration. A signature verification service accumulates function pointers to the Start, Update and Finish functions and a pointer to the initialization structure of a signature verification primitive. Usually, this primitive is provided by the CPL module. Up to 32 different signature verification primitives are supported.
        string CalSignatureVerifyInitConfiguration: set at pre-compile  # Symbolic Name of Init Configuration Structure | This is the name of the C symbol, which contains the configuration of the underlying cryptographic primitive. Usually, this symbol represents a structure provided by the CPL module.
        string CalSignatureVerifyPrimitiveName: set at pre-compile  # Name of Signature Verification Primitive | This is the name of the cryptographic primitive to use. This name will be used to form the function pointers to the Start, Update and Finish functions of the corresponding cryptographic primitive according to the following rule: <name>_[Start|Update|Finish] Usually these functions are provided by the CPL module.
        string CalSignatureVerifyIncludeFile: set at pre-compile, origin=Vector Informatik  # Name of the Cpl header that shall be included for the specific service.
        choice reference CalSignatureVerifyCplRef [0..1]: set at pre-compile, origin=Vector Informatik, destination=[CplSigBMWVerifyConfig, CplPKCS1VerifyConfig, CplRsaSha256VerifyConfig]  # Signature Verify CPL Reference | Reference to the services provided by the CPL. Selecting a reference will populate the configuration fields. Note that the 'Include File' and 'Primitive Name' entries are generated and may have to be corrected.
    container CalSymBlockDecrypt [0..1]  # This container comprises all symmetrical block decryption primitives.
      integer CalSymBlockDecryptMaxCtxBufByteSize: 1..4294967295, set at pre-compile  # Max. Context Buffer Size | This is the maximum size over all context buffers used in all CPL primitives, which implement a symmetrical block decryption. Please note that the calling application has to provide the context buffer. So, it has to be ensured that the size of this buffer matches with the configured value here.
      integer CalSymBlockDecryptMaxKeySize: 1..4294967295, set at pre-compile  # Max. Context Buffer Size | This is the maximum size over all key lengths used in all CPL primitives, which implement a symmetrical block decryption. Please note that the calling application has to provide the key buffer. So, it has to be ensured that the size of this buffer matches with the configured value here.
      container CalSymBlockDecryptConfig [0..32]  # This container comprises the configuration of one symmetrical block decryption service. The container name serves as a symbolic name for the identifier of a service configuration. A symmetrical block decryption service accumulates function pointers to the Start, Update and Finish functions and a pointer to the initialization structure of a symmetrical block decryption primitive. Usually, this primitive is provided by the CPL module. Up to 32 different symmetrical block decryption primitives are supported.
        string CalSymBlockDecryptInitConfiguration: set at pre-compile  # Symbolic Name of Init Configuration Structure | This is the name of the C symbol, which contains the configuration of the underlying cryptographic primitive. Usually, this symbol represents a structure provided by the CPL module.
        string CalSymBlockDecryptPrimitiveName: set at pre-compile  # Name of Symmetrical Block Decryption Primitive | This is the name of the cryptographic primitive to use. This name will be used to form the function pointers to the Start, Update and Finish functions of the corresponding cryptographic primitive according to the following rule: <name>_[Start|Update|Finish] Usually these functions are provided by the CPL module.
        string CalSymBlockDecryptIncludeFile: set at pre-compile, origin=Vector Informatik  # Name of the Cpl header that shall be included for the specific service.
        choice reference CalSymBlockDecryptCplRef [0..1]: set at pre-compile, origin=Vector Informatik, destination=[CplAESDecryptConfig, CplDESDecryptConfig]  # SymBlock Decrypt CPL Reference | Reference to the services provided by the CPL. Selecting a reference will populate the configuration fields. Note that the 'Include File' and 'Primitive Name' entries are generated and may have to be corrected.
    container CalSymBlockEncrypt [0..1]  # This container comprises all symmetrical block encryption primitives.
      integer CalSymBlockEncryptMaxCtxBufByteSize: 1..4294967295, set at pre-compile  # Max. Context Buffer Size | This is the maximum size over all context buffers used in all CPL primitives, which implement a symmetrical block encryption. Please note that the calling application has to provide the context buffer. So, it has to be ensured that the size of this buffer matches with the configured value here.
      integer CalSymBlockEncryptMaxKeySize: 1..4294967295, set at pre-compile  # Max. Key Size | This is the maximum size over all key lengths used in all CPL primitives, which implement a symmetrical block encryption. Please note that the calling application has to provide the key buffer. So, it has to be ensured that the size of this buffer matches with the configured value here.
      container CalSymBlockEncryptConfig [0..32]  # This container comprises the configuration of one symmetrical block encryption service. The container name serves as a symbolic name for the identifier of a service configuration. A symmetrical block encryption service accumulates function pointers to the Start, Update and Finish functions and a pointer to the initialization structure of a symmetrical block encryption primitive. Usually, this primitive is provided by the CPL module. Up to 32 different symmetrical block encryption primitives are supported.
        string CalSymBlockEncryptInitConfiguration: set at pre-compile  # Symbolic Name of Init Configuration Structure | This is the name of the C symbol, which contains the configuration of the underlying cryptographic primitive. Usually, this symbol represents a structure provided by the CPL module.
        string CalSymBlockEncryptPrimitiveName: set at pre-compile  # Name of Symmetrical Block Encryption Primitive | This is the name of the cryptographic primitive to use. This name will be used to form the function pointers to the Start, Update and Finish functions of the corresponding cryptographic primitive according to the following rule: <name>_[Start|Update|Finish] Usually these functions are provided by the CPL module.
        string CalSymBlockEncryptIncludeFile: set at pre-compile, origin=Vector Informatik  # Name of the Cpl header that shall be included for the specific service.
        choice reference CalSymBlockEncryptCplRef [0..1]: set at pre-compile, origin=Vector Informatik, destination=[CplDESEncryptConfig, CplAESEncryptConfig]  # SymBlock Encrypt CPL Reference | Reference to the services provided by the CPL. Selecting a reference will populate the configuration fields. Note that the 'Include File' and 'Primitive Name' entries are generated and may have to be corrected.
    container CalSymDecrypt [0..1]  # This container comprises all symmetrical decryption primitives.
      integer CalSymDecryptMaxCtxBufByteSize: 1..4294967295, set at pre-compile  # Max. Context Buffer Size | This is the maximum size over all context buffers used in all CPL primitives, which implement a symmetrical decryption. Please note that the calling application has to provide the context buffer. So, it has to be ensured that the size of this buffer matches with the configured value here.
      integer CalSymDecryptMaxKeySize: 1..4294967295, set at pre-compile  # Max. Key Size | This is the maximum size over all key lengths used in all CPL primitives, which implement a symmetrical decryption. Please note that the calling application has to provide the key buffer. So, it has to be ensured that the size of this buffer matches with the configured value here.
      container CalSymDecryptConfig [0..32]  # This container comprises the configuration of one symmetrical decryption service. The container name serves as a symbolic name for the identifier of a service configuration. A symmetrical decryption service accumulates function pointers to the Start, Update and Finish functions and a pointer to the initialization structure of a symmetrical decryption primitive. Usually, this primitive is provided by the CPL module. Up to 32 different symmetrical decryption primitives are supported. | The container name serves as a symbolic name for the identifier of a service configuration.
        string CalSymDecryptInitConfiguration: set at pre-compile  # Symbolic Name of Init Configuration Structure | This is the name of the C symbol, which contains the configuration of the underlying cryptographic primitive. Usually, this symbol represents a structure provided by the CPL module.
        string CalSymDecryptPrimitiveName: set at pre-compile  # Name of Symmetrical Decryption Primitive | This is the name of the cryptographic primitive to use. This name will be used to form the function pointers to the Start, Update and Finish functions of the corresponding cryptographic primitive according to the following rule: <name>_[Start|Update|Finish] Usually these functions are provided by the CPL module.
        string CalSymDecryptIncludeFile: set at pre-compile, origin=Vector Informatik  # Name of the Cpl header that shall be included for the specific service.
        choice reference CalSymDecryptCplRef [0..1]: set at pre-compile, origin=Vector Informatik, destination=[CplCbcPkcs5DecryptConfig, CplCbcDecWithBlockEncConfig, CplAesDecrypt128Config]  # Sym Decrypt CPL Reference | Reference to the services provided by the CPL. Selecting a reference will populate the configuration fields. Note that the 'Include File' and 'Primitive Name' entries are generated and may have to be corrected.
    container CalSymEncrypt [0..1]  # This container comprises all symmetrical encryption primitives.
      integer CalSymEncryptMaxCtxBufByteSize: 1..4294967295, set at pre-compile  # Max. Context Buffer Size | This is the maximum size over all context buffers used in all CPL primitives, which implement a symmetrical encryption. Please note that the calling application has to provide the context buffer. So, it has to be ensured that the size of this buffer matches with the configured value here.
      integer CalSymEncryptMaxKeySize: 1..4294967295, set at pre-compile  # Max. Key Size | This is the maximum size over all key lengths used in all CPL primitives, which implement a symmetrical encryption. Please note that the calling application has to provide the key buffer. So, it has to be ensured that the size of this buffer matches with the configured value here.
      container CalSymEncryptConfig [0..32]  # This container comprises the configuration of one symmetrical encryption service. The container name serves as a symbolic name for the identifier of a service configuration. A symmetrical encryption service accumulates function pointers to the Start, Update and Finish functions and a pointer to the initialization structure of a symmetrical encryption primitive. Usually, this primitive is provided by the CPL module. Up to 32 different symmetrical encryption primitives are supported.
        string CalSymBlockEncryptInitConfiguration: set at pre-compile  # Symbolic Name of Init Configuration Structure | This is the name of the C symbol, which contains the configuration of the underlying cryptographic primitive. Usually, this symbol represents a structure provided by the CPL module. NOT USED
        string CalSymEncryptPrimitiveName: set at pre-compile  # Name of Symmetrical Encryption Primitive | This is the name of the cryptographic primitive to use. This name will be used to form the function pointers to the Start, Update and Finish functions of the corresponding cryptographic primitive according to the following rule: <name>_[Start|Update|Finish] Usually these functions are provided by the CPL module.
        string CalSymEncryptIncludeFile: set at pre-compile, origin=Vector Informatik  # Name of the Cpl header that shall be included for the specific service.
        string CalSymEncryptInitConfiguration: set at pre-compile, origin=Vector Informatik  # Symbolic Name of Init Configuration Structure | This is the name of the C symbol, which contains the configuration of the underlying cryptographic primitive. Usually, this symbol represents a structure provided by the CPL module.
        choice reference CalSymEncryptCplRef [0..1]: set at pre-compile, origin=Vector Informatik, destination=CplAesEncrypt128Config  # Sym Encrypt CPL Reference | Reference to the services provided by the CPL. Selecting a reference will populate the configuration fields. Note that the 'Include File' and 'Primitive Name' entries are generated and may have to be corrected.
    container CalSymKeyExtract [0..1]  # This container comprises all symmetrical key extraction primitives.
      integer CalSymKeyExtractMaxCtxBufByteSize: 1..4294967295, set at pre-compile  # Max. Context Buffer Size | This is the maximum size over all context buffers used in all CPL primitives, which implement a symmetrical key extraction. Please note that the calling application has to provide the context buffer. So, it has to be ensured that the size of this buffer matches with the configured value here.
      integer CalSymKeyExtractMaxKeySize: 1..4294967295, set at pre-compile  # Max. Key Size | This is the maximum size over all key lengths used in all CPL primitives, which implement a symmetrical key extraction. Please note that the calling application has to provide the key buffer. So, it has to be ensured that the size of this buffer matches with the configured value here.
      container CalSymKeyExtractConfig [0..32]  # This container comprises the configuration of one symmetrical key extraction service. The container name serves as a symbolic name for the identifier of a service configuration. A symmetrical key extraction service accumulates function pointers to the Start, Update and Finish functions and a pointer to the initialization structure of a symmetrical key extraction primitive. Usually, this primitive is provided by the CPL module. Up to 32 different symmetrical key extraction primitives are supported.
        string CalSymKeyExtractInitConfiguration: set at pre-compile  # Symbolic Name of Init Configuration Structure | This is the name of the C symbol, which contains the configuration of the underlying cryptographic primitive. Usually, this symbol represents a structure provided by the CPL module.
        string CalSymKeyExtractPrimitiveName: set at pre-compile  # Name of Symmetrical Key Extraction Primitive | This is the name of the cryptographic primitive to use. This name will be used to form the function pointers to the Start, Update and Finish functions of the corresponding cryptographic primitive according to the following rule: <name>_[Start|Update|Finish] Usually these functions are provided by the CPL module. .
        string CalSymKeyExtractIncludeFile: set at pre-compile, origin=Vector Informatik  # Name of the Cpl header that shall be included for the specific service.
        choice reference CalSymKeyExtractCplRef [0..1]: set at pre-compile, origin=Vector Informatik, destination=CplSymKeyExtractConfig  # Sym Key Extract CPL Reference | Reference to the services provided by the CPL. Selecting a reference will populate the configuration fields. Note that the 'Include File' and 'Primitive Name' entries are generated and may have to be corrected.
    container CalSymKeyWrapAsym [0..1]  # Container for incorporation of SymKeyWrapAsym primitives.
      integer CalSymKeyWrapAsymMaxPubKeySize: 1..4294967295, set at pre-compile  # Max. Public Key Size | This is the maximum size over all public key types used in all CPL primitives, which implement a symmetrical key wrapping. Please note that the calling application has to provide the key type buffer. So, it has to be ensured that the size of this buffer matches with the configured value here.
      integer CalSymKeyWrapAsymMaxSymKeySize: 1..4294967295, set at pre-compile  # Max. Key Size | This is the maximum size over all key types used in all CPL primitives, which implement a symmetrical key wrapping. Please note that the calling application has to provide the key type buffer. So, it has to be ensured that the size of this buffer matches with the configured value here.
      container CalSymKeyWrapAsymConfig [0..32]  # This container comprises the configuration of one symmetrical key wrapping service. The container name serves as a symbolic name for the identifier of a service configuration. A symmetrical key wrapping service accumulates function pointers to the Start, Update and Finish functions and a pointer to the initialization structure of a symmetrical key wrapping primitive. Usually, this primitive is provided by the CPL module. Up to 32 different symmetrical key wrapping primitives are supported. | The container name serves as a symbolic name for the identifier of a service configuration.
        string CalSymKeyWrapAsymInitConfiguration: set at pre-compile  # Symbolic Name of Init Configuration Structure | This is the name of the C symbol, which contains the configuration of the underlying cryptographic primitive. Usually, this symbol represents a structure provided by the CPL module.
        string CalSymKeyWrapAsymPrimitiveName: set at pre-compile  # Name of Symmetrical Key Wrapping Primitive | This is the name of the cryptographic primitive to use. This name will be used to form the function pointers to the Start, Update and Finish functions of the corresponding cryptographic primitive according to the following rule: <name>_[Start|Update|Finish] Usually these functions are provided by the CPL module.
        string CalSymKeyWrapAsymIncludeFile: set at pre-compile, origin=Vector Informatik  # Name of the Cpl header that shall be included for the specific service.
    container CalSymKeyWrapSym [0..1]  # Container for incorporation of SymKeyWrapSym primitives.
      integer CalSymKeyWrapSymMaxSymKeySize: 1..4294967295, set at pre-compile  # Max. Key Size | This is the maximum size over all key types used in all CPL primitives, which implement a symmetrical key wrapping. Please note that the calling application has to provide the key type buffer. So, it has to be ensured that the size of this buffer matches with the configured value here.
      container CalSymKeyWrapSymConfig [0..32]  # This container comprises the configuration of one symmetrical key wrapping service. The container name serves as a symbolic name for the identifier of a service configuration. A symmetrical key wrapping service accumulates function pointers to the Start, Update and Finish functions and a pointer to the initialization structure of a symmetrical key wrapping primitive. Usually, this primitive is provided by the CPL module. Up to 32 different symmetrical key wrapping primitives are supported. | The container name serves as a symbolic name for the identifier of a service configuration.
        string CalSymKeyWrapSymInitConfiguration: set at pre-compile  # Symbolic Name of Init Configuration Structure | This is the name of the C symbol, which contains the configuration of the underlying cryptographic primitive. Usually, this symbol represents a structure provided by the CPL module.
        string CalSymKeyWrapSymPrimitiveName: set at pre-compile  # Name of Symmetrical Key Wrapping Primitive | This is the name of the cryptographic primitive to use. This name will be used to form the function pointers to the Start, Update and Finish functions of the corresponding cryptographic primitive according to the following rule: <name>_[Start|Update|Finish] Usually these functions are provided by the CPL module.
        string CalSymKeyWrapSymIncludeFile: set at pre-compile, origin=Vector Informatik  # Name of the Cpl header that shall be included for the specific service.
  bsw implementation Cal_Impl: programming-language=C, sw-version=2.01.02, used-code-generator=DaVinci Configurator, vendor-id=30, ar-release-version=4.00.03, behavior=CalBehavior, vendor-specific-module-def=Cal
