AUTOSAR XML (schema 4-0-3)
package /MICROSAR
  module config NvM_Rec: definition=NvM
    3 x NvMBlockDescriptor, all with NvMBswMBlockStatusInformation=0, NvMCalcRamBlockCrc=(unset), NvMBlockUseCrc=0, NvMNvBlockNum=(unset), NvMInitBlockCallback=NULL_PTR, NvMBlockManagementType=NVM_BLOCK_NATIVE, NvMBlockJobPriority=127, NvMReadRamBlockFromNvCallback=NULL_PTR, NvMRomBlockNum=(unset), NvMSelectBlockForWriteAll=0, NvMStaticBlockIDCheck=(unset), NvMUseInitCallback=0, NvMUseJobendCallback=1, NvMUseServicePorts=1, NvMBlockUseSyncMechanism=0, NvMWriteBlockOnce=0, NvMBlockWriteProt=0, NvMWriteRamBlockToNvCallback=NULL_PTR:
      BsNvMCertificates: NvMAutomaticBlockLength=(unset), NvMBlockLengthCheck=(unset), NvMBlockLengthCheckType=(unset), NvMBlockCrcType=(unset), NvMMaxNumOfReadRetries=(unset), NvMMaxNumOfWriteRetries=(unset), NvMRamBlockDataAddress=(unset), NvMResistantToChangedSw=1, NvMRomBlockDataAddress=(unset), NvMSelectBlockForReadAll=0, NvMSingleBlockCallback=(unset), NvMWriteVerification=(unset)
      BsNvMSecEcuMode: NvMAutomaticBlockLength=0, NvMBlockLengthCheck=1, NvMBlockLengthCheckType=1, NvMBlockCrcType=NVM_CRC16, NvMMaxNumOfReadRetries=0, NvMMaxNumOfWriteRetries=3, NvMRamBlockDataAddress=&Coding_CodingData, NvMResistantToChangedSw=0, NvMRomBlockDataAddress=&Coding_CodingDataDefault, NvMSelectBlockForReadAll=1, NvMSingleBlockCallback=NULL_PTR, NvMWriteVerification=0
      BsNvMSfaData: NvMAutomaticBlockLength=0, NvMBlockLengthCheck=1, NvMBlockLengthCheckType=1, NvMBlockCrcType=NVM_CRC16, NvMMaxNumOfReadRetries=0, NvMMaxNumOfWriteRetries=3, NvMRamBlockDataAddress=&Coding_CodingData, NvMResistantToChangedSw=0, NvMRomBlockDataAddress=&Coding_CodingDataDefault, NvMSelectBlockForReadAll=1, NvMSingleBlockCallback=NULL_PTR, NvMWriteVerification=0
    NvMCommonVendorParams: NvMCfgCbkIncludeList=Bs_SecEcuMode.h
