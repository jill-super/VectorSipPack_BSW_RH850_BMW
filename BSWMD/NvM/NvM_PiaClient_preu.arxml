AUTOSAR XML (schema 4-0-3)
package /MICROSAR
  module config NvM_Rec: definition=NvM
    NVM_BLOCK_PIA_PROFILE (NvMBlockDescriptor):
      NvMAutomaticBlockLength = 0
      NvMBlockLengthCheck = 0
      NvMBlockLengthCheckType = 1
      NvMBswMBlockStatusInformation = 0
      NvMCalcRamBlockCrc = (unset)
      NvMBlockCrcType = NVM_CRC16
      NvMBlockUseCrc = 0
      NvMNvBlockNum = 5
      NvMInitBlockCallback = NULL_PTR
      NvMBlockManagementType = NVM_BLOCK_DATASET
      NvMMaxNumOfReadRetries = (unset)
      NvMMaxNumOfWriteRetries = (unset)
      NvMBlockJobPriority = 127
      NvMRamBlockDataAddress = NULL_PTR
      NvMReadRamBlockFromNvCallback = NULL_PTR
      NvMResistantToChangedSw = 0
      NvMRomBlockDataAddress = NULL_PTR
      NvMRomBlockNum = (unset)
      NvMSelectBlockForReadAll = 0
      NvMSelectBlockForWriteAll = 0
      NvMSingleBlockCallback = NULL_PTR
      NvMStaticBlockIDCheck = (unset)
      NvMUseInitCallback = 0
      NvMUseJobendCallback = 1
      NvMUseServicePorts = 1
      NvMBlockUseSyncMechanism = 0
      NvMWriteBlockOnce = 0
      NvMBlockWriteProt = 0
      NvMWriteRamBlockToNvCallback = NULL_PTR
      NvMWriteVerification = (unset)
    NVM_BLOCK_CODING_DATA (NvMBlockDescriptor):
      NvMAutomaticBlockLength = 0
      NvMBlockLengthCheck = 1
      NvMBlockLengthCheckType = 1
      NvMBswMBlockStatusInformation = 0
      NvMCalcRamBlockCrc = (unset)
      NvMBlockCrcType = NVM_CRC16
      NvMBlockUseCrc = 0
      NvMNvBlockNum = (unset)
      NvMInitBlockCallback = NULL_PTR
      NvMBlockManagementType = NVM_BLOCK_NATIVE
      NvMMaxNumOfReadRetries = 0
      NvMMaxNumOfWriteRetries = 3
      NvMBlockJobPriority = 127
      NvMRamBlockDataAddress = &Coding_CodingData
      NvMReadRamBlockFromNvCallback = NULL_PTR
      NvMResistantToChangedSw = 0
      NvMRomBlockDataAddress = &Coding_CodingDataDefault
      NvMRomBlockNum = (unset)
      NvMSelectBlockForReadAll = 1
      NvMSelectBlockForWriteAll = 0
      NvMSingleBlockCallback = NULL_PTR
      NvMStaticBlockIDCheck = (unset)
      NvMUseInitCallback = 0
      NvMUseJobendCallback = 1
      NvMUseServicePorts = 1
      NvMBlockUseSyncMechanism = 0
      NvMWriteBlockOnce = 0
      NvMBlockWriteProt = 0
      NvMWriteRamBlockToNvCallback = NULL_PTR
      NvMWriteVerification = 0
    NvMCommonVendorParams: NvMCfgCbkIncludeList=PiaClient_NvM.h
