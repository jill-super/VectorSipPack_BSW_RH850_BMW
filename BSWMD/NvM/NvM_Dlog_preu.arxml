AUTOSAR XML (schema 4-0-3)
package /MICROSAR
  module config NvM_Rec: definition=NvM
    3 x NvMBlockDescriptor, all with NvMAutomaticBlockLength=0, NvMBlockLengthCheckType=1, NvMBswMBlockStatusInformation=0, NvMCalcRamBlockCrc=(unset), NvMBlockUseCrc=0, NvMInitBlockCallback=NULL_PTR, NvMMaxNumOfWriteRetries=(unset), NvMBlockJobPriority=127, NvMReadRamBlockFromNvCallback=NULL_PTR, NvMResistantToChangedSw=0, NvMRomBlockDataAddress=NULL_PTR, NvMRomBlockNum=(unset), NvMSelectBlockForWriteAll=0, NvMSingleBlockCallback=NULL_PTR, NvMStaticBlockIDCheck=(unset), NvMUseServicePorts=1, NvMBlockUseSyncMechanism=0, NvMWriteBlockOnce=0, NvMWriteRamBlockToNvCallback=NULL_PTR:
      NVM_BLOCK_DLOG_SvkEntry: NvMBlockLengthCheck=0, NvMBlockCrcType=NVM_CRC16, NvMNvBlockNum=5, NvMBlockManagementType=NVM_BLOCK_DATASET, NvMMaxNumOfReadRetries=(unset), NvMRamBlockDataAddress=NULL_PTR, NvMSelectBlockForReadAll=0, NvMUseInitCallback=0, NvMUseJobendCallback=1, NvMBlockWriteProt=0, NvMWriteVerification=(unset)
      NVM_BLOCK_BOOT_PROG_DATA: NvMBlockLengthCheck=1, NvMBlockCrcType=NVM_CRC32, NvMBlockManagementType=NVM_BLOCK_NATIVE, NvMMaxNumOfReadRetries=0, NvMRamBlockDataAddress=&Dlog_ProgData, NvMSelectBlockForReadAll=1, NvMUseInitCallback=1, NvMUseJobendCallback=1, NvMBlockWriteProt=1, NvMWriteVerification=0  # Reqirement according to IntegrationManual_Coding.pdf revision 2.1.2 chapter 6.1 NvM
      NVM_BLOCK_BOOT_SVK_HISTORY: NvMBlockLengthCheck=0, NvMBlockCrcType=NVM_CRC16, NvMBlockManagementType=NVM_BLOCK_NATIVE, NvMMaxNumOfReadRetries=(unset), NvMRamBlockDataAddress=(unset), NvMSelectBlockForReadAll=0, NvMUseInitCallback=1, NvMUseJobendCallback=0, NvMBlockWriteProt=1, NvMWriteVerification=(unset)  # Reqirement according to IntegrationManual_Coding.pdf revision 2.1.2 chapter 6.1 NvM
    NvMCommonVendorParams: NvMCfgCbkIncludeList=Dlog_Nvm.h
