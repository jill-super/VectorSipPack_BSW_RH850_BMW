AUTOSAR XML (schema 4-0-3)
package /MICROSAR
  module config NvM_Rec: definition=NvM
    3 x NvMBlockDescriptor, all with NvMAutomaticBlockLength=0, NvMBlockLengthCheck=1, NvMBlockLengthCheckType=1, NvMBswMBlockStatusInformation=0, NvMCalcRamBlockCrc=(unset), NvMBlockCrcType=NVM_CRC16, NvMBlockUseCrc=0, NvMInitBlockCallback=NULL_PTR, NvMBlockManagementType=NVM_BLOCK_NATIVE, NvMMaxNumOfReadRetries=0, NvMMaxNumOfWriteRetries=3, NvMBlockJobPriority=127, NvMRamBlockDataAddress=&Coding_CodingData, NvMReadRamBlockFromNvCallback=NULL_PTR, NvMResistantToChangedSw=0, NvMRomBlockDataAddress=&Coding_CodingDataDefault, NvMRomBlockNum=(unset), NvMSelectBlockForReadAll=1, NvMSelectBlockForWriteAll=0, NvMSingleBlockCallback=NULL_PTR, NvMStaticBlockIDCheck=(unset), NvMUseInitCallback=0, NvMUseJobendCallback=1, NvMUseServicePorts=0, NvMBlockUseSyncMechanism=0, NvMWriteBlockOnce=0, NvMBlockWriteProt=0, NvMWriteRamBlockToNvCallback=NULL_PTR, NvMWriteVerification=0:
      NVM_BLOCK_DCM_ROE  # Reqirement according to IntegrationManual_Coding.pdf revision 2.1.2 chapter 6.1 NvM
      NvM_BLOCK_DARH  # Reqirement according to IntegrationManual_Coding.pdf revision 2.1.2 chapter 6.1 NvM
      NVM_BLOCK_DARH_DiagnoseMasterEnable  # Reqirement according to IntegrationManual_Coding.pdf revision 2.1.2 chapter 6.1 NvM
    NvMCommonVendorParams: NvMCfgCbkIncludeList=Darh_NvM.h
